// *************************************************************************** *
// *                                                                           *
// * Description:         CANDB File                                           *
// * Generated at:        2025-01-24 14:38                                     *
// * System:              SDB22436                                             *
// * Variant:             L946_ADCU9_ZCUD                                      *
// * Network:             ZCU_CANFD2                                           *
// *                                                                           *
// *************************************************************************** *
VERSION "ZCU_CANFD2"

NS_ :

BS_ :

BU_ :  ETC IHU ZCUD ZCUP

BO_ 434 ZCUDZCUCANFD2Fr10 : 64 ZCUD
 SG_ ActtnCtrlActvFlg : 496|1@0+ (1,0) [0|1] "" IHU
 SG_ ActtnCtrlActvFlg_UB : 504|1@0+ (1,0) [0|1] "" IHU
 SG_ AmbIllmnFwdSts_UB : 5|1@0+ (1,0) [0|1] "" IHU
 SG_ AmbIllmnFwdStsAmblillmn1 : 0|9@0+ (1.0,0.0) [0.0|511.0] "Unitless" IHU
 SG_ AmbIllmnFwdStsAmblillmn2 : 23|8@0+ (1.0,0.0) [0.0|255.0] "Unitless" IHU
 SG_ AmbIllmnFwdStsChks : 31|8@0+ (1.0,0.0) [0.0|255.0] "Unitless" IHU
 SG_ AmbIllmnFwdStsCntr : 4|4@0+ (1.0,0.0) [0.0|15.0] "Unitless" IHU
 SG_ BookChrgnStsFb : 63|2@0+ (1,0) [0|3] "" IHU
 SG_ BookChrgnStsFb_UB : 210|1@0+ (1,0) [0|1] "" IHU
 SG_ ClimaPwrAllwd : 58|11@0+ (1.0,0.0) [0.0|2047.0] "W" IHU,ZCUP
 SG_ ClimaPwrAllwd_UB : 209|1@0+ (1,0) [0|1] "" IHU,ZCUP
 SG_ DcDcPwrLim : 323|1@0+ (1,0) [0|1] "" ZCUP
 SG_ DcDcPwrLim_UB : 322|1@0+ (1,0) [0|1] "" ZCUP
 SG_ DispOfPrpsnPwrPercAct : 79|11@0- (0.1,0.0) [-100.0|102.30000000000001] "%" IHU
 SG_ DispOfPrpsnPwrPercAct_UB : 207|1@0+ (1,0) [0|1] "" IHU
 SG_ DispWhlMotSysPrpsnMod : 84|2@0+ (1.0,0.0) [0.0|3.0] "Unitless" IHU
 SG_ DispWhlMotSysPrpsnMod_UB : 206|1@0+ (1,0) [0|1] "" IHU
 SG_ DrvrMassgRunng : 95|1@0+ (1,0) [0|1] "" IHU
 SG_ DrvrMassgRunng_UB : 205|1@0+ (1,0) [0|1] "" IHU
 SG_ DrvrSeatSts : 305|2@0+ (1,0) [0|3] "" IHU,ZCUP
 SG_ DrvrSeatSts_UB : 314|1@0+ (1,0) [0|1] "" IHU,ZCUP
 SG_ EasyLoadModIndcn : 511|3@0+ (1,0) [0|7] "" IHU
 SG_ EasyLoadModIndcn_UB : 508|1@0+ (1,0) [0|1] "" IHU
 SG_ EgyCnsAllwdForClima : 94|7@0+ (1.0,0.0) [0.0|127.0] "Wh" IHU,ZCUP
 SG_ EgyCnsAllwdForClima_UB : 204|1@0+ (1,0) [0|1] "" IHU,ZCUP
 SG_ EmotCooltIndcnReq : 103|1@0+ (1,0) [0|1] "" IHU
 SG_ EmotCooltIndcnReq_UB : 203|1@0+ (1,0) [0|1] "" IHU
 SG_ EngCooltLvl : 223|1@0+ (1,0) [0|1] "" IHU
 SG_ EngCooltLvl_UB : 222|1@0+ (1,0) [0|1] "" IHU
 SG_ ExtrLiStsOfAssistantLi : 503|2@0+ (1,0) [0|3] "" IHU
 SG_ ExtrLiStsOfAssistantLi_UB : 501|1@0+ (1,0) [0|1] "" IHU
 SG_ HvBattSOCE : 495|8@0+ (0.5,0.0) [0.0|100.0] "%" Vector__XXX
 SG_ HvBattSOCE_UB : 456|1@0+ (1,0) [0|1] "" Vector__XXX
 SG_ HybErrIndcnReq_UB : 211|1@0+ (1,0) [0|1] "" IHU
 SG_ HybErrIndcnReqTelltlBattTracCutOff : 215|1@0+ (1,0) [0|1] "" IHU
 SG_ HybErrIndcnReqTelltlBattTracFailr : 214|1@0+ (1,0) [0|1] "" IHU
 SG_ HybErrIndcnReqTelltlElecDrvFailr : 213|1@0+ (1,0) [0|1] "" IHU
 SG_ HybErrIndcnReqTelltlSysHybFailr : 212|1@0+ (1,0) [0|1] "" IHU
 SG_ IndcrOfDeactvtReFog : 500|1@0+ (1,0) [0|1] "" IHU
 SG_ IndcrOfDeactvtReFog_UB : 499|1@0+ (1,0) [0|1] "" IHU
 SG_ IvtrPhaT_UB : 457|1@0+ (1,0) [0|1] "" IHU
 SG_ IvtrPhaT1 : 471|8@0+ (1.0,-40.0) [-40.0|215.0] "degC" IHU
 SG_ IvtrPhaT2 : 479|8@0+ (1.0,-40.0) [-40.0|215.0] "degC" IHU
 SG_ IvtrPhaT3 : 487|8@0+ (1.0,-40.0) [-40.0|215.0] "degC" IHU
 SG_ KeyReadReqFromLockg : 219|4@0+ (1,0) [0|15] "" ETC,IHU
 SG_ KeyReadReqFromLockg_UB : 208|1@0+ (1,0) [0|1] "" ETC,IHU
 SG_ KeyReadStsToLockg_UB : 196|1@0+ (1,0) [0|1] "" ETC,IHU
 SG_ KeyReadStsToLockgBLE_UB : 202|1@0+ (1,0) [0|1] "" ETC,IHU
 SG_ KeyReadStsToLockgBLEKey0 : 255|2@0+ (1,0) [0|3] "" ETC,IHU
 SG_ KeyReadStsToLockgBLEKey1 : 253|2@0+ (1,0) [0|3] "" ETC,IHU
 SG_ KeyReadStsToLockgBLEKey10 : 251|2@0+ (1,0) [0|3] "" ETC,IHU
 SG_ KeyReadStsToLockgBLEKey11 : 249|2@0+ (1,0) [0|3] "" ETC,IHU
 SG_ KeyReadStsToLockgBLEKey12 : 279|2@0+ (1,0) [0|3] "" ETC,IHU
 SG_ KeyReadStsToLockgBLEKey13 : 277|2@0+ (1,0) [0|3] "" ETC,IHU
 SG_ KeyReadStsToLockgBLEKey14 : 275|2@0+ (1,0) [0|3] "" ETC,IHU
 SG_ KeyReadStsToLockgBLEKey15 : 273|2@0+ (1,0) [0|3] "" ETC,IHU
 SG_ KeyReadStsToLockgBLEKey2 : 263|2@0+ (1,0) [0|3] "" ETC,IHU
 SG_ KeyReadStsToLockgBLEKey3 : 261|2@0+ (1,0) [0|3] "" ETC,IHU
 SG_ KeyReadStsToLockgBLEKey4 : 259|2@0+ (1,0) [0|3] "" ETC,IHU
 SG_ KeyReadStsToLockgBLEKey5 : 257|2@0+ (1,0) [0|3] "" ETC,IHU
 SG_ KeyReadStsToLockgBLEKey6 : 271|2@0+ (1,0) [0|3] "" ETC,IHU
 SG_ KeyReadStsToLockgBLEKey7 : 269|2@0+ (1,0) [0|3] "" ETC,IHU
 SG_ KeyReadStsToLockgBLEKey8 : 267|2@0+ (1,0) [0|3] "" ETC,IHU
 SG_ KeyReadStsToLockgBLEKey9 : 265|2@0+ (1,0) [0|3] "" ETC,IHU
 SG_ KeyReadStsToLockgKey0 : 231|2@0+ (1,0) [0|3] "" ETC,IHU
 SG_ KeyReadStsToLockgKey1 : 229|2@0+ (1,0) [0|3] "" ETC,IHU
 SG_ KeyReadStsToLockgKey10 : 227|2@0+ (1,0) [0|3] "" ETC,IHU
 SG_ KeyReadStsToLockgKey11 : 225|2@0+ (1,0) [0|3] "" ETC,IHU
 SG_ KeyReadStsToLockgKey2 : 239|2@0+ (1,0) [0|3] "" ETC,IHU
 SG_ KeyReadStsToLockgKey3 : 237|2@0+ (1,0) [0|3] "" ETC,IHU
 SG_ KeyReadStsToLockgKey4 : 235|2@0+ (1,0) [0|3] "" ETC,IHU
 SG_ KeyReadStsToLockgKey5 : 233|2@0+ (1,0) [0|3] "" ETC,IHU
 SG_ KeyReadStsToLockgKey6 : 247|2@0+ (1,0) [0|3] "" ETC,IHU
 SG_ KeyReadStsToLockgKey7 : 245|2@0+ (1,0) [0|3] "" ETC,IHU
 SG_ KeyReadStsToLockgKey8 : 243|2@0+ (1,0) [0|3] "" ETC,IHU
 SG_ KeyReadStsToLockgKey9 : 241|2@0+ (1,0) [0|3] "" ETC,IHU
 SG_ KeyReadStsToLockgNFC_UB : 201|1@0+ (1,0) [0|1] "" ETC,IHU
 SG_ KeyReadStsToLockgNFCKey0 : 343|2@0+ (1,0) [0|3] "" ETC,IHU
 SG_ KeyReadStsToLockgNFCKey1 : 341|2@0+ (1,0) [0|3] "" ETC,IHU
 SG_ KeyReadStsToLockgNFCKey10 : 339|2@0+ (1,0) [0|3] "" ETC,IHU
 SG_ KeyReadStsToLockgNFCKey11 : 337|2@0+ (1,0) [0|3] "" ETC,IHU
 SG_ KeyReadStsToLockgNFCKey12 : 351|2@0+ (1,0) [0|3] "" ETC,IHU
 SG_ KeyReadStsToLockgNFCKey13 : 349|2@0+ (1,0) [0|3] "" ETC,IHU
 SG_ KeyReadStsToLockgNFCKey14 : 347|2@0+ (1,0) [0|3] "" ETC,IHU
 SG_ KeyReadStsToLockgNFCKey15 : 345|2@0+ (1,0) [0|3] "" ETC,IHU
 SG_ KeyReadStsToLockgNFCKey2 : 359|2@0+ (1,0) [0|3] "" ETC,IHU
 SG_ KeyReadStsToLockgNFCKey3 : 357|2@0+ (1,0) [0|3] "" ETC,IHU
 SG_ KeyReadStsToLockgNFCKey4 : 355|2@0+ (1,0) [0|3] "" ETC,IHU
 SG_ KeyReadStsToLockgNFCKey5 : 353|2@0+ (1,0) [0|3] "" ETC,IHU
 SG_ KeyReadStsToLockgNFCKey6 : 367|2@0+ (1,0) [0|3] "" ETC,IHU
 SG_ KeyReadStsToLockgNFCKey7 : 365|2@0+ (1,0) [0|3] "" ETC,IHU
 SG_ KeyReadStsToLockgNFCKey8 : 363|2@0+ (1,0) [0|3] "" ETC,IHU
 SG_ KeyReadStsToLockgNFCKey9 : 361|2@0+ (1,0) [0|3] "" ETC,IHU
 SG_ MirrTintgCmd : 102|7@0+ (1.0,0.0) [0.0|100.0] "%" IHU,ZCUP
 SG_ MirrTintgCmd_UB : 200|1@0+ (1,0) [0|1] "" IHU,ZCUP
 SG_ OnBdChrgrSt : 110|4@0+ (1,0) [0|15] "" ZCUP
 SG_ OnBdChrgrSt_UB : 199|1@0+ (1,0) [0|1] "" ZCUP
 SG_ PasAlrmSts : 325|1@0+ (1,0) [0|1] "" IHU
 SG_ PasAlrmSts_UB : 324|1@0+ (1,0) [0|1] "" IHU
 SG_ PhoneForgottenRmn : 104|1@0+ (1,0) [0|1] "" IHU
 SG_ PhoneForgottenRmn_UB : 197|1@0+ (1,0) [0|1] "" IHU
 SG_ PrpsnDistbnOfBOA : 119|2@0+ (1,0) [0|3] "" IHU
 SG_ PrpsnDistbnOfBOA_UB : 177|1@0+ (1,0) [0|1] "" IHU
 SG_ RainLi : 131|1@0+ (1,0) [0|1] "" IHU
 SG_ RainLi_UB : 130|1@0+ (1,0) [0|1] "" IHU
 SG_ ReadLiSts_UB : 176|1@0+ (1,0) [0|1] "" IHU
 SG_ ReadLiStsFirstRowLe : 183|1@0+ (1,0) [0|1] "" IHU
 SG_ ReadLiStsFirstRowRi : 182|1@0+ (1,0) [0|1] "" IHU
 SG_ ReadLiStsSecondRowLe : 181|1@0+ (1,0) [0|1] "" IHU
 SG_ ReadLiStsSecondRowRi : 180|1@0+ (1,0) [0|1] "" IHU
 SG_ ReadLiStsThirdRowLe : 179|1@0+ (1,0) [0|1] "" IHU
 SG_ ReadLiStsThirdRowRi : 178|1@0+ (1,0) [0|1] "" IHU
 SG_ ReFogActvdbyRain : 498|1@0+ (1,0) [0|1] "" IHU
 SG_ ReFogActvdbyRain_UB : 497|1@0+ (1,0) [0|1] "" IHU
 SG_ ReWiprRotyCmd : 221|2@0+ (1,0) [0|3] "" IHU
 SG_ ReWiprRotyCmd_UB : 7|1@0+ (1,0) [0|1] "" IHU
 SG_ RFKApproachReqAndKeyId_UB : 111|1@0+ (1,0) [0|1] "" ETC,IHU
 SG_ RFKApproachReqAndKeyIdKeyId1 : 175|4@0+ (1,0) [0|15] "" ETC,IHU
 SG_ RFKApproachReqAndKeyIdRFKApproachReq : 171|4@0+ (1,0) [0|15] "" ETC,IHU
 SG_ RlyPwrDistbnCmd1WdPreBattSaveCmd : 297|1@0+ (1,0) [0|1] "" IHU,ZCUP
 SG_ RlyPwrDistbnCmd1WdPreBattSaveCmd_UB : 296|1@0+ (1,0) [0|1] "" IHU,ZCUP
 SG_ RmnLockgPrsnlReq : 106|1@0+ (1,0) [0|1] "" IHU
 SG_ RmnLockgPrsnlReq_UB : 105|1@0+ (1,0) [0|1] "" IHU
 SG_ SeatHeatgAvlStsRowSecLe : 61|3@0+ (1,0) [0|7] "" IHU,ZCUP
 SG_ SeatHeatgAvlStsRowSecLe_UB : 332|1@0+ (1,0) [0|1] "" IHU,ZCUP
 SG_ SeatHeatgAvlStsRowSecRi : 82|3@0+ (1,0) [0|7] "" IHU,ZCUP
 SG_ SeatHeatgAvlStsRowSecRi_UB : 333|1@0+ (1,0) [0|1] "" IHU,ZCUP
 SG_ SeatHeatgAvlStsRowThrdLe : 117|3@0+ (1,0) [0|7] "" IHU,ZCUP
 SG_ SeatHeatgAvlStsRowThrdLe_UB : 334|1@0+ (1,0) [0|1] "" IHU,ZCUP
 SG_ SeatHeatgAvlStsRowThrdRi : 114|3@0+ (1,0) [0|7] "" IHU,ZCUP
 SG_ SeatHeatgAvlStsRowThrdRi_UB : 335|1@0+ (1,0) [0|1] "" IHU,ZCUP
 SG_ SeatVentAvlStsRowSecLe : 303|3@0+ (1,0) [0|7] "" IHU,ZCUP
 SG_ SeatVentAvlStsRowSecLe_UB : 326|1@0+ (1,0) [0|1] "" IHU,ZCUP
 SG_ SeatVentAvlStsRowSecRi : 300|3@0+ (1,0) [0|7] "" IHU,ZCUP
 SG_ SeatVentAvlStsRowSecRi_UB : 327|1@0+ (1,0) [0|1] "" IHU,ZCUP
 SG_ SeatVentnAvlStsRowThrdLe : 311|3@0+ (1,0) [0|7] "" IHU,ZCUP
 SG_ SeatVentnAvlStsRowThrdLe_UB : 312|1@0+ (1,0) [0|1] "" IHU,ZCUP
 SG_ SeatVentnAvlStsRowThrdRi : 308|3@0+ (1,0) [0|7] "" IHU,ZCUP
 SG_ SeatVentnAvlStsRowThrdRi_UB : 313|1@0+ (1,0) [0|1] "" IHU,ZCUP
 SG_ ShortDropWinDrvrDoor2 : 317|2@0+ (1,0) [0|3] "" IHU
 SG_ ShortDropWinDrvrDoor2_UB : 315|1@0+ (1,0) [0|1] "" IHU
 SG_ SteerLockEnagOfPrpsnNotSafe : 459|2@0+ (1,0) [0|3] "" IHU
 SG_ SteerLockEnagOfPrpsnNotSafe_UB : 460|1@0+ (1,0) [0|1] "" IHU
 SG_ SteerLockReqNotSafe_UB : 461|1@0+ (1,0) [0|1] "" IHU
 SG_ SteerLockReqNotSafeCommand : 463|2@0+ (1,0) [0|3] "" IHU
 SG_ SteerLockReqNotSafeSteerLockDataReq0 : 407|8@0+ (1.0,0.0) [0.0|255.0] "Unitless" IHU
 SG_ SteerLockReqNotSafeSteerLockDataReq1 : 415|8@0+ (1.0,0.0) [0.0|255.0] "Unitless" IHU
 SG_ SteerLockReqNotSafeSteerLockDataReq2 : 423|8@0+ (1.0,0.0) [0.0|255.0] "Unitless" IHU
 SG_ SteerLockReqNotSafeSteerLockDataReq3 : 431|8@0+ (1.0,0.0) [0.0|255.0] "Unitless" IHU
 SG_ SteerLockReqNotSafeSteerLockDataReq4 : 439|8@0+ (1.0,0.0) [0.0|255.0] "Unitless" IHU
 SG_ SteerLockReqNotSafeSteerLockDataReq5 : 447|8@0+ (1.0,0.0) [0.0|255.0] "Unitless" IHU
 SG_ SteerLockReqNotSafeSteerLockDataReq6 : 455|8@0+ (1.0,0.0) [0.0|255.0] "Unitless" IHU
 SG_ StopStrtInhb : 151|24@0+ (1.0,0.0) [0.0|16777215.0] "Unitless" IHU
 SG_ StopStrtInhb_UB : 184|1@0+ (1,0) [0|1] "" IHU
 SG_ SwtAhbcReq : 51|1@0+ (1,0) [0|1] "" IHU
 SG_ SwtAhbcReq_UB : 50|1@0+ (1,0) [0|1] "" IHU
 SG_ SwtIntmIntlCmd : 55|3@0+ (1,0) [0|7] "" IHU
 SG_ SwtIntmIntlCmd_UB : 52|1@0+ (1,0) [0|1] "" IHU
 SG_ SysShutDwnFlg : 49|1@0+ (1,0) [0|1] "" IHU
 SG_ SysShutDwnFlg_UB : 48|1@0+ (1,0) [0|1] "" IHU
 SG_ TankFlapReqFromSwtIntr : 319|1@0+ (1,0) [0|1] "" IHU
 SG_ TankFlapReqFromSwtIntr_UB : 318|1@0+ (1,0) [0|1] "" IHU
 SG_ TCSDoorNoClsSts : 137|1@0+ (1,0) [0|1] "" IHU
 SG_ TCSDoorNoClsSts_UB : 136|1@0+ (1,0) [0|1] "" IHU
 SG_ TrApprchOpenFbToExtLi : 135|3@0+ (1,0) [0|7] "" IHU
 SG_ TrApprchOpenFbToExtLi_UB : 132|1@0+ (1,0) [0|1] "" IHU
 SG_ TrNoKeyPrsntAcoustReq : 127|1@0+ (1,0) [0|1] "" IHU
 SG_ TrNoKeyPrsntAcoustReq_UB : 126|1@0+ (1,0) [0|1] "" IHU
 SG_ TrPosnUpprProgmReq : 125|1@0+ (1,0) [0|1] "" IHU
 SG_ TrPosnUpprProgmReq_UB : 124|1@0+ (1,0) [0|1] "" IHU
 SG_ TrRelsReqNotSafe : 123|1@0+ (1,0) [0|1] "" IHU
 SG_ TrRelsReqNotSafe_UB : 122|1@0+ (1,0) [0|1] "" IHU
 SG_ TrReqFromSwtIntr : 121|1@0+ (1,0) [0|1] "" IHU
 SG_ TrReqFromSwtIntr_UB : 120|1@0+ (1,0) [0|1] "" IHU
 SG_ TrsmParkAutRdy : 395|1@0+ (1,0) [0|1] "" IHU
 SG_ TrsmParkAutRdy_UB : 394|1@0+ (1,0) [0|1] "" IHU
 SG_ UsgModChgReqFromRFK : 393|1@0+ (1,0) [0|1] "" IHU
 SG_ UsgModChgReqFromRFK_UB : 392|1@0+ (1,0) [0|1] "" IHU
 SG_ UWBApproachTailgateReq_UB : 40|1@0+ (1,0) [0|1] "" IHU
 SG_ UWBApproachTailgateReqKeyId3 : 47|4@0+ (1,0) [0|15] "" IHU
 SG_ UWBApproachTailgateReqUWBApproachTailgateReq : 43|3@0+ (1,0) [0|7] "" IHU
 SG_ VehEgyCoornActvtMsg : 195|3@0+ (1,0) [0|7] "" IHU
 SG_ VehEgyCoornActvtMsg_UB : 198|1@0+ (1,0) [0|1] "" IHU
 SG_ VehEgyCoornEnvtlProtnIndcr : 331|4@0+ (1,0) [0|15] "" IHU
 SG_ VehEgyCoornEnvtlProtnIndcr_UB : 186|1@0+ (1,0) [0|1] "" IHU
 SG_ VehEgyCoornFctStChg : 33|2@0+ (1,0) [0|3] "" IHU
 SG_ VehEgyCoornFctStChg_UB : 34|1@0+ (1,0) [0|1] "" IHU
 SG_ WasRespLevel : 507|2@0+ (1,0) [0|3] "" ZCUP
 SG_ WasRespLevel_UB : 505|1@0+ (1,0) [0|1] "" ZCUP

BO_ 544 ZCUDZCUCANFD2Fr11 : 64 ZCUD
 SG_ BattLoStsFild : 20|1@0+ (1,0) [0|1] "" IHU
 SG_ BattLoStsFild_UB : 170|1@0+ (1,0) [0|1] "" IHU
 SG_ BtnLockSts : 19|1@0+ (1,0) [0|1] "" IHU
 SG_ BtnLockSts_UB : 169|1@0+ (1,0) [0|1] "" IHU
 SG_ ChrgStrtEngRes : 15|4@0+ (1,0) [0|15] "" IHU
 SG_ ChrgStrtEngRes_UB : 168|1@0+ (1,0) [0|1] "" IHU
 SG_ ClimRlyCmd : 18|1@0+ (1,0) [0|1] "" IHU,ZCUP
 SG_ ClimRlyCmd_UB : 167|1@0+ (1,0) [0|1] "" IHU,ZCUP
 SG_ CmptmtCoolgSts : 11|4@0+ (1,0) [0|15] "" ZCUP
 SG_ CmptmtCoolgSts_UB : 166|1@0+ (1,0) [0|1] "" ZCUP
 SG_ DrvrSeatHeatgAvlSts : 23|3@0+ (1,0) [0|7] "" IHU,ZCUP
 SG_ DrvrSeatHeatgAvlSts_UB : 164|1@0+ (1,0) [0|1] "" IHU,ZCUP
 SG_ DrvrSeatVentnLvlSts : 28|2@0+ (1,0) [0|3] "" IHU,ZCUP
 SG_ DrvrSeatVentnLvlSts_UB : 161|1@0+ (1,0) [0|1] "" IHU,ZCUP
 SG_ FuLeakDetdActv : 39|2@0+ (1,0) [0|3] "" IHU
 SG_ FuLeakDetdActv_UB : 159|1@0+ (1,0) [0|1] "" IHU
 SG_ HvHeatrPwrCns : 33|10@0+ (20.0,0.0) [0.0|20460.0] "W" IHU,ZCUP
 SG_ HvHeatrPwrCns_UB : 154|1@0+ (1,0) [0|1] "" IHU,ZCUP
 SG_ KeyIntrVldDetd : 172|1@0+ (1,0) [0|1] "" IHU
 SG_ KeyIntrVldDetd_UB : 171|1@0+ (1,0) [0|1] "" IHU
 SG_ KeyReadStsToVoiceCtrl : 175|2@0+ (1,0) [0|3] "" IHU
 SG_ KeyReadStsToVoiceCtrl_UB : 165|1@0+ (1,0) [0|1] "" IHU
 SG_ LeSolarData : 71|8@0+ (5.0,0.0) [0.0|1275.0] "W/m2" IHU,ZCUP
 SG_ LeSolarData_UB : 153|1@0+ (1,0) [0|1] "" IHU,ZCUP
 SG_ LiBattInPWLockTC : 26|1@0+ (1,0) [0|1] "" IHU
 SG_ LiBattInPWLockTC_UB : 25|1@0+ (1,0) [0|1] "" IHU
 SG_ NotifForEmgyCall : 56|1@0+ (1,0) [0|1] "" IHU
 SG_ NotifForEmgyCall_UB : 152|1@0+ (1,0) [0|1] "" IHU
 SG_ PwrAvlDelta : 87|16@0- (1.0,0.0) [-32768.0|32767.0] "W" IHU,ZCUP
 SG_ PwrAvlDelta_UB : 150|1@0+ (1,0) [0|1] "" IHU,ZCUP
 SG_ PwrOutSetFBMsg : 111|2@0+ (1,0) [0|3] "" IHU
 SG_ PwrOutSetFBMsg_UB : 109|1@0+ (1,0) [0|1] "" IHU
 SG_ RelHumSnsrRelHum : 183|8@0+ (0.5,0.0) [0.0|100.0] "%" IHU
 SG_ RelHumSnsrRelHum_UB : 173|1@0+ (1,0) [0|1] "" IHU
 SG_ RemChrgStrtReq : 17|1@0+ (1,0) [0|1] "" IHU
 SG_ RemChrgStrtReq_UB : 16|1@0+ (1,0) [0|1] "" IHU
 SG_ RiSolarData : 103|8@0+ (5.0,0.0) [0.0|1275.0] "W/m2" IHU,ZCUP
 SG_ RiSolarData_UB : 149|1@0+ (1,0) [0|1] "" IHU,ZCUP
 SG_ RlyCmdCmft : 75|1@0+ (1,0) [0|1] "" IHU,ZCUP
 SG_ RlyCmdCmft_UB : 148|1@0+ (1,0) [0|1] "" IHU,ZCUP
 SG_ RlyPwrDistbnCmd1WdIgnRlyCmd : 74|1@0+ (1,0) [0|1] "" IHU
 SG_ RlyPwrDistbnCmd1WdIgnRlyCmd_UB : 147|1@0+ (1,0) [0|1] "" IHU
 SG_ SolarSnsrVluQf : 73|1@0+ (1,0) [0|1] "" IHU,ZCUP
 SG_ SolarSnsrVluQf_UB : 146|1@0+ (1,0) [0|1] "" IHU,ZCUP
 SG_ SunCurtMvngSts : 72|1@0+ (1,0) [0|1] "" IHU
 SG_ SunCurtMvngSts_UB : 145|1@0+ (1,0) [0|1] "" IHU
 SG_ SunRoofAndCurtFailr_UB : 144|1@0+ (1,0) [0|1] "" IHU
 SG_ SunRoofAndCurtFailrCurtMotFailr : 119|1@0+ (1,0) [0|1] "" IHU
 SG_ SunRoofAndCurtFailrCurtMotHallFailr : 118|1@0+ (1,0) [0|1] "" IHU
 SG_ SunRoofAndCurtFailrCurtMotNotAvl : 117|1@0+ (1,0) [0|1] "" IHU
 SG_ SunRoofAndCurtFailrEcuFailrGen : 116|1@0+ (1,0) [0|1] "" IHU
 SG_ SunRoofAndCurtFailrPanMotFailr : 115|1@0+ (1,0) [0|1] "" IHU
 SG_ SunRoofAndCurtFailrPanMotHallFailr : 114|1@0+ (1,0) [0|1] "" IHU
 SG_ SunRoofAndCurtFailrPanMotNotAvl : 113|1@0+ (1,0) [0|1] "" IHU
 SG_ SunRoofAndCurtFailrResvd : 112|1@0+ (1,0) [0|1] "" IHU
 SG_ TankFlapSts : 105|2@0+ (1,0) [0|3] "" IHU
 SG_ TankFlapSts_UB : 139|1@0+ (1,0) [0|1] "" IHU
 SG_ TrlrLampActvtChk : 37|1@0+ (1,0) [0|1] "" IHU
 SG_ TrlrLampActvtChk_UB : 36|1@0+ (1,0) [0|1] "" IHU
 SG_ TrlrLampChkSts : 7|3@0+ (1,0) [0|7] "" IHU
 SG_ TrlrLampChkSts_UB : 4|1@0+ (1,0) [0|1] "" IHU
 SG_ TrlrLiFltSts : 3|3@0+ (1,0) [0|7] "" IHU
 SG_ TrlrLiFltSts_UB : 0|1@0+ (1,0) [0|1] "" IHU
 SG_ TrlrSrvReq : 35|1@0+ (1,0) [0|1] "" IHU
 SG_ TrlrSrvReq_UB : 34|1@0+ (1,0) [0|1] "" IHU
 SG_ VMMtoHMIFB_UB : 24|1@0+ (1,0) [0|1] "" IHU
 SG_ VMMtoHMIFBSwitch1 : 55|1@0+ (1,0) [0|1] "" IHU
 SG_ VMMtoHMIFBSwitch2 : 54|1@0+ (1,0) [0|1] "" IHU
 SG_ VMMtoHMIFBSwitch3 : 53|1@0+ (1,0) [0|1] "" IHU
 SG_ VMMtoHMIFBSwitch4 : 52|1@0+ (1,0) [0|1] "" IHU
 SG_ VMMtoHMIFBSwitch5 : 51|1@0+ (1,0) [0|1] "" IHU
 SG_ VMMtoHMIFBSwitch6 : 50|1@0+ (1,0) [0|1] "" IHU
 SG_ VMMtoHMIFBSwitch7 : 49|1@0+ (1,0) [0|1] "" IHU
 SG_ VMMtoHMIFBSwitch8 : 48|1@0+ (1,0) [0|1] "" IHU
 SG_ VMMtoHMIMsg : 79|4@0+ (1,0) [0|15] "" IHU
 SG_ VMMtoHMIMsg_UB : 57|1@0+ (1,0) [0|1] "" IHU
 SG_ VMMToHmiSet_UB : 160|1@0+ (1,0) [0|1] "" IHU
 SG_ VMMToHmiSetSetting1 : 191|3@0+ (1,0) [0|7] "" IHU
 SG_ VMMToHmiSetSetting2 : 188|3@0+ (1,0) [0|7] "" IHU
 SG_ VMMToHmiSetSetting3 : 199|3@0+ (1,0) [0|7] "" IHU
 SG_ VMMToHmiSetSetting4 : 196|3@0+ (1,0) [0|7] "" IHU
 SG_ VMMToHmiSetSetting5 : 207|3@0+ (1,0) [0|7] "" IHU
 SG_ VMMToHmiSetSetting6 : 204|3@0+ (1,0) [0|7] "" IHU
 SG_ VMMToHmiSetSetting7 : 215|3@0+ (1,0) [0|7] "" IHU
 SG_ VMMToHmiSetSetting8 : 212|3@0+ (1,0) [0|7] "" IHU
 SG_ WirelsChrgnPhonePwrPerc : 127|14@0+ (0.01,0.0) [0.0|100.0] "%" IHU
 SG_ WirelsChrgnPhonePwrPerc_UB : 138|1@0+ (1,0) [0|1] "" IHU
 SG_ WPCModuleSts : 143|4@0+ (1,0) [0|15] "" IHU,ZCUP
 SG_ WPCModuleSts_UB : 137|1@0+ (1,0) [0|1] "" IHU,ZCUP
 SG_ WtrPmpAuxSts : 129|2@0+ (1,0) [0|3] "" IHU,ZCUP
 SG_ WtrPmpAuxSts_UB : 136|1@0+ (1,0) [0|1] "" IHU,ZCUP

BO_ 565 ZCUDZCUCANFD2Fr12 : 64 ZCUD
 SG_ ActvnOfTrCmptmtLi : 463|8@0+ (1.0,0.0) [0.0|100.0] "%" IHU
 SG_ ActvnOfTrCmptmtLi_UB : 87|1@0+ (1,0) [0|1] "" IHU
 SG_ BrkSysWarnIndcnReqSec : 74|1@0+ (1,0) [0|1] "" IHU
 SG_ BrkSysWarnIndcnReqSec_UB : 75|1@0+ (1,0) [0|1] "" IHU
 SG_ CarLoctrActvnSts : 7|2@0+ (1,0) [0|3] "" IHU
 SG_ CarLoctrActvnSts_UB : 107|1@0+ (1,0) [0|1] "" IHU
 SG_ CcvmSts_UB : 297|1@0+ (1,0) [0|1] "" IHU
 SG_ CcvmStsVlvBlkFlt : 319|1@0+ (1,0) [0|1] "" IHU
 SG_ CcvmStsVlvCalibSts : 318|2@0+ (1,0) [0|3] "" IHU
 SG_ CcvmStsVlvCmdPosnErr : 316|1@0+ (1,0) [0|1] "" IHU
 SG_ CcvmStsVlvLoTErr : 315|1@0+ (1,0) [0|1] "" IHU
 SG_ CcvmStsVlvMoveSts : 314|1@0+ (1,0) [0|1] "" IHU
 SG_ CcvmStsVlvNVMFlt : 313|1@0+ (1,0) [0|1] "" IHU
 SG_ CcvmStsVlvOpenCircFlt : 312|1@0+ (1,0) [0|1] "" IHU
 SG_ CcvmStsVlvOverTErr : 327|1@0+ (1,0) [0|1] "" IHU
 SG_ CcvmStsVlvOverTrvlFlt : 326|1@0+ (1,0) [0|1] "" IHU
 SG_ CcvmStsVlvOverTWarn : 325|1@0+ (1,0) [0|1] "" IHU
 SG_ CcvmStsVlvOverUErr : 324|1@0+ (1,0) [0|1] "" IHU
 SG_ CcvmStsVlvPosn : 321|10@0+ (0.1,0.0) [0.0|100.0] "%" IHU
 SG_ CcvmStsVlvPosnCtrlTimeOutFlt : 322|1@0+ (1,0) [0|1] "" IHU
 SG_ CcvmStsVlvPosnUkwnFlt : 323|1@0+ (1,0) [0|1] "" IHU
 SG_ CcvmStsVlvPreHeatgSts : 343|1@0+ (1,0) [0|1] "" IHU
 SG_ CcvmStsVlvSelfLearnFlt : 342|1@0+ (1,0) [0|1] "" IHU
 SG_ CcvmStsVlvShoCircFlt : 341|1@0+ (1,0) [0|1] "" IHU
 SG_ CcvmStsVlvSpdLvlSts : 340|2@0+ (1,0) [0|3] "" IHU
 SG_ CcvmStsVlvUnderUErr : 338|1@0+ (1,0) [0|1] "" IHU
 SG_ CcvVlvSts_UB : 352|1@0+ (1,0) [0|1] "" IHU
 SG_ CcvVlvSts2PosSts : 337|10@0+ (0.26367188,-45.0) [-45.0|224.73633324000002] "Unitless" IHU
 SG_ CcvVlvSts2PosSts_UB : 296|1@0+ (1,0) [0|1] "" IHU
 SG_ CcvVlvStsARC : 359|2@0+ (1.0,0.0) [0.0|3.0] "Unitless" IHU
 SG_ CcvVlvStsIntFlt : 357|1@0+ (1,0) [0|1] "" IHU
 SG_ CcvVlvStsOprFlt : 356|1@0+ (1,0) [0|1] "" IHU
 SG_ CcvVlvStsTrqSts : 355|3@0+ (1,0) [0|7] "" IHU
 SG_ ChdLockRightFailStsToHmi : 5|2@0+ (1,0) [0|3] "" IHU
 SG_ ChdLockRightFailStsToHmi_UB : 106|1@0+ (1,0) [0|1] "" IHU
 SG_ ChdPrtnLeftFailStsToHmi : 3|2@0+ (1,0) [0|3] "" IHU
 SG_ ChdPrtnLeftFailStsToHmi_UB : 105|1@0+ (1,0) [0|1] "" IHU
 SG_ ChrgLidAcSts : 69|2@0+ (1,0) [0|3] "" Vector__XXX
 SG_ ChrgLidAcSts_UB : 85|1@0+ (1,0) [0|1] "" Vector__XXX
 SG_ ChrgLidDCorAcDcSts : 37|2@0+ (1,0) [0|3] "" Vector__XXX
 SG_ ChrgLidDCorAcDcSts_UB : 92|1@0+ (1,0) [0|1] "" Vector__XXX
 SG_ ChrgnSpd : 167|11@0+ (1.0,0.0) [0.0|2047.0] "Km/h" IHU
 SG_ ChrgnSpd_UB : 96|1@0+ (1,0) [0|1] "" IHU
 SG_ ClimaCmd : 23|1@0+ (1,0) [0|1] "" IHU,ZCUP
 SG_ ClimaCmd_UB : 104|1@0+ (1,0) [0|1] "" IHU,ZCUP
 SG_ CmprFb_UB : 172|1@0+ (1,0) [0|1] "" IHU
 SG_ CmprFbCmprI : 183|12@0+ (0.1,0.0) [0.0|409.5] "A" IHU
 SG_ CmprFbCmprIPha : 199|8@0+ (0.5,0.0) [0.0|127.0] "A" IHU
 SG_ CmprFbCmprSpd : 207|8@0+ (50.0,0.0) [0.0|12700.0] "rpm" IHU
 SG_ CmprFbCmprSts1 : 237|3@0+ (1,0) [0|7] "" IHU
 SG_ CmprFbCmprSts2 : 187|4@0+ (1,0) [0|15] "" IHU
 SG_ CmprFbCmprT1 : 215|8@0+ (1.0,-50.0) [-50.0|204.0] "degC" IHU
 SG_ CmprFbCmprT2 : 223|8@0+ (1.0,-50.0) [-50.0|204.0] "degC" IHU
 SG_ CmprFbCmprU : 231|10@0+ (2.0,0.0) [0.0|2046.0] "Volt" IHU
 SG_ CrashUnlckFailrSts : 22|2@0+ (1,0) [0|3] "" IHU
 SG_ CrashUnlckFailrSts_UB : 103|1@0+ (1,0) [0|1] "" IHU
 SG_ DrvrSeatHeatgAutoSts : 19|2@0+ (1,0) [0|3] "" IHU
 SG_ DrvrSeatHeatgAutoSts_UB : 100|1@0+ (1,0) [0|1] "" IHU
 SG_ DrvrSeatVentnAutoSts : 39|2@0+ (1,0) [0|3] "" IHU
 SG_ DrvrSeatVentnAutoSts_UB : 99|1@0+ (1,0) [0|1] "" IHU
 SG_ Edcp2PmpSts_UB : 70|1@0+ (1,0) [0|1] "" IHU
 SG_ Edcp2PmpStsCooltPmpDryErr : 367|2@0+ (1,0) [0|3] "" IHU
 SG_ Edcp2PmpStsCooltPmpEmgyModSts : 365|2@0+ (1,0) [0|3] "" IHU
 SG_ Edcp2PmpStsCooltPmpErrSts : 363|2@0+ (1,0) [0|3] "" IHU
 SG_ Edcp2PmpStsCooltPmpI : 375|8@0+ (0.2,0.0) [0.0|50.800000000000004] "A" IHU
 SG_ Edcp2PmpStsCooltPmpIErr : 361|2@0+ (1,0) [0|3] "" IHU
 SG_ Edcp2PmpStsCooltPmpMonrSpd : 383|2@0+ (1,0) [0|3] "" IHU
 SG_ Edcp2PmpStsCooltPmpPostRunSts : 381|2@0+ (1,0) [0|3] "" IHU
 SG_ Edcp2PmpStsCooltPmpSetPostRunReq : 423|3@0+ (1,0) [0|7] "" IHU
 SG_ Edcp2PmpStsCooltPmpSetSpdReq : 391|8@0+ (1.0,0.0) [0.0|254.0] "Unitless" IHU
 SG_ Edcp2PmpStsCooltPmpSpd : 399|8@0+ (1.0,0.0) [0.0|254.0] "Unitless" IHU
 SG_ Edcp2PmpStsCooltPmpT : 407|8@0+ (1.0,-50.0) [-50.0|200.0] "degC" IHU
 SG_ Edcp2PmpStsCooltPmpTErr : 379|2@0+ (1,0) [0|3] "" IHU
 SG_ Edcp2PmpStsCooltPmpU : 415|8@0+ (0.1,0.0) [0.0|25.0] "Volt" IHU
 SG_ Edcp2PmpStsCooltPmpUErr : 377|2@0+ (1,0) [0|3] "" IHU
 SG_ Edcp2PmpStsCooltPmpUnstallSts : 420|2@0+ (1,0) [0|3] "" IHU
 SG_ EngForbidRespFromVMM : 20|1@0+ (1,0) [0|1] "" IHU
 SG_ EngForbidRespFromVMM_UB : 97|1@0+ (1,0) [0|1] "" IHU
 SG_ EpbApplyEnaSec : 171|1@0+ (1,0) [0|1] "" IHU
 SG_ EpbApplyEnaSec_UB : 170|1@0+ (1,0) [0|1] "" IHU
 SG_ EpbRelsEnaSec : 169|1@0+ (1,0) [0|1] "" IHU
 SG_ EpbRelsEnaSec_UB : 168|1@0+ (1,0) [0|1] "" IHU
 SG_ ErsCmdByKey : 33|2@0+ (1,0) [0|3] "" IHU,ZCUP
 SG_ ErsCmdByKey_UB : 95|1@0+ (1,0) [0|1] "" IHU,ZCUP
 SG_ HctvSts_UB : 76|1@0+ (1,0) [0|1] "" IHU
 SG_ HctvStsVlvBlkFlt : 431|1@0+ (1,0) [0|1] "" IHU
 SG_ HctvStsVlvCalibSts : 430|2@0+ (1,0) [0|3] "" IHU
 SG_ HctvStsVlvCmdPosnErr : 428|1@0+ (1,0) [0|1] "" IHU
 SG_ HctvStsVlvLoTErr : 427|1@0+ (1,0) [0|1] "" IHU
 SG_ HctvStsVlvMoveSts : 426|1@0+ (1,0) [0|1] "" IHU
 SG_ HctvStsVlvNVMFlt : 425|1@0+ (1,0) [0|1] "" IHU
 SG_ HctvStsVlvOpenCircFlt : 424|1@0+ (1,0) [0|1] "" IHU
 SG_ HctvStsVlvOverTErr : 439|1@0+ (1,0) [0|1] "" IHU
 SG_ HctvStsVlvOverTrvlFlt : 438|1@0+ (1,0) [0|1] "" IHU
 SG_ HctvStsVlvOverTWarn : 437|1@0+ (1,0) [0|1] "" IHU
 SG_ HctvStsVlvOverUErr : 436|1@0+ (1,0) [0|1] "" IHU
 SG_ HctvStsVlvPosn : 433|10@0+ (0.1,0.0) [0.0|100.0] "%" IHU
 SG_ HctvStsVlvPosnCtrlTimeOutFlt : 435|1@0+ (1,0) [0|1] "" IHU
 SG_ HctvStsVlvPosnUkwnFlt : 434|1@0+ (1,0) [0|1] "" IHU
 SG_ HctvStsVlvPreHeatgSts : 455|1@0+ (1,0) [0|1] "" IHU
 SG_ HctvStsVlvSelfLearnFlt : 454|1@0+ (1,0) [0|1] "" IHU
 SG_ HctvStsVlvShoCircFlt : 453|1@0+ (1,0) [0|1] "" IHU
 SG_ HctvStsVlvSpdLvlSts : 452|2@0+ (1,0) [0|3] "" IHU
 SG_ HctvStsVlvUnderUErr : 450|1@0+ (1,0) [0|1] "" IHU
 SG_ HmiDefrstrElecSts_UB : 94|1@0+ (1,0) [0|1] "" IHU
 SG_ HmiDefrstrElecStsFrnt : 47|3@0+ (1,0) [0|7] "" IHU
 SG_ HmiDefrstrElecStsMirrr : 44|3@0+ (1,0) [0|7] "" IHU
 SG_ HmiDefrstrElecStsRe : 55|3@0+ (1,0) [0|7] "" IHU
 SG_ HvBattPmpStat_UB : 298|1@0+ (1,0) [0|1] "" IHU
 SG_ HvBattPmpStatCooltPmpDryErr : 247|2@0+ (1,0) [0|3] "" IHU
 SG_ HvBattPmpStatCooltPmpEmgyModSts : 245|2@0+ (1,0) [0|3] "" IHU
 SG_ HvBattPmpStatCooltPmpErrSts : 243|2@0+ (1,0) [0|3] "" IHU
 SG_ HvBattPmpStatCooltPmpI : 255|8@0+ (0.2,0.0) [0.0|50.800000000000004] "A" IHU
 SG_ HvBattPmpStatCooltPmpIErr : 241|2@0+ (1,0) [0|3] "" IHU
 SG_ HvBattPmpStatCooltPmpMonrSpd : 263|2@0+ (1,0) [0|3] "" IHU
 SG_ HvBattPmpStatCooltPmpPostRunSts : 261|2@0+ (1,0) [0|3] "" IHU
 SG_ HvBattPmpStatCooltPmpSetPostRunReq : 303|3@0+ (1,0) [0|7] "" IHU
 SG_ HvBattPmpStatCooltPmpSetSpdReq : 271|8@0+ (1.0,0.0) [0.0|254.0] "Unitless" IHU
 SG_ HvBattPmpStatCooltPmpSpd : 279|8@0+ (1.0,0.0) [0.0|254.0] "Unitless" IHU
 SG_ HvBattPmpStatCooltPmpT : 287|8@0+ (1.0,-50.0) [-50.0|200.0] "degC" IHU
 SG_ HvBattPmpStatCooltPmpTErr : 259|2@0+ (1,0) [0|3] "" IHU
 SG_ HvBattPmpStatCooltPmpU : 295|8@0+ (0.1,0.0) [0.0|25.0] "Volt" IHU
 SG_ HvBattPmpStatCooltPmpUErr : 257|2@0+ (1,0) [0|3] "" IHU
 SG_ HvBattPmpStatCooltPmpUnstallSts : 300|2@0+ (1,0) [0|3] "" IHU
 SG_ HvCooltHeatrICnsSig : 15|8@0+ (0.25,0.0) [0.0|63.75] "Unitless" IHU
 SG_ HvCooltHeatrICnsSig_UB : 0|1@0+ (1,0) [0|1] "" IHU
 SG_ HvHeatrPwrCnsDes : 17|10@0+ (20.0,0.0) [0.0|20460.0] "W" IHU
 SG_ HvHeatrPwrCnsDes_UB : 1|1@0+ (1,0) [0|1] "" IHU
 SG_ ImobMgrWarnIndcn : 51|2@0+ (1,0) [0|3] "" IHU
 SG_ ImobMgrWarnIndcn_UB : 93|1@0+ (1,0) [0|1] "" IHU
 SG_ KeyNotPrsntMsgToDrvr : 73|1@0+ (1,0) [0|1] "" IHU
 SG_ KeyNotPrsntMsgToDrvr_UB : 72|1@0+ (1,0) [0|1] "" IHU
 SG_ MotConsDrvCyc : 119|32@0+ (0.1,0.0) [0.0|800000.0] "Kilojoule_1" IHU
 SG_ MotConsDrvCyc_UB : 52|1@0+ (1,0) [0|1] "" IHU
 SG_ PinionSteerAgMax1 : 471|15@0- (0.0009765625,0.0) [-14.5|14.5] "rad" Vector__XXX
 SG_ PinionSteerAgMax1_UB : 472|1@0+ (1,0) [0|1] "" Vector__XXX
 SG_ PostHeatgRunTiEstimd : 151|16@0+ (1.0,0.0) [0.0|65535.0] "Unitless" IHU,ZCUP
 SG_ PostHeatgRunTiEstimd_UB : 98|1@0+ (1,0) [0|1] "" IHU,ZCUP
 SG_ PrpsnErrIndcnReq : 49|2@0+ (1,0) [0|3] "" IHU
 SG_ PrpsnErrIndcnReq_UB : 91|1@0+ (1,0) [0|1] "" IHU
 SG_ RlyPwrDistbnCmd1WdIgnRlyExtCmd : 59|1@0+ (1,0) [0|1] "" IHU
 SG_ RlyPwrDistbnCmd1WdIgnRlyExtCmd_UB : 89|1@0+ (1,0) [0|1] "" IHU
 SG_ SteerWhlHeatgAvlSts : 58|3@0+ (1,0) [0|7] "" IHU
 SG_ SteerWhlHeatgAvlSts_UB : 86|1@0+ (1,0) [0|1] "" IHU
 SG_ SteerWhlHeatgStrtAutCdnOk : 65|1@0+ (1,0) [0|1] "" IHU
 SG_ SteerWhlHeatgStrtAutCdnOk_UB : 84|1@0+ (1,0) [0|1] "" IHU
 SG_ StrtInProgs : 67|2@0+ (1,0) [0|3] "" IHU,ZCUP
 SG_ StrtInProgs_UB : 83|1@0+ (1,0) [0|1] "" IHU,ZCUP
 SG_ StrtMsgToDrvr : 63|4@0+ (1,0) [0|15] "" IHU
 SG_ StrtMsgToDrvr_UB : 71|1@0+ (1,0) [0|1] "" IHU
 SG_ SysDirIndcnFailr : 64|1@0+ (1,0) [0|1] "" IHU
 SG_ SysDirIndcnFailr_UB : 82|1@0+ (1,0) [0|1] "" IHU
 SG_ TInCooltAtStrtOfClima : 311|8@0+ (1.0,-40.0) [-40.0|215.0] "degC" IHU,ZCUP
 SG_ TInCooltAtStrtOfClima_UB : 77|1@0+ (1,0) [0|1] "" IHU,ZCUP
 SG_ TrAntiPnch : 79|1@0+ (1,0) [0|1] "" IHU
 SG_ TrAntiPnch_UB : 81|1@0+ (1,0) [0|1] "" IHU
 SG_ TrObstclDetn : 78|1@0+ (1,0) [0|1] "" IHU
 SG_ TrObstclDetn_UB : 80|1@0+ (1,0) [0|1] "" IHU

BO_ 1154 ZCUDZCUCANFD2Fr13 : 64 ZCUD
 SG_ BattSnsrStReq : 507|2@0+ (1,0) [0|3] "" IHU
 SG_ BattSnsrStReq_UB : 505|1@0+ (1,0) [0|1] "" IHU
 SG_ BrkLiReqRegen_UB : 19|1@0+ (1,0) [0|1] "" IHU
 SG_ BrkLiReqRegenChks : 31|8@0+ (1.0,0.0) [0.0|255.0] "Unitless" IHU
 SG_ BrkLiReqRegenCntr : 39|4@0+ (1.0,0.0) [0.0|15.0] "Unitless" IHU
 SG_ BrkLiReqRegenOnOff : 35|1@0+ (1,0) [0|1] "" IHU
 SG_ DHTStSafe_UB : 416|1@0+ (1,0) [0|1] "" IHU
 SG_ DHTStSafeChks : 383|8@0+ (1.0,0.0) [0.0|255.0] "Unitless" IHU
 SG_ DHTStSafeCntr : 391|4@0+ (1.0,0.0) [0.0|15.0] "Unitless" IHU
 SG_ DHTStSafeRsv : 387|4@0+ (1.0,0.0) [0.0|15.0] "Unitless" IHU
 SG_ DHTStSafeSpd : 415|15@0- (1.0,0.0) [-16384.0|16383.0] "rpm" IHU
 SG_ DHTStSafeSpdQf : 399|2@0+ (1,0) [0|3] "" IHU
 SG_ DHTStSafeTqRt : 395|12@0+ (0.01,0.0) [0.0|40.95] "Unitless" IHU
 SG_ DHTStSafeTqRtQf : 397|2@0+ (1,0) [0|3] "" IHU
 SG_ DtEngdSt_UB : 8|1@0+ (1,0) [0|1] "" IHU
 SG_ DtEngdStDtEngdFrnt : 23|1@0+ (1,0) [0|1] "" IHU
 SG_ DtEngdStDtEngdRe : 22|1@0+ (1,0) [0|1] "" IHU
 SG_ DtEngdStDtNotEngdFrnt : 21|1@0+ (1,0) [0|1] "" IHU
 SG_ DtEngdStDtNotEngdRe : 20|1@0+ (1,0) [0|1] "" IHU
 SG_ ElecMot2ErrIndcnReq : 207|1@0+ (1,0) [0|1] "" IHU
 SG_ ElecMot2ErrIndcnReq_UB : 206|1@0+ (1,0) [0|1] "" IHU
 SG_ ElecMot2LimnIndcn : 431|16@0+ (1.0,0.0) [0.0|65535.0] "Unitless" IHU
 SG_ ElecMot2LimnIndcn_UB : 205|1@0+ (1,0) [0|1] "" IHU
 SG_ ElecMot2UDc : 447|11@0+ (0.25,0.0) [0.0|511.0] "Volt" IHU
 SG_ ElecMot2UDc_UB : 204|1@0+ (1,0) [0|1] "" IHU
 SG_ EngRunngReqByTrsm : 203|2@0+ (1,0) [0|3] "" IHU
 SG_ EngRunngReqByTrsm_UB : 271|1@0+ (1,0) [0|1] "" IHU
 SG_ HwRowFrstPassFldRsdSwt : 354|2@0+ (1,0) [0|3] "" IHU
 SG_ HwRowFrstPassFldRsdSwt_UB : 352|1@0+ (1,0) [0|1] "" IHU
 SG_ IsgActvDampgModReq : 18|2@0+ (1,0) [0|3] "" IHU
 SG_ IsgActvDampgModReq_UB : 16|1@0+ (1,0) [0|1] "" IHU
 SG_ IsgModReq : 55|4@0+ (1,0) [0|15] "" IHU
 SG_ IsgModReq_UB : 51|1@0+ (1,0) [0|1] "" IHU
 SG_ IsgPwrLimMax : 33|10@0+ (0.5,0.0) [0.0|511.0] "kW" IHU
 SG_ IsgPwrLimMax_UB : 34|1@0+ (1,0) [0|1] "" IHU
 SG_ IsgPwrLimMin : 49|10@0+ (0.5,-511.0) [-511.0|0.0] "kW" IHU
 SG_ IsgPwrLimMin_UB : 50|1@0+ (1,0) [0|1] "" IHU
 SG_ IsgSpdReq : 71|15@0- (1.0,0.0) [-16384.0|16383.0] "rpm" IHU
 SG_ IsgSpdReq_UB : 72|1@0+ (1,0) [0|1] "" IHU
 SG_ IsgTqAllwd_UB : 103|1@0+ (1,0) [0|1] "" IHU
 SG_ IsgTqAllwdChks : 87|8@0+ (1.0,0.0) [0.0|255.0] "Unitless" IHU
 SG_ IsgTqAllwdCntr : 95|4@0+ (1.0,0.0) [0.0|15.0] "Unitless" IHU
 SG_ IsgTqAllwdIsgTqAllwd : 91|4@0+ (1.0,0.0) [0.0|15.0] "Unitless" IHU
 SG_ OvrdDecelByDrvr_UB : 101|1@0+ (1,0) [0|1] "" IHU
 SG_ OvrdDecelByDrvrChks : 111|8@0+ (1.0,0.0) [0.0|255.0] "Unitless" IHU
 SG_ OvrdDecelByDrvrCntr : 99|4@0+ (1.0,0.0) [0.0|15.0] "Unitless" IHU
 SG_ OvrdDecelByDrvrOvrdDecelByDrvr : 100|1@0+ (1,0) [0|1] "" IHU
 SG_ ParkByDrvrWhlsFrntSafe_UB : 102|1@0+ (1,0) [0|1] "" IHU
 SG_ ParkByDrvrWhlsFrntSafeChks : 119|8@0+ (1.0,0.0) [0.0|255.0] "Unitless" IHU
 SG_ ParkByDrvrWhlsFrntSafeCntr : 127|4@0+ (1.0,0.0) [0.0|15.0] "Unitless" IHU
 SG_ ParkByDrvrWhlsFrntSafeSts : 123|1@0+ (1,0) [0|1] "" IHU
 SG_ PropLgtCtrlModCfmd_UB : 136|1@0+ (1,0) [0|1] "" IHU
 SG_ PropLgtCtrlModCfmdChks : 135|8@0+ (1.0,0.0) [0.0|255.0] "Unitless" IHU
 SG_ PropLgtCtrlModCfmdCntr : 143|4@0+ (1.0,0.0) [0.0|15.0] "Unitless" IHU
 SG_ PropLgtCtrlModCfmdLgtDegradation : 122|3@0+ (1,0) [0|7] "" IHU
 SG_ PropLgtCtrlModCfmdPropLgtCtrlModCfmd : 139|3@0+ (1,0) [0|7] "" IHU
 SG_ PrpsnTqFrntReq : 151|16@0- (1.0,0.0) [-20000.0|20000.0] "NewtonMeter" IHU
 SG_ PrpsnTqFrntReq_UB : 167|1@0+ (1,0) [0|1] "" IHU
 SG_ PrpsnTqReReq : 175|16@0- (1.0,0.0) [-20000.0|20000.0] "NewtonMeter" IHU
 SG_ PrpsnTqReReq_UB : 166|1@0+ (1,0) [0|1] "" IHU
 SG_ PtAllwdToTrsmActrSafe_UB : 165|1@0+ (1,0) [0|1] "" IHU
 SG_ PtAllwdToTrsmActrSafeChks : 191|8@0+ (1.0,0.0) [0.0|255.0] "Unitless" IHU
 SG_ PtAllwdToTrsmActrSafeCntr : 199|4@0+ (1.0,0.0) [0.0|15.0] "Unitless" IHU
 SG_ PtAllwdToTrsmActrSafePtAllwdToTrsmActr : 195|4@0+ (1,0) [0|15] "" IHU
 SG_ PtBrkTqCpTot_UB : 216|1@0+ (1,0) [0|1] "" IHU
 SG_ PtBrkTqCpTot1 : 215|15@0- (1.0,0.0) [-16384.0|16380.0] "NewtonMeter" IHU
 SG_ PtBrkTqCpTotQf : 201|2@0+ (1,0) [0|3] "" IHU
 SG_ PtGearRatFrntAct : 231|12@0+ (0.01,0.0) [0.0|40.95] "Unitless" IHU
 SG_ PtGearRatFrntAct_UB : 164|1@0+ (1,0) [0|1] "" IHU
 SG_ PtGearTar : 235|4@0+ (1,0) [0|15] "" IHU
 SG_ PtGearTar_UB : 163|1@0+ (1,0) [0|1] "" IHU
 SG_ PtJTot_UB : 162|1@0+ (1,0) [0|1] "" IHU
 SG_ PtJTotAtTrsmAxleOutp : 247|12@0+ (0.03,0.0) [0.0|122.85] "Unitless" IHU
 SG_ PtJTotChks : 263|8@0+ (1.0,0.0) [0.0|255.0] "Unitless" IHU
 SG_ PtJTotCntr : 251|4@0+ (1.0,0.0) [0.0|15.0] "Unitless" IHU
 SG_ PtRgnTarTqAtReAxle_UB : 280|1@0+ (1,0) [0|1] "" IHU
 SG_ PtRgnTarTqAtReAxleAtReAxle : 279|15@0- (1.0,0.0) [-16384.0|16380.0] "NewtonMeter" IHU
 SG_ PtRgnTarTqAtReAxleQf : 265|2@0+ (1,0) [0|3] "" IHU
 SG_ PtTotRgnTarTq_UB : 304|1@0+ (1,0) [0|1] "" IHU
 SG_ PtTotRgnTarTq1 : 303|15@0- (1.0,0.0) [-16384.0|16380.0] "NewtonMeter" IHU
 SG_ PtTotRgnTarTqQf : 289|2@0+ (1,0) [0|3] "" IHU
 SG_ PtTqAtAxleAvlFrntMax : 319|13@0- (4.0,0.0) [-16384.0|16380.0] "NewtonMeter" IHU
 SG_ PtTqAtAxleAvlFrntMax_UB : 161|1@0+ (1,0) [0|1] "" IHU
 SG_ PtTqAtAxleAvlFrntMin : 335|13@0- (4.0,0.0) [-16384.0|16380.0] "NewtonMeter" IHU
 SG_ PtTqAtAxleAvlFrntMin_UB : 160|1@0+ (1,0) [0|1] "" IHU
 SG_ PtTqAtAxleAvlReMax : 351|13@0- (4.0,0.0) [-16384.0|16380.0] "NewtonMeter" IHU
 SG_ PtTqAtAxleAvlReMax_UB : 322|1@0+ (1,0) [0|1] "" IHU
 SG_ PtTqAtAxleAvlReMin : 367|15@0- (1.0,0.0) [-16384.0|16380.0] "NewtonMeter" IHU
 SG_ PtTqAtAxleAvlReMin_UB : 368|1@0+ (1,0) [0|1] "" IHU
 SG_ PtWhlTqTar : 7|14@0+ (1.0,-6383.0) [-6383.0|10000.0] "NewtonMeter" IHU
 SG_ PtWhlTqTar_UB : 9|1@0+ (1,0) [0|1] "" IHU
 SG_ RlyCrashForHvsysReq : 321|1@0+ (1,0) [0|1] "" IHU
 SG_ RlyCrashForHvsysReq_UB : 320|1@0+ (1,0) [0|1] "" IHU
 SG_ TrsmActrPosn2_UB : 464|1@0+ (1,0) [0|1] "" IHU
 SG_ TrsmActrPosn2TrsmActrPosn : 467|3@0+ (1,0) [0|7] "" IHU
 SG_ TrsmActrPosn2TrsmActrPosnChks : 463|8@0+ (1.0,0.0) [0.0|255.0] "Unitless" IHU
 SG_ TrsmActrPosn2TrsmActrPosnCntr : 471|4@0+ (1.0,0.0) [0.0|15.0] "Unitless" IHU
 SG_ TrsmGearAct : 270|4@0+ (1,0) [0|15] "" IHU
 SG_ TrsmGearAct_UB : 266|1@0+ (1,0) [0|1] "" IHU
 SG_ TrsmGearChgProgs : 295|3@0+ (1,0) [0|7] "" IHU
 SG_ TrsmGearChgProgs_UB : 292|1@0+ (1,0) [0|1] "" IHU
 SG_ TrsmGearNotAvlSts : 479|12@0+ (1.0,0.0) [0.0|4095.0] "Unitless" IHU
 SG_ TrsmGearNotAvlSts_UB : 291|1@0+ (1,0) [0|1] "" IHU
 SG_ TrsmGearRat : 483|12@0+ (0.01,0.0) [0.0|40.95] "Unitless" IHU
 SG_ TrsmGearRat_UB : 290|1@0+ (1,0) [0|1] "" IHU
 SG_ TrsmGearRatTar : 503|12@0+ (0.01,0.0) [0.0|40.95] "Unitless" IHU
 SG_ TrsmGearRatTar_UB : 338|1@0+ (1,0) [0|1] "" IHU
 SG_ TrsmGearTar : 451|4@0+ (1,0) [0|15] "" IHU
 SG_ TrsmGearTar_UB : 452|1@0+ (1,0) [0|1] "" IHU

BO_ 528 ZCUDZCUCANFD2Fr14 : 64 ZCUD
 SG_ DrvrSeatHeatgActlPwrCns : 7|8@0+ (1.0,0.0) [0.0|255.0] "Unitless" IHU,ZCUP
 SG_ DrvrSeatHeatgActlPwrCns_UB : 351|1@0+ (1,0) [0|1] "" IHU,ZCUP
 SG_ DrvrSeatHeatgDesPwrCns : 15|8@0+ (1.0,0.0) [0.0|255.0] "Unitless" IHU,ZCUP
 SG_ DrvrSeatHeatgDesPwrCns_UB : 350|1@0+ (1,0) [0|1] "" IHU,ZCUP
 SG_ DrvrSeatVentnActlPwrCns : 23|8@0+ (1.0,0.0) [0.0|255.0] "Unitless" IHU,ZCUP
 SG_ DrvrSeatVentnActlPwrCns_UB : 348|1@0+ (1,0) [0|1] "" IHU,ZCUP
 SG_ DrvrSeatVentnDesPwrCns : 31|8@0+ (1.0,0.0) [0.0|255.0] "Unitless" IHU,ZCUP
 SG_ DrvrSeatVentnDesPwrCns_UB : 347|1@0+ (1,0) [0|1] "" IHU,ZCUP
 SG_ DstEstimdToEmptyForDrvgElecPredTyp2 : 41|10@0+ (1.0,0.0) [0.0|1023.0] "KiloMtr" IHU
 SG_ DstEstimdToEmptyForDrvgElecPredTyp2_UB : 345|1@0+ (1,0) [0|1] "" IHU
 SG_ DstTrvldAct : 87|25@0+ (0.1,0.0) [0.0|2000000.0] "km" IHU
 SG_ DstTrvldAct_UB : 342|1@0+ (1,0) [0|1] "" IHU
 SG_ DstTrvldOfEng : 104|25@0+ (0.1,0.0) [0.0|2000000.0] "km" IHU
 SG_ DstTrvldOfEng_UB : 341|1@0+ (1,0) [0|1] "" IHU
 SG_ DstTrvldOfEV : 143|25@0+ (0.1,0.0) [0.0|2000000.0] "km" IHU
 SG_ DstTrvldOfEV_UB : 340|1@0+ (1,0) [0|1] "" IHU
 SG_ ElecMot2InvrT : 63|8@0+ (1.0,-50.0) [-50.0|200.0] "degC" IHU
 SG_ ElecMot2InvrT_UB : 71|1@0+ (1,0) [0|1] "" IHU
 SG_ ElecMot2MotT : 79|8@0+ (1.0,-50.0) [-50.0|200.0] "degC" IHU
 SG_ ElecMot2MotT_UB : 70|1@0+ (1,0) [0|1] "" IHU
 SG_ EPedlDrvrIndcnMsg : 43|2@0+ (1,0) [0|3] "" IHU
 SG_ EPedlDrvrIndcnMsg_UB : 338|1@0+ (1,0) [0|1] "" IHU
 SG_ EPedlInhbnSts : 189|1@0+ (1,0) [0|1] "" IHU
 SG_ EPedlInhbnSts_UB : 337|1@0+ (1,0) [0|1] "" IHU
 SG_ ErsDelayTiCfm : 188|1@0+ (1,0) [0|1] "" IHU
 SG_ ErsDelayTiCfm_UB : 336|1@0+ (1,0) [0|1] "" IHU
 SG_ ErsStrtRes : 110|5@0+ (1,0) [0|31] "" IHU
 SG_ ErsStrtRes_UB : 105|1@0+ (1,0) [0|1] "" IHU
 SG_ HealthOfEngOil : 175|7@0+ (1.0,0.0) [0.0|100.0] "%" IHU
 SG_ HealthOfEngOil_UB : 335|1@0+ (1,0) [0|1] "" IHU
 SG_ HpcDeiceReq : 69|3@0+ (1,0) [0|7] "" IHU,ZCUP
 SG_ HpcDeiceReq_UB : 66|1@0+ (1,0) [0|1] "" IHU,ZCUP
 SG_ HpcHpCoolgPwrSts : 187|1@0+ (1,0) [0|1] "" IHU,ZCUP
 SG_ HpcHpCoolgPwrSts_UB : 334|1@0+ (1,0) [0|1] "" IHU,ZCUP
 SG_ HpcHpHeatgPwrSts : 186|1@0+ (1,0) [0|1] "" IHU,ZCUP
 SG_ HpcHpHeatgPwrSts_UB : 333|1@0+ (1,0) [0|1] "" IHU,ZCUP
 SG_ HpcHpModReq : 166|7@0+ (1,0) [0|127] "" IHU,ZCUP
 SG_ HpcHpModReq_UB : 332|1@0+ (1,0) [0|1] "" IHU,ZCUP
 SG_ HvacCooltFlowAct : 183|10@0+ (0.05,0.0) [0.0|51.150000000000006] "L / min" IHU,ZCUP
 SG_ HvacCooltFlowAct_UB : 331|1@0+ (1,0) [0|1] "" IHU,ZCUP
 SG_ HvacCooltVlvStsSig : 207|3@0+ (1,0) [0|7] "" IHU,ZCUP
 SG_ HvacCooltVlvStsSig_UB : 330|1@0+ (1,0) [0|1] "" IHU,ZCUP
 SG_ HvBattThermPwrCns : 185|10@0+ (20.0,0.0) [0.0|20460.0] "W" IHU
 SG_ HvBattThermPwrCns_UB : 329|1@0+ (1,0) [0|1] "" IHU
 SG_ HvCabinThermPwrCns : 201|10@0+ (20.0,0.0) [0.0|20460.0] "W" IHU
 SG_ HvCabinThermPwrCns_UB : 328|1@0+ (1,0) [0|1] "" IHU
 SG_ HvCooltHeatrEnad : 343|1@0+ (1,0) [0|1] "" IHU,ZCUP
 SG_ HvCooltHeatrEnad_UB : 318|1@0+ (1,0) [0|1] "" IHU,ZCUP
 SG_ HvCooltHeatrStsSig : 204|3@0+ (1,0) [0|7] "" IHU,ZCUP
 SG_ HvCooltHeatrStsSig_UB : 327|1@0+ (1,0) [0|1] "" IHU,ZCUP
 SG_ HvSysRlySts_UB : 326|1@0+ (1,0) [0|1] "" ZCUP
 SG_ HvSysRlyStsChks : 223|8@0+ (1.0,0.0) [0.0|255.0] "Unitless" ZCUP
 SG_ HvSysRlyStsCntr : 231|4@0+ (1.0,0.0) [0.0|15.0] "Unitless" ZCUP
 SG_ HvSysRlyStsHvSysRlySts : 227|2@0+ (1,0) [0|3] "" ZCUP
 SG_ ISecDcDcActHiSide : 503|13@0+ (0.1,-410.0) [-410.0|409.1] "A" IHU
 SG_ ISecDcDcActHiSide_UB : 506|1@0+ (1,0) [0|1] "" IHU
 SG_ NatUsgDayOfOil : 247|10@0+ (1.0,0.0) [0.0|1023.0] "Unitless" IHU
 SG_ NatUsgDayOfOil_UB : 324|1@0+ (1,0) [0|1] "" IHU
 SG_ OilHealthIfDisp : 253|1@0+ (1,0) [0|1] "" IHU
 SG_ OilHealthIfDisp_UB : 323|1@0+ (1,0) [0|1] "" IHU
 SG_ PEMState : 225|2@0+ (1,0) [0|3] "" IHU
 SG_ PEMState_UB : 321|1@0+ (1,0) [0|1] "" IHU
 SG_ RainSnsrStsToHMI : 320|1@0+ (1,0) [0|1] "" IHU
 SG_ RainSnsrStsToHMI_UB : 312|1@0+ (1,0) [0|1] "" IHU
 SG_ RemindChrgn : 252|1@0+ (1,0) [0|1] "" IHU
 SG_ RemindChrgn_UB : 317|1@0+ (1,0) [0|1] "" IHU
 SG_ RoadInFor : 263|3@0+ (1,0) [0|7] "" IHU
 SG_ RoadInFor_UB : 316|1@0+ (1,0) [0|1] "" IHU
 SG_ SeatOccptAtRowSecMid2 : 251|2@0+ (1,0) [0|3] "" IHU,ZCUP
 SG_ SeatOccptAtRowSecMid2_UB : 325|1@0+ (1,0) [0|1] "" IHU,ZCUP
 SG_ SeatOccptAtRowSecMidSnsSts2 : 249|2@0+ (1,0) [0|3] "" IHU,ZCUP
 SG_ SeatOccptAtRowSecMidSnsSts2_UB : 339|1@0+ (1,0) [0|1] "" IHU,ZCUP
 SG_ SlopReducEngCoeff_UB : 315|1@0+ (1,0) [0|1] "" IHU
 SG_ SlopReducEngCoeffSlopEqu12 : 359|8@0+ (1.0,0.0) [0.0|100.0] "%" IHU
 SG_ SlopReducEngCoeffSlopEqu2 : 367|8@0+ (1.0,0.0) [0.0|100.0] "%" IHU
 SG_ SlopReducEngCoeffSlopEqu4 : 375|8@0+ (1.0,0.0) [0.0|100.0] "%" IHU
 SG_ SlopReducEngCoeffSlopEqu6 : 383|8@0+ (1.0,0.0) [0.0|100.0] "%" IHU
 SG_ SlopReducEngCoeffSlopEqu9 : 391|8@0+ (1.0,0.0) [0.0|100.0] "%" IHU
 SG_ SlopRiseEngCoeff_UB : 314|1@0+ (1,0) [0|1] "" IHU
 SG_ SlopRiseEngCoeffSlopEqu12 : 399|8@0+ (1.0,0.0) [0.0|100.0] "%" IHU
 SG_ SlopRiseEngCoeffSlopEqu2 : 407|8@0+ (1.0,0.0) [0.0|100.0] "%" IHU
 SG_ SlopRiseEngCoeffSlopEqu4 : 415|8@0+ (1.0,0.0) [0.0|100.0] "%" IHU
 SG_ SlopRiseEngCoeffSlopEqu6 : 423|8@0+ (1.0,0.0) [0.0|100.0] "%" IHU
 SG_ SlopRiseEngCoeffSlopEqu9 : 431|8@0+ (1.0,0.0) [0.0|100.0] "%" IHU
 SG_ SpdRelatWght_UB : 313|1@0+ (1,0) [0|1] "" IHU
 SG_ SpdRelatWghtSpdEqu10 : 439|8@0+ (1.0,0.0) [0.0|255.0] "Unitless" IHU
 SG_ SpdRelatWghtSpdEqu100 : 447|8@0+ (1.0,0.0) [0.0|255.0] "Unitless" IHU
 SG_ SpdRelatWghtSpdEqu120 : 455|8@0+ (1.0,0.0) [0.0|255.0] "Unitless" IHU
 SG_ SpdRelatWghtSpdEqu140 : 463|8@0+ (1.0,0.0) [0.0|255.0] "Unitless" IHU
 SG_ SpdRelatWghtSpdEqu20 : 471|8@0+ (1.0,0.0) [0.0|255.0] "Unitless" IHU
 SG_ SpdRelatWghtSpdEqu40 : 479|8@0+ (1.0,0.0) [0.0|255.0] "Unitless" IHU
 SG_ SpdRelatWghtSpdEqu60 : 487|8@0+ (1.0,0.0) [0.0|255.0] "Unitless" IHU
 SG_ SpdRelatWghtSpdEqu80 : 495|8@0+ (1.0,0.0) [0.0|255.0] "Unitless" IHU
 SG_ SwtStrt3 : 39|2@0+ (1,0) [0|3] "" IHU
 SG_ SwtStrt3_UB : 37|1@0+ (1,0) [0|1] "" IHU
 SG_ SwtStrt4 : 35|2@0+ (1,0) [0|3] "" IHU
 SG_ SwtStrt4_UB : 36|1@0+ (1,0) [0|1] "" IHU
 SG_ TotDstTrvldOfEng : 256|25@0+ (0.1,0.0) [0.0|2000000.0] "km" IHU
 SG_ TotDstTrvldOfEng_UB : 257|1@0+ (1,0) [0|1] "" IHU
 SG_ TotDstTrvldOfEV : 295|25@0+ (0.1,0.0) [0.0|2000000.0] "km" IHU
 SG_ TotDstTrvldOfEV_UB : 259|1@0+ (1,0) [0|1] "" IHU
 SG_ TrOpenerByFootOperCmd : 168|1@0+ (1,0) [0|1] "" IHU
 SG_ TrOpenerByFootOperCmd_UB : 239|1@0+ (1,0) [0|1] "" IHU
 SG_ WiprActvFromWMM : 260|1@0+ (1,0) [0|1] "" IHU
 SG_ WiprActvFromWMM_UB : 258|1@0+ (1,0) [0|1] "" IHU

BO_ 880 ZCUDZCUCANFD2Fr15 : 64 ZCUD
 SG_ AccrPedlLnr_UB : 42|1@0+ (1,0) [0|1] "" IHU
 SG_ AccrPedlLnrAccrPedlRat : 111|15@0+ (0.00390625,0.0) [0.0|100.0] "%" IHU
 SG_ AccrPedlLnrChks : 103|8@0+ (1.0,0.0) [0.0|255.0] "Unitless" IHU
 SG_ AccrPedlLnrCntr : 127|4@0+ (1.0,0.0) [0.0|15.0] "Unitless" IHU
 SG_ AccrPedlNotCmpl_UB : 43|1@0+ (1,0) [0|1] "" IHU
 SG_ AccrPedlNotCmplPsd : 143|1@0+ (1,0) [0|1] "" IHU
 SG_ AccrPedlNotCmplPsdChks : 135|8@0+ (1.0,0.0) [0.0|255.0] "Unitless" IHU
 SG_ AccrPedlNotCmplPsdCntr : 123|4@0+ (1.0,0.0) [0.0|15.0] "Unitless" IHU
 SG_ AccrPedlNotCmplPsdSts : 142|1@0+ (1,0) [0|1] "" IHU
 SG_ AccrPedlRatGrdt : 151|15@0- (0.0625,0.0) [-1000.0|1000.0] "PercPerSec" IHU
 SG_ AccrPedlRatGrdt_UB : 48|1@0+ (1,0) [0|1] "" IHU
 SG_ AmbTURaw : 167|12@0+ (0.1,-70.0) [-70.0|339.5] "degC" IHU
 SG_ AmbTURaw_UB : 152|1@0+ (1,0) [0|1] "" IHU
 SG_ CrsCtrlrActvnOk : 141|1@0+ (1,0) [0|1] "" IHU
 SG_ CrsCtrlrActvnOk_UB : 140|1@0+ (1,0) [0|1] "" IHU
 SG_ DeactvtTestCom : 139|1@0+ (1,0) [0|1] "" IHU
 SG_ DeactvtTestCom_UB : 138|1@0+ (1,0) [0|1] "" IHU
 SG_ DrvrPrpsnTqReq : 183|16@0- (1.0,0.0) [-20000.0|20000.0] "NewtonMeter" IHU
 SG_ DrvrPrpsnTqReq_UB : 137|1@0+ (1,0) [0|1] "" IHU
 SG_ EngPAmbAir : 79|8@0+ (5.0,0.0) [0.0|1275.0] "hPa" IHU
 SG_ EngPAmbAir_UB : 66|1@0+ (1,0) [0|1] "" IHU
 SG_ EngPwrCns : 87|11@0+ (1.0,0.0) [0.0|2047.0] "W" IHU
 SG_ EngPwrCns_UB : 67|1@0+ (1,0) [0|1] "" IHU
 SG_ ImobBrkNrSerlReq : 171|1@0+ (1,0) [0|1] "" IHU
 SG_ ImobBrkNrSerlReq_UB : 136|1@0+ (1,0) [0|1] "" IHU
 SG_ ImobEngSts1 : 170|2@0+ (1,0) [0|3] "" IHU
 SG_ ImobEngSts1_UB : 168|1@0+ (1,0) [0|1] "" IHU
 SG_ ImobEngSts3 : 89|2@0+ (1,0) [0|3] "" IHU
 SG_ ImobEngSts3_UB : 41|1@0+ (1,0) [0|1] "" IHU
 SG_ PtDtModReq : 71|3@0+ (1,0) [0|7] "" IHU
 SG_ PtDtModReq_UB : 68|1@0+ (1,0) [0|1] "" IHU
 SG_ PtReqToTrsmActr : 19|3@0+ (1,0) [0|7] "" IHU
 SG_ PtReqToTrsmActr_UB : 16|1@0+ (1,0) [0|1] "" IHU
 SG_ PtTqTotDrgAtWhls : 31|16@0- (1.0,0.0) [-20000.0|20000.0] "NewtonMeter" IHU
 SG_ PtTqTotDrgAtWhls_UB : 62|1@0+ (1,0) [0|1] "" IHU
 SG_ SwtTrClsSts : 47|1@0+ (1,0) [0|1] "" IHU
 SG_ SwtTrClsSts_UB : 46|1@0+ (1,0) [0|1] "" IHU
 SG_ ThermFctReq : 40|1@0+ (1,0) [0|1] "" IHU
 SG_ ThermFctReq_UB : 63|1@0+ (1,0) [0|1] "" IHU
 SG_ TrsmCluTEstimdOfClu0 : 15|9@0+ (1.25,-40.0) [-40.0|598.75] "degC" IHU
 SG_ TrsmCluTEstimdOfClu0_UB : 22|1@0+ (1,0) [0|1] "" IHU
 SG_ TrsmErrIndcnReq : 21|1@0+ (1,0) [0|1] "" IHU
 SG_ TrsmErrIndcnReq_UB : 20|1@0+ (1,0) [0|1] "" IHU
 SG_ TrsmHotSt : 92|2@0+ (1,0) [0|3] "" IHU
 SG_ TrsmHotSt_UB : 90|1@0+ (1,0) [0|1] "" IHU
 SG_ TrsmShiftInhb : 45|1@0+ (1,0) [0|1] "" IHU
 SG_ TrsmShiftInhb_UB : 44|1@0+ (1,0) [0|1] "" IHU

CM_ SG_ 434 ActtnCtrlActvFlg "GVMC Control active flag";
CM_ SG_ 434 AmbIllmnFwdStsAmblillmn1 "9 bit ambient ullumination level.";
CM_ SG_ 434 AmbIllmnFwdStsAmblillmn2 "8 bit ambient ullumination level.";
CM_ SG_ 434 AmbIllmnFwdStsChks "checksum";
CM_ SG_ 434 AmbIllmnFwdStsCntr "counter";
CM_ SG_ 434 BookChrgnStsFb "Feedback status of bookcharging function during charging.";
CM_ SG_ 434 ClimaPwrAllwd "Tells how much power the climate system is allowed to consume as decided by DPLC.";
CM_ SG_ 434 DcDcPwrLim "Limit the power of some low-voltage accessories";
CM_ SG_ 434 DispOfPrpsnPwrPercAct "Actual propulsion power (sum of powertrain acuators plus braking) for display in Electrical Propulsion Driver Support (PHEV powermeter). Does not include inertia effects or losses. Includes engine braking.";
CM_ SG_ 434 DispWhlMotSysPrpsnMod "rear motor operation mode used for power flow indication";
CM_ SG_ 434 DrvrMassgRunng "Gateway to CAN from Seat ECU of the Massage Module feedback signal if massage funcitonality is currently running.";
CM_ SG_ 434 DrvrSeatSts "Describes if an occupant is detected in the driver seat.";
CM_ SG_ 434 EasyLoadModIndcn "Easy Load Mold Indication";
CM_ SG_ 434 EgyCnsAllwdForClima "Energy consumption allowed for climate.";
CM_ SG_ 434 EmotCooltIndcnReq "Request to display warning / info message to customer in DIM regarding emotor coolant level.";
CM_ SG_ 434 EngCooltLvl "Engine coolant level in traditional car or hyvrid car. In EV vehicle, it represents the coolant level in electric drivetrain cooling circuit.";
CM_ SG_ 434 ExtrLiStsOfAssistantLi "Assistant light activation signal";
CM_ SG_ 434 HvBattSOCE "Pack State of Certified Energy";
CM_ SG_ 434 HybErrIndcnReqTelltlBattTracCutOff " Traction Battery Cut-Off";
CM_ SG_ 434 HybErrIndcnReqTelltlBattTracFailr " Traction Battery Failure";
CM_ SG_ 434 HybErrIndcnReqTelltlElecDrvFailr " Electrical Machine and controller overheated";
CM_ SG_ 434 HybErrIndcnReqTelltlSysHybFailr " System Failure";
CM_ SG_ 434 IndcrOfDeactvtReFog "to notice driver to deactivate rear fog while rain already change light";
CM_ SG_ 434 IvtrPhaT1 "Inverter phase temperature 1";
CM_ SG_ 434 IvtrPhaT2 "Inverter phase temperature 2";
CM_ SG_ 434 IvtrPhaT3 "Inverter phase temperature 3";
CM_ SG_ 434 KeyReadReqFromLockg "Key search request from the Locking subsystem.
Search is requested by location (Idle needed between each search).
Possible key locations in the read reaquest:
KeyLocnDrvrExt - External driver side
KeyLocnPassExt - External passenger side
KeyLocnTrExt - External behind trunk
KeyLocnAllInt - All internal zones
KeyLocnResvInt - Internal backup reader (front central position)
KeyLocnResvIntSimple - Quick/simple internal backup reader request";
CM_ SG_ 434 KeyReadStsToLockgBLEKey0 "key read status";
CM_ SG_ 434 KeyReadStsToLockgBLEKey1 "key read status";
CM_ SG_ 434 KeyReadStsToLockgBLEKey10 "key read status";
CM_ SG_ 434 KeyReadStsToLockgBLEKey11 "key read status";
CM_ SG_ 434 KeyReadStsToLockgBLEKey12 "key read status";
CM_ SG_ 434 KeyReadStsToLockgBLEKey13 "key read status";
CM_ SG_ 434 KeyReadStsToLockgBLEKey14 "key read status";
CM_ SG_ 434 KeyReadStsToLockgBLEKey15 "key read status";
CM_ SG_ 434 KeyReadStsToLockgBLEKey2 "key read status";
CM_ SG_ 434 KeyReadStsToLockgBLEKey3 "key read status";
CM_ SG_ 434 KeyReadStsToLockgBLEKey4 "key read status";
CM_ SG_ 434 KeyReadStsToLockgBLEKey5 "key read status";
CM_ SG_ 434 KeyReadStsToLockgBLEKey6 "key read status";
CM_ SG_ 434 KeyReadStsToLockgBLEKey7 "key read status";
CM_ SG_ 434 KeyReadStsToLockgBLEKey8 "key read status";
CM_ SG_ 434 KeyReadStsToLockgBLEKey9 "key read status";
CM_ SG_ 434 KeyReadStsToLockgKey0 "Key search answer back to the Locking subsystem, per key ID.
KeyPrsntStsIdle - Idle (default value)
KeyPrsntStsInProgs- Search in progress
KeyPrsntStsNotPsnt- Key not present/found
KeyPrsntStsPrsnt- Key present/found";
CM_ SG_ 434 KeyReadStsToLockgKey1 "Key search answer back to the Locking subsystem, per key ID.
KeyPrsntStsIdle - Idle (default value)
KeyPrsntStsInProgs- Search in progress
KeyPrsntStsNotPsnt- Key not present/found
KeyPrsntStsPrsnt- Key present/found";
CM_ SG_ 434 KeyReadStsToLockgKey10 "Key search answer back to the Locking subsystem, per key ID.
KeyPrsntStsIdle - Idle (default value)
KeyPrsntStsInProgs- Search in progress
KeyPrsntStsNotPsnt- Key not present/found
KeyPrsntStsPrsnt- Key present/found";
CM_ SG_ 434 KeyReadStsToLockgKey11 "Key search answer back to the Locking subsystem, per key ID.
KeyPrsntStsIdle - Idle (default value)
KeyPrsntStsInProgs- Search in progress
KeyPrsntStsNotPsnt- Key not present/found
KeyPrsntStsPrsnt- Key present/found";
CM_ SG_ 434 KeyReadStsToLockgKey2 "Key search answer back to the Locking subsystem, per key ID.
KeyPrsntStsIdle - Idle (default value)
KeyPrsntStsInProgs- Search in progress
KeyPrsntStsNotPsnt- Key not present/found
KeyPrsntStsPrsnt- Key present/found";
CM_ SG_ 434 KeyReadStsToLockgKey3 "Key search answer back to the Locking subsystem, per key ID.
KeyPrsntStsIdle - Idle (default value)
KeyPrsntStsInProgs- Search in progress
KeyPrsntStsNotPsnt- Key not present/found
KeyPrsntStsPrsnt- Key present/found";
CM_ SG_ 434 KeyReadStsToLockgKey4 "Key search answer back to the Locking subsystem, per key ID.
KeyPrsntStsIdle - Idle (default value)
KeyPrsntStsInProgs- Search in progress
KeyPrsntStsNotPsnt- Key not present/found
KeyPrsntStsPrsnt- Key present/found";
CM_ SG_ 434 KeyReadStsToLockgKey5 "Key search answer back to the Locking subsystem, per key ID.
KeyPrsntStsIdle - Idle (default value)
KeyPrsntStsInProgs- Search in progress
KeyPrsntStsNotPsnt- Key not present/found
KeyPrsntStsPrsnt- Key present/found";
CM_ SG_ 434 KeyReadStsToLockgKey6 "Key search answer back to the Locking subsystem, per key ID.
KeyPrsntStsIdle - Idle (default value)
KeyPrsntStsInProgs- Search in progress
KeyPrsntStsNotPsnt- Key not present/found
KeyPrsntStsPrsnt- Key present/found";
CM_ SG_ 434 KeyReadStsToLockgKey7 "Key search answer back to the Locking subsystem, per key ID.
KeyPrsntStsIdle - Idle (default value)
KeyPrsntStsInProgs- Search in progress
KeyPrsntStsNotPsnt- Key not present/found
KeyPrsntStsPrsnt- Key present/found";
CM_ SG_ 434 KeyReadStsToLockgKey8 "Key search answer back to the Locking subsystem, per key ID.
KeyPrsntStsIdle - Idle (default value)
KeyPrsntStsInProgs- Search in progress
KeyPrsntStsNotPsnt- Key not present/found
KeyPrsntStsPrsnt- Key present/found";
CM_ SG_ 434 KeyReadStsToLockgKey9 "Key search answer back to the Locking subsystem, per key ID.
KeyPrsntStsIdle - Idle (default value)
KeyPrsntStsInProgs- Search in progress
KeyPrsntStsNotPsnt- Key not present/found
KeyPrsntStsPrsnt- Key present/found";
CM_ SG_ 434 KeyReadStsToLockgNFCKey0 "key read status";
CM_ SG_ 434 KeyReadStsToLockgNFCKey1 "key read status";
CM_ SG_ 434 KeyReadStsToLockgNFCKey10 "key read status";
CM_ SG_ 434 KeyReadStsToLockgNFCKey11 "key read status";
CM_ SG_ 434 KeyReadStsToLockgNFCKey12 "key read status";
CM_ SG_ 434 KeyReadStsToLockgNFCKey13 "key read status";
CM_ SG_ 434 KeyReadStsToLockgNFCKey14 "key read status";
CM_ SG_ 434 KeyReadStsToLockgNFCKey15 "key read status";
CM_ SG_ 434 KeyReadStsToLockgNFCKey2 "key read status";
CM_ SG_ 434 KeyReadStsToLockgNFCKey3 "key read status";
CM_ SG_ 434 KeyReadStsToLockgNFCKey4 "key read status";
CM_ SG_ 434 KeyReadStsToLockgNFCKey5 "key read status";
CM_ SG_ 434 KeyReadStsToLockgNFCKey6 "key read status";
CM_ SG_ 434 KeyReadStsToLockgNFCKey7 "key read status";
CM_ SG_ 434 KeyReadStsToLockgNFCKey8 "key read status";
CM_ SG_ 434 KeyReadStsToLockgNFCKey9 "key read status";
CM_ SG_ 434 MirrTintgCmd "Dimming level of the outer rear view mirrors. 0-100%.";
CM_ SG_ 434 OnBdChrgrSt "The charging state of OBC";
CM_ SG_ 434 PasAlrmSts "Signal is used to request HMI to re-activate Pasive Arming in user settings when the 24h disabling timer times out.";
CM_ SG_ 434 PhoneForgottenRmn "remind user that the mobile phone was forgotten";
CM_ SG_ 434 PrpsnDistbnOfBOA "Sent to the HMI to remind the HMI that the textbox should be displayed.";
CM_ SG_ 434 RainLi "Information about rain detection for light activation/deactivation.";
CM_ SG_ 434 ReadLiStsFirstRowLe "First row left reading light lamp status information ";
CM_ SG_ 434 ReadLiStsFirstRowRi "First row right reading light lamp status information ";
CM_ SG_ 434 ReadLiStsSecondRowLe "Second row left reading light lamp status information ";
CM_ SG_ 434 ReadLiStsSecondRowRi "Second row right reading light lamp status information ";
CM_ SG_ 434 ReadLiStsThirdRowLe "Third row left reading light lamp status information ";
CM_ SG_ 434 ReadLiStsThirdRowRi "Third row right reading light lamp status information ";
CM_ SG_ 434 ReFogActvdbyRain "to tell HMI Rear Fog already activated by rain detection";
CM_ SG_ 434 ReWiprRotyCmd "ROCKER SWITCH(in end of wiper stalk)
Rocker switch moving UP/DOWN
Controling rear wiper speed in cars with rear wiper";
CM_ SG_ 434 RFKApproachReqAndKeyIdKeyId1 "key id";
CM_ SG_ 434 RFKApproachReqAndKeyIdRFKApproachReq "approach request to unlock,lock,light";
CM_ SG_ 434 RlyPwrDistbnCmd1WdPreBattSaveCmd "Prewarning that BttrySaver relay will be shut off. the value changes to 1, 30 sec prior the shut off";
CM_ SG_ 434 RmnLockgPrsnlReq "RmnLockgPrsnlReq - Request for Private Locking Reminder
When private locking is ON, and the user tries to open the glove box or trunk via instrument panel button, a private locking reminder shall be shown to the user via HMI. The reminder shall be shown when this signal changes value from Off to On";
CM_ SG_ 434 SeatHeatgAvlStsRowSecLe "Seat heating on, off, error and limitation status for first second left seat.";
CM_ SG_ 434 SeatHeatgAvlStsRowSecRi "Seat heating on, off, error and limitation status for second row right seat.";
CM_ SG_ 434 SeatHeatgAvlStsRowThrdLe "Seat heating on, off, error and limitation status for third left seat.";
CM_ SG_ 434 SeatHeatgAvlStsRowThrdRi "Seat heating on, off, error and limitation status for third row right seat.";
CM_ SG_ 434 SeatVentAvlStsRowSecLe "Seat ventilation on, off, error and limitation status for second row left seat.";
CM_ SG_ 434 SeatVentAvlStsRowSecRi "Seat ventilation on, off, error and limitation status for second row right seat.";
CM_ SG_ 434 SeatVentnAvlStsRowThrdLe "Seat ventilation on, off, error and limitation status for third row left seat.";
CM_ SG_ 434 SeatVentnAvlStsRowThrdRi "Seat ventilation on, off, error and limitation status for third row right seat.";
CM_ SG_ 434 ShortDropWinDrvrDoor2 "Driver window short drop2  request to open/close frameless doors";
CM_ SG_ 434 SteerLockEnagOfPrpsnNotSafe "Flag propulsion as not allowed for safety reasons";
CM_ SG_ 434 SteerLockReqNotSafeCommand "Internal signal between ImobSteerLockMgr and SftyMgrForSteerLockMgr with command to lock or unlock SCL and 7 bytes response ";
CM_ SG_ 434 SteerLockReqNotSafeSteerLockDataReq0 "Internal signal between ImobSteerLockMgr and SftyMgrForSteerLockMgr with command to lock or unlock SCL and 7 bytes response ";
CM_ SG_ 434 SteerLockReqNotSafeSteerLockDataReq1 "Internal signal between ImobSteerLockMgr and SftyMgrForSteerLockMgr with command to lock or unlock SCL and 7 bytes response ";
CM_ SG_ 434 SteerLockReqNotSafeSteerLockDataReq2 "Internal signal between ImobSteerLockMgr and SftyMgrForSteerLockMgr with command to lock or unlock SCL and 7 bytes response ";
CM_ SG_ 434 SteerLockReqNotSafeSteerLockDataReq3 "Internal signal between ImobSteerLockMgr and SftyMgrForSteerLockMgr with command to lock or unlock SCL and 7 bytes response ";
CM_ SG_ 434 SteerLockReqNotSafeSteerLockDataReq4 "Internal signal between ImobSteerLockMgr and SftyMgrForSteerLockMgr with command to lock or unlock SCL and 7 bytes response ";
CM_ SG_ 434 SteerLockReqNotSafeSteerLockDataReq5 "Internal signal between ImobSteerLockMgr and SftyMgrForSteerLockMgr with command to lock or unlock SCL and 7 bytes response ";
CM_ SG_ 434 SteerLockReqNotSafeSteerLockDataReq6 "Internal signal between ImobSteerLockMgr and SftyMgrForSteerLockMgr with command to lock or unlock SCL and 7 bytes response ";
CM_ SG_ 434 StopStrtInhb "Stop Start inhibit reason, displayed to driver in IHU.";
CM_ SG_ 434 SwtAhbcReq "Separate signal to represent AHBC switch";
CM_ SG_ 434 SwtIntmIntlCmd "ROTARY SWITCH
Rotary switch in wiper stalk
Controling wiper interval setting(and RS sensibility)";
CM_ SG_ 434 SysShutDwnFlg "Cut off high voltage flag position";
CM_ SG_ 434 TankFlapReqFromSwtIntr "TankFlapReqFromSwtIntr - Tank Falp Request from Interior Switch

Interior Tank Flap button status.

Psd - Pressed
NotPsd - Not Pressed";
CM_ SG_ 434 TCSDoorNoClsSts "TCSDoorNoClsSts";
CM_ SG_ 434 TrApprchOpenFbToExtLi "TrApprchOpenFbToExtLi - Trunk Approach Open Feedback to Exterior Light
Request signal from central locking to exterior light, to perform flashing of turn indicators to inform customer that trunk will soon open when approach unlock functionality is active.
0 - 0 Idle (No request)
1 - 1 ExtLigtFBReq (request normal blink)
2 - 2 ExtLigtFBStop (Stop normal blink)
3 - 3 FastExtLigtFBReq (Request Fast blink)
4 - 4 FastExtLigtFBStop (Stop Fast blink)";
CM_ SG_ 434 TrNoKeyPrsntAcoustReq "TrNoKeyPrsntAcoustReq - Request for audible feedback sound when no valid key is present.
The audible sound shall be given when the signal changes value from off to on.";
CM_ SG_ 434 TrPosnUpprProgmReq "TrPosnUpprProgmReq - Tailgate Upper Position Program Request
POT shall program upper position when this signal changes value from Off to On.";
CM_ SG_ 434 TrRelsReqNotSafe "TrRelsReqNotSafe - Tailgate/Bootlid Release Request Not Safe

Request to release the tailgate/bootlid. Signal is filtered through ASIL A SWC to ensure tailgate/bootlid is not relased when vehicle is moving.

On - Release request
Off - No release request";
CM_ SG_ 434 TrReqFromSwtIntr "TrReqFromSwtIntr - Tailgate/Bootlid Requst from Interior Switch

Switch status signal from interior tailgate/bootlid button.

Psd - Pressed
NotPsd - Not Pressed";
CM_ SG_ 434 TrsmParkAutRdy "Describes if a single button push/action is enough to allow engine shut off. Will be set when the transmission is in Park. For Shift-By-Wire systems signal will also be set when automatic parking function is ready to put the transmission in Park at engine shut off.";
CM_ SG_ 434 UsgModChgReqFromRFK "Request UsgMod change to inactive from abandon for RFK key";
CM_ SG_ 434 UWBApproachTailgateReqKeyId3 "key id";
CM_ SG_ 434 UWBApproachTailgateReqUWBApproachTailgateReq "tailgate approach request";
CM_ SG_ 434 VehEgyCoornActvtMsg "Indicate the reasons why the activation of function fails";
CM_ SG_ 434 VehEgyCoornEnvtlProtnIndcr "A parameter which indicates the environmenatal pretection after the VEC function finishes.";
CM_ SG_ 434 VehEgyCoornFctStChg "Indicate the three different function states, lncluding Activated, Closed , and Closed";
CM_ SG_ 434 WasRespLevel "Wading Protection level";
CM_ SG_ 544 BattLoStsFild "Battery warning (from the key).
Signal to request HMI message to driver (On - show battery low message, Off - No message)";
CM_ SG_ 544 BtnLockSts "Lock button on the remote (pressed - not pressed).";
CM_ SG_ 544 ChrgStrtEngRes "Status of Charging Start Function.";
CM_ SG_ 544 ClimRlyCmd "climate relay status";
CM_ SG_ 544 CmptmtCoolgSts "Status of compartment cooling";
CM_ SG_ 544 DrvrSeatHeatgAvlSts "Seat heating on, off, error and limitation status for driver seat.";
CM_ SG_ 544 DrvrSeatVentnLvlSts "Seat ventilation level for first row driver seat.";
CM_ SG_ 544 FuLeakDetdActv "Signal to VMM indicating activated / finished leakage detection monitoring. 0 = Idle, no action is performed. 1 = Evaluation, Entry conditions not met. 2 = Activated, leakage detection monitoring has been activated. 3 = Finished, leakage detection monitoring has been finished.";
CM_ SG_ 544 HvHeatrPwrCns "Measured power consumption of the HVCH.";
CM_ SG_ 544 KeyIntrVldDetd "Informs when a key search (lowest security level as locking or unlocking the vehicle) has found a valid key inside the vehicle.";
CM_ SG_ 544 KeyReadStsToVoiceCtrl "key search status to voice control systerm";
CM_ SG_ 544 LeSolarData "left side solar value for climate control.";
CM_ SG_ 544 LiBattInPWLockTC "Li-ion battery power locking mobile phone APP reminder signal
When BMS2 sends BattFltStsPrim=15, set LiBattInPWLockTC=1 for 20s, the mobile phone APP needs to send a reminder text. In order to avoid reminding customers repeatedly and causing complaints, this signal is only set once when an ignition cycle meets the conditions, LiBattInPWLock=0, Indicates that no reminder is required.
";
CM_ SG_ 544 NotifForEmgyCall "Information if there is a need for the vehicle to perform an emergency call.";
CM_ SG_ 544 PwrAvlDelta "Avalable delta power";
CM_ SG_ 544 PwrOutSetFBMsg "Delay PwrOut failure reason ToAPP";
CM_ SG_ 544 RelHumSnsrRelHum "Compartment relative humidity signal.";
CM_ SG_ 544 RemChrgStrtReq "Engine remote start request.";
CM_ SG_ 544 RiSolarData "right side solar value for climate control.";
CM_ SG_ 544 RlyCmdCmft "Comfort Relat status";
CM_ SG_ 544 RlyPwrDistbnCmd1WdIgnRlyCmd "Ignition relay status";
CM_ SG_ 544 SolarSnsrVluQf "Solar value quality flag for climate control.";
CM_ SG_ 544 SunCurtMvngSts "Interface indicating movement status of Sun Curtain. Value TRUE equals movement";
CM_ SG_ 544 SunRoofAndCurtFailrCurtMotFailr "Curtain motor short circuit";
CM_ SG_ 544 SunRoofAndCurtFailrCurtMotHallFailr "Curtain motor hall sensor short or open";
CM_ SG_ 544 SunRoofAndCurtFailrCurtMotNotAvl "Curtain motor open circuit";
CM_ SG_ 544 SunRoofAndCurtFailrEcuFailrGen "General failure in the SRM ECU
";
CM_ SG_ 544 SunRoofAndCurtFailrPanMotFailr "Panel motor short circuit";
CM_ SG_ 544 SunRoofAndCurtFailrPanMotHallFailr "Panel motor hall sensor short or open";
CM_ SG_ 544 SunRoofAndCurtFailrPanMotNotAvl "Panel motor open circuit";
CM_ SG_ 544 SunRoofAndCurtFailrResvd "Resevered value, not used";
CM_ SG_ 544 TankFlapSts "TankFlapSts -Tank Flap Status
Ukwn - Unknown status
Opend - Opened
Clsd - Closed";
CM_ SG_ 544 TrlrLampActvtChk "TrlrLampActvtChkNotAvl - Disable trailer lamp check.
TrlrLampActvtChkAvl - Enable trailer lamp check.";
CM_ SG_ 544 TrlrLampChkSts "TrlrLampChkStrtd - Trailer lamp check started.
TrlrLampChkCmpl - Trailer lamp check Completed.
CnclOper - Cancelled operation by user.
TrlrLampEngOffReqd - Required user to turn off the engine.
Resd1/2/3 - Reserved1/2/3.";
CM_ SG_ 544 TrlrLiFltSts "0 - Brake light and both DIs work well.
1 - Right DI is in failure status.
2 - Left DI is in failure status.
3 - Both DIs are in failure status.
4 - Brake light is in failure status.
5 - Brake light and right DI are in failure status.
6 - Brake light and left DI are in failure status.
7 - Brake light and both DIs are in failure status.";
CM_ SG_ 544 TrlrSrvReq "No Flt - Towbar release button works well.
Flt - Towba release button is stuck.";
CM_ SG_ 544 VMMtoHMIFBSwitch1 "reserved";
CM_ SG_ 544 VMMtoHMIFBSwitch2 "reserved";
CM_ SG_ 544 VMMtoHMIFBSwitch3 "reserved";
CM_ SG_ 544 VMMtoHMIFBSwitch4 "reserved";
CM_ SG_ 544 VMMtoHMIFBSwitch5 "reserved";
CM_ SG_ 544 VMMtoHMIFBSwitch6 "reserved";
CM_ SG_ 544 VMMtoHMIFBSwitch7 "reserved";
CM_ SG_ 544 VMMtoHMIFBSwitch8 "reserved";
CM_ SG_ 544 VMMtoHMIMsg "reserved";
CM_ SG_ 544 VMMToHmiSetSetting1 "reserved";
CM_ SG_ 544 VMMToHmiSetSetting2 "reserved";
CM_ SG_ 544 VMMToHmiSetSetting3 "reserved";
CM_ SG_ 544 VMMToHmiSetSetting4 "reserved";
CM_ SG_ 544 VMMToHmiSetSetting5 "reserved";
CM_ SG_ 544 VMMToHmiSetSetting6 "reserved";
CM_ SG_ 544 VMMToHmiSetSetting7 "reserved";
CM_ SG_ 544 VMMToHmiSetSetting8 "reserved";
CM_ SG_ 544 WirelsChrgnPhonePwrPerc "0-100.00,means current smart phone charging percent.";
CM_ SG_ 544 WPCModuleSts "WPC charging status and exception status";
CM_ SG_ 544 WtrPmpAuxSts "Auxiliary water pump status.";
CM_ SG_ 565 ActvnOfTrCmptmtLi "CEM internal signal. PWM signal to control Luggage Illumination";
CM_ SG_ 565 BrkSysWarnIndcnReqSec "Secondary brake system warning indication request";
CM_ SG_ 565 CarLoctrActvnSts "Notification to telematics if the Car locator activation has failed. System1 for Exterior light AND System2 for Sound and signaling.";
CM_ SG_ 565 CcvmStsVlvBlkFlt "Valve blocked error.";
CM_ SG_ 565 CcvmStsVlvCalibSts "Valve calibration status.";
CM_ SG_ 565 CcvmStsVlvCmdPosnErr "Valve position command is not plausible.";
CM_ SG_ 565 CcvmStsVlvLoTErr "Valve lower-temp error.";
CM_ SG_ 565 CcvmStsVlvMoveSts "Valve move status.";
CM_ SG_ 565 CcvmStsVlvNVMFlt "Valve position memory is lost.";
CM_ SG_ 565 CcvmStsVlvOpenCircFlt "Valve open circuit fault.";
CM_ SG_ 565 CcvmStsVlvOverTErr "Valve over-temp error.";
CM_ SG_ 565 CcvmStsVlvOverTrvlFlt "Valve over-temp warning.";
CM_ SG_ 565 CcvmStsVlvOverTWarn "Valve over-travel error.";
CM_ SG_ 565 CcvmStsVlvOverUErr "Valve error due to the voltage over the maximum.";
CM_ SG_ 565 CcvmStsVlvPosn "Valve actual position.";
CM_ SG_ 565 CcvmStsVlvPosnCtrlTimeOutFlt "Valve position control is time out.";
CM_ SG_ 565 CcvmStsVlvPosnUkwnFlt "Valve position unkown fault.";
CM_ SG_ 565 CcvmStsVlvPreHeatgSts "Valve preheated status";
CM_ SG_ 565 CcvmStsVlvSelfLearnFlt "Valve self-learning fault.";
CM_ SG_ 565 CcvmStsVlvShoCircFlt "Valve short circuit fault.";
CM_ SG_ 565 CcvmStsVlvSpdLvlSts "Valve speed level status.";
CM_ SG_ 565 CcvmStsVlvUnderUErr "Valve error due to the voltage under the minimum";
CM_ SG_ 565 CcvVlvSts2PosSts "Valve Position Feedback";
CM_ SG_ 565 CcvVlvStsARC "Valves Alive Rolling Counter";
CM_ SG_ 565 CcvVlvStsIntFlt "Valve Internal Fualt Present";
CM_ SG_ 565 CcvVlvStsOprFlt "Valve Operational Fault Present";
CM_ SG_ 565 CcvVlvStsTrqSts "Valve Torque Feedback";
CM_ SG_ 565 ChdLockRightFailStsToHmi "Signal sent from the Driver door module to the Driver information module to inform if there is a failure in the electric child lock funtionality for right rear door";
CM_ SG_ 565 ChdPrtnLeftFailStsToHmi "Signal sent from the Driver door module to the Driver information module to inform if there is a failure in the electric child lock funtionality";
CM_ SG_ 565 ChrgLidAcSts "ChrgLidAcSts - Charge lid for Alternating current
Ukwn - Unknown status
Opend - Opened
Clsd - Closed";
CM_ SG_ 565 ChrgLidDCorAcDcSts "ChrgLidDCorAcDcSts - Charge lid Directc current OR Alternating current and  Direct current
Ukwn - Unknown status
Opend - Opened
Clsd - Closed";
CM_ SG_ 565 ChrgnSpd "Charging speed indication to driver in kph.";
CM_ SG_ 565 ClimaCmd "Indicates whether the climate sub-system is allowed by CELC to start a requested operation.";
CM_ SG_ 565 CmprFbCmprI "Compressor current";
CM_ SG_ 565 CmprFbCmprIPha "Compressor phase current";
CM_ SG_ 565 CmprFbCmprSpd "Compressor rotational speed";
CM_ SG_ 565 CmprFbCmprSts1 "Compressor status";
CM_ SG_ 565 CmprFbCmprSts2 "Compressor status";
CM_ SG_ 565 CmprFbCmprT1 "Compressor IGBT temperature";
CM_ SG_ 565 CmprFbCmprT2 "Compressor capacitor/IGBT temperature";
CM_ SG_ 565 CmprFbCmprU "Compressor high voltage";
CM_ SG_ 565 CrashUnlckFailrSts "CrashUnlckFailrStsToHmi - Crash unlock failure status to HMI
When a fault is detected, that may lead to that the vehicle side doors are not correctly unlocked at impact, the driver shall be warned via HMI. The warning shall be shown when this signal is equal to OnOffSafeOn.";
CM_ SG_ 565 DrvrSeatHeatgAutoSts "Automatic status feedback signal for seats heating of first row left.";
CM_ SG_ 565 DrvrSeatVentnAutoSts "Automatic status feedback signal for seats ventilation of first row left.";
CM_ SG_ 565 Edcp2PmpStsCooltPmpDryErr "water pump MT Dryrun error";
CM_ SG_ 565 Edcp2PmpStsCooltPmpEmgyModSts "water pump MT, Status Emergency mode";
CM_ SG_ 565 Edcp2PmpStsCooltPmpErrSts "water pump error status";
CM_ SG_ 565 Edcp2PmpStsCooltPmpI "Actual current consumption";
CM_ SG_ 565 Edcp2PmpStsCooltPmpIErr "water pump MT current error";
CM_ SG_ 565 Edcp2PmpStsCooltPmpMonrSpd "water pump MT, RPM Monitoring";
CM_ SG_ 565 Edcp2PmpStsCooltPmpPostRunSts "water pump post run status";
CM_ SG_ 565 Edcp2PmpStsCooltPmpSetPostRunReq "water pump set post run speed request";
CM_ SG_ 565 Edcp2PmpStsCooltPmpSetSpdReq "water pump MT Set speed";
CM_ SG_ 565 Edcp2PmpStsCooltPmpSpd "Actual speed from coolant pump";
CM_ SG_ 565 Edcp2PmpStsCooltPmpT "water pump MT Temperature";
CM_ SG_ 565 Edcp2PmpStsCooltPmpTErr "water pump MT temperature error";
CM_ SG_ 565 Edcp2PmpStsCooltPmpU "water pump MT Voltage";
CM_ SG_ 565 Edcp2PmpStsCooltPmpUErr "water pump MT voltage error";
CM_ SG_ 565 Edcp2PmpStsCooltPmpUnstallSts "water pump MT, Deblocking";
CM_ SG_ 565 EngForbidRespFromVMM "response for Telematic that VMM had received EngForbidReq and stored in NVM";
CM_ SG_ 565 EpbApplyEnaSec "EPB software apply button enable.";
CM_ SG_ 565 EpbRelsEnaSec "EPB software release button enable.";
CM_ SG_ 565 ErsCmdByKey "Signaling Engine Remote Start commands from the keyfob.

- ErsCmdNotSet: No ERS command active
- ErsCmdOn: Keyfob command to start ERS
- ErsCmdOff: Keyfob command to stop ERS";
CM_ SG_ 565 HctvStsVlvBlkFlt "Valve blocked error.";
CM_ SG_ 565 HctvStsVlvCalibSts "Valve calibration status.";
CM_ SG_ 565 HctvStsVlvCmdPosnErr "Valve position command is not plausible";
CM_ SG_ 565 HctvStsVlvLoTErr "Valve lower-temp error";
CM_ SG_ 565 HctvStsVlvMoveSts "Valve move status";
CM_ SG_ 565 HctvStsVlvNVMFlt "Valve position memory is lost.";
CM_ SG_ 565 HctvStsVlvOpenCircFlt "Valve open circuit fault.";
CM_ SG_ 565 HctvStsVlvOverTErr "Valve over-temp error.";
CM_ SG_ 565 HctvStsVlvOverTrvlFlt "Valve over-temp warning.";
CM_ SG_ 565 HctvStsVlvOverTWarn "Valve over-travel error.";
CM_ SG_ 565 HctvStsVlvOverUErr "Valve error due to the voltage over the maximum.";
CM_ SG_ 565 HctvStsVlvPosn "Valve actual position.";
CM_ SG_ 565 HctvStsVlvPosnCtrlTimeOutFlt "Valve position control is time out.";
CM_ SG_ 565 HctvStsVlvPosnUkwnFlt "Valve position unkown fault.";
CM_ SG_ 565 HctvStsVlvPreHeatgSts "Valve preheated status";
CM_ SG_ 565 HctvStsVlvSelfLearnFlt "Valve self-learning fault.";
CM_ SG_ 565 HctvStsVlvShoCircFlt "Valve short circuit fault.";
CM_ SG_ 565 HctvStsVlvSpdLvlSts "Valve speed level status.";
CM_ SG_ 565 HctvStsVlvUnderUErr "Valve error due to the voltage under the minimum";
CM_ SG_ 565 HmiDefrstrElecStsFrnt "Front windscreen, rear window and exterior rear view mirror electrical defroster status as indicated in the HMI (does not reflect when the defrosters have been activated by climate control hidden from driver). Includes information regarding how they have been activated and their availability.";
CM_ SG_ 565 HmiDefrstrElecStsMirrr "Front windscreen, rear window and exterior rear view mirror electrical defroster status as indicated in the HMI (does not reflect when the defrosters have been activated by climate control hidden from driver). Includes information regarding how they have been activated and their availability. ";
CM_ SG_ 565 HmiDefrstrElecStsRe "Front windscreen, rear window and exterior rear view mirror electrical defroster status as indicated in the HMI (does not reflect when the defrosters have been activated by climate control hidden from driver). Includes information regarding how they have been activated and their availability. ";
CM_ SG_ 565 HvBattPmpStatCooltPmpDryErr "water pump MT Dryrun error";
CM_ SG_ 565 HvBattPmpStatCooltPmpEmgyModSts "water pump MT, Status Emergency mode";
CM_ SG_ 565 HvBattPmpStatCooltPmpErrSts "water pump error status";
CM_ SG_ 565 HvBattPmpStatCooltPmpI "Actual current consumption from battery coolant pump.";
CM_ SG_ 565 HvBattPmpStatCooltPmpIErr "water pump MT current error";
CM_ SG_ 565 HvBattPmpStatCooltPmpMonrSpd "water pump MT, RPM Monitoring";
CM_ SG_ 565 HvBattPmpStatCooltPmpPostRunSts "water pump post run status";
CM_ SG_ 565 HvBattPmpStatCooltPmpSetPostRunReq "water pump set post run speed request";
CM_ SG_ 565 HvBattPmpStatCooltPmpSetSpdReq "Coolant pump set speed request";
CM_ SG_ 565 HvBattPmpStatCooltPmpSpd "Coolant pump actual speed";
CM_ SG_ 565 HvBattPmpStatCooltPmpT "water pump MT Temperature ";
CM_ SG_ 565 HvBattPmpStatCooltPmpTErr "water pump MT temperature error";
CM_ SG_ 565 HvBattPmpStatCooltPmpU "Coolant pump voltage";
CM_ SG_ 565 HvBattPmpStatCooltPmpUErr "water pump MT voltage error";
CM_ SG_ 565 HvBattPmpStatCooltPmpUnstallSts "water pump MT, Deblocking";
CM_ SG_ 565 HvCooltHeatrICnsSig "contains information of how much current that is consumed  from the high voltage supply.";
CM_ SG_ 565 HvHeatrPwrCnsDes "Desired power consumption for the HVCH.";
CM_ SG_ 565 ImobMgrWarnIndcn "RVI warning to be shown in DIM";
CM_ SG_ 565 KeyNotPrsntMsgToDrvr "Trigger HMI message regarding a non present key.";
CM_ SG_ 565 MotConsDrvCyc "Cumulatived charge amount of all motors in this driving cycle";
CM_ SG_ 565 PinionSteerAgMax1 "PinionSteerAgMax1 contains the current maximal pinion angle. Depends on tire size and vehicle type.";
CM_ SG_ 565 PostHeatgRunTiEstimd "Estimated heating afterrun time.";
CM_ SG_ 565 PrpsnErrIndcnReq "MIL signal sent to DIM";
CM_ SG_ 565 RlyPwrDistbnCmd1WdIgnRlyExtCmd "status of the ignition extended relay";
CM_ SG_ 565 SteerWhlHeatgAvlSts "Steering wheel heating activation, deactivation, unavailable and error status.";
CM_ SG_ 565 SteerWhlHeatgStrtAutCdnOk "Information about if it is OK to start the steering wheel heating automatically";
CM_ SG_ 565 StrtInProgs "Indicating to HMI that a driver start is initiated";
CM_ SG_ 565 StrtMsgToDrvr "Signal to HMI used for messages to driver related to start and turning off the engine";
CM_ SG_ 565 SysDirIndcnFailr "Indication of Direction Indicator system failure to the driver.

Values:
No Fault or Fault.";
CM_ SG_ 565 TInCooltAtStrtOfClima "Temperature measured by the heater in the coolant at the start of the latest pre-conditioning.";
CM_ SG_ 565 TrAntiPnch "Contains info if POT motor anti-pinch is activated or not";
CM_ SG_ 565 TrObstclDetn "TrObstclDetn - Trunk Obstacle Detection
Signal if obstacle is detected by trunk while opening.
False - No obstacle detected
True - Obstacle detected";
CM_ SG_ 1154 BattSnsrStReq "Battery sensor state";
CM_ SG_ 1154 BrkLiReqRegenChks "checksum";
CM_ SG_ 1154 BrkLiReqRegenCntr "counter";
CM_ SG_ 1154 BrkLiReqRegenOnOff "Brake light illumination request for regeneration.";
CM_ SG_ 1154 DHTStSafeChks "Chechsum";
CM_ SG_ 1154 DHTStSafeCntr "Rolling Counter";
CM_ SG_ 1154 DHTStSafeRsv "Reserved for FuSa";
CM_ SG_ 1154 DHTStSafeSpd "P1 actual speed";
CM_ SG_ 1154 DHTStSafeSpdQf "P1 actual speed quality factor";
CM_ SG_ 1154 DHTStSafeTqRt "Actual gear ratio";
CM_ SG_ 1154 DHTStSafeTqRtQf "Actual gear ratio quality factor";
CM_ SG_ 1154 DtEngdStDtEngdFrnt "Drivetrain engaged, front wheels";
CM_ SG_ 1154 DtEngdStDtEngdRe "Drivetrain engaged, rear wheels";
CM_ SG_ 1154 DtEngdStDtNotEngdFrnt "Drivetrain not engaged, front wheels";
CM_ SG_ 1154 DtEngdStDtNotEngdRe "Drivetrain not engaged, rear wheels";
CM_ SG_ 1154 ElecMot2ErrIndcnReq "MIL ilumination req from EM2";
CM_ SG_ 1154 ElecMot2LimnIndcn "LOS signal";
CM_ SG_ 1154 ElecMot2UDc "HVDC voltage";
CM_ SG_ 1154 EngRunngReqByTrsm "Engine running request from transmission. Supplier request engine running to prevent stalling when transmisson is disengaged. 2 bit signal. 0 - Default, 1 - Inhibit Stop, 2 - Running Requested, 3 - Reserved.";
CM_ SG_ 1154 HwRowFrstPassFldRsdSwt "Passenger Seat Fold Rise Switch Signal";
CM_ SG_ 1154 IsgActvDampgModReq "Mode signal for ISG damping. 0 = No damping; 1 = Low damping; 2 = Medium damping; 3 = High damping";
CM_ SG_ 1154 IsgModReq "Mode request for ISG motor drive system.";
CM_ SG_ 1154 IsgPwrLimMax "Maximum ISG motor drive system powerlimit on DC side. Positive power means power flowing into inverter.";
CM_ SG_ 1154 IsgPwrLimMin "Minimum ISG motor drive system powerlimit on DC side. Positive power means power flowing into inverter.";
CM_ SG_ 1154 IsgSpdReq "ISG speed request for engine speed control by ISG.";
CM_ SG_ 1154 IsgTqAllwdChks "Checksum for IsgTqAllwd";
CM_ SG_ 1154 IsgTqAllwdCntr "Counter for IsgTqAllwd";
CM_ SG_ 1154 IsgTqAllwdIsgTqAllwd "Indication if ISG is allowed to apply propulsive or regenerative torque on wheels.";
CM_ SG_ 1154 OvrdDecelByDrvrChks "Reports the driver intent to override a deceleration. Based on Accelerator pedal being distinctively pressed.checksum";
CM_ SG_ 1154 OvrdDecelByDrvrCntr "Reports the driver intent to override a deceleration. Based on Accelerator pedal being distinctively pressed.checksum";
CM_ SG_ 1154 OvrdDecelByDrvrOvrdDecelByDrvr "Reports the driver intent to override a deceleration. Based on Accelerator pedal being distinctively pressed.";
CM_ SG_ 1154 ParkByDrvrWhlsFrntSafeChks "Checksum of ParkByDrvrWhlsFrntSafe";
CM_ SG_ 1154 ParkByDrvrWhlsFrntSafeCntr "Counter of ParkByDrvrWhlsFrntSafe";
CM_ SG_ 1154 ParkByDrvrWhlsFrntSafeSts "Front wheels safe status when parking by driver.";
CM_ SG_ 1154 PropLgtCtrlModCfmdChks "Checksum for PropLgtCtrlModCfmd";
CM_ SG_ 1154 PropLgtCtrlModCfmdCntr "Counter for PropLgtCtrlModCfmd";
CM_ SG_ 1154 PropLgtCtrlModCfmdLgtDegradation "Defradation status for longitudinal control mode";
CM_ SG_ 1154 PropLgtCtrlModCfmdPropLgtCtrlModCfmd "Describe which longitudinal control mode is actived ";
CM_ SG_ 1154 PrpsnTqFrntReq "Propulsion wheel torque request at front wheel axle. This request is arbitrated from driver request and autonomous driving functions (CC, ACC, etc) requests. The torque includes effects from auxiliary loads, transmissions, etc.";
CM_ SG_ 1154 PrpsnTqReReq "Propulsion wheel torque request at rear wheel axle. This request is arbitrated from driver request and autonomous driving functions (CC, ACC, etc) requests. The torque includes effects from auxiliary loads, transmission, etc.";
CM_ SG_ 1154 PtAllwdToTrsmActrSafeChks "Checksum for PtAllwdToTrsmActr";
CM_ SG_ 1154 PtAllwdToTrsmActrSafeCntr "Counter for PtAllwdToTrsmActr";
CM_ SG_ 1154 PtAllwdToTrsmActrSafePtAllwdToTrsmActr "Powertrain allowed to transmission actuator.";
CM_ SG_ 1154 PtBrkTqCpTot1 "Powertrain total brake torque capacity, including zero accelerator pedal coast retardation torque.";
CM_ SG_ 1154 PtBrkTqCpTotQf "Quality factor";
CM_ SG_ 1154 PtGearRatFrntAct "The signal is used to conclude if a tire lost contact with the road surface.";
CM_ SG_ 1154 PtGearTar "Target gear is for most cases identical to actual gear. The value differs to actual gear during gear shifts and for a hybrid when in electric mode.";
CM_ SG_ 1154 PtJTotAtTrsmAxleOutp "Total aggregated powertrain inertia at transmission output axle including final drive, before left/right differential, and before front/rear differental.";
CM_ SG_ 1154 PtJTotChks "Checksum of Total aggregated powertrain inertia at transmission output axle including final drive, before left/right differential, and before front/rear differental.";
CM_ SG_ 1154 PtJTotCntr "Rollingcounter of Total aggregated powertrain inertia at transmission output axle including final drive, before left/right differential, and before front/rear differental.";
CM_ SG_ 1154 PtRgnTarTqAtReAxleAtReAxle "powertrain regeneration target torque at rear axle";
CM_ SG_ 1154 PtRgnTarTqAtReAxleQf "Quality factor";
CM_ SG_ 1154 PtTotRgnTarTq1 "powertrain total regeneration target torque";
CM_ SG_ 1154 PtTotRgnTarTqQf "Quality factor";
CM_ SG_ 1154 PtTqAtAxleAvlFrntMax "Available propulsion maximum torque at front wheel axle, mean value of right and left wheels. Sign definition: A positive torque will accelerate the vehicle in the driver desired direction. ";
CM_ SG_ 1154 PtTqAtAxleAvlFrntMin "Available propulsion munimum torque at front wheel axle, mean value of right and left wheels. Sign definition: A positive torque will accelerate the vehicle in the driver desired direction. ";
CM_ SG_ 1154 PtTqAtAxleAvlReMax "Available propulsion maximum torque at rear wheel axle, mean value of right and left wheels. Sign definition: A positive torque will accelerate the vehicle in the driver desired direction. ";
CM_ SG_ 1154 PtTqAtAxleAvlReMin "Available propulsion minimum torque at rear wheel axle, mean value of right and left wheels. Sign definition: A positive torque will accelerate the vehicle in the driver desired direction. ";
CM_ SG_ 1154 PtWhlTqTar "Powertrain final torque request on the wheel";
CM_ SG_ 1154 RlyCrashForHvsysReq "Request to CEM to close crash relay.";
CM_ SG_ 1154 TrsmActrPosn2TrsmActrPosn "Describes the transmission position (P, R, N, D). Can also take intermediate positions (PR, RN, ND). If error are detected on position sensors undefined is set. Transmission measured gear lever position";
CM_ SG_ 1154 TrsmActrPosn2TrsmActrPosnChks "E2E checksum";
CM_ SG_ 1154 TrsmActrPosn2TrsmActrPosnCntr "Data counter";
CM_ SG_ 1154 TrsmGearAct "Transmission Gear Actual. Actual gear engaged sent by transmission supplier.";
CM_ SG_ 1154 TrsmGearChgProgs "Transmission gear change in progress. Transmission supplier sent signal containing informatoin regarding which phase the gear shift is in. 0 - not changing gear, 1 - start phase, 2 - tourqe phase, 3 - inertia phase, 4 - end phase.";
CM_ SG_ 1154 TrsmGearNotAvlSts "TCM use signal Trsm Gear Not Available Status to inform ECM which gears is unavailable for gear shifting.Signal is used during failsafe operation Availability mode.Default 0-no gears unavailable.Bit 0-First gear EB not available.Bit 1-First gear not available.Bit X-Xth gear not available";
CM_ SG_ 1154 TrsmGearRat "Transmission gear ratio. Ratio between rotational speed on ingoing shaft and outgoing shaft.";
CM_ SG_ 1154 TrsmGearRatTar "Transmission gear ratio target. Target gear ratio for fix lock-up and current gear.";
CM_ SG_ 1154 TrsmGearTar " Transmission gear target. Target gear recieved by transmission supplier. 0 - neutral disengaged, 1-13 - gear 1-13, 14 - unknown, 15 - reverse.";
CM_ SG_ 528 DrvrSeatHeatgActlPwrCns "Actual power consumption for driver seat climate, including ventilation and heating.";
CM_ SG_ 528 DrvrSeatHeatgDesPwrCns "Desired power consumption for driver seat climate, including ventilation and heating.";
CM_ SG_ 528 DrvrSeatVentnActlPwrCns "Actual driver seat ventilation power consumption.";
CM_ SG_ 528 DrvrSeatVentnDesPwrCns "Desired driver seat ventilation power consumption.";
CM_ SG_ 528 DstEstimdToEmptyForDrvgElecPredTyp2 "Predicted distance till empty in economic driving behavior of type 2.";
CM_ SG_ 528 DstTrvldAct "Actual Total Travlled Distance after Last Reset, in km";
CM_ SG_ 528 DstTrvldOfEng "Travlled Distance after Last Reset (Engine), in km";
CM_ SG_ 528 DstTrvldOfEV "Travlled Distance after Last Reset (EV), in km";
CM_ SG_ 528 ElecMot2InvrT "Temperature of the inverter";
CM_ SG_ 528 ElecMot2MotT "Temperature of the auxiliary motor";
CM_ SG_ 528 EPedlDrvrIndcnMsg "E-pedal pop out message driver indication.";
CM_ SG_ 528 EPedlInhbnSts "E-Pedal inhibit flag.";
CM_ SG_ 528 ErsDelayTiCfm "response to Telematics when received the signal TelmEngDelayTi";
CM_ SG_ 528 ErsStrtRes "Result of the latest ErsOn cmd attempt or, if last ERS run was aborted, the reason for that abort";
CM_ SG_ 528 HealthOfEngOil "Health of Engine Oil";
CM_ SG_ 528 HpcDeiceReq "Deice request from heat pump.";
CM_ SG_ 528 HpcHpCoolgPwrSts "Whether heat pump satisfies cooling request of climate control.";
CM_ SG_ 528 HpcHpHeatgPwrSts "Whether heat pump satisfies heating request of climate control.";
CM_ SG_ 528 HpcHpModReq "Heat pump mode request.";
CM_ SG_ 528 HvacCooltFlowAct "Actual coolant flow through HVAC unit generated by the engine coolant system control. (l/min)";
CM_ SG_ 528 HvacCooltVlvStsSig "HW heating three-way valve status in EMA or CMA1.5";
CM_ SG_ 528 HvBattThermPwrCns "High voltage power consumption for battery thermal management.";
CM_ SG_ 528 HvCabinThermPwrCns "High voltage power consumption for AC cabin cooling or heating.";
CM_ SG_ 528 HvCooltHeatrEnad "HVCH enable signal sent by thermal management.";
CM_ SG_ 528 HvCooltHeatrStsSig "Informs of HVCH status.";
CM_ SG_ 528 HvSysRlyStsChks "Checksum for E2E";
CM_ SG_ 528 HvSysRlyStsCntr "Counter for E2E";
CM_ SG_ 528 HvSysRlyStsHvSysRlySts "Actual state of the main contactors.";
CM_ SG_ 528 ISecDcDcActHiSide "Actual measured current on the HV side of second DCDC";
CM_ SG_ 528 NatUsgDayOfOil "Natural Using Days of Engine Oil after Last Reset";
CM_ SG_ 528 OilHealthIfDisp "The flag for whether to display the oil health signal or not";
CM_ SG_ 528 PEMState "Predict energy management state";
CM_ SG_ 528 RainSnsrStsToHMI "Information regarding when the rain sensor function is turned on and in control of the wipers. ";
CM_ SG_ 528 RemindChrgn "When the vehicle is in the commonly used charging place and meets the commonly used charging time, and the deviation between the current SOC and the commonly charged SOC is within a certain range, this signal should be used to inform the large screen to remind the user.";
CM_ SG_ 528 RoadInFor "Indicates the current road condition information";
CM_ SG_ 528 SeatOccptAtRowSecMid2 "Describes if an occupant is detected in the  seat.";
CM_ SG_ 528 SeatOccptAtRowSecMidSnsSts2 "Informs if there is a fault on the driver seat sensor is detected through electrical measurements, or plausibility judgement. NotOk means sensor is judged as faulty. Di means that the sensor is not configured.";
CM_ SG_ 528 SlopReducEngCoeffSlopEqu12 "Energy consumption reduce coefficiency at road slopes=-12 degrees.";
CM_ SG_ 528 SlopReducEngCoeffSlopEqu2 "Energy consumption reduce coefficiency at road slopes=-2 degrees.";
CM_ SG_ 528 SlopReducEngCoeffSlopEqu4 "Energy consumption reduce coefficiency at road slopes=-4 degrees.";
CM_ SG_ 528 SlopReducEngCoeffSlopEqu6 "Energy consumption reduce coefficiency at road slopes=-6 degrees.";
CM_ SG_ 528 SlopReducEngCoeffSlopEqu9 "Energy consumption reduce coefficiency at road slopes=-9 degrees.";
CM_ SG_ 528 SlopRiseEngCoeffSlopEqu12 "Energy consumption rise coefficiency at road slopes=12 degrees.";
CM_ SG_ 528 SlopRiseEngCoeffSlopEqu2 "Energy consumption rise coefficiency at road slopes=2 degrees.";
CM_ SG_ 528 SlopRiseEngCoeffSlopEqu4 "Energy consumption rise coefficiency at road slopes=4 degrees.";
CM_ SG_ 528 SlopRiseEngCoeffSlopEqu6 "Energy consumption rise coefficiency at road slopes=6 degrees.";
CM_ SG_ 528 SlopRiseEngCoeffSlopEqu9 "Energy consumption rise coefficiency at road slopes=9 degrees.";
CM_ SG_ 528 SpdRelatWghtSpdEqu10 "Energy consumption coefficiency at vehicle speeds=10kph.";
CM_ SG_ 528 SpdRelatWghtSpdEqu100 "Energy consumption coefficiency at vehicle speeds=100kph.";
CM_ SG_ 528 SpdRelatWghtSpdEqu120 "Energy consumption coefficiency at vehicle speeds=120kph.";
CM_ SG_ 528 SpdRelatWghtSpdEqu140 "Energy consumption coefficiency at vehicle speeds=140kph.";
CM_ SG_ 528 SpdRelatWghtSpdEqu20 "Energy consumption coefficiency at vehicle speeds=20kph.";
CM_ SG_ 528 SpdRelatWghtSpdEqu40 "Energy consumption coefficiency at vehicle speeds=40kph.";
CM_ SG_ 528 SpdRelatWghtSpdEqu60 "Energy consumption coefficiency at vehicle speeds=60kph.";
CM_ SG_ 528 SpdRelatWghtSpdEqu80 "Energy consumption coefficiency at vehicle speeds=80kph.";
CM_ SG_ 528 SwtStrt3 "one way knob --Start device actuated";
CM_ SG_ 528 SwtStrt4 "one way button --Start device actuated";
CM_ SG_ 528 TotDstTrvldOfEng "Total Travlled Distance(Engine), in km";
CM_ SG_ 528 TotDstTrvldOfEV "Total Travlled Distance(EV), in km";
CM_ SG_ 528 TrOpenerByFootOperCmd "TrOpenerByFootOperCmd - Command for FMDM (Foot Movement Detection Module)
This signal is used to activate or deactivate FMDM foor movement detection.
On - Foot movement detection ON
Off - Foot movement detection OFF";
CM_ SG_ 528 WiprActvFromWMM "Information regarding wiper activation";
CM_ SG_ 880 AccrPedlLnrAccrPedlRat "CVC filtered accelerator pedal";
CM_ SG_ 880 AccrPedlLnrChks "checksum";
CM_ SG_ 880 AccrPedlLnrCntr "counter";
CM_ SG_ 880 AccrPedlNotCmplPsd "Indicate if the accelerator pedal is not fully pressed. Indicate Yes if it is secured to ASIL-A that the accelerator pedal is not fully pressed. Safe state=No";
CM_ SG_ 880 AccrPedlNotCmplPsdChks "Indicate if the accelerator pedal is not fully pressed. Checksum";
CM_ SG_ 880 AccrPedlNotCmplPsdCntr "Indicate if the accelerator pedal is not fully pressed. Counter";
CM_ SG_ 880 AccrPedlNotCmplPsdSts "Indicate if the accelerator pedal is not fully pressed. If set, then AccrPedlNotCmpl fulfill ASIL-B integrity";
CM_ SG_ 880 AccrPedlRatGrdt "Derivative of accelerator pedal position.";
CM_ SG_ 880 AmbTURaw "Ambient temp raw data in deg C";
CM_ SG_ 880 CrsCtrlrActvnOk "The signal informs if Cruise Controller can be activated or not. Primarily used by HMI to know if Cruise Controller activation requests by driver should be ignored or not.";
CM_ SG_ 880 DeactvtTestCom "Scantool communication on/ff0=on=scantool communication is on1=off=scantool communication is off.";
CM_ SG_ 880 DrvrPrpsnTqReq "Torque request from driver via accelerator pedal.";
CM_ SG_ 880 EngPAmbAir "Ambient pressure";
CM_ SG_ 880 EngPwrCns "The current actual power consumption of power train.";
CM_ SG_ 880 ImobBrkNrSerlReq "ECM request to BCM to send serial number used for immo authentication.";
CM_ SG_ 880 ImobEngSts1 "ECM CEM immo status. Can be undefined, immobilised, motive mobilised or non motive mobilised.";
CM_ SG_ 880 ImobEngSts3 "IGM CEM message immo status. Undefined, immobilised, motive mobilised or non motive mobilised.";
CM_ SG_ 880 PtDtModReq "Drivetrain mode request(EV/Serial/Parallel)";
CM_ SG_ 880 PtReqToTrsmActr "Request to transmission actuator (PRND)";
CM_ SG_ 880 PtTqTotDrgAtWhls "Propulsion torque level at zero accelerator pedal position.";
CM_ SG_ 880 SwtTrClsSts "SwtTrClsSts - Close Tailgate/Bootlid switch status

Status signal for shutface close switch.

Psd - Pressed
NotPsd - Not Pressed";
CM_ SG_ 880 ThermFctReq "Request from ThermalManagement to set usage mode to inactive";
CM_ SG_ 880 TrsmCluTEstimdOfClu0 "Clutch C0 temperature";
CM_ SG_ 880 TrsmErrIndcnReq "TCM uses signal Transmission Error Indication Request to send a MIL-request to ECM. ECM will then act upon this request and iluminate the MIL. For VEP software, TCM transmits signal after two consecutive failed driving cycles (for a MIL-relevant code). Default value - 0 (Off)";
CM_ SG_ 880 TrsmHotSt "Transmission hot state. Indicate transmission is in hot state. 0 - Not in hot state, 1 - Hot state level 1, 2 - Hot state level 2.";
CM_ SG_ 880 TrsmShiftInhb "Transmission Shift Inhibit. Block shifting request signal sent from transmission supplier. 0 - shift inhibit not active, 1 - Shift inhibit active.";
BA_DEF_ BO_ "CANFD_BRS" ENUM "0","1";
BA_DEF_ BO_ "GenMsgCycleTime" INT 0 65536; // [ms]
BA_DEF_ BO_ "GenMsgDelayTime" INT 0 65536; // [ms]
BA_DEF_ BO_ "GenMsgSendType" ENUM "cyclic", "spontaneous", "not-used", "not-used", "not-used", "cyclicAndSpontaneous", "not-used", "cyclicIfActive", "NoMsgSendType"; // [us]
BA_DEF_ BO_ "GenMsgStartDelayTime" INT 0 65536; // [ms]
BA_DEF_ BO_ "VFrameFormat" ENUM "StandardCAN","ExtendedCAN","reserved","J1939PG","reserved","reserved","reserved","reserved","reserved","reserved","reserved","reserved","reserved","reserved","StandardCAN_FD","ExtendedCAN_FD";
BA_DEF_ SG_ "GenSigSendType" ENUM "Cyclic","OnWrite","OnWriteWithRepetition","OnChange","OnChangeWithRepetition","IfActive","IfActiveWithRepetition","NoSigSendType";
BA_DEF_ SG_ "GenSigStartValue" HEX 0 80000000;
BA_DEF_ BO_ "GenMsgILSupport" ENUM "No","Yes";
BA_DEF_ BO_ "NmAsrMessage" ENUM "No","Yes";
BA_DEF_ SG_ "GenSigFuncType" ENUM "NoFunction","n/a","n/a","n/a","n/a","n/a","n/a","n/a","n/a","n/a","n/a","n/a","n/a","n/a","n/a","CHK","CNTR","n/a","n/a","n/a","CNTR_AR_01","CRC_AR_01_BOTH","CRC_AR_01_ALT","CRC_AR_01_LOW","CRC_AR_01_NIBBLE","CNTR_AR_04","CRC_AR_04A","CNTR_AR_05","CRC_AR_05";
BA_DEF_ SG_ "GenSigDataID" STRING;
BA_DEF_DEF_ "CANFD_BRS" "1";
BA_DEF_DEF_ "GenSigStartValue" 0;
BA_DEF_DEF_ "VFrameFormat" "J1939PG";
BA_DEF_DEF_ "GenSigSendType" "NoSigSendType";
BA_DEF_DEF_ "GenMsgCycleTime" 0;
BA_DEF_DEF_ "GenMsgDelayTime" 0;
BA_DEF_DEF_ "GenMsgStartDelayTime" 0;
BA_DEF_DEF_ "GenMsgSendType" "NoMsgSendType";
BA_DEF_DEF_ "GenMsgILSupport" "Yes";
BA_DEF_DEF_ "NmAsrMessage" "No";
BA_DEF_DEF_ "GenSigFuncType" "NoFunction";
BA_DEF_DEF_ "GenSigDataID" "";
// Frame: ZCUDZCUCANFD2Fr10
BA_ "GenMsgCycleTime" BO_ 434 100.000;
BA_ "GenMsgSendType" BO_ 434 0;
BA_ "VFrameFormat" BO_ 434 14;
// Frame: ZCUDZCUCANFD2Fr11
BA_ "GenMsgCycleTime" BO_ 544 250.000;
BA_ "GenMsgSendType" BO_ 544 0;
BA_ "VFrameFormat" BO_ 544 14;
// Frame: ZCUDZCUCANFD2Fr12
BA_ "GenMsgCycleTime" BO_ 565 300.000;
BA_ "GenMsgSendType" BO_ 565 0;
BA_ "VFrameFormat" BO_ 565 14;
// Frame: ZCUDZCUCANFD2Fr13
BA_ "GenMsgCycleTime" BO_ 1154 900.000;
BA_ "GenMsgSendType" BO_ 1154 0;
BA_ "VFrameFormat" BO_ 1154 14;
// Frame: ZCUDZCUCANFD2Fr14
BA_ "GenMsgCycleTime" BO_ 528 200.000;
BA_ "GenMsgSendType" BO_ 528 0;
BA_ "VFrameFormat" BO_ 528 14;
// Frame: ZCUDZCUCANFD2Fr15
BA_ "GenMsgCycleTime" BO_ 880 700.000;
BA_ "GenMsgSendType" BO_ 880 0;
BA_ "VFrameFormat" BO_ 880 14;
BA_ "GenSigSendType" SG_ 880 AccrPedlLnrAccrPedlRat 0;
BA_ "GenSigDataID" SG_ 880 AccrPedlLnrChks "0x2C3";
BA_ "GenSigFuncType" SG_ 880 AccrPedlLnrChks 15;
BA_ "GenSigSendType" SG_ 880 AccrPedlLnrChks 0;
BA_ "GenSigFuncType" SG_ 880 AccrPedlLnrCntr 16;
BA_ "GenSigSendType" SG_ 880 AccrPedlLnrCntr 0;
BA_ "GenSigSendType" SG_ 880 AccrPedlNotCmplPsd 0;
BA_ "GenSigDataID" SG_ 880 AccrPedlNotCmplPsdChks "0xCD";
BA_ "GenSigFuncType" SG_ 880 AccrPedlNotCmplPsdChks 15;
BA_ "GenSigSendType" SG_ 880 AccrPedlNotCmplPsdChks 0;
BA_ "GenSigStartValue" SG_ 880 AccrPedlNotCmplPsdChks 255;
BA_ "GenSigFuncType" SG_ 880 AccrPedlNotCmplPsdCntr 16;
BA_ "GenSigSendType" SG_ 880 AccrPedlNotCmplPsdCntr 0;
BA_ "GenSigSendType" SG_ 880 AccrPedlNotCmplPsdSts 0;
BA_ "GenSigSendType" SG_ 880 AccrPedlRatGrdt 0;
BA_ "GenSigSendType" SG_ 434 ActtnCtrlActvFlg 0;
BA_ "GenSigSendType" SG_ 565 ActvnOfTrCmptmtLi 0;
BA_ "GenSigSendType" SG_ 434 AmbIllmnFwdStsAmblillmn1 0;
BA_ "GenSigSendType" SG_ 434 AmbIllmnFwdStsAmblillmn2 0;
BA_ "GenSigSendType" SG_ 434 AmbIllmnFwdStsChks 0;
BA_ "GenSigSendType" SG_ 434 AmbIllmnFwdStsCntr 0;
BA_ "GenSigSendType" SG_ 880 AmbTURaw 0;
BA_ "GenSigStartValue" SG_ 880 AmbTURaw 700;
BA_ "GenSigSendType" SG_ 544 BattLoStsFild 0;
BA_ "GenSigSendType" SG_ 1154 BattSnsrStReq 0;
BA_ "GenSigSendType" SG_ 434 BookChrgnStsFb 0;
BA_ "GenSigDataID" SG_ 1154 BrkLiReqRegenChks "0x1B5F";
BA_ "GenSigFuncType" SG_ 1154 BrkLiReqRegenChks 15;
BA_ "GenSigSendType" SG_ 1154 BrkLiReqRegenChks 0;
BA_ "GenSigFuncType" SG_ 1154 BrkLiReqRegenCntr 16;
BA_ "GenSigSendType" SG_ 1154 BrkLiReqRegenCntr 0;
BA_ "GenSigSendType" SG_ 1154 BrkLiReqRegenOnOff 0;
BA_ "GenSigSendType" SG_ 565 BrkSysWarnIndcnReqSec 0;
BA_ "GenSigSendType" SG_ 544 BtnLockSts 0;
BA_ "GenSigSendType" SG_ 565 CarLoctrActvnSts 0;
BA_ "GenSigStartValue" SG_ 565 CcvVlvSts2PosSts 170.6666634;
BA_ "GenSigSendType" SG_ 565 ChdLockRightFailStsToHmi 0;
BA_ "GenSigStartValue" SG_ 565 ChdLockRightFailStsToHmi 2;
BA_ "GenSigSendType" SG_ 565 ChdPrtnLeftFailStsToHmi 0;
BA_ "GenSigStartValue" SG_ 565 ChdPrtnLeftFailStsToHmi 2;
BA_ "GenSigSendType" SG_ 565 ChrgLidAcSts 0;
BA_ "GenSigSendType" SG_ 565 ChrgLidDCorAcDcSts 0;
BA_ "GenSigSendType" SG_ 544 ChrgStrtEngRes 0;
BA_ "GenSigSendType" SG_ 565 ChrgnSpd 0;
BA_ "GenSigSendType" SG_ 544 ClimRlyCmd 0;
BA_ "GenSigSendType" SG_ 565 ClimaCmd 0;
BA_ "GenSigSendType" SG_ 434 ClimaPwrAllwd 0;
BA_ "GenSigSendType" SG_ 565 CmprFbCmprI 0;
BA_ "GenSigSendType" SG_ 565 CmprFbCmprIPha 0;
BA_ "GenSigSendType" SG_ 565 CmprFbCmprSpd 0;
BA_ "GenSigSendType" SG_ 565 CmprFbCmprSts1 0;
BA_ "GenSigSendType" SG_ 565 CmprFbCmprSts2 0;
BA_ "GenSigSendType" SG_ 565 CmprFbCmprT1 0;
BA_ "GenSigStartValue" SG_ 565 CmprFbCmprT1 50;
BA_ "GenSigSendType" SG_ 565 CmprFbCmprT2 0;
BA_ "GenSigStartValue" SG_ 565 CmprFbCmprT2 50;
BA_ "GenSigSendType" SG_ 565 CmprFbCmprU 0;
BA_ "GenSigSendType" SG_ 544 CmptmtCoolgSts 0;
BA_ "GenSigSendType" SG_ 565 CrashUnlckFailrSts 0;
BA_ "GenSigStartValue" SG_ 565 CrashUnlckFailrSts 2;
BA_ "GenSigSendType" SG_ 880 CrsCtrlrActvnOk 0;
BA_ "GenSigDataID" SG_ 1154 DHTStSafeChks "0x1786";
BA_ "GenSigFuncType" SG_ 1154 DHTStSafeChks 15;
BA_ "GenSigSendType" SG_ 1154 DHTStSafeChks 0;
BA_ "GenSigFuncType" SG_ 1154 DHTStSafeCntr 16;
BA_ "GenSigSendType" SG_ 1154 DHTStSafeCntr 0;
BA_ "GenSigSendType" SG_ 1154 DHTStSafeRsv 0;
BA_ "GenSigSendType" SG_ 1154 DHTStSafeSpd 0;
BA_ "GenSigSendType" SG_ 1154 DHTStSafeSpdQf 0;
BA_ "GenSigSendType" SG_ 1154 DHTStSafeTqRt 0;
BA_ "GenSigSendType" SG_ 1154 DHTStSafeTqRtQf 0;
BA_ "GenSigSendType" SG_ 434 DcDcPwrLim 0;
BA_ "GenSigSendType" SG_ 880 DeactvtTestCom 0;
BA_ "GenSigSendType" SG_ 434 DispOfPrpsnPwrPercAct 0;
BA_ "GenSigSendType" SG_ 434 DispWhlMotSysPrpsnMod 0;
BA_ "GenSigSendType" SG_ 434 DrvrMassgRunng 0;
BA_ "GenSigSendType" SG_ 880 DrvrPrpsnTqReq 0;
BA_ "GenSigSendType" SG_ 528 DrvrSeatHeatgActlPwrCns 0;
BA_ "GenSigSendType" SG_ 565 DrvrSeatHeatgAutoSts 0;
BA_ "GenSigSendType" SG_ 544 DrvrSeatHeatgAvlSts 0;
BA_ "GenSigSendType" SG_ 528 DrvrSeatHeatgDesPwrCns 0;
BA_ "GenSigSendType" SG_ 434 DrvrSeatSts 0;
BA_ "GenSigStartValue" SG_ 434 DrvrSeatSts 1;
BA_ "GenSigSendType" SG_ 528 DrvrSeatVentnActlPwrCns 0;
BA_ "GenSigSendType" SG_ 565 DrvrSeatVentnAutoSts 0;
BA_ "GenSigSendType" SG_ 528 DrvrSeatVentnDesPwrCns 0;
BA_ "GenSigSendType" SG_ 544 DrvrSeatVentnLvlSts 0;
BA_ "GenSigSendType" SG_ 528 DstEstimdToEmptyForDrvgElecPredTyp2 0;
BA_ "GenSigSendType" SG_ 528 DstTrvldAct 0;
BA_ "GenSigSendType" SG_ 528 DstTrvldOfEV 0;
BA_ "GenSigSendType" SG_ 528 DstTrvldOfEng 0;
BA_ "GenSigSendType" SG_ 1154 DtEngdStDtEngdFrnt 0;
BA_ "GenSigSendType" SG_ 1154 DtEngdStDtEngdRe 0;
BA_ "GenSigSendType" SG_ 1154 DtEngdStDtNotEngdFrnt 0;
BA_ "GenSigSendType" SG_ 1154 DtEngdStDtNotEngdRe 0;
BA_ "GenSigSendType" SG_ 434 EasyLoadModIndcn 0;
BA_ "GenSigStartValue" SG_ 565 Edcp2PmpStsCooltPmpT 100;
BA_ "GenSigSendType" SG_ 434 EgyCnsAllwdForClima 0;
BA_ "GenSigSendType" SG_ 1154 ElecMot2ErrIndcnReq 0;
BA_ "GenSigSendType" SG_ 528 ElecMot2InvrT 0;
BA_ "GenSigStartValue" SG_ 528 ElecMot2InvrT 50;
BA_ "GenSigSendType" SG_ 1154 ElecMot2LimnIndcn 0;
BA_ "GenSigSendType" SG_ 528 ElecMot2MotT 0;
BA_ "GenSigStartValue" SG_ 528 ElecMot2MotT 50;
BA_ "GenSigSendType" SG_ 1154 ElecMot2UDc 0;
BA_ "GenSigSendType" SG_ 565 EngForbidRespFromVMM 0;
BA_ "GenSigSendType" SG_ 880 EngPAmbAir 0;
BA_ "GenSigSendType" SG_ 880 EngPwrCns 0;
BA_ "GenSigSendType" SG_ 1154 EngRunngReqByTrsm 0;
BA_ "GenSigSendType" SG_ 565 EpbApplyEnaSec 0;
BA_ "GenSigSendType" SG_ 565 EpbRelsEnaSec 0;
BA_ "GenSigSendType" SG_ 565 ErsCmdByKey 0;
BA_ "GenSigSendType" SG_ 528 ErsDelayTiCfm 0;
BA_ "GenSigSendType" SG_ 528 ErsStrtRes 0;
BA_ "GenSigSendType" SG_ 434 ExtrLiStsOfAssistantLi 0;
BA_ "GenSigSendType" SG_ 544 FuLeakDetdActv 0;
BA_ "GenSigSendType" SG_ 528 HealthOfEngOil 0;
BA_ "GenSigStartValue" SG_ 528 HealthOfEngOil 100;
BA_ "GenSigSendType" SG_ 565 HmiDefrstrElecStsFrnt 0;
BA_ "GenSigSendType" SG_ 565 HmiDefrstrElecStsMirrr 0;
BA_ "GenSigSendType" SG_ 565 HmiDefrstrElecStsRe 0;
BA_ "GenSigSendType" SG_ 565 HvBattPmpStatCooltPmpDryErr 0;
BA_ "GenSigSendType" SG_ 565 HvBattPmpStatCooltPmpEmgyModSts 0;
BA_ "GenSigSendType" SG_ 565 HvBattPmpStatCooltPmpErrSts 0;
BA_ "GenSigSendType" SG_ 565 HvBattPmpStatCooltPmpI 0;
BA_ "GenSigSendType" SG_ 565 HvBattPmpStatCooltPmpIErr 0;
BA_ "GenSigSendType" SG_ 565 HvBattPmpStatCooltPmpMonrSpd 0;
BA_ "GenSigSendType" SG_ 565 HvBattPmpStatCooltPmpPostRunSts 0;
BA_ "GenSigSendType" SG_ 565 HvBattPmpStatCooltPmpSetPostRunReq 0;
BA_ "GenSigSendType" SG_ 565 HvBattPmpStatCooltPmpSetSpdReq 0;
BA_ "GenSigSendType" SG_ 565 HvBattPmpStatCooltPmpSpd 0;
BA_ "GenSigSendType" SG_ 565 HvBattPmpStatCooltPmpT 0;
BA_ "GenSigStartValue" SG_ 565 HvBattPmpStatCooltPmpT 100;
BA_ "GenSigSendType" SG_ 565 HvBattPmpStatCooltPmpTErr 0;
BA_ "GenSigSendType" SG_ 565 HvBattPmpStatCooltPmpU 0;
BA_ "GenSigSendType" SG_ 565 HvBattPmpStatCooltPmpUErr 0;
BA_ "GenSigSendType" SG_ 565 HvBattPmpStatCooltPmpUnstallSts 0;
BA_ "GenSigSendType" SG_ 434 HvBattSOCE 0;
BA_ "GenSigStartValue" SG_ 434 HvBattSOCE 200;
BA_ "GenSigSendType" SG_ 528 HvCooltHeatrEnad 0;
BA_ "GenSigSendType" SG_ 565 HvCooltHeatrICnsSig 0;
BA_ "GenSigSendType" SG_ 528 HvCooltHeatrStsSig 0;
BA_ "GenSigSendType" SG_ 544 HvHeatrPwrCns 0;
BA_ "GenSigSendType" SG_ 565 HvHeatrPwrCnsDes 0;
BA_ "GenSigDataID" SG_ 528 HvSysRlyStsChks "0x15";
BA_ "GenSigFuncType" SG_ 528 HvSysRlyStsChks 15;
BA_ "GenSigSendType" SG_ 528 HvSysRlyStsChks 0;
BA_ "GenSigFuncType" SG_ 528 HvSysRlyStsCntr 16;
BA_ "GenSigSendType" SG_ 528 HvSysRlyStsCntr 0;
BA_ "GenSigSendType" SG_ 528 HvSysRlyStsHvSysRlySts 0;
BA_ "GenSigStartValue" SG_ 528 HvSysRlyStsHvSysRlySts 2;
BA_ "GenSigSendType" SG_ 528 HvacCooltFlowAct 0;
BA_ "GenSigSendType" SG_ 528 HvacCooltVlvStsSig 0;
BA_ "GenSigSendType" SG_ 1154 HwRowFrstPassFldRsdSwt 0;
BA_ "GenSigSendType" SG_ 434 HybErrIndcnReqTelltlBattTracCutOff 0;
BA_ "GenSigSendType" SG_ 434 HybErrIndcnReqTelltlBattTracFailr 0;
BA_ "GenSigSendType" SG_ 434 HybErrIndcnReqTelltlElecDrvFailr 0;
BA_ "GenSigSendType" SG_ 434 HybErrIndcnReqTelltlSysHybFailr 0;
BA_ "GenSigStartValue" SG_ 528 ISecDcDcActHiSide 4100;
BA_ "GenSigSendType" SG_ 880 ImobBrkNrSerlReq 0;
BA_ "GenSigSendType" SG_ 880 ImobEngSts1 0;
BA_ "GenSigSendType" SG_ 880 ImobEngSts3 0;
BA_ "GenSigSendType" SG_ 565 ImobMgrWarnIndcn 0;
BA_ "GenSigSendType" SG_ 434 IndcrOfDeactvtReFog 0;
BA_ "GenSigSendType" SG_ 1154 IsgActvDampgModReq 0;
BA_ "GenSigStartValue" SG_ 1154 IsgActvDampgModReq 2;
BA_ "GenSigSendType" SG_ 1154 IsgModReq 0;
BA_ "GenSigSendType" SG_ 1154 IsgPwrLimMax 0;
BA_ "GenSigSendType" SG_ 1154 IsgPwrLimMin 0;
BA_ "GenSigStartValue" SG_ 1154 IsgPwrLimMin 1022;
BA_ "GenSigSendType" SG_ 1154 IsgSpdReq 0;
BA_ "GenSigDataID" SG_ 1154 IsgTqAllwdChks "0x50";
BA_ "GenSigFuncType" SG_ 1154 IsgTqAllwdChks 15;
BA_ "GenSigSendType" SG_ 1154 IsgTqAllwdChks 0;
BA_ "GenSigFuncType" SG_ 1154 IsgTqAllwdCntr 16;
BA_ "GenSigSendType" SG_ 1154 IsgTqAllwdCntr 0;
BA_ "GenSigSendType" SG_ 1154 IsgTqAllwdIsgTqAllwd 0;
BA_ "GenSigStartValue" SG_ 434 IvtrPhaT1 40;
BA_ "GenSigStartValue" SG_ 434 IvtrPhaT2 40;
BA_ "GenSigStartValue" SG_ 434 IvtrPhaT3 40;
BA_ "GenSigSendType" SG_ 544 KeyIntrVldDetd 0;
BA_ "GenSigSendType" SG_ 565 KeyNotPrsntMsgToDrvr 0;
BA_ "GenSigSendType" SG_ 434 KeyReadReqFromLockg 0;
BA_ "GenSigSendType" SG_ 434 KeyReadStsToLockgBLEKey0 0;
BA_ "GenSigSendType" SG_ 434 KeyReadStsToLockgBLEKey1 0;
BA_ "GenSigSendType" SG_ 434 KeyReadStsToLockgBLEKey10 0;
BA_ "GenSigSendType" SG_ 434 KeyReadStsToLockgBLEKey11 0;
BA_ "GenSigSendType" SG_ 434 KeyReadStsToLockgBLEKey12 0;
BA_ "GenSigSendType" SG_ 434 KeyReadStsToLockgBLEKey13 0;
BA_ "GenSigSendType" SG_ 434 KeyReadStsToLockgBLEKey14 0;
BA_ "GenSigSendType" SG_ 434 KeyReadStsToLockgBLEKey15 0;
BA_ "GenSigSendType" SG_ 434 KeyReadStsToLockgBLEKey2 0;
BA_ "GenSigSendType" SG_ 434 KeyReadStsToLockgBLEKey3 0;
BA_ "GenSigSendType" SG_ 434 KeyReadStsToLockgBLEKey4 0;
BA_ "GenSigSendType" SG_ 434 KeyReadStsToLockgBLEKey5 0;
BA_ "GenSigSendType" SG_ 434 KeyReadStsToLockgBLEKey6 0;
BA_ "GenSigSendType" SG_ 434 KeyReadStsToLockgBLEKey7 0;
BA_ "GenSigSendType" SG_ 434 KeyReadStsToLockgBLEKey8 0;
BA_ "GenSigSendType" SG_ 434 KeyReadStsToLockgBLEKey9 0;
BA_ "GenSigSendType" SG_ 434 KeyReadStsToLockgKey0 0;
BA_ "GenSigSendType" SG_ 434 KeyReadStsToLockgKey1 0;
BA_ "GenSigSendType" SG_ 434 KeyReadStsToLockgKey10 0;
BA_ "GenSigSendType" SG_ 434 KeyReadStsToLockgKey11 0;
BA_ "GenSigSendType" SG_ 434 KeyReadStsToLockgKey2 0;
BA_ "GenSigSendType" SG_ 434 KeyReadStsToLockgKey3 0;
BA_ "GenSigSendType" SG_ 434 KeyReadStsToLockgKey4 0;
BA_ "GenSigSendType" SG_ 434 KeyReadStsToLockgKey5 0;
BA_ "GenSigSendType" SG_ 434 KeyReadStsToLockgKey6 0;
BA_ "GenSigSendType" SG_ 434 KeyReadStsToLockgKey7 0;
BA_ "GenSigSendType" SG_ 434 KeyReadStsToLockgKey8 0;
BA_ "GenSigSendType" SG_ 434 KeyReadStsToLockgKey9 0;
BA_ "GenSigSendType" SG_ 434 KeyReadStsToLockgNFCKey0 0;
BA_ "GenSigSendType" SG_ 434 KeyReadStsToLockgNFCKey1 0;
BA_ "GenSigSendType" SG_ 434 KeyReadStsToLockgNFCKey10 0;
BA_ "GenSigSendType" SG_ 434 KeyReadStsToLockgNFCKey11 0;
BA_ "GenSigSendType" SG_ 434 KeyReadStsToLockgNFCKey12 0;
BA_ "GenSigSendType" SG_ 434 KeyReadStsToLockgNFCKey13 0;
BA_ "GenSigSendType" SG_ 434 KeyReadStsToLockgNFCKey14 0;
BA_ "GenSigSendType" SG_ 434 KeyReadStsToLockgNFCKey15 0;
BA_ "GenSigSendType" SG_ 434 KeyReadStsToLockgNFCKey2 0;
BA_ "GenSigSendType" SG_ 434 KeyReadStsToLockgNFCKey3 0;
BA_ "GenSigSendType" SG_ 434 KeyReadStsToLockgNFCKey4 0;
BA_ "GenSigSendType" SG_ 434 KeyReadStsToLockgNFCKey5 0;
BA_ "GenSigSendType" SG_ 434 KeyReadStsToLockgNFCKey6 0;
BA_ "GenSigSendType" SG_ 434 KeyReadStsToLockgNFCKey7 0;
BA_ "GenSigSendType" SG_ 434 KeyReadStsToLockgNFCKey8 0;
BA_ "GenSigSendType" SG_ 434 KeyReadStsToLockgNFCKey9 0;
BA_ "GenSigSendType" SG_ 544 KeyReadStsToVoiceCtrl 0;
BA_ "GenSigSendType" SG_ 544 LeSolarData 0;
BA_ "GenSigStartValue" SG_ 544 LeSolarData 50.8;
BA_ "GenSigSendType" SG_ 544 LiBattInPWLockTC 0;
BA_ "GenSigSendType" SG_ 434 MirrTintgCmd 0;
BA_ "GenSigSendType" SG_ 565 MotConsDrvCyc 0;
BA_ "GenSigSendType" SG_ 528 NatUsgDayOfOil 0;
BA_ "GenSigSendType" SG_ 544 NotifForEmgyCall 0;
BA_ "GenSigSendType" SG_ 528 OilHealthIfDisp 0;
BA_ "GenSigSendType" SG_ 434 OnBdChrgrSt 0;
BA_ "GenSigDataID" SG_ 1154 OvrdDecelByDrvrChks "0x6E";
BA_ "GenSigFuncType" SG_ 1154 OvrdDecelByDrvrChks 15;
BA_ "GenSigSendType" SG_ 1154 OvrdDecelByDrvrChks 0;
BA_ "GenSigStartValue" SG_ 1154 OvrdDecelByDrvrChks 255;
BA_ "GenSigFuncType" SG_ 1154 OvrdDecelByDrvrCntr 16;
BA_ "GenSigSendType" SG_ 1154 OvrdDecelByDrvrCntr 0;
BA_ "GenSigSendType" SG_ 1154 OvrdDecelByDrvrOvrdDecelByDrvr 0;
BA_ "GenSigSendType" SG_ 528 PEMState 0;
BA_ "GenSigDataID" SG_ 1154 ParkByDrvrWhlsFrntSafeChks "0xA5";
BA_ "GenSigFuncType" SG_ 1154 ParkByDrvrWhlsFrntSafeChks 15;
BA_ "GenSigSendType" SG_ 1154 ParkByDrvrWhlsFrntSafeChks 0;
BA_ "GenSigFuncType" SG_ 1154 ParkByDrvrWhlsFrntSafeCntr 16;
BA_ "GenSigSendType" SG_ 1154 ParkByDrvrWhlsFrntSafeCntr 0;
BA_ "GenSigSendType" SG_ 1154 ParkByDrvrWhlsFrntSafeSts 0;
BA_ "GenSigSendType" SG_ 434 PasAlrmSts 0;
BA_ "GenSigSendType" SG_ 565 PinionSteerAgMax1 0;
BA_ "GenSigSendType" SG_ 565 PostHeatgRunTiEstimd 0;
BA_ "GenSigDataID" SG_ 1154 PropLgtCtrlModCfmdChks "0x1E";
BA_ "GenSigFuncType" SG_ 1154 PropLgtCtrlModCfmdChks 15;
BA_ "GenSigSendType" SG_ 1154 PropLgtCtrlModCfmdChks 0;
BA_ "GenSigFuncType" SG_ 1154 PropLgtCtrlModCfmdCntr 16;
BA_ "GenSigSendType" SG_ 1154 PropLgtCtrlModCfmdCntr 0;
BA_ "GenSigSendType" SG_ 1154 PropLgtCtrlModCfmdLgtDegradation 0;
BA_ "GenSigSendType" SG_ 1154 PropLgtCtrlModCfmdPropLgtCtrlModCfmd 0;
BA_ "GenSigSendType" SG_ 434 PrpsnDistbnOfBOA 0;
BA_ "GenSigSendType" SG_ 565 PrpsnErrIndcnReq 0;
BA_ "GenSigStartValue" SG_ 565 PrpsnErrIndcnReq 1;
BA_ "GenSigSendType" SG_ 1154 PrpsnTqFrntReq 0;
BA_ "GenSigSendType" SG_ 1154 PrpsnTqReReq 0;
BA_ "GenSigDataID" SG_ 1154 PtAllwdToTrsmActrSafeChks "0x3F";
BA_ "GenSigFuncType" SG_ 1154 PtAllwdToTrsmActrSafeChks 15;
BA_ "GenSigSendType" SG_ 1154 PtAllwdToTrsmActrSafeChks 0;
BA_ "GenSigFuncType" SG_ 1154 PtAllwdToTrsmActrSafeCntr 16;
BA_ "GenSigSendType" SG_ 1154 PtAllwdToTrsmActrSafeCntr 0;
BA_ "GenSigSendType" SG_ 1154 PtAllwdToTrsmActrSafePtAllwdToTrsmActr 0;
BA_ "GenSigSendType" SG_ 1154 PtBrkTqCpTot1 0;
BA_ "GenSigSendType" SG_ 1154 PtBrkTqCpTotQf 0;
BA_ "GenSigSendType" SG_ 880 PtDtModReq 0;
BA_ "GenSigSendType" SG_ 1154 PtGearRatFrntAct 0;
BA_ "GenSigSendType" SG_ 1154 PtGearTar 0;
BA_ "GenSigSendType" SG_ 1154 PtJTotAtTrsmAxleOutp 0;
BA_ "GenSigDataID" SG_ 1154 PtJTotChks "0x110";
BA_ "GenSigFuncType" SG_ 1154 PtJTotChks 15;
BA_ "GenSigSendType" SG_ 1154 PtJTotChks 0;
BA_ "GenSigFuncType" SG_ 1154 PtJTotCntr 16;
BA_ "GenSigSendType" SG_ 1154 PtJTotCntr 0;
BA_ "GenSigSendType" SG_ 880 PtReqToTrsmActr 0;
BA_ "GenSigStartValue" SG_ 880 PtReqToTrsmActr 4;
BA_ "GenSigSendType" SG_ 1154 PtRgnTarTqAtReAxleAtReAxle 0;
BA_ "GenSigSendType" SG_ 1154 PtRgnTarTqAtReAxleQf 0;
BA_ "GenSigSendType" SG_ 1154 PtTotRgnTarTq1 0;
BA_ "GenSigSendType" SG_ 1154 PtTotRgnTarTqQf 0;
BA_ "GenSigSendType" SG_ 1154 PtTqAtAxleAvlFrntMax 0;
BA_ "GenSigSendType" SG_ 1154 PtTqAtAxleAvlFrntMin 0;
BA_ "GenSigSendType" SG_ 1154 PtTqAtAxleAvlReMax 0;
BA_ "GenSigSendType" SG_ 1154 PtTqAtAxleAvlReMin 0;
BA_ "GenSigSendType" SG_ 880 PtTqTotDrgAtWhls 0;
BA_ "GenSigSendType" SG_ 1154 PtWhlTqTar 0;
BA_ "GenSigStartValue" SG_ 1154 PtWhlTqTar 6383;
BA_ "GenSigSendType" SG_ 544 PwrAvlDelta 0;
BA_ "GenSigSendType" SG_ 544 PwrOutSetFBMsg 0;
BA_ "GenSigSendType" SG_ 434 RFKApproachReqAndKeyIdKeyId1 0;
BA_ "GenSigSendType" SG_ 434 RFKApproachReqAndKeyIdRFKApproachReq 0;
BA_ "GenSigSendType" SG_ 434 RainLi 0;
BA_ "GenSigSendType" SG_ 528 RainSnsrStsToHMI 0;
BA_ "GenSigSendType" SG_ 434 ReFogActvdbyRain 0;
BA_ "GenSigSendType" SG_ 434 ReWiprRotyCmd 0;
BA_ "GenSigSendType" SG_ 434 ReadLiStsFirstRowLe 0;
BA_ "GenSigSendType" SG_ 434 ReadLiStsFirstRowRi 0;
BA_ "GenSigSendType" SG_ 434 ReadLiStsSecondRowLe 0;
BA_ "GenSigSendType" SG_ 434 ReadLiStsSecondRowRi 0;
BA_ "GenSigSendType" SG_ 434 ReadLiStsThirdRowLe 0;
BA_ "GenSigSendType" SG_ 434 ReadLiStsThirdRowRi 0;
BA_ "GenSigSendType" SG_ 544 RelHumSnsrRelHum 0;
BA_ "GenSigStartValue" SG_ 544 RelHumSnsrRelHum 80;
BA_ "GenSigSendType" SG_ 544 RemChrgStrtReq 0;
BA_ "GenSigSendType" SG_ 528 RemindChrgn 0;
BA_ "GenSigSendType" SG_ 544 RiSolarData 0;
BA_ "GenSigStartValue" SG_ 544 RiSolarData 50.8;
BA_ "GenSigSendType" SG_ 544 RlyCmdCmft 0;
BA_ "GenSigSendType" SG_ 1154 RlyCrashForHvsysReq 0;
BA_ "GenSigSendType" SG_ 544 RlyPwrDistbnCmd1WdIgnRlyCmd 0;
BA_ "GenSigSendType" SG_ 565 RlyPwrDistbnCmd1WdIgnRlyExtCmd 0;
BA_ "GenSigSendType" SG_ 434 RlyPwrDistbnCmd1WdPreBattSaveCmd 0;
BA_ "GenSigSendType" SG_ 434 RmnLockgPrsnlReq 0;
BA_ "GenSigSendType" SG_ 528 RoadInFor 0;
BA_ "GenSigSendType" SG_ 434 SeatHeatgAvlStsRowSecLe 0;
BA_ "GenSigSendType" SG_ 434 SeatHeatgAvlStsRowSecRi 0;
BA_ "GenSigSendType" SG_ 434 SeatHeatgAvlStsRowThrdLe 0;
BA_ "GenSigSendType" SG_ 434 SeatHeatgAvlStsRowThrdRi 0;
BA_ "GenSigSendType" SG_ 528 SeatOccptAtRowSecMid2 0;
BA_ "GenSigStartValue" SG_ 528 SeatOccptAtRowSecMid2 1;
BA_ "GenSigSendType" SG_ 528 SeatOccptAtRowSecMidSnsSts2 0;
BA_ "GenSigSendType" SG_ 434 SeatVentAvlStsRowSecLe 0;
BA_ "GenSigSendType" SG_ 434 SeatVentAvlStsRowSecRi 0;
BA_ "GenSigSendType" SG_ 434 SeatVentnAvlStsRowThrdLe 0;
BA_ "GenSigSendType" SG_ 434 SeatVentnAvlStsRowThrdRi 0;
BA_ "GenSigSendType" SG_ 434 ShortDropWinDrvrDoor2 0;
BA_ "GenSigSendType" SG_ 544 SolarSnsrVluQf 0;
BA_ "GenSigStartValue" SG_ 544 SolarSnsrVluQf 1;
BA_ "GenSigSendType" SG_ 434 SteerLockEnagOfPrpsnNotSafe 0;
BA_ "GenSigSendType" SG_ 434 SteerLockReqNotSafeCommand 0;
BA_ "GenSigSendType" SG_ 434 SteerLockReqNotSafeSteerLockDataReq0 0;
BA_ "GenSigSendType" SG_ 434 SteerLockReqNotSafeSteerLockDataReq1 0;
BA_ "GenSigSendType" SG_ 434 SteerLockReqNotSafeSteerLockDataReq2 0;
BA_ "GenSigSendType" SG_ 434 SteerLockReqNotSafeSteerLockDataReq3 0;
BA_ "GenSigSendType" SG_ 434 SteerLockReqNotSafeSteerLockDataReq4 0;
BA_ "GenSigSendType" SG_ 434 SteerLockReqNotSafeSteerLockDataReq5 0;
BA_ "GenSigSendType" SG_ 434 SteerLockReqNotSafeSteerLockDataReq6 0;
BA_ "GenSigSendType" SG_ 565 SteerWhlHeatgAvlSts 0;
BA_ "GenSigSendType" SG_ 565 SteerWhlHeatgStrtAutCdnOk 0;
BA_ "GenSigSendType" SG_ 434 StopStrtInhb 0;
BA_ "GenSigSendType" SG_ 565 StrtInProgs 0;
BA_ "GenSigSendType" SG_ 565 StrtMsgToDrvr 0;
BA_ "GenSigSendType" SG_ 544 SunCurtMvngSts 0;
BA_ "GenSigSendType" SG_ 544 SunRoofAndCurtFailrCurtMotFailr 0;
BA_ "GenSigSendType" SG_ 544 SunRoofAndCurtFailrCurtMotHallFailr 0;
BA_ "GenSigSendType" SG_ 544 SunRoofAndCurtFailrCurtMotNotAvl 0;
BA_ "GenSigSendType" SG_ 544 SunRoofAndCurtFailrEcuFailrGen 0;
BA_ "GenSigSendType" SG_ 544 SunRoofAndCurtFailrPanMotFailr 0;
BA_ "GenSigSendType" SG_ 544 SunRoofAndCurtFailrPanMotHallFailr 0;
BA_ "GenSigSendType" SG_ 544 SunRoofAndCurtFailrPanMotNotAvl 0;
BA_ "GenSigSendType" SG_ 544 SunRoofAndCurtFailrResvd 0;
BA_ "GenSigSendType" SG_ 434 SwtAhbcReq 0;
BA_ "GenSigSendType" SG_ 434 SwtIntmIntlCmd 0;
BA_ "GenSigStartValue" SG_ 434 SwtIntmIntlCmd 4;
BA_ "GenSigSendType" SG_ 528 SwtStrt3 0;
BA_ "GenSigSendType" SG_ 528 SwtStrt4 0;
BA_ "GenSigSendType" SG_ 880 SwtTrClsSts 0;
BA_ "GenSigSendType" SG_ 565 SysDirIndcnFailr 0;
BA_ "GenSigSendType" SG_ 434 TCSDoorNoClsSts 0;
BA_ "GenSigSendType" SG_ 565 TInCooltAtStrtOfClima 0;
BA_ "GenSigStartValue" SG_ 565 TInCooltAtStrtOfClima 40;
BA_ "GenSigSendType" SG_ 434 TankFlapReqFromSwtIntr 0;
BA_ "GenSigSendType" SG_ 544 TankFlapSts 0;
BA_ "GenSigSendType" SG_ 880 ThermFctReq 0;
BA_ "GenSigSendType" SG_ 528 TotDstTrvldOfEV 0;
BA_ "GenSigSendType" SG_ 528 TotDstTrvldOfEng 0;
BA_ "GenSigSendType" SG_ 565 TrAntiPnch 0;
BA_ "GenSigSendType" SG_ 434 TrApprchOpenFbToExtLi 0;
BA_ "GenSigSendType" SG_ 434 TrNoKeyPrsntAcoustReq 0;
BA_ "GenSigSendType" SG_ 565 TrObstclDetn 0;
BA_ "GenSigSendType" SG_ 528 TrOpenerByFootOperCmd 0;
BA_ "GenSigSendType" SG_ 434 TrPosnUpprProgmReq 0;
BA_ "GenSigSendType" SG_ 434 TrRelsReqNotSafe 0;
BA_ "GenSigSendType" SG_ 434 TrReqFromSwtIntr 0;
BA_ "GenSigSendType" SG_ 544 TrlrLampActvtChk 0;
BA_ "GenSigSendType" SG_ 544 TrlrLampChkSts 0;
BA_ "GenSigSendType" SG_ 544 TrlrLiFltSts 0;
BA_ "GenSigSendType" SG_ 544 TrlrSrvReq 0;
BA_ "GenSigSendType" SG_ 1154 TrsmActrPosn2TrsmActrPosn 0;
BA_ "GenSigStartValue" SG_ 1154 TrsmActrPosn2TrsmActrPosn 7;
BA_ "GenSigDataID" SG_ 1154 TrsmActrPosn2TrsmActrPosnChks "0xD2";
BA_ "GenSigFuncType" SG_ 1154 TrsmActrPosn2TrsmActrPosnChks 15;
BA_ "GenSigSendType" SG_ 1154 TrsmActrPosn2TrsmActrPosnChks 0;
BA_ "GenSigFuncType" SG_ 1154 TrsmActrPosn2TrsmActrPosnCntr 16;
BA_ "GenSigSendType" SG_ 1154 TrsmActrPosn2TrsmActrPosnCntr 0;
BA_ "GenSigSendType" SG_ 880 TrsmCluTEstimdOfClu0 0;
BA_ "GenSigStartValue" SG_ 880 TrsmCluTEstimdOfClu0 32;
BA_ "GenSigSendType" SG_ 880 TrsmErrIndcnReq 0;
BA_ "GenSigSendType" SG_ 1154 TrsmGearAct 0;
BA_ "GenSigSendType" SG_ 1154 TrsmGearChgProgs 0;
BA_ "GenSigSendType" SG_ 1154 TrsmGearNotAvlSts 0;
BA_ "GenSigSendType" SG_ 1154 TrsmGearRat 0;
BA_ "GenSigSendType" SG_ 1154 TrsmGearRatTar 0;
BA_ "GenSigSendType" SG_ 1154 TrsmGearTar 0;
BA_ "GenSigSendType" SG_ 880 TrsmHotSt 0;
BA_ "GenSigSendType" SG_ 434 TrsmParkAutRdy 0;
BA_ "GenSigSendType" SG_ 880 TrsmShiftInhb 0;
BA_ "GenSigSendType" SG_ 434 UWBApproachTailgateReqKeyId3 0;
BA_ "GenSigSendType" SG_ 434 UWBApproachTailgateReqUWBApproachTailgateReq 0;
BA_ "GenSigSendType" SG_ 434 UsgModChgReqFromRFK 0;
BA_ "GenSigSendType" SG_ 544 VMMToHmiSetSetting1 0;
BA_ "GenSigSendType" SG_ 544 VMMToHmiSetSetting2 0;
BA_ "GenSigSendType" SG_ 544 VMMToHmiSetSetting3 0;
BA_ "GenSigSendType" SG_ 544 VMMToHmiSetSetting4 0;
BA_ "GenSigSendType" SG_ 544 VMMToHmiSetSetting5 0;
BA_ "GenSigSendType" SG_ 544 VMMToHmiSetSetting6 0;
BA_ "GenSigSendType" SG_ 544 VMMToHmiSetSetting7 0;
BA_ "GenSigSendType" SG_ 544 VMMToHmiSetSetting8 0;
BA_ "GenSigSendType" SG_ 544 VMMtoHMIFBSwitch1 0;
BA_ "GenSigSendType" SG_ 544 VMMtoHMIFBSwitch2 0;
BA_ "GenSigSendType" SG_ 544 VMMtoHMIFBSwitch3 0;
BA_ "GenSigSendType" SG_ 544 VMMtoHMIFBSwitch4 0;
BA_ "GenSigSendType" SG_ 544 VMMtoHMIFBSwitch5 0;
BA_ "GenSigSendType" SG_ 544 VMMtoHMIFBSwitch6 0;
BA_ "GenSigSendType" SG_ 544 VMMtoHMIFBSwitch7 0;
BA_ "GenSigSendType" SG_ 544 VMMtoHMIFBSwitch8 0;
BA_ "GenSigSendType" SG_ 544 VMMtoHMIMsg 0;
BA_ "GenSigSendType" SG_ 434 VehEgyCoornActvtMsg 0;
BA_ "GenSigSendType" SG_ 434 VehEgyCoornEnvtlProtnIndcr 0;
BA_ "GenSigSendType" SG_ 434 VehEgyCoornFctStChg 0;
BA_ "GenSigStartValue" SG_ 544 WPCModuleSts 1;
BA_ "GenSigSendType" SG_ 434 WasRespLevel 0;
BA_ "GenSigSendType" SG_ 528 WiprActvFromWMM 0;
BA_ "GenSigSendType" SG_ 544 WtrPmpAuxSts 0;
VAL_ 434 ActtnCtrlActvFlg 0 "Boolean_FALSE" 1 "Boolean_TRUE";
VAL_ 434 BookChrgnStsFb 0 "BookChrgnStsFb_Default" 1 "BookChrgnStsFb_Success" 2 "BookChrgnStsFb_Fail" 3 "BookChrgnStsFb_Finished";
VAL_ 434 DcDcPwrLim 0 "Boolean_FALSE" 1 "Boolean_TRUE";
VAL_ 434 DrvrMassgRunng 0 "OnOff1_Off" 1 "OnOff1_On";
VAL_ 434 DrvrSeatSts 0 "OccptPresSt1_Undefd1" 1 "OccptPresSt1_OccptNotPrsnt" 2 "OccptPresSt1_OccptPrsnt" 3 "OccptPresSt1_Undefd2";
VAL_ 434 EasyLoadModIndcn 0 "EasyLoadMod_Ukwn" 1 "EasyLoadMod_FullyOpend" 2 "EasyLoadMod_FullyClsd" 3 "EasyLoadMod_Stab" 4 "EasyLoadMod_Neg" 5 "EasyLoadMod_Pos" 6 "EasyLoadMod_Resv1" 7 "EasyLoadMod_Resv2";
VAL_ 434 EmotCooltIndcnReq 0 "Boolean_FALSE" 1 "Boolean_TRUE";
VAL_ 434 EngCooltLvl 0 "FldLvl_FldLvlHi" 1 "FldLvl_FldLvlLo";
VAL_ 434 ExtrLiStsOfAssistantLi 0 "DevSts4_Off" 1 "DevSts4_On" 2 "DevSts4_Err" 3 "DevSts4_Resd";
VAL_ 434 HybErrIndcnReqTelltlBattTracCutOff 0 "Flg1_Rst" 1 "Flg1_Set";
VAL_ 434 HybErrIndcnReqTelltlBattTracFailr 0 "Flg1_Rst" 1 "Flg1_Set";
VAL_ 434 HybErrIndcnReqTelltlElecDrvFailr 0 "Flg1_Rst" 1 "Flg1_Set";
VAL_ 434 HybErrIndcnReqTelltlSysHybFailr 0 "Flg1_Rst" 1 "Flg1_Set";
VAL_ 434 IndcrOfDeactvtReFog 0 "OnOff1_Off" 1 "OnOff1_On";
VAL_ 434 KeyReadReqFromLockg 0 "KeyLocn1_KeyLocnIdle" 1 "KeyLocn1_KeyLocnAll" 2 "KeyLocn1_KeyLocnAllExt" 3 "KeyLocn1_KeyLocnDrvrExt" 4 "KeyLocn1_KeyLocnPassExt" 5 "KeyLocn1_KeyLocnTrExt" 6 "KeyLocn1_KeyLocnAllInt" 7 "KeyLocn1_KeyLocnDrvrInt" 8 "KeyLocn1_KeyLocnPassInt" 9 "KeyLocn1_KeyLocnResvInt" 10 "KeyLocn1_KeyLocnResvIntSimple";
VAL_ 434 KeyReadStsToLockgBLEKey0 0 "KeyPrsntSts1_KeyPrsntStsIdle" 1 "KeyPrsntSts1_KeyPrsntStsInProgs" 2 "KeyPrsntSts1_KeyPrsntStsNotPrsnt" 3 "KeyPrsntSts1_KeyPrsntStsPrsnt";
VAL_ 434 KeyReadStsToLockgBLEKey1 0 "KeyPrsntSts1_KeyPrsntStsIdle" 1 "KeyPrsntSts1_KeyPrsntStsInProgs" 2 "KeyPrsntSts1_KeyPrsntStsNotPrsnt" 3 "KeyPrsntSts1_KeyPrsntStsPrsnt";
VAL_ 434 KeyReadStsToLockgBLEKey10 0 "KeyPrsntSts1_KeyPrsntStsIdle" 1 "KeyPrsntSts1_KeyPrsntStsInProgs" 2 "KeyPrsntSts1_KeyPrsntStsNotPrsnt" 3 "KeyPrsntSts1_KeyPrsntStsPrsnt";
VAL_ 434 KeyReadStsToLockgBLEKey11 0 "KeyPrsntSts1_KeyPrsntStsIdle" 1 "KeyPrsntSts1_KeyPrsntStsInProgs" 2 "KeyPrsntSts1_KeyPrsntStsNotPrsnt" 3 "KeyPrsntSts1_KeyPrsntStsPrsnt";
VAL_ 434 KeyReadStsToLockgBLEKey12 0 "KeyPrsntSts1_KeyPrsntStsIdle" 1 "KeyPrsntSts1_KeyPrsntStsInProgs" 2 "KeyPrsntSts1_KeyPrsntStsNotPrsnt" 3 "KeyPrsntSts1_KeyPrsntStsPrsnt";
VAL_ 434 KeyReadStsToLockgBLEKey13 0 "KeyPrsntSts1_KeyPrsntStsIdle" 1 "KeyPrsntSts1_KeyPrsntStsInProgs" 2 "KeyPrsntSts1_KeyPrsntStsNotPrsnt" 3 "KeyPrsntSts1_KeyPrsntStsPrsnt";
VAL_ 434 KeyReadStsToLockgBLEKey14 0 "KeyPrsntSts1_KeyPrsntStsIdle" 1 "KeyPrsntSts1_KeyPrsntStsInProgs" 2 "KeyPrsntSts1_KeyPrsntStsNotPrsnt" 3 "KeyPrsntSts1_KeyPrsntStsPrsnt";
VAL_ 434 KeyReadStsToLockgBLEKey15 0 "KeyPrsntSts1_KeyPrsntStsIdle" 1 "KeyPrsntSts1_KeyPrsntStsInProgs" 2 "KeyPrsntSts1_KeyPrsntStsNotPrsnt" 3 "KeyPrsntSts1_KeyPrsntStsPrsnt";
VAL_ 434 KeyReadStsToLockgBLEKey2 0 "KeyPrsntSts1_KeyPrsntStsIdle" 1 "KeyPrsntSts1_KeyPrsntStsInProgs" 2 "KeyPrsntSts1_KeyPrsntStsNotPrsnt" 3 "KeyPrsntSts1_KeyPrsntStsPrsnt";
VAL_ 434 KeyReadStsToLockgBLEKey3 0 "KeyPrsntSts1_KeyPrsntStsIdle" 1 "KeyPrsntSts1_KeyPrsntStsInProgs" 2 "KeyPrsntSts1_KeyPrsntStsNotPrsnt" 3 "KeyPrsntSts1_KeyPrsntStsPrsnt";
VAL_ 434 KeyReadStsToLockgBLEKey4 0 "KeyPrsntSts1_KeyPrsntStsIdle" 1 "KeyPrsntSts1_KeyPrsntStsInProgs" 2 "KeyPrsntSts1_KeyPrsntStsNotPrsnt" 3 "KeyPrsntSts1_KeyPrsntStsPrsnt";
VAL_ 434 KeyReadStsToLockgBLEKey5 0 "KeyPrsntSts1_KeyPrsntStsIdle" 1 "KeyPrsntSts1_KeyPrsntStsInProgs" 2 "KeyPrsntSts1_KeyPrsntStsNotPrsnt" 3 "KeyPrsntSts1_KeyPrsntStsPrsnt";
VAL_ 434 KeyReadStsToLockgBLEKey6 0 "KeyPrsntSts1_KeyPrsntStsIdle" 1 "KeyPrsntSts1_KeyPrsntStsInProgs" 2 "KeyPrsntSts1_KeyPrsntStsNotPrsnt" 3 "KeyPrsntSts1_KeyPrsntStsPrsnt";
VAL_ 434 KeyReadStsToLockgBLEKey7 0 "KeyPrsntSts1_KeyPrsntStsIdle" 1 "KeyPrsntSts1_KeyPrsntStsInProgs" 2 "KeyPrsntSts1_KeyPrsntStsNotPrsnt" 3 "KeyPrsntSts1_KeyPrsntStsPrsnt";
VAL_ 434 KeyReadStsToLockgBLEKey8 0 "KeyPrsntSts1_KeyPrsntStsIdle" 1 "KeyPrsntSts1_KeyPrsntStsInProgs" 2 "KeyPrsntSts1_KeyPrsntStsNotPrsnt" 3 "KeyPrsntSts1_KeyPrsntStsPrsnt";
VAL_ 434 KeyReadStsToLockgBLEKey9 0 "KeyPrsntSts1_KeyPrsntStsIdle" 1 "KeyPrsntSts1_KeyPrsntStsInProgs" 2 "KeyPrsntSts1_KeyPrsntStsNotPrsnt" 3 "KeyPrsntSts1_KeyPrsntStsPrsnt";
VAL_ 434 KeyReadStsToLockgKey0 0 "KeyPrsntSts1_KeyPrsntStsIdle" 1 "KeyPrsntSts1_KeyPrsntStsInProgs" 2 "KeyPrsntSts1_KeyPrsntStsNotPrsnt" 3 "KeyPrsntSts1_KeyPrsntStsPrsnt";
VAL_ 434 KeyReadStsToLockgKey1 0 "KeyPrsntSts1_KeyPrsntStsIdle" 1 "KeyPrsntSts1_KeyPrsntStsInProgs" 2 "KeyPrsntSts1_KeyPrsntStsNotPrsnt" 3 "KeyPrsntSts1_KeyPrsntStsPrsnt";
VAL_ 434 KeyReadStsToLockgKey10 0 "KeyPrsntSts1_KeyPrsntStsIdle" 1 "KeyPrsntSts1_KeyPrsntStsInProgs" 2 "KeyPrsntSts1_KeyPrsntStsNotPrsnt" 3 "KeyPrsntSts1_KeyPrsntStsPrsnt";
VAL_ 434 KeyReadStsToLockgKey11 0 "KeyPrsntSts1_KeyPrsntStsIdle" 1 "KeyPrsntSts1_KeyPrsntStsInProgs" 2 "KeyPrsntSts1_KeyPrsntStsNotPrsnt" 3 "KeyPrsntSts1_KeyPrsntStsPrsnt";
VAL_ 434 KeyReadStsToLockgKey2 0 "KeyPrsntSts1_KeyPrsntStsIdle" 1 "KeyPrsntSts1_KeyPrsntStsInProgs" 2 "KeyPrsntSts1_KeyPrsntStsNotPrsnt" 3 "KeyPrsntSts1_KeyPrsntStsPrsnt";
VAL_ 434 KeyReadStsToLockgKey3 0 "KeyPrsntSts1_KeyPrsntStsIdle" 1 "KeyPrsntSts1_KeyPrsntStsInProgs" 2 "KeyPrsntSts1_KeyPrsntStsNotPrsnt" 3 "KeyPrsntSts1_KeyPrsntStsPrsnt";
VAL_ 434 KeyReadStsToLockgKey4 0 "KeyPrsntSts1_KeyPrsntStsIdle" 1 "KeyPrsntSts1_KeyPrsntStsInProgs" 2 "KeyPrsntSts1_KeyPrsntStsNotPrsnt" 3 "KeyPrsntSts1_KeyPrsntStsPrsnt";
VAL_ 434 KeyReadStsToLockgKey5 0 "KeyPrsntSts1_KeyPrsntStsIdle" 1 "KeyPrsntSts1_KeyPrsntStsInProgs" 2 "KeyPrsntSts1_KeyPrsntStsNotPrsnt" 3 "KeyPrsntSts1_KeyPrsntStsPrsnt";
VAL_ 434 KeyReadStsToLockgKey6 0 "KeyPrsntSts1_KeyPrsntStsIdle" 1 "KeyPrsntSts1_KeyPrsntStsInProgs" 2 "KeyPrsntSts1_KeyPrsntStsNotPrsnt" 3 "KeyPrsntSts1_KeyPrsntStsPrsnt";
VAL_ 434 KeyReadStsToLockgKey7 0 "KeyPrsntSts1_KeyPrsntStsIdle" 1 "KeyPrsntSts1_KeyPrsntStsInProgs" 2 "KeyPrsntSts1_KeyPrsntStsNotPrsnt" 3 "KeyPrsntSts1_KeyPrsntStsPrsnt";
VAL_ 434 KeyReadStsToLockgKey8 0 "KeyPrsntSts1_KeyPrsntStsIdle" 1 "KeyPrsntSts1_KeyPrsntStsInProgs" 2 "KeyPrsntSts1_KeyPrsntStsNotPrsnt" 3 "KeyPrsntSts1_KeyPrsntStsPrsnt";
VAL_ 434 KeyReadStsToLockgKey9 0 "KeyPrsntSts1_KeyPrsntStsIdle" 1 "KeyPrsntSts1_KeyPrsntStsInProgs" 2 "KeyPrsntSts1_KeyPrsntStsNotPrsnt" 3 "KeyPrsntSts1_KeyPrsntStsPrsnt";
VAL_ 434 KeyReadStsToLockgNFCKey0 0 "KeyPrsntSts1_KeyPrsntStsIdle" 1 "KeyPrsntSts1_KeyPrsntStsInProgs" 2 "KeyPrsntSts1_KeyPrsntStsNotPrsnt" 3 "KeyPrsntSts1_KeyPrsntStsPrsnt";
VAL_ 434 KeyReadStsToLockgNFCKey1 0 "KeyPrsntSts1_KeyPrsntStsIdle" 1 "KeyPrsntSts1_KeyPrsntStsInProgs" 2 "KeyPrsntSts1_KeyPrsntStsNotPrsnt" 3 "KeyPrsntSts1_KeyPrsntStsPrsnt";
VAL_ 434 KeyReadStsToLockgNFCKey10 0 "KeyPrsntSts1_KeyPrsntStsIdle" 1 "KeyPrsntSts1_KeyPrsntStsInProgs" 2 "KeyPrsntSts1_KeyPrsntStsNotPrsnt" 3 "KeyPrsntSts1_KeyPrsntStsPrsnt";
VAL_ 434 KeyReadStsToLockgNFCKey11 0 "KeyPrsntSts1_KeyPrsntStsIdle" 1 "KeyPrsntSts1_KeyPrsntStsInProgs" 2 "KeyPrsntSts1_KeyPrsntStsNotPrsnt" 3 "KeyPrsntSts1_KeyPrsntStsPrsnt";
VAL_ 434 KeyReadStsToLockgNFCKey12 0 "KeyPrsntSts1_KeyPrsntStsIdle" 1 "KeyPrsntSts1_KeyPrsntStsInProgs" 2 "KeyPrsntSts1_KeyPrsntStsNotPrsnt" 3 "KeyPrsntSts1_KeyPrsntStsPrsnt";
VAL_ 434 KeyReadStsToLockgNFCKey13 0 "KeyPrsntSts1_KeyPrsntStsIdle" 1 "KeyPrsntSts1_KeyPrsntStsInProgs" 2 "KeyPrsntSts1_KeyPrsntStsNotPrsnt" 3 "KeyPrsntSts1_KeyPrsntStsPrsnt";
VAL_ 434 KeyReadStsToLockgNFCKey14 0 "KeyPrsntSts1_KeyPrsntStsIdle" 1 "KeyPrsntSts1_KeyPrsntStsInProgs" 2 "KeyPrsntSts1_KeyPrsntStsNotPrsnt" 3 "KeyPrsntSts1_KeyPrsntStsPrsnt";
VAL_ 434 KeyReadStsToLockgNFCKey15 0 "KeyPrsntSts1_KeyPrsntStsIdle" 1 "KeyPrsntSts1_KeyPrsntStsInProgs" 2 "KeyPrsntSts1_KeyPrsntStsNotPrsnt" 3 "KeyPrsntSts1_KeyPrsntStsPrsnt";
VAL_ 434 KeyReadStsToLockgNFCKey2 0 "KeyPrsntSts1_KeyPrsntStsIdle" 1 "KeyPrsntSts1_KeyPrsntStsInProgs" 2 "KeyPrsntSts1_KeyPrsntStsNotPrsnt" 3 "KeyPrsntSts1_KeyPrsntStsPrsnt";
VAL_ 434 KeyReadStsToLockgNFCKey3 0 "KeyPrsntSts1_KeyPrsntStsIdle" 1 "KeyPrsntSts1_KeyPrsntStsInProgs" 2 "KeyPrsntSts1_KeyPrsntStsNotPrsnt" 3 "KeyPrsntSts1_KeyPrsntStsPrsnt";
VAL_ 434 KeyReadStsToLockgNFCKey4 0 "KeyPrsntSts1_KeyPrsntStsIdle" 1 "KeyPrsntSts1_KeyPrsntStsInProgs" 2 "KeyPrsntSts1_KeyPrsntStsNotPrsnt" 3 "KeyPrsntSts1_KeyPrsntStsPrsnt";
VAL_ 434 KeyReadStsToLockgNFCKey5 0 "KeyPrsntSts1_KeyPrsntStsIdle" 1 "KeyPrsntSts1_KeyPrsntStsInProgs" 2 "KeyPrsntSts1_KeyPrsntStsNotPrsnt" 3 "KeyPrsntSts1_KeyPrsntStsPrsnt";
VAL_ 434 KeyReadStsToLockgNFCKey6 0 "KeyPrsntSts1_KeyPrsntStsIdle" 1 "KeyPrsntSts1_KeyPrsntStsInProgs" 2 "KeyPrsntSts1_KeyPrsntStsNotPrsnt" 3 "KeyPrsntSts1_KeyPrsntStsPrsnt";
VAL_ 434 KeyReadStsToLockgNFCKey7 0 "KeyPrsntSts1_KeyPrsntStsIdle" 1 "KeyPrsntSts1_KeyPrsntStsInProgs" 2 "KeyPrsntSts1_KeyPrsntStsNotPrsnt" 3 "KeyPrsntSts1_KeyPrsntStsPrsnt";
VAL_ 434 KeyReadStsToLockgNFCKey8 0 "KeyPrsntSts1_KeyPrsntStsIdle" 1 "KeyPrsntSts1_KeyPrsntStsInProgs" 2 "KeyPrsntSts1_KeyPrsntStsNotPrsnt" 3 "KeyPrsntSts1_KeyPrsntStsPrsnt";
VAL_ 434 KeyReadStsToLockgNFCKey9 0 "KeyPrsntSts1_KeyPrsntStsIdle" 1 "KeyPrsntSts1_KeyPrsntStsInProgs" 2 "KeyPrsntSts1_KeyPrsntStsNotPrsnt" 3 "KeyPrsntSts1_KeyPrsntStsPrsnt";
VAL_ 434 OnBdChrgrSt 0 "ChrgrSts1_Idle" 1 "ChrgrSts1_PreStrt" 2 "ChrgrSts1_Chrgn" 3 "ChrgrSts1_Alrm" 4 "ChrgrSts1_Srv" 5 "ChrgrSts1_Diagc" 6 "ChrgrSts1_Boot" 7 "ChrgrSts1_Rstrt" 8 "ChrgrSts1_DisChrgn" 9 "ChrgrSts1_BookChrgn" 10 "ChrgrSts1_Shutdown" 11 "ChrgrSts1_Heating" 12 "ChrgrSts1_Cooling";
VAL_ 434 PasAlrmSts 0 "NoReqOffReq_NoReq" 1 "NoReqOffReq_OffReq";
VAL_ 434 PhoneForgottenRmn 0 "Boolean_FALSE" 1 "Boolean_TRUE";
VAL_ 434 PrpsnDistbnOfBOA 0 "Resp01_No" 1 "Resp01_Yes" 2 "Resp01_Error" 3 "Resp01_Reserve";
VAL_ 434 RainLi 0 "OnOff1_Off" 1 "OnOff1_On";
VAL_ 434 ReadLiStsFirstRowLe 0 "Boolean_FALSE" 1 "Boolean_TRUE";
VAL_ 434 ReadLiStsFirstRowRi 0 "Boolean_FALSE" 1 "Boolean_TRUE";
VAL_ 434 ReadLiStsSecondRowLe 0 "Boolean_FALSE" 1 "Boolean_TRUE";
VAL_ 434 ReadLiStsSecondRowRi 0 "Boolean_FALSE" 1 "Boolean_TRUE";
VAL_ 434 ReadLiStsThirdRowLe 0 "Boolean_FALSE" 1 "Boolean_TRUE";
VAL_ 434 ReadLiStsThirdRowRi 0 "Boolean_FALSE" 1 "Boolean_TRUE";
VAL_ 434 ReFogActvdbyRain 0 "OnOff1_Off" 1 "OnOff1_On";
VAL_ 434 ReWiprRotyCmd 0 "ReWiprRotyCmd2_ReWiprRotyOff" 1 "ReWiprRotyCmd2_ReWiprRotyResd" 2 "ReWiprRotyCmd2_ReWiprRotyIntm" 3 "ReWiprRotyCmd2_ReWiprRotyContns";
VAL_ 434 RFKApproachReqAndKeyIdKeyId1 0 "KeyId1_Key0" 1 "KeyId1_Key1" 2 "KeyId1_Key2" 3 "KeyId1_Key3" 4 "KeyId1_Key4" 5 "KeyId1_Key5" 6 "KeyId1_Key6" 7 "KeyId1_Key7" 8 "KeyId1_Key8" 9 "KeyId1_Key9" 10 "KeyId1_Key10" 11 "KeyId1_Key11";
VAL_ 434 RFKApproachReqAndKeyIdRFKApproachReq 0 "RFKApproachReq_Idle" 1 "RFKApproachReq_Light" 2 "RFKApproachReq_Unlock" 3 "RFKApproachReq_Lock" 4 "RFKApproachReq_TailgateFlashReq1" 5 "RFKApproachReq_TailgateFlashReq2" 6 "RFKApproachReq_TailgateOpenReq";
VAL_ 434 RlyPwrDistbnCmd1WdPreBattSaveCmd 0 "OnOff1_Off" 1 "OnOff1_On";
VAL_ 434 RmnLockgPrsnlReq 0 "OnOff1_Off" 1 "OnOff1_On";
VAL_ 434 SeatHeatgAvlStsRowSecLe 0 "StsFd_None" 1 "StsFd_On" 2 "StsFd_Off" 3 "StsFd_Error" 4 "StsFd_Functionallimit" 5 "StsFd_Energylimit" 6 "StsFd_Resvd1" 7 "StsFd_Resvd2";
VAL_ 434 SeatHeatgAvlStsRowSecRi 0 "StsFd_None" 1 "StsFd_On" 2 "StsFd_Off" 3 "StsFd_Error" 4 "StsFd_Functionallimit" 5 "StsFd_Energylimit" 6 "StsFd_Resvd1" 7 "StsFd_Resvd2";
VAL_ 434 SeatHeatgAvlStsRowThrdLe 0 "StsFd_None" 1 "StsFd_On" 2 "StsFd_Off" 3 "StsFd_Error" 4 "StsFd_Functionallimit" 5 "StsFd_Energylimit" 6 "StsFd_Resvd1" 7 "StsFd_Resvd2";
VAL_ 434 SeatHeatgAvlStsRowThrdRi 0 "StsFd_None" 1 "StsFd_On" 2 "StsFd_Off" 3 "StsFd_Error" 4 "StsFd_Functionallimit" 5 "StsFd_Energylimit" 6 "StsFd_Resvd1" 7 "StsFd_Resvd2";
VAL_ 434 SeatVentAvlStsRowSecLe 0 "StsFd_None" 1 "StsFd_On" 2 "StsFd_Off" 3 "StsFd_Error" 4 "StsFd_Functionallimit" 5 "StsFd_Energylimit" 6 "StsFd_Resvd1" 7 "StsFd_Resvd2";
VAL_ 434 SeatVentAvlStsRowSecRi 0 "StsFd_None" 1 "StsFd_On" 2 "StsFd_Off" 3 "StsFd_Error" 4 "StsFd_Functionallimit" 5 "StsFd_Energylimit" 6 "StsFd_Resvd1" 7 "StsFd_Resvd2";
VAL_ 434 SeatVentnAvlStsRowThrdLe 0 "StsFd_None" 1 "StsFd_On" 2 "StsFd_Off" 3 "StsFd_Error" 4 "StsFd_Functionallimit" 5 "StsFd_Energylimit" 6 "StsFd_Resvd1" 7 "StsFd_Resvd2";
VAL_ 434 SeatVentnAvlStsRowThrdRi 0 "StsFd_None" 1 "StsFd_On" 2 "StsFd_Off" 3 "StsFd_Error" 4 "StsFd_Functionallimit" 5 "StsFd_Energylimit" 6 "StsFd_Resvd1" 7 "StsFd_Resvd2";
VAL_ 434 ShortDropWinDrvrDoor2 0 "ShortDrop_Idle" 1 "ShortDrop_Close" 2 "ShortDrop_Open";
VAL_ 434 SteerLockEnagOfPrpsnNotSafe 0 "SteerLockEnagOfPrpsn_SteerLockEnagResd1" 1 "SteerLockEnagOfPrpsn_PrpsnInhbFromSteerLock" 2 "SteerLockEnagOfPrpsn_PrpsnAllwdFromSteerLock" 3 "SteerLockEnagOfPrpsn_SteerLockEnagResd2";
VAL_ 434 SteerLockReqNotSafeCommand 0 "SteerLockReqCmd_SteerIdleCmd" 1 "SteerLockReqCmd_SteerUnlckCmd" 2 "SteerLockReqCmd_SteerLockCmd" 3 "SteerLockReqCmd_SteerResdCmd";
VAL_ 434 SwtAhbcReq 0 "PsdNotPsd_NotPsd" 1 "PsdNotPsd_Psd";
VAL_ 434 SwtIntmIntlCmd 0 "WipgSpdIntlFromHmi_Posn0" 1 "WipgSpdIntlFromHmi_Posn1" 2 "WipgSpdIntlFromHmi_Posn2" 3 "WipgSpdIntlFromHmi_Posn3" 4 "WipgSpdIntlFromHmi_Posn4" 5 "WipgSpdIntlFromHmi_Posn5" 6 "WipgSpdIntlFromHmi_Posn6" 7 "WipgSpdIntlFromHmi_Posn7";
VAL_ 434 SysShutDwnFlg 0 "SysShutDwnFlg_NotShutdown" 1 "SysShutDwnFlg_Shutdown";
VAL_ 434 TankFlapReqFromSwtIntr 0 "PsdNotPsd1_NotPsd" 1 "PsdNotPsd1_Psd";
VAL_ 434 TCSDoorNoClsSts 0 "OnOff1_Off" 1 "OnOff1_On";
VAL_ 434 TrApprchOpenFbToExtLi 0 "ExtLight_Idle" 1 "ExtLight_ExtLightFBReq" 2 "ExtLight_ExtLightFBStop" 3 "ExtLight_FastExtLightFBReq" 4 "ExtLight_FastExtLightFBStop";
VAL_ 434 TrNoKeyPrsntAcoustReq 0 "OnOff1_Off" 1 "OnOff1_On";
VAL_ 434 TrPosnUpprProgmReq 0 "OnOff1_Off" 1 "OnOff1_On";
VAL_ 434 TrRelsReqNotSafe 0 "OnOff1_Off" 1 "OnOff1_On";
VAL_ 434 TrReqFromSwtIntr 0 "PsdNotPsd1_NotPsd" 1 "PsdNotPsd1_Psd";
VAL_ 434 TrsmParkAutRdy 0 "TrsmParkAutRdy1_NotReady" 1 "TrsmParkAutRdy1_Ready";
VAL_ 434 UsgModChgReqFromRFK 0 "ReqSts1_NotReqd" 1 "ReqSts1_Reqd";
VAL_ 434 UWBApproachTailgateReqKeyId3 0 "KeyId3_Key0" 1 "KeyId3_Key1" 2 "KeyId3_Key2" 3 "KeyId3_Key3" 4 "KeyId3_Key4" 5 "KeyId3_Key5" 6 "KeyId3_Key6" 7 "KeyId3_Key7" 8 "KeyId3_Key8" 9 "KeyId3_Key9" 10 "KeyId3_Key10" 11 "KeyId3_Key11" 12 "KeyId3_Key12" 13 "KeyId3_Key13" 14 "KeyId3_Key14" 15 "KeyId3_Key15";
VAL_ 434 UWBApproachTailgateReqUWBApproachTailgateReq 0 "UWBApproachTailgateReq_Idle" 1 "UWBApproachTailgateReq_FlashReq1" 2 "UWBApproachTailgateReq_FlashReq2" 3 "UWBApproachTailgateReq_TailgateOpenReq";
VAL_ 434 VehEgyCoornActvtMsg 0 "VehEgyCoornActvtMsg_NoResponse" 1 "VehEgyCoornActvtMsg_VehModNotMetNeed" 2 "VehEgyCoornActvtMsg_DrvModNotMet" 3 "VehEgyCoornActvtMsg_BattModNotMet" 4 "VehEgyCoornActvtMsg_EngLoSpd" 5 "VehEgyCoornActvtMsg_LossofNegnSig" 6 "VehEgyCoornActvtMsg_DestNotSet" 7 "VehEgyCoornActvtMsg_NotInPlanPah";
VAL_ 434 VehEgyCoornEnvtlProtnIndcr 0 "VehEgyCoornEnvtlProtnIndcr_NoResponse" 1 "VehEgyCoornEnvtlProtnIndcr_EnvtlProtnIndcrLvl1" 2 "VehEgyCoornEnvtlProtnIndcr_EnvtlProtnIndcrLvl2" 3 "VehEgyCoornEnvtlProtnIndcr_EnvtlProtnIndcrLvl3" 4 "VehEgyCoornEnvtlProtnIndcr_EnvtlProtnIndcrLvl4" 5 "VehEgyCoornEnvtlProtnIndcr_EnvtlProtnIndcrLvl5" 6 "VehEgyCoornEnvtlProtnIndcr_EnvtlProtnIndcrLvl6" 7 "VehEgyCoornEnvtlProtnIndcr_EnvtlProtnIndcrLvl7" 8 "VehEgyCoornEnvtlProtnIndcr_EnvtlProtnIndcrLvl8" 9 "VehEgyCoornEnvtlProtnIndcr_EnvtlProtnIndcrLvl9";
VAL_ 434 VehEgyCoornFctStChg 0 "VehEgyCoornFctStChg_Dormant" 1 "VehEgyCoornFctStChg_Closed" 2 "VehEgyCoornFctStChg_Activated" 3 "VehEgyCoornFctStChg_Standby";
VAL_ 434 WasRespLevel 0 "WasRespLevel_Default" 1 "WasRespLevel_Level1" 2 "WasRespLevel_Level2" 3 "WasRespLevel_Reserved";
VAL_ 544 BattLoStsFild 0 "OnOff1_Off" 1 "OnOff1_On";
VAL_ 544 BtnLockSts 0 "PsdNotPsd1_NotPsd" 1 "PsdNotPsd1_Psd";
VAL_ 544 ChrgStrtEngRes 0 "ChrgStrtEngRes_ChrgStrtNotSet" 1 "ChrgStrtEngRes_ChrgStrtActive" 2 "ChrgStrtEngRes_ChrgStrtFinished" 3 "ChrgStrtEngRes_ChrgStrtCableConnected" 4 "ChrgStrtEngRes_ChrgStrtHoodOpen" 5 "ChrgStrtEngRes_ChrgStrtLowFuel" 6 "ChrgStrtEngRes_ChrgStrtGearNotP" 7 "ChrgStrtEngRes_ChrgStrtMaxTime" 8 "ChrgStrtEngRes_NoValidKey" 9 "ChrgStrtEngRes_LVSystemError" 10 "ChrgStrtEngRes_HVSystemError" 11 "ChrgStrtEngRes_ChrgStrtMaxNumber" 12 "ChrgStrtEngRes_Reserved1" 13 "ChrgStrtEngRes_Reserved2";
VAL_ 544 ClimRlyCmd 0 "OnOff1_Off" 1 "OnOff1_On";
VAL_ 544 CmptmtCoolgSts 0 "CmptmtCoolgSts_OffNoReq" 1 "CmptmtCoolgSts_OffByEvaprTLo" 2 "CmptmtCoolgSts_OffByPLo" 3 "CmptmtCoolgSts_OffByAmbTOutOfRng" 4 "CmptmtCoolgSts_OffBySysFailr" 5 "CmptmtCoolgSts_OffByLoadCut" 6 "CmptmtCoolgSts_OnWithBattCoolg" 7 "CmptmtCoolgSts_On";
VAL_ 544 DrvrSeatHeatgAvlSts 0 "StsFd_None" 1 "StsFd_On" 2 "StsFd_Off" 3 "StsFd_Error" 4 "StsFd_Functionallimit" 5 "StsFd_Energylimit" 6 "StsFd_Resvd1" 7 "StsFd_Resvd2";
VAL_ 544 DrvrSeatVentnLvlSts 0 "SeatClimaLvl_Off" 1 "SeatClimaLvl_Lvl1" 2 "SeatClimaLvl_Lvl2" 3 "SeatClimaLvl_Lvl3";
VAL_ 544 FuLeakDetdActv 0 "ActvnCyc1_Idle" 1 "ActvnCyc1_Evln" 2 "ActvnCyc1_Actvd" 3 "ActvnCyc1_Finshd";
VAL_ 544 KeyIntrVldDetd 0 "Boolean_FALSE" 1 "Boolean_TRUE";
VAL_ 544 KeyReadStsToVoiceCtrl 0 "KeyPrsntSts1_KeyPrsntStsIdle" 1 "KeyPrsntSts1_KeyPrsntStsInProgs" 2 "KeyPrsntSts1_KeyPrsntStsNotPrsnt" 3 "KeyPrsntSts1_KeyPrsntStsPrsnt";
VAL_ 544 LiBattInPWLockTC 0 "OnOff1_Off" 1 "OnOff1_On";
VAL_ 544 NotifForEmgyCall 0 "Boolean_FALSE" 1 "Boolean_TRUE";
VAL_ 544 PwrOutSetFBMsg 0 "PwrOutSetFBMsg_Off" 1 "PwrOutSetFBMsg_LowSoc" 2 "PwrOutSetFBMsg_DcDcError";
VAL_ 544 RemChrgStrtReq 0 "OnOff1_Off" 1 "OnOff1_On";
VAL_ 544 RlyCmdCmft 0 "OnOff1_Off" 1 "OnOff1_On";
VAL_ 544 RlyPwrDistbnCmd1WdIgnRlyCmd 0 "OnOff1_Off" 1 "OnOff1_On";
VAL_ 544 SolarSnsrVluQf 0 "DataQf_NotOk" 1 "DataQf_Ok";
VAL_ 544 SunCurtMvngSts 0 "Boolean_FALSE" 1 "Boolean_TRUE";
VAL_ 544 SunRoofAndCurtFailrCurtMotFailr 0 "Boolean_FALSE" 1 "Boolean_TRUE";
VAL_ 544 SunRoofAndCurtFailrCurtMotHallFailr 0 "Boolean_FALSE" 1 "Boolean_TRUE";
VAL_ 544 SunRoofAndCurtFailrCurtMotNotAvl 0 "Boolean_FALSE" 1 "Boolean_TRUE";
VAL_ 544 SunRoofAndCurtFailrEcuFailrGen 0 "Boolean_FALSE" 1 "Boolean_TRUE";
VAL_ 544 SunRoofAndCurtFailrPanMotFailr 0 "Boolean_FALSE" 1 "Boolean_TRUE";
VAL_ 544 SunRoofAndCurtFailrPanMotHallFailr 0 "Boolean_FALSE" 1 "Boolean_TRUE";
VAL_ 544 SunRoofAndCurtFailrPanMotNotAvl 0 "Boolean_FALSE" 1 "Boolean_TRUE";
VAL_ 544 SunRoofAndCurtFailrResvd 0 "Boolean_FALSE" 1 "Boolean_TRUE";
VAL_ 544 TankFlapSts 0 "DoorSts2_Ukwn" 1 "DoorSts2_Opend" 2 "DoorSts2_Clsd";
VAL_ 544 TrlrLampActvtChk 0 "TrlrLampChkSts1_TrlrLampChkNotAvl" 1 "TrlrLampChkSts1_TrlrLampChkAvl";
VAL_ 544 TrlrLampChkSts 0 "TrlrLampChkSts2_Idle" 1 "TrlrLampChkSts2_TrlrLampChkStrtd" 2 "TrlrLampChkSts2_TrlrLampChkCmpl" 3 "TrlrLampChkSts2_CnclOper" 4 "TrlrLampChkSts2_TrlrLampEngOffReqd" 5 "TrlrLampChkSts2_Resd1" 6 "TrlrLampChkSts2_Resd2" 7 "TrlrLampChkSts2_Resd3";
VAL_ 544 TrlrLiFltSts 0 "LampFailrSts1_LampNoFailr" 1 "LampFailrSts1_LampIndcrTurnRiFailr" 2 "LampFailrSts1_LampIndcrTurnLeFailr" 3 "LampFailrSts1_LampIndcrTurnLeAndRiFailr" 4 "LampFailrSts1_BrkLampFailr" 5 "LampFailrSts1_BrkLampAndIndcrTurnRiFailr" 6 "LampFailrSts1_BrkLampAndIndcrTurnLeFailr" 7 "LampFailrSts1_BrkAndIndcrTurnAllFailr";
VAL_ 544 TrlrSrvReq 0 "DevErrSts2_NoFlt" 1 "DevErrSts2_Flt";
VAL_ 544 VMMtoHMIFBSwitch1 0 "OnOff1_Off" 1 "OnOff1_On";
VAL_ 544 VMMtoHMIFBSwitch2 0 "OnOff1_Off" 1 "OnOff1_On";
VAL_ 544 VMMtoHMIFBSwitch3 0 "OnOff1_Off" 1 "OnOff1_On";
VAL_ 544 VMMtoHMIFBSwitch4 0 "OnOff1_Off" 1 "OnOff1_On";
VAL_ 544 VMMtoHMIFBSwitch5 0 "OnOff1_Off" 1 "OnOff1_On";
VAL_ 544 VMMtoHMIFBSwitch6 0 "OnOff1_Off" 1 "OnOff1_On";
VAL_ 544 VMMtoHMIFBSwitch7 0 "OnOff1_Off" 1 "OnOff1_On";
VAL_ 544 VMMtoHMIFBSwitch8 0 "OnOff1_Off" 1 "OnOff1_On";
VAL_ 544 VMMtoHMIMsg 0 "StrtMsg2_NoMsg" 1 "StrtMsg2_Msg1" 2 "StrtMsg2_Msg2" 3 "StrtMsg2_Msg3" 4 "StrtMsg2_Msg4" 5 "StrtMsg2_Msg5" 6 "StrtMsg2_Msg6" 7 "StrtMsg2_Msg7" 8 "StrtMsg2_Msg8" 9 "StrtMsg2_Msg9" 10 "StrtMsg2_Msg10" 11 "StrtMsg2_Msg11" 12 "StrtMsg2_Msg12" 13 "StrtMsg2_Msg13";
VAL_ 544 VMMToHmiSetSetting1 0 "HMIsetting_Off" 1 "HMIsetting_Level1" 2 "HMIsetting_Level2" 3 "HMIsetting_Level3" 4 "HMIsetting_Level4" 5 "HMIsetting_Level5" 6 "HMIsetting_Level6" 7 "HMIsetting_NoReq";
VAL_ 544 VMMToHmiSetSetting2 0 "HMIsetting_Off" 1 "HMIsetting_Level1" 2 "HMIsetting_Level2" 3 "HMIsetting_Level3" 4 "HMIsetting_Level4" 5 "HMIsetting_Level5" 6 "HMIsetting_Level6" 7 "HMIsetting_NoReq";
VAL_ 544 VMMToHmiSetSetting3 0 "HMIsetting_Off" 1 "HMIsetting_Level1" 2 "HMIsetting_Level2" 3 "HMIsetting_Level3" 4 "HMIsetting_Level4" 5 "HMIsetting_Level5" 6 "HMIsetting_Level6" 7 "HMIsetting_NoReq";
VAL_ 544 VMMToHmiSetSetting4 0 "HMIsetting_Off" 1 "HMIsetting_Level1" 2 "HMIsetting_Level2" 3 "HMIsetting_Level3" 4 "HMIsetting_Level4" 5 "HMIsetting_Level5" 6 "HMIsetting_Level6" 7 "HMIsetting_NoReq";
VAL_ 544 VMMToHmiSetSetting5 0 "HMIsetting_Off" 1 "HMIsetting_Level1" 2 "HMIsetting_Level2" 3 "HMIsetting_Level3" 4 "HMIsetting_Level4" 5 "HMIsetting_Level5" 6 "HMIsetting_Level6" 7 "HMIsetting_NoReq";
VAL_ 544 VMMToHmiSetSetting6 0 "HMIsetting_Off" 1 "HMIsetting_Level1" 2 "HMIsetting_Level2" 3 "HMIsetting_Level3" 4 "HMIsetting_Level4" 5 "HMIsetting_Level5" 6 "HMIsetting_Level6" 7 "HMIsetting_NoReq";
VAL_ 544 VMMToHmiSetSetting7 0 "HMIsetting_Off" 1 "HMIsetting_Level1" 2 "HMIsetting_Level2" 3 "HMIsetting_Level3" 4 "HMIsetting_Level4" 5 "HMIsetting_Level5" 6 "HMIsetting_Level6" 7 "HMIsetting_NoReq";
VAL_ 544 VMMToHmiSetSetting8 0 "HMIsetting_Off" 1 "HMIsetting_Level1" 2 "HMIsetting_Level2" 3 "HMIsetting_Level3" 4 "HMIsetting_Level4" 5 "HMIsetting_Level5" 6 "HMIsetting_Level6" 7 "HMIsetting_NoReq";
VAL_ 544 WPCModuleSts 0 "WPCModuleSts_OverTemperatureProtected" 1 "WPCModuleSts_Standby" 2 "WPCModuleSts_Charging" 3 "WPCModuleSts_FOD" 4 "WPCModuleSts_VoltageProtected" 5 "WPCModuleSts_OverPowerProtected" 6 "WPCModuleSts_Transmittingcoildisable" 7 "WPCModuleSts_OFF" 8 "WPCModuleSts_ChargingCompleted" 9 "WPCModuleSts_DeactivatedbyUser" 10 "WPCModuleSts_50WCharging" 11 "WPCModuleSts_Resvd3" 12 "WPCModuleSts_Resvd4" 13 "WPCModuleSts_Resvd5" 14 "WPCModuleSts_Resvd6" 15 "WPCModuleSts_Invalid";
VAL_ 544 WtrPmpAuxSts 0 "OnOffCrit1_NotVld1" 1 "OnOffCrit1_Off" 2 "OnOffCrit1_On" 3 "OnOffCrit1_NotVld2";
VAL_ 565 BrkSysWarnIndcnReqSec 0 "OnOff2_On" 1 "OnOff2_Off";
VAL_ 565 CarLoctrActvnSts 0 "ActvnWithMsg_Idle" 1 "ActvnWithMsg_Activation_Successful" 2 "ActvnWithMsg_Activation_Fail";
VAL_ 565 CcvmStsVlvBlkFlt 0 "Boolean_FALSE" 1 "Boolean_TRUE";
VAL_ 565 CcvmStsVlvCalibSts 0 "VlvCalibSts_NotInitialized" 1 "VlvCalibSts_Initializing" 2 "VlvCalibSts_Initialized" 3 "VlvCalibSts_Reserved";
VAL_ 565 CcvmStsVlvCmdPosnErr 0 "Boolean_FALSE" 1 "Boolean_TRUE";
VAL_ 565 CcvmStsVlvLoTErr 0 "Boolean_FALSE" 1 "Boolean_TRUE";
VAL_ 565 CcvmStsVlvMoveSts 0 "Boolean_FALSE" 1 "Boolean_TRUE";
VAL_ 565 CcvmStsVlvNVMFlt 0 "Boolean_FALSE" 1 "Boolean_TRUE";
VAL_ 565 CcvmStsVlvOpenCircFlt 0 "Boolean_FALSE" 1 "Boolean_TRUE";
VAL_ 565 CcvmStsVlvOverTErr 0 "Boolean_FALSE" 1 "Boolean_TRUE";
VAL_ 565 CcvmStsVlvOverTrvlFlt 0 "Boolean_FALSE" 1 "Boolean_TRUE";
VAL_ 565 CcvmStsVlvOverTWarn 0 "Boolean_FALSE" 1 "Boolean_TRUE";
VAL_ 565 CcvmStsVlvOverUErr 0 "Boolean_FALSE" 1 "Boolean_TRUE";
VAL_ 565 CcvmStsVlvPosnCtrlTimeOutFlt 0 "Boolean_FALSE" 1 "Boolean_TRUE";
VAL_ 565 CcvmStsVlvPosnUkwnFlt 0 "Boolean_FALSE" 1 "Boolean_TRUE";
VAL_ 565 CcvmStsVlvPreHeatgSts 0 "Boolean_FALSE" 1 "Boolean_TRUE";
VAL_ 565 CcvmStsVlvSelfLearnFlt 0 "Boolean_FALSE" 1 "Boolean_TRUE";
VAL_ 565 CcvmStsVlvShoCircFlt 0 "Boolean_FALSE" 1 "Boolean_TRUE";
VAL_ 565 CcvmStsVlvSpdLvlSts 0 "VlvSpdLvlReq_Invalid" 1 "VlvSpdLvlReq_Level1" 2 "VlvSpdLvlReq_Level2" 3 "VlvSpdLvlReq_Reserved";
VAL_ 565 CcvmStsVlvUnderUErr 0 "Boolean_FALSE" 1 "Boolean_TRUE";
VAL_ 565 CcvVlvStsIntFlt 0 "Boolean_FALSE" 1 "Boolean_TRUE";
VAL_ 565 CcvVlvStsOprFlt 0 "Boolean_FALSE" 1 "Boolean_TRUE";
VAL_ 565 CcvVlvStsTrqSts 0 "VlvTqSts_NoTorque" 1 "VlvTqSts_NominalTorque" 2 "VlvTqSts_Boost20perc" 3 "VlvTqSts_Boost40perc" 4 "VlvTqSts_Boost60perc" 5 "VlvTqSts_Boost80perc" 6 "VlvTqSts_Boost100perc";
VAL_ 565 ChdLockRightFailStsToHmi 0 "OnOffSafe1_OnOffSafeInvld1" 1 "OnOffSafe1_OnOffSafeOn" 2 "OnOffSafe1_OnOffSafeOff" 3 "OnOffSafe1_OnOffSafeInvld2";
VAL_ 565 ChdPrtnLeftFailStsToHmi 0 "OnOffSafe1_OnOffSafeInvld1" 1 "OnOffSafe1_OnOffSafeOn" 2 "OnOffSafe1_OnOffSafeOff" 3 "OnOffSafe1_OnOffSafeInvld2";
VAL_ 565 ChrgLidAcSts 0 "DoorSts2_Ukwn" 1 "DoorSts2_Opend" 2 "DoorSts2_Clsd";
VAL_ 565 ChrgLidDCorAcDcSts 0 "DoorSts2_Ukwn" 1 "DoorSts2_Opend" 2 "DoorSts2_Clsd";
VAL_ 565 ClimaCmd 0 "OkNotOk_NotOk" 1 "OkNotOk_Ok";
VAL_ 565 CmprFbCmprSts1 0 "CmprSts_CmprOff" 1 "CmprSts_CmprOn" 2 "CmprSts_CmprPwrLimd" 3 "CmprSts_CmprPreHeat" 4 "CmprSts_Reserved1" 5 "CmprSts_Reserved2" 6 "CmprSts_Reserved3" 7 "CmprSts_SigNotAvl";
VAL_ 565 CmprFbCmprSts2 0 "CompStat_NormalOperation" 1 "CompStat_DegradedOperation" 2 "CompStat_Inoperative";
VAL_ 565 CrashUnlckFailrSts 0 "OnOffSafe1_OnOffSafeInvld1" 1 "OnOffSafe1_OnOffSafeOn" 2 "OnOffSafe1_OnOffSafeOff" 3 "OnOffSafe1_OnOffSafeInvld2";
VAL_ 565 DrvrSeatHeatgAutoSts 0 "OffOnErrInvalid_Off" 1 "OffOnErrInvalid_On" 2 "OffOnErrInvalid_Err" 3 "OffOnErrInvalid_Invalid";
VAL_ 565 DrvrSeatVentnAutoSts 0 "OffOnErrInvalid_Off" 1 "OffOnErrInvalid_On" 2 "OffOnErrInvalid_Err" 3 "OffOnErrInvalid_Invalid";
VAL_ 565 Edcp2PmpStsCooltPmpDryErr 0 "CooltPmpDryErr_RunDryNotDetd" 1 "CooltPmpDryErr_RunDryDetd" 2 "CooltPmpDryErr_Resd1" 3 "CooltPmpDryErr_Resd2";
VAL_ 565 Edcp2PmpStsCooltPmpEmgyModSts 0 "CooltPmpEmgyModSts_EmgyRunNotActv" 1 "CooltPmpEmgyModSts_EmgyRunActv" 2 "CooltPmpEmgyModSts_Resd1" 3 "CooltPmpEmgyModSts_Resd2";
VAL_ 565 Edcp2PmpStsCooltPmpErrSts 0 "CooltPmpErrSts_StNoErr" 1 "CooltPmpErrSts_StErr" 2 "CooltPmpErrSts_StNewErr" 3 "CooltPmpErrSts_Resd";
VAL_ 565 Edcp2PmpStsCooltPmpIErr 0 "CooltPmpIErr_INoErr" 1 "CooltPmpIErr_IErr" 2 "CooltPmpIErr_Resd1" 3 "CooltPmpIErr_Resd2";
VAL_ 565 Edcp2PmpStsCooltPmpMonrSpd 0 "CooltPmpMonrSpd_MonrSpdActv" 1 "CooltPmpMonrSpd_MonrSpdNoActv" 2 "CooltPmpMonrSpd_Resd1" 3 "CooltPmpMonrSpd_Resd2";
VAL_ 565 Edcp2PmpStsCooltPmpPostRunSts 0 "CooltPmpPostRunSts_CooltPmpPostRunFinshd" 1 "CooltPmpPostRunSts_CooltPmpPostRunCncld" 2 "CooltPmpPostRunSts_Resd1" 3 "CooltPmpPostRunSts_Resd2";
VAL_ 565 Edcp2PmpStsCooltPmpSetPostRunReq 0 "CooltPmpSetPostRunReq_CooltPmpSetNoPostRun" 1 "CooltPmpSetPostRunReq_CooltPmpSetPostRun1" 2 "CooltPmpSetPostRunReq_CooltPmpSetPostRun2" 3 "CooltPmpSetPostRunReq_CooltPmpSetPostRun3" 4 "CooltPmpSetPostRunReq_CooltPmpSetPostRun4" 5 "CooltPmpSetPostRunReq_CooltPmpSetPostRun5" 6 "CooltPmpSetPostRunReq_Resd1" 7 "CooltPmpSetPostRunReq_Resd2";
VAL_ 565 Edcp2PmpStsCooltPmpTErr 0 "CooltPmpTErr_CooltPmpNoTErr" 1 "CooltPmpTErr_CooltPmpTErr" 2 "CooltPmpTErr_Resd1" 3 "CooltPmpTErr_Resd2";
VAL_ 565 Edcp2PmpStsCooltPmpUErr 0 "CooltPmpUErr_CooltPmpNoUErr" 1 "CooltPmpUErr_CooltPmpUErr" 2 "CooltPmpUErr_Resd1" 3 "CooltPmpUErr_Resd2";
VAL_ 565 Edcp2PmpStsCooltPmpUnstallSts 0 "CooltPmpUnstallSts_CooltPmpUnstallNotActv" 1 "CooltPmpUnstallSts_CooltPmpUnstallActv" 2 "CooltPmpUnstallSts_Resd1" 3 "CooltPmpUnstallSts_Resd2";
VAL_ 565 EngForbidRespFromVMM 0 "NoYes1_No" 1 "NoYes1_Yes";
VAL_ 565 EpbApplyEnaSec 0 "YesNo2_No" 1 "YesNo2_Yes";
VAL_ 565 EpbRelsEnaSec 0 "YesNo2_No" 1 "YesNo2_Yes";
VAL_ 565 ErsCmdByKey 0 "ErsCmd_ErsCmdNotSet" 1 "ErsCmd_ErsCmdOn" 2 "ErsCmd_ErsCmdOff";
VAL_ 565 HctvStsVlvBlkFlt 0 "Boolean_FALSE" 1 "Boolean_TRUE";
VAL_ 565 HctvStsVlvCalibSts 0 "VlvCalibSts_NotInitialized" 1 "VlvCalibSts_Initializing" 2 "VlvCalibSts_Initialized" 3 "VlvCalibSts_Reserved";
VAL_ 565 HctvStsVlvCmdPosnErr 0 "Boolean_FALSE" 1 "Boolean_TRUE";
VAL_ 565 HctvStsVlvLoTErr 0 "Boolean_FALSE" 1 "Boolean_TRUE";
VAL_ 565 HctvStsVlvMoveSts 0 "Boolean_FALSE" 1 "Boolean_TRUE";
VAL_ 565 HctvStsVlvNVMFlt 0 "Boolean_FALSE" 1 "Boolean_TRUE";
VAL_ 565 HctvStsVlvOpenCircFlt 0 "Boolean_FALSE" 1 "Boolean_TRUE";
VAL_ 565 HctvStsVlvOverTErr 0 "Boolean_FALSE" 1 "Boolean_TRUE";
VAL_ 565 HctvStsVlvOverTrvlFlt 0 "Boolean_FALSE" 1 "Boolean_TRUE";
VAL_ 565 HctvStsVlvOverTWarn 0 "Boolean_FALSE" 1 "Boolean_TRUE";
VAL_ 565 HctvStsVlvOverUErr 0 "Boolean_FALSE" 1 "Boolean_TRUE";
VAL_ 565 HctvStsVlvPosnCtrlTimeOutFlt 0 "Boolean_FALSE" 1 "Boolean_TRUE";
VAL_ 565 HctvStsVlvPosnUkwnFlt 0 "Boolean_FALSE" 1 "Boolean_TRUE";
VAL_ 565 HctvStsVlvPreHeatgSts 0 "Boolean_FALSE" 1 "Boolean_TRUE";
VAL_ 565 HctvStsVlvSelfLearnFlt 0 "Boolean_FALSE" 1 "Boolean_TRUE";
VAL_ 565 HctvStsVlvShoCircFlt 0 "Boolean_FALSE" 1 "Boolean_TRUE";
VAL_ 565 HctvStsVlvSpdLvlSts 0 "VlvSpdLvlReq_Invalid" 1 "VlvSpdLvlReq_Level1" 2 "VlvSpdLvlReq_Level2" 3 "VlvSpdLvlReq_Reserved";
VAL_ 565 HctvStsVlvUnderUErr 0 "Boolean_FALSE" 1 "Boolean_TRUE";
VAL_ 565 HmiDefrstrElecStsFrnt 0 "ActrDefrstSts_Off" 1 "ActrDefrstSts_On" 2 "ActrDefrstSts_Limited" 3 "ActrDefrstSts_NotAvailable" 4 "ActrDefrstSts_TmrOff" 5 "ActrDefrstSts_AutoCdn";
VAL_ 565 HmiDefrstrElecStsMirrr 0 "ActrDefrstSts_Off" 1 "ActrDefrstSts_On" 2 "ActrDefrstSts_Limited" 3 "ActrDefrstSts_NotAvailable" 4 "ActrDefrstSts_TmrOff" 5 "ActrDefrstSts_AutoCdn";
VAL_ 565 HmiDefrstrElecStsRe 0 "ActrDefrstSts_Off" 1 "ActrDefrstSts_On" 2 "ActrDefrstSts_Limited" 3 "ActrDefrstSts_NotAvailable" 4 "ActrDefrstSts_TmrOff" 5 "ActrDefrstSts_AutoCdn";
VAL_ 565 HvBattPmpStatCooltPmpDryErr 0 "CooltPmpDryErr_RunDryNotDetd" 1 "CooltPmpDryErr_RunDryDetd" 2 "CooltPmpDryErr_Resd1" 3 "CooltPmpDryErr_Resd2";
VAL_ 565 HvBattPmpStatCooltPmpEmgyModSts 0 "CooltPmpEmgyModSts_EmgyRunNotActv" 1 "CooltPmpEmgyModSts_EmgyRunActv" 2 "CooltPmpEmgyModSts_Resd1" 3 "CooltPmpEmgyModSts_Resd2";
VAL_ 565 HvBattPmpStatCooltPmpErrSts 0 "CooltPmpErrSts_StNoErr" 1 "CooltPmpErrSts_StErr" 2 "CooltPmpErrSts_StNewErr" 3 "CooltPmpErrSts_Resd";
VAL_ 565 HvBattPmpStatCooltPmpIErr 0 "CooltPmpIErr_INoErr" 1 "CooltPmpIErr_IErr" 2 "CooltPmpIErr_Resd1" 3 "CooltPmpIErr_Resd2";
VAL_ 565 HvBattPmpStatCooltPmpMonrSpd 0 "CooltPmpMonrSpd_MonrSpdActv" 1 "CooltPmpMonrSpd_MonrSpdNoActv" 2 "CooltPmpMonrSpd_Resd1" 3 "CooltPmpMonrSpd_Resd2";
VAL_ 565 HvBattPmpStatCooltPmpPostRunSts 0 "CooltPmpPostRunSts_CooltPmpPostRunFinshd" 1 "CooltPmpPostRunSts_CooltPmpPostRunCncld" 2 "CooltPmpPostRunSts_Resd1" 3 "CooltPmpPostRunSts_Resd2";
VAL_ 565 HvBattPmpStatCooltPmpSetPostRunReq 0 "CooltPmpSetPostRunReq_CooltPmpSetNoPostRun" 1 "CooltPmpSetPostRunReq_CooltPmpSetPostRun1" 2 "CooltPmpSetPostRunReq_CooltPmpSetPostRun2" 3 "CooltPmpSetPostRunReq_CooltPmpSetPostRun3" 4 "CooltPmpSetPostRunReq_CooltPmpSetPostRun4" 5 "CooltPmpSetPostRunReq_CooltPmpSetPostRun5" 6 "CooltPmpSetPostRunReq_Resd1" 7 "CooltPmpSetPostRunReq_Resd2";
VAL_ 565 HvBattPmpStatCooltPmpTErr 0 "CooltPmpTErr_CooltPmpNoTErr" 1 "CooltPmpTErr_CooltPmpTErr" 2 "CooltPmpTErr_Resd1" 3 "CooltPmpTErr_Resd2";
VAL_ 565 HvBattPmpStatCooltPmpUErr 0 "CooltPmpUErr_CooltPmpNoUErr" 1 "CooltPmpUErr_CooltPmpUErr" 2 "CooltPmpUErr_Resd1" 3 "CooltPmpUErr_Resd2";
VAL_ 565 HvBattPmpStatCooltPmpUnstallSts 0 "CooltPmpUnstallSts_CooltPmpUnstallNotActv" 1 "CooltPmpUnstallSts_CooltPmpUnstallActv" 2 "CooltPmpUnstallSts_Resd1" 3 "CooltPmpUnstallSts_Resd2";
VAL_ 565 ImobMgrWarnIndcn 0 "ImobMgrWarnIndcn_ImobNoWarnIndcn" 1 "ImobMgrWarnIndcn_ImobVehImobnRem" 2 "ImobMgrWarnIndcn_Tbd";
VAL_ 565 KeyNotPrsntMsgToDrvr 0 "Boolean_FALSE" 1 "Boolean_TRUE";
VAL_ 565 PrpsnErrIndcnReq 1 "MilSt_Off" 2 "MilSt_On" 3 "MilSt_Blink";
VAL_ 565 RlyPwrDistbnCmd1WdIgnRlyExtCmd 0 "OnOff1_Off" 1 "OnOff1_On";
VAL_ 565 SteerWhlHeatgAvlSts 0 "StsFd_None" 1 "StsFd_On" 2 "StsFd_Off" 3 "StsFd_Error" 4 "StsFd_Functionallimit" 5 "StsFd_Energylimit" 6 "StsFd_Resvd1" 7 "StsFd_Resvd2";
VAL_ 565 SteerWhlHeatgStrtAutCdnOk 0 "OkNotOk_NotOk" 1 "OkNotOk_Ok";
VAL_ 565 StrtInProgs 0 "StrtInProgs1_StrtStsOff" 1 "StrtInProgs1_StrtStsImminent" 2 "StrtInProgs1_StrtStsStrtng" 3 "StrtInProgs1_StrtStsRunng";
VAL_ 565 StrtMsgToDrvr 0 "StrtMsg2_NoMsg" 1 "StrtMsg2_Msg1" 2 "StrtMsg2_Msg2" 3 "StrtMsg2_Msg3" 4 "StrtMsg2_Msg4" 5 "StrtMsg2_Msg5" 6 "StrtMsg2_Msg6" 7 "StrtMsg2_Msg7" 8 "StrtMsg2_Msg8" 9 "StrtMsg2_Msg9" 10 "StrtMsg2_Msg10" 11 "StrtMsg2_Msg11" 12 "StrtMsg2_Msg12" 13 "StrtMsg2_Msg13";
VAL_ 565 SysDirIndcnFailr 0 "DevErrSts2_NoFlt" 1 "DevErrSts2_Flt";
VAL_ 565 TrAntiPnch 0 "Boolean_FALSE" 1 "Boolean_TRUE";
VAL_ 565 TrObstclDetn 0 "Boolean_FALSE" 1 "Boolean_TRUE";
VAL_ 1154 BattSnsrStReq 0 "BattSnsrSt_Off" 1 "BattSnsrSt_Accessory" 2 "BattSnsrSt_IgnistionONOrDriving" 3 "BattSnsrSt_Cranking";
VAL_ 1154 BrkLiReqRegenOnOff 0 "OnOff1_Off" 1 "OnOff1_On";
VAL_ 1154 DHTStSafeSpdQf 0 "Qf1_DevOfDataUndefd" 1 "Qf1_DataTmpUndefdAndEvlnInProgs" 2 "Qf1_DevOfDataNotWithinRngAllwd" 3 "Qf1_DataCalcdWithDevDefd";
VAL_ 1154 DHTStSafeTqRtQf 0 "Qf1_DevOfDataUndefd" 1 "Qf1_DataTmpUndefdAndEvlnInProgs" 2 "Qf1_DevOfDataNotWithinRngAllwd" 3 "Qf1_DataCalcdWithDevDefd";
VAL_ 1154 DtEngdStDtEngdFrnt 0 "Flg1_Rst" 1 "Flg1_Set";
VAL_ 1154 DtEngdStDtEngdRe 0 "Flg1_Rst" 1 "Flg1_Set";
VAL_ 1154 DtEngdStDtNotEngdFrnt 0 "Flg1_Rst" 1 "Flg1_Set";
VAL_ 1154 DtEngdStDtNotEngdRe 0 "Flg1_Rst" 1 "Flg1_Set";
VAL_ 1154 ElecMot2ErrIndcnReq 0 "OnOff1_Off" 1 "OnOff1_On";
VAL_ 1154 EngRunngReqByTrsm 0 "EngRunngReq_Dft" 1 "EngRunngReq_StopInhb" 2 "EngRunngReq_RunReq" 3 "EngRunngReq_Resd";
VAL_ 1154 HwRowFrstPassFldRsdSwt 0 "SwtHozlSts1_Idle" 1 "SwtHozlSts1_Fwd" 2 "SwtHozlSts1_Backw";
VAL_ 1154 IsgActvDampgModReq 0 "WhlMotSysActvDampgModCodSts_NoDampg" 1 "WhlMotSysActvDampgModCodSts_LoDampg" 2 "WhlMotSysActvDampgModCodSts_MedDampg" 3 "WhlMotSysActvDampgModCodSts_HiDampg";
VAL_ 1154 IsgModReq 0 "IsgModTyp1_Inin" 1 "IsgModTyp1_Stb" 2 "IsgModTyp1_TqCtrl" 3 "IsgModTyp1_SpdCtrl" 4 "IsgModTyp1_UDcCtrl" 5 "IsgModTyp1_PreChrg" 6 "IsgModTyp1_PwrDwn" 7 "IsgModTyp1_Flt" 8 "IsgModTyp1_TcsCtrl" 9 "IsgModTyp1_Reserved1" 10 "IsgModTyp1_Reserved2" 11 "IsgModTyp1_Reserved3" 12 "IsgModTyp1_Reserved4" 13 "IsgModTyp1_Reserved5" 14 "IsgModTyp1_Reserved6" 15 "IsgModTyp1_Reserved7";
VAL_ 1154 OvrdDecelByDrvrOvrdDecelByDrvr 0 "NoYes1_No" 1 "NoYes1_Yes";
VAL_ 1154 ParkByDrvrWhlsFrntSafeSts 0 "Flg1_Rst" 1 "Flg1_Set";
VAL_ 1154 PropLgtCtrlModCfmdLgtDegradation 0 "LgtDegrad_NoDegradation" 1 "LgtDegrad_TorqueLimitation" 2 "LgtDegrad_TotallyFault" 3 "LgtDegrad_Reserved1" 4 "LgtDegrad_Reserved2" 5 "LgtDegrad_Reserved3" 6 "LgtDegrad_Reserved4" 7 "LgtDegrad_Reserved5";
VAL_ 1154 PropLgtCtrlModCfmdPropLgtCtrlModCfmd 0 "LgtCtrlModCfmd_NotRequest" 1 "LgtCtrlModCfmd_TJP_HWC" 2 "LgtCtrlModCfmd_APA" 3 "LgtCtrlModCfmd_RPA" 4 "LgtCtrlModCfmd_HPA" 5 "LgtCtrlModCfmd_NOP" 6 "LgtCtrlModCfmd_E2E" 7 "LgtCtrlModCfmd_Reserved3";
VAL_ 1154 PtAllwdToTrsmActrSafePtAllwdToTrsmActr 0 "PtAllwdToTrsmActr1_NotAllwd1" 1 "PtAllwdToTrsmActr1_RvsAllwd" 2 "PtAllwdToTrsmActr1_RvsNotAllwd" 3 "PtAllwdToTrsmActr1_NotAllwd2" 4 "PtAllwdToTrsmActr1_ParkRelsAllwd" 5 "PtAllwdToTrsmActr1_RvsAllwdAndParkRelsAllwd" 6 "PtAllwdToTrsmActr1_RvsNotAllwdAndParkRelsAllwd" 7 "PtAllwdToTrsmActr1_NotAllwd3" 8 "PtAllwdToTrsmActr1_ParkRelsNotAllwd" 9 "PtAllwdToTrsmActr1_RvsAllwdAndParkRelsNotAllwd" 10 "PtAllwdToTrsmActr1_RvsNotAllwdAndParkRelsNotAllwd" 11 "PtAllwdToTrsmActr1_NotAllwd4" 12 "PtAllwdToTrsmActr1_NotAllwd5" 13 "PtAllwdToTrsmActr1_NotAllwd6" 14 "PtAllwdToTrsmActr1_NotAllwd7" 15 "PtAllwdToTrsmActr1_NotAllwd8";
VAL_ 1154 PtBrkTqCpTotQf 0 "Qf1_DevOfDataUndefd" 1 "Qf1_DataTmpUndefdAndEvlnInProgs" 2 "Qf1_DevOfDataNotWithinRngAllwd" 3 "Qf1_DataCalcdWithDevDefd";
VAL_ 1154 PtGearTar 0 "PtGearAct1_Neut" 1 "PtGearAct1_Gear1" 2 "PtGearAct1_Gear2" 3 "PtGearAct1_Gear3" 4 "PtGearAct1_Gear4" 5 "PtGearAct1_Gear5" 6 "PtGearAct1_Gear6" 7 "PtGearAct1_Gear7" 8 "PtGearAct1_Gear8" 9 "PtGearAct1_Gear9" 10 "PtGearAct1_Gear10" 11 "PtGearAct1_Gear11" 12 "PtGearAct1_Gear12" 13 "PtGearAct1_Drv" 14 "PtGearAct1_Ukwn" 15 "PtGearAct1_Rvs";
VAL_ 1154 PtRgnTarTqAtReAxleQf 0 "Qf1_DevOfDataUndefd" 1 "Qf1_DataTmpUndefdAndEvlnInProgs" 2 "Qf1_DevOfDataNotWithinRngAllwd" 3 "Qf1_DataCalcdWithDevDefd";
VAL_ 1154 PtTotRgnTarTqQf 0 "Qf1_DevOfDataUndefd" 1 "Qf1_DataTmpUndefdAndEvlnInProgs" 2 "Qf1_DevOfDataNotWithinRngAllwd" 3 "Qf1_DataCalcdWithDevDefd";
VAL_ 1154 RlyCrashForHvsysReq 0 "OnOff1_Off" 1 "OnOff1_On";
VAL_ 1154 TrsmActrPosn2TrsmActrPosn 0 "TrsmActrPosn1_Park" 1 "TrsmActrPosn1_ParkRvs" 2 "TrsmActrPosn1_Rvs" 3 "TrsmActrPosn1_RvsNeut" 4 "TrsmActrPosn1_Neut" 5 "TrsmActrPosn1_NeutDrv" 6 "TrsmActrPosn1_Drv" 7 "TrsmActrPosn1_Undefd";
VAL_ 1154 TrsmGearAct 0 "PtGearAct1_Neut" 1 "PtGearAct1_Gear1" 2 "PtGearAct1_Gear2" 3 "PtGearAct1_Gear3" 4 "PtGearAct1_Gear4" 5 "PtGearAct1_Gear5" 6 "PtGearAct1_Gear6" 7 "PtGearAct1_Gear7" 8 "PtGearAct1_Gear8" 9 "PtGearAct1_Gear9" 10 "PtGearAct1_Gear10" 11 "PtGearAct1_Gear11" 12 "PtGearAct1_Gear12" 13 "PtGearAct1_Drv" 14 "PtGearAct1_Ukwn" 15 "PtGearAct1_Rvs";
VAL_ 1154 TrsmGearChgProgs 0 "TrsmGearChgProgs1_GearShiftChgNotActv" 1 "TrsmGearChgProgs1_StrtPha" 2 "TrsmGearChgProgs1_TqPha" 3 "TrsmGearChgProgs1_JPha" 4 "TrsmGearChgProgs1_EndPha";
VAL_ 1154 TrsmGearTar 0 "PtGearAct1_Neut" 1 "PtGearAct1_Gear1" 2 "PtGearAct1_Gear2" 3 "PtGearAct1_Gear3" 4 "PtGearAct1_Gear4" 5 "PtGearAct1_Gear5" 6 "PtGearAct1_Gear6" 7 "PtGearAct1_Gear7" 8 "PtGearAct1_Gear8" 9 "PtGearAct1_Gear9" 10 "PtGearAct1_Gear10" 11 "PtGearAct1_Gear11" 12 "PtGearAct1_Gear12" 13 "PtGearAct1_Drv" 14 "PtGearAct1_Ukwn" 15 "PtGearAct1_Rvs";
VAL_ 528 EPedlDrvrIndcnMsg 0 "IndcnMsg_NoIndcn" 1 "IndcnMsg_NoBrkPedlPsd" 2 "IndcnMsg_Flt" 3 "IndcnMsg_LowPrio";
VAL_ 528 EPedlInhbnSts 0 "Boolean_FALSE" 1 "Boolean_TRUE";
VAL_ 528 ErsDelayTiCfm 0 "NoYes1_No" 1 "NoYes1_Yes";
VAL_ 528 ErsStrtRes 0 "ErsStrtRes_ErsStrtNotSet" 1 "ErsStrtRes_ErsStrtSuccess" 2 "ErsStrtRes_ErsStrtInhMaxNoStart" 3 "ErsStrtRes_ErsStrtInhCarUnlocked" 4 "ErsStrtRes_ErsStrtInhKeyInCar" 5 "ErsStrtRes_ErsStrtInhDoorOpen" 6 "ErsStrtRes_ErsStrtInhHoodOpen" 7 "ErsStrtRes_ErsStrtInhGearNotP" 8 "ErsStrtRes_ErsStrtInhUserInCar" 9 "ErsStrtRes_ErsStrtInhPedalPressed" 10 "ErsStrtRes_ErsStrtInhLoFuel" 11 "ErsStrtRes_ErsStrtInhLoBatt" 12 "ErsStrtRes_ErsStrtInhEngCoolant" 13 "ErsStrtRes_ErsStrtInhEngFault" 14 "ErsStrtRes_ErsStrtlnhChrgCblCnnctd" 15 "ErsStrtRes_ErsStrtlnhOther" 16 "ErsStrtRes_ErsStrtAbrtEngFault" 17 "ErsStrtRes_ErsStrtAbrtEngCoolant" 18 "ErsStrtRes_ErsStrtAbrtLoFuel" 19 "ErsStrtRes_ErsStrtAbrtLoBatt" 20 "ErsStrtRes_ErsStrtAbrtOther";
VAL_ 528 HpcDeiceReq 0 "DeiceReq_NoReq" 1 "DeiceReq_DeiceChecking" 2 "DeiceReq_Deicing" 3 "DeiceReq_Reserved";
VAL_ 528 HpcHpCoolgPwrSts 0 "Boolean_FALSE" 1 "Boolean_TRUE";
VAL_ 528 HpcHpHeatgPwrSts 0 "Boolean_FALSE" 1 "Boolean_TRUE";
VAL_ 528 HpcHpModReq 0 "HeatPmpModCmd_Initialization" 1 "HeatPmpModCmd_Mode1" 2 "HeatPmpModCmd_Mode2" 3 "HeatPmpModCmd_Mode3" 4 "HeatPmpModCmd_Mode4" 5 "HeatPmpModCmd_Mode5" 6 "HeatPmpModCmd_Mode6" 7 "HeatPmpModCmd_Mode7" 8 "HeatPmpModCmd_Mode8" 9 "HeatPmpModCmd_Mode9" 10 "HeatPmpModCmd_Mode10" 11 "HeatPmpModCmd_Mode11" 12 "HeatPmpModCmd_Mode12" 13 "HeatPmpModCmd_Mode13" 14 "HeatPmpModCmd_Mode14" 15 "HeatPmpModCmd_Mode15" 16 "HeatPmpModCmd_Mode16" 17 "HeatPmpModCmd_Mode17" 18 "HeatPmpModCmd_Mode18" 19 "HeatPmpModCmd_Mode19" 20 "HeatPmpModCmd_Mode20" 21 "HeatPmpModCmd_Reserved";
VAL_ 528 HvacCooltVlvStsSig 0 "HvacCooltVlvSts_VlvReqdToClsd" 1 "HvacCooltVlvSts_VlvReqdToOpen" 2 "HvacCooltVlvSts_ElecErrByCircOpen" 3 "HvacCooltVlvSts_ElecErrShoToGnd" 4 "HvacCooltVlvSts_ElecErrShoToPwrSply" 5 "HvacCooltVlvSts_Resd";
VAL_ 528 HvCooltHeatrEnad 0 "Boolean_FALSE" 1 "Boolean_TRUE";
VAL_ 528 HvCooltHeatrStsSig 0 "HvCooltHeatrSts_Off" 1 "HvCooltHeatrSts_LockedUntilNextStart" 2 "HvCooltHeatrSts_LockedUntilService" 3 "HvCooltHeatrSts_LockedPermanent" 4 "HvCooltHeatrSts_Operation" 5 "HvCooltHeatrSts_Reserved1" 6 "HvCooltHeatrSts_Reserved2" 7 "HvCooltHeatrSts_Reserved3";
VAL_ 528 HvSysRlyStsHvSysRlySts 0 "HvActvnSts_Open" 1 "HvActvnSts_Clsd" 2 "HvActvnSts_KeepSt" 3 "HvActvnSts_OpenAndReqActvDcha";
VAL_ 528 OilHealthIfDisp 0 "Boolean_FALSE" 1 "Boolean_TRUE";
VAL_ 528 PEMState 0 "PEMState_invalid" 1 "PEMState_inactive" 2 "PEMState_temporary_inactive" 3 "PEMState_active";
VAL_ 528 RainSnsrStsToHMI 0 "OnOff1_Off" 1 "OnOff1_On";
VAL_ 528 RemindChrgn 0 "Boolean_FALSE" 1 "Boolean_TRUE";
VAL_ 528 RoadInFor 0 "RoadInFor_Invalid" 1 "RoadInFor_City" 2 "RoadInFor_County" 3 "RoadInFor_FerryWay";
VAL_ 528 SeatOccptAtRowSecMid2 0 "OccptPresSt1_Undefd1" 1 "OccptPresSt1_OccptNotPrsnt" 2 "OccptPresSt1_OccptPrsnt" 3 "OccptPresSt1_Undefd2";
VAL_ 528 SeatOccptAtRowSecMidSnsSts2 0 "OkNokDi_Ok" 1 "OkNokDi_NotOk" 2 "OkNokDi_Disabled" 3 "OkNokDi_Reserved";
VAL_ 528 SwtStrt3 0 "PsdNotPsd2_NoInfo1" 1 "PsdNotPsd2_NotPsd" 2 "PsdNotPsd2_Psd" 3 "PsdNotPsd2_NoInfo2";
VAL_ 528 SwtStrt4 0 "PsdNotPsd2_NoInfo1" 1 "PsdNotPsd2_NotPsd" 2 "PsdNotPsd2_Psd" 3 "PsdNotPsd2_NoInfo2";
VAL_ 528 TrOpenerByFootOperCmd 0 "OnOff1_Off" 1 "OnOff1_On";
VAL_ 528 WiprActvFromWMM 0 "OnOff1_Off" 1 "OnOff1_On";
VAL_ 880 AccrPedlNotCmplPsd 0 "NoYes1_No" 1 "NoYes1_Yes";
VAL_ 880 AccrPedlNotCmplPsdSts 0 "NoYes1_No" 1 "NoYes1_Yes";
VAL_ 880 CrsCtrlrActvnOk 0 "OnOff1_Off" 1 "OnOff1_On";
VAL_ 880 DeactvtTestCom 0 "OnOff2_On" 1 "OnOff2_Off";
VAL_ 880 ImobBrkNrSerlReq 0 "OnOff1_Off" 1 "OnOff1_On";
VAL_ 880 ImobEngSts1 0 "ImobSts_ImobUndefd" 1 "ImobSts_ImobImobn" 2 "ImobSts_ImobMtn" 3 "ImobSts_ImobNoMtn";
VAL_ 880 ImobEngSts3 0 "ImobSts_ImobUndefd" 1 "ImobSts_ImobImobn" 2 "ImobSts_ImobMtn" 3 "ImobSts_ImobNoMtn";
VAL_ 880 PtDtModReq 0 "PtModReq_Ev" 1 "PtModReq_Serial" 2 "PtModReq_Parallel" 3 "PtModReq_P2Gen" 4 "PtModReq_ParallelLaunch";
VAL_ 880 PtReqToTrsmActr 0 "PtReqToTrsmActr2_ParkReq" 1 "PtReqToTrsmActr2_RvsReq" 2 "PtReqToTrsmActr2_NeutReq" 3 "PtReqToTrsmActr2_DrvReq" 4 "PtReqToTrsmActr2_NoMoveReq" 5 "PtReqToTrsmActr2_Resd1" 6 "PtReqToTrsmActr2_Resd2" 7 "PtReqToTrsmActr2_Resd3";
VAL_ 880 SwtTrClsSts 0 "PsdNotPsd_NotPsd" 1 "PsdNotPsd_Psd";
VAL_ 880 ThermFctReq 0 "Boolean_FALSE" 1 "Boolean_TRUE";
VAL_ 880 TrsmErrIndcnReq 0 "OnOff1_Off" 1 "OnOff1_On";
VAL_ 880 TrsmHotSt 0 "TrsmHotSt1_HotStNotActv" 1 "TrsmHotSt1_LvlHotSt1" 2 "TrsmHotSt1_LvlHotSt2";
VAL_ 880 TrsmShiftInhb 0 "TrsmShiftInhb1_TrsmShiftInhbNotActv" 1 "TrsmShiftInhb1_TrsmShiftInhbActv";
SIG_GROUP_ 880 AccrPedlLnr 1 : AccrPedlLnrAccrPedlRat AccrPedlLnrChks AccrPedlLnrCntr;
SIG_GROUP_ 880 AccrPedlNotCmpl 1 : AccrPedlNotCmplPsd AccrPedlNotCmplPsdChks AccrPedlNotCmplPsdCntr AccrPedlNotCmplPsdSts;
SIG_GROUP_ 434 AmbIllmnFwdSts 1 : AmbIllmnFwdStsAmblillmn1 AmbIllmnFwdStsAmblillmn2 AmbIllmnFwdStsChks AmbIllmnFwdStsCntr;
SIG_GROUP_ 1154 BrkLiReqRegen 1 : BrkLiReqRegenChks BrkLiReqRegenCntr BrkLiReqRegenOnOff;
SIG_GROUP_ 565 CcvmSts 1 : CcvmStsVlvBlkFlt CcvmStsVlvCalibSts CcvmStsVlvCmdPosnErr CcvmStsVlvLoTErr CcvmStsVlvMoveSts CcvmStsVlvNVMFlt CcvmStsVlvOpenCircFlt CcvmStsVlvOverTErr CcvmStsVlvOverTrvlFlt CcvmStsVlvOverTWarn CcvmStsVlvOverUErr CcvmStsVlvPosn CcvmStsVlvPosnCtrlTimeOutFlt CcvmStsVlvPosnUkwnFlt CcvmStsVlvPreHeatgSts CcvmStsVlvSelfLearnFlt CcvmStsVlvShoCircFlt CcvmStsVlvSpdLvlSts CcvmStsVlvUnderUErr;
SIG_GROUP_ 565 CcvVlvSts 1 : CcvVlvStsARC CcvVlvStsIntFlt CcvVlvStsOprFlt CcvVlvStsTrqSts;
SIG_GROUP_ 565 CmprFb 1 : CmprFbCmprI CmprFbCmprIPha CmprFbCmprSpd CmprFbCmprSts1 CmprFbCmprSts2 CmprFbCmprT1 CmprFbCmprT2 CmprFbCmprU;
SIG_GROUP_ 1154 DHTStSafe 1 : DHTStSafeChks DHTStSafeCntr DHTStSafeRsv DHTStSafeSpd DHTStSafeSpdQf DHTStSafeTqRt DHTStSafeTqRtQf;
SIG_GROUP_ 1154 DtEngdSt 1 : DtEngdStDtEngdFrnt DtEngdStDtEngdRe DtEngdStDtNotEngdFrnt DtEngdStDtNotEngdRe;
SIG_GROUP_ 565 Edcp2PmpSts 1 : Edcp2PmpStsCooltPmpDryErr Edcp2PmpStsCooltPmpEmgyModSts Edcp2PmpStsCooltPmpErrSts Edcp2PmpStsCooltPmpI Edcp2PmpStsCooltPmpIErr Edcp2PmpStsCooltPmpMonrSpd Edcp2PmpStsCooltPmpPostRunSts Edcp2PmpStsCooltPmpSetPostRunReq Edcp2PmpStsCooltPmpSetSpdReq Edcp2PmpStsCooltPmpSpd Edcp2PmpStsCooltPmpT Edcp2PmpStsCooltPmpTErr Edcp2PmpStsCooltPmpU Edcp2PmpStsCooltPmpUErr Edcp2PmpStsCooltPmpUnstallSts;
SIG_GROUP_ 565 HctvSts 1 : HctvStsVlvBlkFlt HctvStsVlvCalibSts HctvStsVlvCmdPosnErr HctvStsVlvLoTErr HctvStsVlvMoveSts HctvStsVlvNVMFlt HctvStsVlvOpenCircFlt HctvStsVlvOverTErr HctvStsVlvOverTrvlFlt HctvStsVlvOverTWarn HctvStsVlvOverUErr HctvStsVlvPosn HctvStsVlvPosnCtrlTimeOutFlt HctvStsVlvPosnUkwnFlt HctvStsVlvPreHeatgSts HctvStsVlvSelfLearnFlt HctvStsVlvShoCircFlt HctvStsVlvSpdLvlSts HctvStsVlvUnderUErr;
SIG_GROUP_ 565 HmiDefrstrElecSts 1 : HmiDefrstrElecStsFrnt HmiDefrstrElecStsMirrr HmiDefrstrElecStsRe;
SIG_GROUP_ 565 HvBattPmpStat 1 : HvBattPmpStatCooltPmpDryErr HvBattPmpStatCooltPmpEmgyModSts HvBattPmpStatCooltPmpErrSts HvBattPmpStatCooltPmpI HvBattPmpStatCooltPmpIErr HvBattPmpStatCooltPmpMonrSpd HvBattPmpStatCooltPmpPostRunSts HvBattPmpStatCooltPmpSetPostRunReq HvBattPmpStatCooltPmpSetSpdReq HvBattPmpStatCooltPmpSpd HvBattPmpStatCooltPmpT HvBattPmpStatCooltPmpTErr HvBattPmpStatCooltPmpU HvBattPmpStatCooltPmpUErr HvBattPmpStatCooltPmpUnstallSts;
SIG_GROUP_ 528 HvSysRlySts 1 : HvSysRlyStsChks HvSysRlyStsCntr HvSysRlyStsHvSysRlySts;
SIG_GROUP_ 434 HybErrIndcnReq 1 : HybErrIndcnReqTelltlBattTracCutOff HybErrIndcnReqTelltlBattTracFailr HybErrIndcnReqTelltlElecDrvFailr HybErrIndcnReqTelltlSysHybFailr;
SIG_GROUP_ 1154 IsgTqAllwd 1 : IsgTqAllwdChks IsgTqAllwdCntr IsgTqAllwdIsgTqAllwd;
SIG_GROUP_ 434 IvtrPhaT 1 : IvtrPhaT1 IvtrPhaT2 IvtrPhaT3;
SIG_GROUP_ 434 KeyReadStsToLockg 1 : KeyReadStsToLockgKey0 KeyReadStsToLockgKey1 KeyReadStsToLockgKey10 KeyReadStsToLockgKey11 KeyReadStsToLockgKey2 KeyReadStsToLockgKey3 KeyReadStsToLockgKey4 KeyReadStsToLockgKey5 KeyReadStsToLockgKey6 KeyReadStsToLockgKey7 KeyReadStsToLockgKey8 KeyReadStsToLockgKey9;
SIG_GROUP_ 434 KeyReadStsToLockgBLE 1 : KeyReadStsToLockgBLEKey0 KeyReadStsToLockgBLEKey1 KeyReadStsToLockgBLEKey10 KeyReadStsToLockgBLEKey11 KeyReadStsToLockgBLEKey12 KeyReadStsToLockgBLEKey13 KeyReadStsToLockgBLEKey14 KeyReadStsToLockgBLEKey15 KeyReadStsToLockgBLEKey2 KeyReadStsToLockgBLEKey3 KeyReadStsToLockgBLEKey4 KeyReadStsToLockgBLEKey5 KeyReadStsToLockgBLEKey6 KeyReadStsToLockgBLEKey7 KeyReadStsToLockgBLEKey8 KeyReadStsToLockgBLEKey9;
SIG_GROUP_ 434 KeyReadStsToLockgNFC 1 : KeyReadStsToLockgNFCKey0 KeyReadStsToLockgNFCKey1 KeyReadStsToLockgNFCKey10 KeyReadStsToLockgNFCKey11 KeyReadStsToLockgNFCKey12 KeyReadStsToLockgNFCKey13 KeyReadStsToLockgNFCKey14 KeyReadStsToLockgNFCKey15 KeyReadStsToLockgNFCKey2 KeyReadStsToLockgNFCKey3 KeyReadStsToLockgNFCKey4 KeyReadStsToLockgNFCKey5 KeyReadStsToLockgNFCKey6 KeyReadStsToLockgNFCKey7 KeyReadStsToLockgNFCKey8 KeyReadStsToLockgNFCKey9;
SIG_GROUP_ 1154 OvrdDecelByDrvr 1 : OvrdDecelByDrvrChks OvrdDecelByDrvrCntr OvrdDecelByDrvrOvrdDecelByDrvr;
SIG_GROUP_ 1154 ParkByDrvrWhlsFrntSafe 1 : ParkByDrvrWhlsFrntSafeChks ParkByDrvrWhlsFrntSafeCntr ParkByDrvrWhlsFrntSafeSts;
SIG_GROUP_ 1154 PropLgtCtrlModCfmd 1 : PropLgtCtrlModCfmdChks PropLgtCtrlModCfmdCntr PropLgtCtrlModCfmdLgtDegradation PropLgtCtrlModCfmdPropLgtCtrlModCfmd;
SIG_GROUP_ 1154 PtAllwdToTrsmActrSafe 1 : PtAllwdToTrsmActrSafeChks PtAllwdToTrsmActrSafeCntr PtAllwdToTrsmActrSafePtAllwdToTrsmActr;
SIG_GROUP_ 1154 PtBrkTqCpTot 1 : PtBrkTqCpTot1 PtBrkTqCpTotQf;
SIG_GROUP_ 1154 PtJTot 1 : PtJTotAtTrsmAxleOutp PtJTotChks PtJTotCntr;
SIG_GROUP_ 1154 PtRgnTarTqAtReAxle 1 : PtRgnTarTqAtReAxleAtReAxle PtRgnTarTqAtReAxleQf;
SIG_GROUP_ 1154 PtTotRgnTarTq 1 : PtTotRgnTarTq1 PtTotRgnTarTqQf;
SIG_GROUP_ 434 ReadLiSts 1 : ReadLiStsFirstRowLe ReadLiStsFirstRowRi ReadLiStsSecondRowLe ReadLiStsSecondRowRi ReadLiStsThirdRowLe ReadLiStsThirdRowRi;
SIG_GROUP_ 434 RFKApproachReqAndKeyId 1 : RFKApproachReqAndKeyIdKeyId1 RFKApproachReqAndKeyIdRFKApproachReq;
SIG_GROUP_ 528 SlopReducEngCoeff 1 : SlopReducEngCoeffSlopEqu12 SlopReducEngCoeffSlopEqu2 SlopReducEngCoeffSlopEqu4 SlopReducEngCoeffSlopEqu6 SlopReducEngCoeffSlopEqu9;
SIG_GROUP_ 528 SlopRiseEngCoeff 1 : SlopRiseEngCoeffSlopEqu12 SlopRiseEngCoeffSlopEqu2 SlopRiseEngCoeffSlopEqu4 SlopRiseEngCoeffSlopEqu6 SlopRiseEngCoeffSlopEqu9;
SIG_GROUP_ 528 SpdRelatWght 1 : SpdRelatWghtSpdEqu10 SpdRelatWghtSpdEqu100 SpdRelatWghtSpdEqu120 SpdRelatWghtSpdEqu140 SpdRelatWghtSpdEqu20 SpdRelatWghtSpdEqu40 SpdRelatWghtSpdEqu60 SpdRelatWghtSpdEqu80;
SIG_GROUP_ 434 SteerLockReqNotSafe 1 : SteerLockReqNotSafeCommand SteerLockReqNotSafeSteerLockDataReq0 SteerLockReqNotSafeSteerLockDataReq1 SteerLockReqNotSafeSteerLockDataReq2 SteerLockReqNotSafeSteerLockDataReq3 SteerLockReqNotSafeSteerLockDataReq4 SteerLockReqNotSafeSteerLockDataReq5 SteerLockReqNotSafeSteerLockDataReq6;
SIG_GROUP_ 544 SunRoofAndCurtFailr 1 : SunRoofAndCurtFailrCurtMotFailr SunRoofAndCurtFailrCurtMotHallFailr SunRoofAndCurtFailrCurtMotNotAvl SunRoofAndCurtFailrEcuFailrGen SunRoofAndCurtFailrPanMotFailr SunRoofAndCurtFailrPanMotHallFailr SunRoofAndCurtFailrPanMotNotAvl SunRoofAndCurtFailrResvd;
SIG_GROUP_ 1154 TrsmActrPosn2 1 : TrsmActrPosn2TrsmActrPosn TrsmActrPosn2TrsmActrPosnChks TrsmActrPosn2TrsmActrPosnCntr;
SIG_GROUP_ 434 UWBApproachTailgateReq 1 : UWBApproachTailgateReqKeyId3 UWBApproachTailgateReqUWBApproachTailgateReq;
SIG_GROUP_ 544 VMMtoHMIFB 1 : VMMtoHMIFBSwitch1 VMMtoHMIFBSwitch2 VMMtoHMIFBSwitch3 VMMtoHMIFBSwitch4 VMMtoHMIFBSwitch5 VMMtoHMIFBSwitch6 VMMtoHMIFBSwitch7 VMMtoHMIFBSwitch8;
SIG_GROUP_ 544 VMMToHmiSet 1 : VMMToHmiSetSetting1 VMMToHmiSetSetting2 VMMToHmiSetSetting3 VMMToHmiSetSetting4 VMMToHmiSetSetting5 VMMToHmiSetSetting6 VMMToHmiSetSetting7 VMMToHmiSetSetting8;
