// *************************************************************************** *
// *                                                                           *
// * Description:         CANDB File                                           *
// * Generated at:        2025-01-24 14:38                                     *
// * System:              SDB22436                                             *
// * Variant:             L946_ADCU9_ZCUD                                      *
// * Network:             ZCU_CANFD2                                           *
// *                                                                           *
// *************************************************************************** *
VERSION "ZCU_CANFD2"

NS_ :

BS_ :

BU_ :  ETC IHU ZCUD ZCUP

BO_ 643 ZcupZCUCANFD2Fr09 : 64 ZCUP
 SG_ CdsParkgClimaActv : 20|1@0+ (1,0) [0|1] "" IHU
 SG_ CdsParkgClimaActv_UB : 19|1@0+ (1,0) [0|1] "" IHU
 SG_ ClimaOvrHeatProActv : 17|1@0+ (1,0) [0|1] "" IHU
 SG_ ClimaOvrHeatProActv_UB : 112|1@0+ (1,0) [0|1] "" IHU
 SG_ CmptmtAirDistbnRsp_UB : 18|1@0+ (1,0) [0|1] "" IHU,ZCUD
 SG_ CmptmtAirDistbnRspAirDistbnDrvr : 7|3@0+ (1,0) [0|7] "" IHU,ZCUD
 SG_ CmptmtAirDistbnRspAirDistbnPass : 4|3@0+ (1,0) [0|7] "" IHU,ZCUD
 SG_ CmptmtAirDistbnRspAirDistbnSecLe : 15|3@0+ (1,0) [0|7] "" IHU,ZCUD
 SG_ CmptmtAirDistbnRspAirDistbnSecRi : 12|3@0+ (1,0) [0|7] "" IHU,ZCUD
 SG_ CmptmtAirDistbnRspAirDistbnThrd : 23|3@0+ (1,0) [0|7] "" IHU,ZCUD
 SG_ DoorPassCinhIntFailInf_UB : 29|1@0+ (1,0) [0|1] "" IHU
 SG_ DoorPassCinhIntFailInfCinchFlt1 : 31|1@0+ (1,0) [0|1] "" IHU
 SG_ DoorPassCinhIntFailInfCinchRestFlt : 30|1@0+ (1,0) [0|1] "" IHU
 SG_ DoorPassRelsFail_UB : 25|1@0+ (1,0) [0|1] "" IHU
 SG_ DoorPassRelsFailCinchOverTimed : 28|1@0+ (1,0) [0|1] "" IHU
 SG_ DoorPassRelsFailFailure1 : 27|1@0+ (1,0) [0|1] "" IHU
 SG_ DoorPassRelsFailMechRels : 26|1@0+ (1,0) [0|1] "" IHU
 SG_ DoorRiReCinhIntFailInf_UB : 24|1@0+ (1,0) [0|1] "" IHU
 SG_ DoorRiReCinhIntFailInfCinchFlt1 : 39|1@0+ (1,0) [0|1] "" IHU
 SG_ DoorRiReCinhIntFailInfCinchRestFlt : 38|1@0+ (1,0) [0|1] "" IHU
 SG_ DoorRiReRelsFail_UB : 34|1@0+ (1,0) [0|1] "" IHU
 SG_ DoorRiReRelsFailCinchOverTimed : 37|1@0+ (1,0) [0|1] "" IHU
 SG_ DoorRiReRelsFailFailure1 : 36|1@0+ (1,0) [0|1] "" IHU
 SG_ DoorRiReRelsFailMechRels : 35|1@0+ (1,0) [0|1] "" IHU
 SG_ HvacAirTForMaxTZone_UB : 122|1@0+ (1,0) [0|1] "" IHU,ZCUD
 SG_ HvacAirTForMaxTZoneEvaprTFrnt : 47|13@0- (0.1,0.0) [-256.0|255.9] "degC" IHU,ZCUD
 SG_ HvacAirTForMaxTZoneEvaprTQf : 50|1@0+ (1,0) [0|1] "" IHU,ZCUD
 SG_ HvacHeatgReq : 141|1@0+ (1,0) [0|1] "" IHU,ZCUD
 SG_ HvacHeatgReq_UB : 140|1@0+ (1,0) [0|1] "" IHU,ZCUD
 SG_ HvahAirTsp : 79|11@0+ (0.1,-40.0) [-40.0|164.70000000000002] "degC" IHU,ZCUD
 SG_ HvahAirTsp_UB : 123|1@0+ (1,0) [0|1] "" IHU,ZCUD
 SG_ IntPm25LvlFrmClima : 84|3@0+ (1,0) [0|7] "" IHU
 SG_ IntPm25LvlFrmClima_UB : 124|1@0+ (1,0) [0|1] "" IHU
 SG_ IntPm25VluFrmClima : 111|10@0+ (1.0,0.0) [0.0|1023.0] "Unitless" IHU
 SG_ IntPm25VluFrmClima_UB : 126|1@0+ (1,0) [0|1] "" IHU
 SG_ OutdPm25LvlFrmClima : 66|3@0+ (1,0) [0|7] "" IHU
 SG_ OutdPm25LvlFrmClima_UB : 125|1@0+ (1,0) [0|1] "" IHU
 SG_ OutdPm25VluFrmClima : 95|10@0+ (1.0,0.0) [0.0|1023.0] "Unitless" IHU
 SG_ OutdPm25VluFrmClima_UB : 127|1@0+ (1,0) [0|1] "" IHU
 SG_ PassSeatHeatgAutoSts : 33|2@0+ (1,0) [0|3] "" IHU
 SG_ PassSeatHeatgAutoSts_UB : 128|1@0+ (1,0) [0|1] "" IHU
 SG_ PassSeatHeatgAvlSts : 101|3@0+ (1,0) [0|7] "" IHU
 SG_ PassSeatHeatgAvlSts_UB : 129|1@0+ (1,0) [0|1] "" IHU
 SG_ PassSeatVentnAutoSts : 81|2@0+ (1,0) [0|3] "" IHU
 SG_ PassSeatVentnAutoSts_UB : 131|1@0+ (1,0) [0|1] "" IHU
 SG_ RemClimaDefrstSts : 117|1@0+ (1,0) [0|1] "" IHU
 SG_ RemClimaDefrstSts_UB : 132|1@0+ (1,0) [0|1] "" IHU
 SG_ RemClimaHvSts : 116|1@0+ (1,0) [0|1] "" IHU
 SG_ RemClimaHvSts_UB : 133|1@0+ (1,0) [0|1] "" IHU
 SG_ RemVentActvSts : 115|1@0+ (1,0) [0|1] "" IHU
 SG_ RemVentActvSts_UB : 134|1@0+ (1,0) [0|1] "" IHU
 SG_ RemVentReqRspnFb : 114|1@0+ (1,0) [0|1] "" IHU
 SG_ RemVentReqRspnFb_UB : 135|1@0+ (1,0) [0|1] "" IHU
 SG_ RemVentWarnSts : 97|2@0+ (1,0) [0|3] "" IHU
 SG_ RemVentWarnSts_UB : 136|1@0+ (1,0) [0|1] "" IHU
 SG_ TgtHvacAirTForMaxTZone : 63|13@0- (0.1,0.0) [-256.0|255.9] "degC" IHU,ZCUD
 SG_ TgtHvacAirTForMaxTZone_UB : 137|1@0+ (1,0) [0|1] "" IHU,ZCUD
 SG_ WinFailrStsAtPass : 98|1@0+ (1,0) [0|1] "" IHU
 SG_ WinFailrStsAtPass_UB : 138|1@0+ (1,0) [0|1] "" IHU
 SG_ WinFailrStsAtReRi : 113|1@0+ (1,0) [0|1] "" IHU
 SG_ WinFailrStsAtReRi_UB : 139|1@0+ (1,0) [0|1] "" IHU

BO_ 882 ZcupZCUCANFD2Fr10 : 64 ZCUP
 SG_ ClimaActvAlrmSts : 23|1@0+ (1,0) [0|1] "" IHU,ZCUD
 SG_ ClimaActvAlrmSts_UB : 7|1@0+ (1,0) [0|1] "" IHU,ZCUD
 SG_ HvacHeatElmAirMFlowEstimdFirstLe : 169|10@0+ (1.0,0.0) [0.0|1000.0] "Kg / h" ZCUD
 SG_ HvacHeatElmAirMFlowEstimdFirstLe_UB : 170|1@0+ (1,0) [0|1] "" ZCUD
 SG_ HvacHeatElmAirMFlowEstimdFirstRi : 191|10@0+ (1.0,0.0) [0.0|1000.0] "Kg / h" ZCUD
 SG_ HvacHeatElmAirMFlowEstimdFirstRi_UB : 171|1@0+ (1,0) [0|1] "" ZCUD
 SG_ HvacHeatElmAirMFlowEstimdSecLe : 193|10@0+ (1.0,0.0) [0.0|1000.0] "Kg / h" ZCUD
 SG_ HvacHeatElmAirMFlowEstimdSecLe_UB : 172|1@0+ (1,0) [0|1] "" ZCUD
 SG_ HvacHexAirT_UB : 6|1@0+ (1,0) [0|1] "" IHU,ZCUD
 SG_ HvacHexAirTHvacAirTForHeatrFrnt : 4|13@0- (0.1,0.0) [-256.0|255.9] "degC" IHU,ZCUD
 SG_ HvacHexAirTHvacAirTForHeatrFrntQf : 5|1@0+ (1,0) [0|1] "" IHU,ZCUD
 SG_ HwRowFrstPassFrntExtMotCtrl : 21|2@0+ (1,0) [0|3] "" IHU
 SG_ HwRowFrstPassFrntExtMotCtrl_UB : 22|1@0+ (1,0) [0|1] "" IHU
 SG_ HwRowFrstPassFrntHeiMotCtrl : 19|2@0+ (1,0) [0|3] "" IHU
 SG_ HwRowFrstPassFrntHeiMotCtrl_UB : 17|1@0+ (1,0) [0|1] "" IHU
 SG_ HwRowFrstPassHeiMotCtrl : 31|2@0+ (1,0) [0|3] "" IHU
 SG_ HwRowFrstPassHeiMotCtrl_UB : 16|1@0+ (1,0) [0|1] "" IHU
 SG_ HwRowFrstPassInclMotCtrl : 29|2@0+ (1,0) [0|3] "" IHU
 SG_ HwRowFrstPassInclMotCtrl_UB : 27|1@0+ (1,0) [0|1] "" IHU
 SG_ HwRowFrstPassSldMotCtrl : 25|2@0+ (1,0) [0|3] "" IHU
 SG_ HwRowFrstPassSldMotCtrl_UB : 26|1@0+ (1,0) [0|1] "" IHU
 SG_ IntrLiAmb1_UB : 174|1@0+ (1,0) [0|1] "" IHU
 SG_ IntrLiAmb1BnIngrd : 47|8@0+ (1.0,0.0) [0.0|255.0] "Unitless" IHU
 SG_ IntrLiAmb1GrnIngrd : 55|8@0+ (1.0,0.0) [0.0|255.0] "Unitless" IHU
 SG_ IntrLiAmb1Intensty : 95|7@0+ (1.0,0.0) [0.0|127.0] "Unitless" IHU
 SG_ IntrLiAmb1RedIngrd : 63|8@0+ (1.0,0.0) [0.0|255.0] "Unitless" IHU
 SG_ IntrLiAmb1SelCmd1 : 71|8@0+ (1.0,0.0) [0.0|255.0] "Unitless" IHU
 SG_ IntrLiAmb1SelCmd2 : 79|8@0+ (1.0,0.0) [0.0|255.0] "Unitless" IHU
 SG_ IntrLiAmb1SynchDelay : 103|7@0+ (1.0,0.0) [0.0|127.0] "Unitless" IHU
 SG_ IntrLiAmb1TargetTransitionTime : 87|8@0+ (1.0,0.0) [0.0|255.0] "Unitless" IHU
 SG_ IntrLiAmb1Trigger : 88|1@0+ (1,0) [0|1] "" IHU
 SG_ IntrLiAmb1Update : 96|1@0+ (1,0) [0|1] "" IHU
 SG_ IntrLiAmb2_UB : 175|1@0+ (1,0) [0|1] "" IHU
 SG_ IntrLiAmb2BnIngrd : 111|8@0+ (1.0,0.0) [0.0|255.0] "Unitless" IHU
 SG_ IntrLiAmb2GrnIngrd : 119|8@0+ (1.0,0.0) [0.0|255.0] "Unitless" IHU
 SG_ IntrLiAmb2Intensty : 159|7@0+ (1.0,0.0) [0.0|127.0] "Unitless" IHU
 SG_ IntrLiAmb2RedIngrd : 127|8@0+ (1.0,0.0) [0.0|255.0] "Unitless" IHU
 SG_ IntrLiAmb2SelCmd1 : 135|8@0+ (1.0,0.0) [0.0|255.0] "Unitless" IHU
 SG_ IntrLiAmb2SelCmd2 : 143|8@0+ (1.0,0.0) [0.0|255.0] "Unitless" IHU
 SG_ IntrLiAmb2SynchDelay : 167|7@0+ (1.0,0.0) [0.0|127.0] "Unitless" IHU
 SG_ IntrLiAmb2TargetTransitionTime : 151|8@0+ (1.0,0.0) [0.0|255.0] "Unitless" IHU
 SG_ IntrLiAmb2Trigger : 152|1@0+ (1,0) [0|1] "" IHU
 SG_ IntrLiAmb2Update : 160|1@0+ (1,0) [0|1] "" IHU
 SG_ WinHwSwtPassDoor : 39|3@0+ (1,0) [0|7] "" IHU
 SG_ WinHwSwtPassDoor_UB : 36|1@0+ (1,0) [0|1] "" IHU
 SG_ WinHwSwtPassReDoor : 35|3@0+ (1,0) [0|7] "" IHU
 SG_ WinHwSwtPassReDoor_UB : 32|1@0+ (1,0) [0|1] "" IHU

BO_ 451 ZcupZCUCANFD2Fr11 : 64 ZCUP
 SG_ BkpOfDstTrvldFromVehCom : 180|21@0+ (1.0,0.0) [0.0|2000000.0] "km" IHU
 SG_ BkpOfDstTrvldFromVehCom_UB : 207|1@0+ (1,0) [0|1] "" IHU
 SG_ CCMFragraCh1AvlTiPrec : 247|10@0+ (0.1,0.0) [0.0|100.0] "%" IHU
 SG_ CCMFragraCh1AvlTiPrec_UB : 293|1@0+ (1,0) [0|1] "" IHU
 SG_ CCMFragraCh2AvlTiPrec : 253|10@0+ (0.1,0.0) [0.0|100.0] "%" IHU
 SG_ CCMFragraCh2AvlTiPrec_UB : 292|1@0+ (1,0) [0|1] "" IHU
 SG_ CCMFragraCh3AvlTiPrec : 259|10@0+ (0.1,0.0) [0.0|100.0] "%" IHU
 SG_ CCMFragraCh3AvlTiPrec_UB : 291|1@0+ (1,0) [0|1] "" IHU
 SG_ CCMFragraCh4AvlTiPrec : 265|10@0+ (0.1,0.0) [0.0|100.0] "%" IHU
 SG_ CCMFragraCh4AvlTiPrec_UB : 290|1@0+ (1,0) [0|1] "" IHU
 SG_ CCMFragraCh5AvlTiPrec : 287|10@0+ (0.1,0.0) [0.0|100.0] "%" IHU
 SG_ CCMFragraCh5AvlTiPrec_UB : 289|1@0+ (1,0) [0|1] "" IHU
 SG_ CCMHvahFltIndcn : 233|1@0+ (1,0) [0|1] "" IHU
 SG_ CCMHvahFltIndcn_UB : 232|1@0+ (1,0) [0|1] "" IHU
 SG_ ClimaOvrHeatProActvSts : 303|1@0+ (1,0) [0|1] "" IHU
 SG_ ClimaOvrHeatProActvSts_UB : 302|1@0+ (1,0) [0|1] "" IHU
 SG_ ClimaPwrCns : 10|11@0+ (1.0,0.0) [0.0|2047.0] "W" IHU,ZCUD
 SG_ ClimaPwrCns_UB : 88|1@0+ (1,0) [0|1] "" IHU,ZCUD
 SG_ ClimaPwrCritDes : 34|11@0+ (1.0,0.0) [0.0|2047.0] "W" IHU,ZCUD
 SG_ ClimaPwrCritDes_UB : 89|1@0+ (1,0) [0|1] "" IHU,ZCUD
 SG_ ClimaPwrNormDes : 106|11@0+ (1.0,0.0) [0.0|2047.0] "W" IHU,ZCUD
 SG_ ClimaPwrNormDes_UB : 120|1@0+ (1,0) [0|1] "" IHU,ZCUD
 SG_ DstTrvldVldFromVehCom : 182|1@0+ (1,0) [0|1] "" IHU
 SG_ DstTrvldVldFromVehCom_UB : 181|1@0+ (1,0) [0|1] "" IHU
 SG_ EcoClimaSts : 301|1@0+ (1,0) [0|1] "" IHU,ZCUD
 SG_ EcoClimaSts_UB : 300|1@0+ (1,0) [0|1] "" IHU,ZCUD
 SG_ ElecAirVentnDrvrAvlStsLotus : 327|3@0+ (1,0) [0|7] "" Vector__XXX
 SG_ ElecAirVentnDrvrAvlStsLotus_UB : 313|1@0+ (1,0) [0|1] "" Vector__XXX
 SG_ ElecAirVentnPassAvlStsLotus : 324|3@0+ (1,0) [0|7] "" Vector__XXX
 SG_ ElecAirVentnPassAvlStsLotus_UB : 312|1@0+ (1,0) [0|1] "" Vector__XXX
 SG_ ElecAirVentnReLeAvlStsLotus : 335|3@0+ (1,0) [0|7] "" Vector__XXX
 SG_ ElecAirVentnReLeAvlStsLotus_UB : 329|1@0+ (1,0) [0|1] "" Vector__XXX
 SG_ ElecAirVentnReRiAvlStsLotus : 332|3@0+ (1,0) [0|7] "" Vector__XXX
 SG_ ElecAirVentnReRiAvlStsLotus_UB : 328|1@0+ (1,0) [0|1] "" Vector__XXX
 SG_ FltOfFrntTurnIndcrLe : 72|1@0+ (1,0) [0|1] "" IHU,ZCUD
 SG_ FltOfFrntTurnIndcrLe_UB : 90|1@0+ (1,0) [0|1] "" IHU,ZCUD
 SG_ FltOfFrntTurnIndcrRi : 64|1@0+ (1,0) [0|1] "" IHU,ZCUD
 SG_ FltOfFrntTurnIndcrRi_UB : 91|1@0+ (1,0) [0|1] "" IHU,ZCUD
 SG_ FltOfReTurnIndcrLe : 56|1@0+ (1,0) [0|1] "" IHU,ZCUD
 SG_ FltOfReTurnIndcrLe_UB : 107|1@0+ (1,0) [0|1] "" IHU,ZCUD
 SG_ FltOfReTurnIndcrRi : 48|1@0+ (1,0) [0|1] "" IHU,ZCUD
 SG_ FltOfReTurnIndcrRi_UB : 136|1@0+ (1,0) [0|1] "" IHU,ZCUD
 SG_ FrntClimaManModCmftSts : 343|2@0+ (1,0) [0|3] "" IHU
 SG_ FrntClimaManModCmftSts_UB : 321|1@0+ (1,0) [0|1] "" IHU
 SG_ FuSnsrActvSide_UB : 137|1@0+ (1,0) [0|1] "" IHU
 SG_ FuSnsrActvSideFuLvlSnsrRawVal : 7|11@0+ (1.0,0.0) [0.0|2047.0] "Ohm" IHU
 SG_ FuSnsrActvSideGenQF : 12|2@0+ (1,0) [0|3] "" IHU
 SG_ FuSnsrPasSide_UB : 138|1@0+ (1,0) [0|1] "" IHU
 SG_ FuSnsrPasSideFuLvlSnsrRawVal : 31|11@0+ (1.0,0.0) [0.0|2047.0] "Ohm" IHU
 SG_ FuSnsrPasSideGenQF : 36|2@0+ (1,0) [0|3] "" IHU
 SG_ HvacFanLvlFbFrnt : 307|4@0+ (1,0) [0|15] "" IHU
 SG_ HvacFanLvlFbFrnt_UB : 314|1@0+ (1,0) [0|1] "" IHU
 SG_ HvacFanLvlFbRe : 319|4@0+ (1,0) [0|15] "" IHU
 SG_ HvacFanLvlFbRe_UB : 315|1@0+ (1,0) [0|1] "" IHU
 SG_ HvacRecircAct : 55|7@0+ (1.0,0.0) [0.0|100.0] "%" IHU,ZCUD
 SG_ HvacRecircAct_UB : 139|1@0+ (1,0) [0|1] "" IHU,ZCUD
 SG_ IntLightPasSideDoorSupply : 63|7@0+ (1.0,0.0) [0.0|100.0] "Unitless" IHU,ZCUD
 SG_ IntLightPasSideDoorSupply_UB : 152|1@0+ (1,0) [0|1] "" IHU,ZCUD
 SG_ IntLightPasSideSupply : 71|7@0+ (1.0,0.0) [0.0|100.0] "Unitless" IHU,ZCUD
 SG_ IntLightPasSideSupply_UB : 153|1@0+ (1,0) [0|1] "" IHU,ZCUD
 SG_ IntLightRePasDoorSupply : 79|7@0+ (1.0,0.0) [0.0|100.0] "Unitless" IHU,ZCUD
 SG_ IntLightRePasDoorSupply_UB : 154|1@0+ (1,0) [0|1] "" IHU,ZCUD
 SG_ IntLightRePasSideSupply : 127|7@0+ (1.0,0.0) [0.0|100.0] "Unitless" IHU,ZCUD
 SG_ IntLightRePasSideSupply_UB : 155|1@0+ (1,0) [0|1] "" IHU,ZCUD
 SG_ PassMassgRunng : 235|1@0+ (1,0) [0|1] "" IHU
 SG_ PassMassgRunng_UB : 234|1@0+ (1,0) [0|1] "" IHU
 SG_ PassSeatActvSpplFct : 206|3@0+ (1,0) [0|7] "" IHU
 SG_ PassSeatActvSpplFct_UB : 236|1@0+ (1,0) [0|1] "" IHU
 SG_ PassSeatAutMovmtSts : 309|2@0+ (1,0) [0|3] "" IHU
 SG_ PassSeatAutMovmtSts_UB : 310|1@0+ (1,0) [0|1] "" IHU
 SG_ PassSeatHeatgLvlSts : 299|2@0+ (1,0) [0|3] "" IHU
 SG_ PassSeatHeatgLvlSts_UB : 311|1@0+ (1,0) [0|1] "" IHU
 SG_ PassSeatSwtSts2_UB : 237|1@0+ (1,0) [0|1] "" IHU
 SG_ PassSeatSwtSts2PassSeatSwtAdjmtOfSpplFctHozlSts : 223|2@0+ (1,0) [0|3] "" IHU
 SG_ PassSeatSwtSts2PassSeatSwtAdjmtOfSpplFctVerSts : 221|2@0+ (1,0) [0|3] "" IHU
 SG_ PassSeatSwtSts2PassSeatSwtHdrstHozlSts : 219|2@0+ (1,0) [0|3] "" IHU
 SG_ PassSeatSwtSts2PassSeatSwtHdrstVertSts : 217|2@0+ (1,0) [0|3] "" IHU
 SG_ PassSeatSwtSts2PassSeatSwtHeiFrntSts : 231|2@0+ (1,0) [0|3] "" IHU
 SG_ PassSeatSwtSts2PassSeatSwtHeiSts : 229|2@0+ (1,0) [0|3] "" IHU
 SG_ PassSeatSwtSts2PassSeatSwtInclSts : 227|2@0+ (1,0) [0|3] "" IHU
 SG_ PassSeatSwtSts2PassSeatSwtSelnOfSpplFctStsSts : 225|2@0+ (1,0) [0|3] "" IHU
 SG_ PassSeatSwtSts2PassSeatSwtSldSts : 239|2@0+ (1,0) [0|3] "" IHU
 SG_ PassSeatVentnLvlSts : 297|2@0+ (1,0) [0|3] "" IHU
 SG_ PassSeatVentnLvlSts_UB : 288|1@0+ (1,0) [0|1] "" IHU
 SG_ PwrEstimdAtStbForClima : 202|11@0+ (1.0,0.0) [0.0|2047.0] "W" IHU,ZCUD
 SG_ PwrEstimdAtStbForClima_UB : 203|1@0+ (1,0) [0|1] "" IHU,ZCUD
 SG_ ReClimaManModCmftSts : 341|2@0+ (1,0) [0|3] "" IHU
 SG_ ReClimaManModCmftSts_UB : 320|1@0+ (1,0) [0|1] "" IHU

BO_ 258 ZcupZCUCANFD2Fr12 : 64 ZCUP
 SG_ ClimaSts : 1|1@0+ (1,0) [0|1] "" IHU,ZCUD
 SG_ ClimaSts_UB : 8|1@0+ (1,0) [0|1] "" IHU,ZCUD
 SG_ DoorPassHndlSts : 7|3@0+ (1,0) [0|7] "" IHU,ZCUD
 SG_ DoorPassHndlSts_UB : 9|1@0+ (1,0) [0|1] "" IHU,ZCUD
 SG_ DoorPassReLockSts : 15|2@0+ (1,0) [0|3] "" IHU,ZCUD
 SG_ DoorPassReLockSts_UB : 10|1@0+ (1,0) [0|1] "" IHU,ZCUD
 SG_ DoorRiReHndlSts : 4|3@0+ (1,0) [0|7] "" IHU,ZCUD
 SG_ DoorRiReHndlSts_UB : 11|1@0+ (1,0) [0|1] "" IHU,ZCUD
 SG_ EngRunngReqByClima : 13|2@0+ (1,0) [0|3] "" IHU,ZCUD
 SG_ EngRunngReqByClima_UB : 23|1@0+ (1,0) [0|1] "" IHU,ZCUD
 SG_ FrntSeatPassLinFbToSecSeat : 46|3@0+ (1,0) [0|7] "" ZCUD
 SG_ FrntSeatPassLinFbToSecSeat_UB : 43|1@0+ (1,0) [0|1] "" ZCUD
 SG_ HvacCoolgEnaFrnt : 0|1@0+ (1,0) [0|1] "" IHU,ZCUD
 SG_ HvacCoolgEnaFrnt_UB : 22|1@0+ (1,0) [0|1] "" IHU,ZCUD
 SG_ HvacFanSts3HvacFanSpdFd : 39|8@0+ (20.0,300.0) [300.0|5400.0] "rpm" IHU
 SG_ HvacFanSts3HvacFanSpdFd_UB : 47|1@0+ (1,0) [0|1] "" IHU
 SG_ SeatClimaDurgClimaHmiSeatHeatgForRowThrdLe : 31|2@0+ (1,0) [0|3] "" ZCUD
 SG_ SeatClimaDurgClimaHmiSeatHeatgForRowThrdLe_UB : 21|1@0+ (1,0) [0|1] "" ZCUD
 SG_ SeatClimaDurgClimaHmiSeatHeatgForRowThrdRi : 29|2@0+ (1,0) [0|3] "" ZCUD
 SG_ SeatClimaDurgClimaHmiSeatHeatgForRowThrdRi_UB : 20|1@0+ (1,0) [0|1] "" ZCUD
 SG_ SeatClimaDurgClimaHmiSeatVentnForRowThrdLe : 27|2@0+ (1,0) [0|3] "" ZCUD
 SG_ SeatClimaDurgClimaHmiSeatVentnForRowThrdLe_UB : 19|1@0+ (1,0) [0|1] "" ZCUD
 SG_ SeatClimaDurgClimaHmiSeatVentnForRowThrdRi : 25|2@0+ (1,0) [0|3] "" ZCUD
 SG_ SeatClimaDurgClimaHmiSeatVentnForRowThrdRi_UB : 18|1@0+ (1,0) [0|1] "" ZCUD

BO_ 455 ZcupZCUCANFD2Fr15 : 64 ZCUP
 SG_ ClimaManModCmftPopUpReq : 38|3@0+ (1,0) [0|7] "" IHU
 SG_ ClimaManModCmftPopUpReq_UB : 35|1@0+ (1,0) [0|1] "" IHU
 SG_ ClimaOffReq : 31|2@0+ (1,0) [0|3] "" IHU
 SG_ ClimaOffReq_UB : 27|1@0+ (1,0) [0|1] "" IHU
 SG_ ClimaOvrHeatProRspn : 23|1@0+ (1,0) [0|1] "" IHU
 SG_ ClimaOvrHeatProRspn_UB : 26|1@0+ (1,0) [0|1] "" IHU
 SG_ ClimaOvrHeatProWarn : 29|2@0+ (1,0) [0|3] "" IHU
 SG_ ClimaOvrHeatProWarn_UB : 25|1@0+ (1,0) [0|1] "" IHU
 SG_ DiDblLock : 3|1@0+ (1,0) [0|1] "" IHU,ZCUD
 SG_ DiDblLock_UB : 9|1@0+ (1,0) [0|1] "" IHU,ZCUD
 SG_ RemClimaDelaySts : 2|1@0+ (1,0) [0|1] "" IHU
 SG_ RemClimaDelaySts_UB : 8|1@0+ (1,0) [0|1] "" IHU
 SG_ RemClimaExtnTiRspn : 1|1@0+ (1,0) [0|1] "" IHU
 SG_ RemClimaExtnTiRspn_UB : 16|1@0+ (1,0) [0|1] "" IHU
 SG_ RemClimaHvRspn : 0|1@0+ (1,0) [0|1] "" IHU
 SG_ RemClimaHvRspn_UB : 17|1@0+ (1,0) [0|1] "" IHU
 SG_ RemClimaWarn : 7|4@0+ (1,0) [0|15] "" IHU
 SG_ RemClimaWarn_UB : 18|1@0+ (1,0) [0|1] "" IHU
 SG_ RemStrtClimaRspn : 11|1@0+ (1,0) [0|1] "" IHU
 SG_ RemStrtClimaRspn_UB : 19|1@0+ (1,0) [0|1] "" IHU
 SG_ RoofOpnReqFrmClima : 10|1@0+ (1,0) [0|1] "" IHU,ZCUD
 SG_ RoofOpnReqFrmClima_UB : 20|1@0+ (1,0) [0|1] "" IHU,ZCUD
 SG_ SchedCmptHeatCoolFB : 15|2@0+ (1,0) [0|3] "" IHU
 SG_ SchedCmptHeatCoolFB_UB : 21|1@0+ (1,0) [0|1] "" IHU
 SG_ WinAndRoofReqFrmClima : 13|2@0+ (1,0) [0|3] "" IHU,ZCUD
 SG_ WinAndRoofReqFrmClima_UB : 22|1@0+ (1,0) [0|1] "" IHU,ZCUD

BO_ 51 ZcupZCUCANFD2Fr16 : 64 ZCUP
 SG_ BodyDataTraceZCUP1_UB : 511|1@0+ (1,0) [0|1] "" ZCUD
 SG_ BodyDataTraceZCUP1Functiondevpsignalgroup1 : 7|8@0+ (1.0,0.0) [0.0|255.0] "Unitless" ZCUD
 SG_ BodyDataTraceZCUP1Functiondevpsignalgroup2 : 15|8@0+ (1.0,0.0) [0.0|255.0] "Unitless" ZCUD
 SG_ BodyDataTraceZCUP1Functiondevpsignalgroup3 : 23|8@0+ (1.0,0.0) [0.0|255.0] "Unitless" ZCUD
 SG_ BodyDataTraceZCUP1Functiondevpsignalgroup4 : 31|8@0+ (1.0,0.0) [0.0|255.0] "Unitless" ZCUD
 SG_ BodyDataTraceZCUP1Functiondevpsignalgroup5 : 39|8@0+ (1.0,0.0) [0.0|255.0] "Unitless" ZCUD
 SG_ BodyDataTraceZCUP1Functiondevpsignalgroup6 : 47|8@0+ (1.0,0.0) [0.0|255.0] "Unitless" ZCUD
 SG_ BodyDataTraceZCUP1Functiondevpsignalgroup7 : 55|8@0+ (1.0,0.0) [0.0|255.0] "Unitless" ZCUD
 SG_ BodyDataTraceZCUP1Functiondevpsignalgroup8 : 63|8@0+ (1.0,0.0) [0.0|255.0] "Unitless" ZCUD
 SG_ BodyDataTraceZCUP2_UB : 510|1@0+ (1,0) [0|1] "" ZCUD
 SG_ BodyDataTraceZCUP2Functiondevpsignalgroup1 : 71|8@0+ (1.0,0.0) [0.0|255.0] "Unitless" ZCUD
 SG_ BodyDataTraceZCUP2Functiondevpsignalgroup2 : 79|8@0+ (1.0,0.0) [0.0|255.0] "Unitless" ZCUD
 SG_ BodyDataTraceZCUP2Functiondevpsignalgroup3 : 87|8@0+ (1.0,0.0) [0.0|255.0] "Unitless" ZCUD
 SG_ BodyDataTraceZCUP2Functiondevpsignalgroup4 : 95|8@0+ (1.0,0.0) [0.0|255.0] "Unitless" ZCUD
 SG_ BodyDataTraceZCUP2Functiondevpsignalgroup5 : 103|8@0+ (1.0,0.0) [0.0|255.0] "Unitless" ZCUD
 SG_ BodyDataTraceZCUP2Functiondevpsignalgroup6 : 111|8@0+ (1.0,0.0) [0.0|255.0] "Unitless" ZCUD
 SG_ BodyDataTraceZCUP2Functiondevpsignalgroup7 : 119|8@0+ (1.0,0.0) [0.0|255.0] "Unitless" ZCUD
 SG_ BodyDataTraceZCUP2Functiondevpsignalgroup8 : 127|8@0+ (1.0,0.0) [0.0|255.0] "Unitless" ZCUD
 SG_ BodyDataTraceZCUP3_UB : 509|1@0+ (1,0) [0|1] "" ZCUD
 SG_ BodyDataTraceZCUP3Functiondevpsignalgroup1 : 135|8@0+ (1.0,0.0) [0.0|255.0] "Unitless" ZCUD
 SG_ BodyDataTraceZCUP3Functiondevpsignalgroup2 : 143|8@0+ (1.0,0.0) [0.0|255.0] "Unitless" ZCUD
 SG_ BodyDataTraceZCUP3Functiondevpsignalgroup3 : 151|8@0+ (1.0,0.0) [0.0|255.0] "Unitless" ZCUD
 SG_ BodyDataTraceZCUP3Functiondevpsignalgroup4 : 159|8@0+ (1.0,0.0) [0.0|255.0] "Unitless" ZCUD
 SG_ BodyDataTraceZCUP3Functiondevpsignalgroup5 : 167|8@0+ (1.0,0.0) [0.0|255.0] "Unitless" ZCUD
 SG_ BodyDataTraceZCUP3Functiondevpsignalgroup6 : 175|8@0+ (1.0,0.0) [0.0|255.0] "Unitless" ZCUD
 SG_ BodyDataTraceZCUP3Functiondevpsignalgroup7 : 183|8@0+ (1.0,0.0) [0.0|255.0] "Unitless" ZCUD
 SG_ BodyDataTraceZCUP3Functiondevpsignalgroup8 : 191|8@0+ (1.0,0.0) [0.0|255.0] "Unitless" ZCUD
 SG_ BodyDataTraceZCUP4_UB : 508|1@0+ (1,0) [0|1] "" ZCUD
 SG_ BodyDataTraceZCUP4Functiondevpsignalgroup1 : 199|8@0+ (1.0,0.0) [0.0|255.0] "Unitless" ZCUD
 SG_ BodyDataTraceZCUP4Functiondevpsignalgroup2 : 207|8@0+ (1.0,0.0) [0.0|255.0] "Unitless" ZCUD
 SG_ BodyDataTraceZCUP4Functiondevpsignalgroup3 : 215|8@0+ (1.0,0.0) [0.0|255.0] "Unitless" ZCUD
 SG_ BodyDataTraceZCUP4Functiondevpsignalgroup4 : 223|8@0+ (1.0,0.0) [0.0|255.0] "Unitless" ZCUD
 SG_ BodyDataTraceZCUP4Functiondevpsignalgroup5 : 231|8@0+ (1.0,0.0) [0.0|255.0] "Unitless" ZCUD
 SG_ BodyDataTraceZCUP4Functiondevpsignalgroup6 : 239|8@0+ (1.0,0.0) [0.0|255.0] "Unitless" ZCUD
 SG_ BodyDataTraceZCUP4Functiondevpsignalgroup7 : 247|8@0+ (1.0,0.0) [0.0|255.0] "Unitless" ZCUD
 SG_ BodyDataTraceZCUP4Functiondevpsignalgroup8 : 255|8@0+ (1.0,0.0) [0.0|255.0] "Unitless" ZCUD
 SG_ BodyDataTraceZCUP5_UB : 507|1@0+ (1,0) [0|1] "" ZCUD
 SG_ BodyDataTraceZCUP5Functiondevpsignalgroup1 : 263|8@0+ (1.0,0.0) [0.0|255.0] "Unitless" ZCUD
 SG_ BodyDataTraceZCUP5Functiondevpsignalgroup2 : 271|8@0+ (1.0,0.0) [0.0|255.0] "Unitless" ZCUD
 SG_ BodyDataTraceZCUP5Functiondevpsignalgroup3 : 279|8@0+ (1.0,0.0) [0.0|255.0] "Unitless" ZCUD
 SG_ BodyDataTraceZCUP5Functiondevpsignalgroup4 : 287|8@0+ (1.0,0.0) [0.0|255.0] "Unitless" ZCUD
 SG_ BodyDataTraceZCUP5Functiondevpsignalgroup5 : 295|8@0+ (1.0,0.0) [0.0|255.0] "Unitless" ZCUD
 SG_ BodyDataTraceZCUP5Functiondevpsignalgroup6 : 303|8@0+ (1.0,0.0) [0.0|255.0] "Unitless" ZCUD
 SG_ BodyDataTraceZCUP5Functiondevpsignalgroup7 : 311|8@0+ (1.0,0.0) [0.0|255.0] "Unitless" ZCUD
 SG_ BodyDataTraceZCUP5Functiondevpsignalgroup8 : 319|8@0+ (1.0,0.0) [0.0|255.0] "Unitless" ZCUD
 SG_ BodyDataTraceZCUP6_UB : 506|1@0+ (1,0) [0|1] "" ZCUD
 SG_ BodyDataTraceZCUP6Functiondevpsignalgroup1 : 327|8@0+ (1.0,0.0) [0.0|255.0] "Unitless" ZCUD
 SG_ BodyDataTraceZCUP6Functiondevpsignalgroup2 : 335|8@0+ (1.0,0.0) [0.0|255.0] "Unitless" ZCUD
 SG_ BodyDataTraceZCUP6Functiondevpsignalgroup3 : 343|8@0+ (1.0,0.0) [0.0|255.0] "Unitless" ZCUD
 SG_ BodyDataTraceZCUP6Functiondevpsignalgroup4 : 351|8@0+ (1.0,0.0) [0.0|255.0] "Unitless" ZCUD
 SG_ BodyDataTraceZCUP6Functiondevpsignalgroup5 : 359|8@0+ (1.0,0.0) [0.0|255.0] "Unitless" ZCUD
 SG_ BodyDataTraceZCUP6Functiondevpsignalgroup6 : 367|8@0+ (1.0,0.0) [0.0|255.0] "Unitless" ZCUD
 SG_ BodyDataTraceZCUP6Functiondevpsignalgroup7 : 375|8@0+ (1.0,0.0) [0.0|255.0] "Unitless" ZCUD
 SG_ BodyDataTraceZCUP6Functiondevpsignalgroup8 : 383|8@0+ (1.0,0.0) [0.0|255.0] "Unitless" ZCUD
 SG_ BodyDataTraceZCUP7_UB : 505|1@0+ (1,0) [0|1] "" ZCUD
 SG_ BodyDataTraceZCUP7Functiondevpsignalgroup1 : 391|8@0+ (1.0,0.0) [0.0|255.0] "Unitless" ZCUD
 SG_ BodyDataTraceZCUP7Functiondevpsignalgroup2 : 399|8@0+ (1.0,0.0) [0.0|255.0] "Unitless" ZCUD
 SG_ BodyDataTraceZCUP7Functiondevpsignalgroup3 : 407|8@0+ (1.0,0.0) [0.0|255.0] "Unitless" ZCUD
 SG_ BodyDataTraceZCUP7Functiondevpsignalgroup4 : 415|8@0+ (1.0,0.0) [0.0|255.0] "Unitless" ZCUD
 SG_ BodyDataTraceZCUP7Functiondevpsignalgroup5 : 423|8@0+ (1.0,0.0) [0.0|255.0] "Unitless" ZCUD
 SG_ BodyDataTraceZCUP7Functiondevpsignalgroup6 : 431|8@0+ (1.0,0.0) [0.0|255.0] "Unitless" ZCUD
 SG_ BodyDataTraceZCUP7Functiondevpsignalgroup7 : 439|8@0+ (1.0,0.0) [0.0|255.0] "Unitless" ZCUD
 SG_ BodyDataTraceZCUP7Functiondevpsignalgroup8 : 447|8@0+ (1.0,0.0) [0.0|255.0] "Unitless" ZCUD

BO_ 1350 ZcupZCUCANFD2VFCVectorFr : 8 ZCUP
 SG_ VFCVectorZCUPBlockID : 1|2@0+ (1.0,0.0) [0.0|3.0] "Unitless" IHU
 SG_ VFCVectorZCUPVFCid0 : 2|1@0+ (1,0) [0|1] "" IHU
 SG_ VFCVectorZCUPVFCid1 : 3|1@0+ (1,0) [0|1] "" IHU
 SG_ VFCVectorZCUPVFCid10 : 12|1@0+ (1,0) [0|1] "" IHU
 SG_ VFCVectorZCUPVFCid11 : 13|1@0+ (1,0) [0|1] "" IHU
 SG_ VFCVectorZCUPVFCid12 : 14|1@0+ (1,0) [0|1] "" IHU
 SG_ VFCVectorZCUPVFCid13 : 15|1@0+ (1,0) [0|1] "" IHU
 SG_ VFCVectorZCUPVFCid14 : 16|1@0+ (1,0) [0|1] "" IHU
 SG_ VFCVectorZCUPVFCid15 : 17|1@0+ (1,0) [0|1] "" IHU
 SG_ VFCVectorZCUPVFCid16 : 18|1@0+ (1,0) [0|1] "" IHU
 SG_ VFCVectorZCUPVFCid17 : 19|1@0+ (1,0) [0|1] "" IHU
 SG_ VFCVectorZCUPVFCid18 : 20|1@0+ (1,0) [0|1] "" IHU
 SG_ VFCVectorZCUPVFCid19 : 21|1@0+ (1,0) [0|1] "" IHU
 SG_ VFCVectorZCUPVFCid2 : 4|1@0+ (1,0) [0|1] "" IHU
 SG_ VFCVectorZCUPVFCid20 : 22|1@0+ (1,0) [0|1] "" IHU
 SG_ VFCVectorZCUPVFCid21 : 23|1@0+ (1,0) [0|1] "" IHU
 SG_ VFCVectorZCUPVFCid22 : 24|1@0+ (1,0) [0|1] "" IHU
 SG_ VFCVectorZCUPVFCid23 : 25|1@0+ (1,0) [0|1] "" IHU
 SG_ VFCVectorZCUPVFCid24 : 26|1@0+ (1,0) [0|1] "" IHU
 SG_ VFCVectorZCUPVFCid25 : 27|1@0+ (1,0) [0|1] "" IHU
 SG_ VFCVectorZCUPVFCid26 : 28|1@0+ (1,0) [0|1] "" IHU
 SG_ VFCVectorZCUPVFCid27 : 29|1@0+ (1,0) [0|1] "" IHU
 SG_ VFCVectorZCUPVFCid28 : 30|1@0+ (1,0) [0|1] "" IHU
 SG_ VFCVectorZCUPVFCid29 : 31|1@0+ (1,0) [0|1] "" IHU
 SG_ VFCVectorZCUPVFCid3 : 5|1@0+ (1,0) [0|1] "" IHU
 SG_ VFCVectorZCUPVFCid30 : 32|1@0+ (1,0) [0|1] "" IHU
 SG_ VFCVectorZCUPVFCid31 : 33|1@0+ (1,0) [0|1] "" IHU
 SG_ VFCVectorZCUPVFCid32 : 34|1@0+ (1,0) [0|1] "" IHU
 SG_ VFCVectorZCUPVFCid33 : 35|1@0+ (1,0) [0|1] "" IHU
 SG_ VFCVectorZCUPVFCid34 : 36|1@0+ (1,0) [0|1] "" IHU
 SG_ VFCVectorZCUPVFCid35 : 37|1@0+ (1,0) [0|1] "" IHU
 SG_ VFCVectorZCUPVFCid36 : 38|1@0+ (1,0) [0|1] "" IHU
 SG_ VFCVectorZCUPVFCid37 : 39|1@0+ (1,0) [0|1] "" IHU
 SG_ VFCVectorZCUPVFCid38 : 40|1@0+ (1,0) [0|1] "" IHU
 SG_ VFCVectorZCUPVFCid39 : 41|1@0+ (1,0) [0|1] "" IHU
 SG_ VFCVectorZCUPVFCid4 : 6|1@0+ (1,0) [0|1] "" IHU
 SG_ VFCVectorZCUPVFCid40 : 42|1@0+ (1,0) [0|1] "" IHU
 SG_ VFCVectorZCUPVFCid41 : 43|1@0+ (1,0) [0|1] "" IHU
 SG_ VFCVectorZCUPVFCid42 : 44|1@0+ (1,0) [0|1] "" IHU
 SG_ VFCVectorZCUPVFCid43 : 45|1@0+ (1,0) [0|1] "" IHU
 SG_ VFCVectorZCUPVFCid44 : 46|1@0+ (1,0) [0|1] "" IHU
 SG_ VFCVectorZCUPVFCid45 : 47|1@0+ (1,0) [0|1] "" IHU
 SG_ VFCVectorZCUPVFCid46 : 48|1@0+ (1,0) [0|1] "" IHU
 SG_ VFCVectorZCUPVFCid47 : 49|1@0+ (1,0) [0|1] "" IHU
 SG_ VFCVectorZCUPVFCid48 : 50|1@0+ (1,0) [0|1] "" IHU
 SG_ VFCVectorZCUPVFCid49 : 51|1@0+ (1,0) [0|1] "" IHU
 SG_ VFCVectorZCUPVFCid5 : 7|1@0+ (1,0) [0|1] "" IHU
 SG_ VFCVectorZCUPVFCid50 : 52|1@0+ (1,0) [0|1] "" IHU
 SG_ VFCVectorZCUPVFCid51 : 53|1@0+ (1,0) [0|1] "" IHU
 SG_ VFCVectorZCUPVFCid52 : 54|1@0+ (1,0) [0|1] "" IHU
 SG_ VFCVectorZCUPVFCid53 : 55|1@0+ (1,0) [0|1] "" IHU
 SG_ VFCVectorZCUPVFCid54 : 56|1@0+ (1,0) [0|1] "" IHU
 SG_ VFCVectorZCUPVFCid55 : 57|1@0+ (1,0) [0|1] "" IHU
 SG_ VFCVectorZCUPVFCid56 : 58|1@0+ (1,0) [0|1] "" IHU
 SG_ VFCVectorZCUPVFCid57 : 59|1@0+ (1,0) [0|1] "" IHU
 SG_ VFCVectorZCUPVFCid58 : 60|1@0+ (1,0) [0|1] "" IHU
 SG_ VFCVectorZCUPVFCid59 : 61|1@0+ (1,0) [0|1] "" IHU
 SG_ VFCVectorZCUPVFCid6 : 8|1@0+ (1,0) [0|1] "" IHU
 SG_ VFCVectorZCUPVFCid60 : 62|1@0+ (1,0) [0|1] "" IHU
 SG_ VFCVectorZCUPVFCid61 : 63|1@0+ (1,0) [0|1] "" IHU
 SG_ VFCVectorZCUPVFCid7 : 9|1@0+ (1,0) [0|1] "" IHU
 SG_ VFCVectorZCUPVFCid8 : 10|1@0+ (1,0) [0|1] "" IHU
 SG_ VFCVectorZCUPVFCid9 : 11|1@0+ (1,0) [0|1] "" IHU

CM_ SG_ 643 CdsParkgClimaActv "CDS parking climatization activation status.";
CM_ SG_ 643 ClimaOvrHeatProActv "Over heat protection function activation status.";
CM_ SG_ 643 CmptmtAirDistbnRspAirDistbnDrvr "Air Distribution for driver";
CM_ SG_ 643 CmptmtAirDistbnRspAirDistbnPass "Air Distribution for passenger";
CM_ SG_ 643 CmptmtAirDistbnRspAirDistbnSecLe "Air Distribution for second left";
CM_ SG_ 643 CmptmtAirDistbnRspAirDistbnSecRi "Air Distribution for second right";
CM_ SG_ 643 CmptmtAirDistbnRspAirDistbnThrd "Air Distribution for third floor";
CM_ SG_ 643 DoorPassCinhIntFailInfCinchFlt1 "Cinch fault";
CM_ SG_ 643 DoorPassCinhIntFailInfCinchRestFlt "Cinch reset fault";
CM_ SG_ 643 DoorPassRelsFailCinchOverTimed "Cinch processwas not successfull. It is overtimed.";
CM_ SG_ 643 DoorPassRelsFailFailure1 "Issue described by requiremnt according to specific project";
CM_ SG_ 643 DoorPassRelsFailMechRels "Door Mechanical release (No Power operated)";
CM_ SG_ 643 DoorRiReCinhIntFailInfCinchFlt1 "Cinch fault";
CM_ SG_ 643 DoorRiReCinhIntFailInfCinchRestFlt "Cinch reset fault";
CM_ SG_ 643 DoorRiReRelsFailCinchOverTimed "Cinch processwas not successfull. It is overtimed.";
CM_ SG_ 643 DoorRiReRelsFailFailure1 "Issue described by requiremnt according to specific project";
CM_ SG_ 643 DoorRiReRelsFailMechRels "Door Mechanical release (No Power operated)";
CM_ SG_ 643 HvacAirTForMaxTZoneEvaprTFrnt "hvac outlet temp in max temp zone.";
CM_ SG_ 643 HvacAirTForMaxTZoneEvaprTQf "hvac outlet temp in max temp zone Of";
CM_ SG_ 643 HvacHeatgReq "Hvac heating request";
CM_ SG_ 643 HvahAirTsp "Air temperature target temperature at outlet of HVAH. Only used by EF1E.";
CM_ SG_ 643 IntPm25LvlFrmClima "Inside PM 2.5 level of compartment.";
CM_ SG_ 643 IntPm25VluFrmClima "Inside PM 2.5 value of compartment.";
CM_ SG_ 643 OutdPm25LvlFrmClima "Outside PM 2.5 level of compartment.";
CM_ SG_ 643 OutdPm25VluFrmClima "Outside PM2.5 value of compartment.";
CM_ SG_ 643 PassSeatHeatgAutoSts "Automatic status feedback signal for seats heating of first row right.";
CM_ SG_ 643 PassSeatHeatgAvlSts "Seat heating on, off, error and limitation status for passenger seat.";
CM_ SG_ 643 PassSeatVentnAutoSts "Automatic status feedback signal for seats ventilation of first row right.";
CM_ SG_ 643 RemClimaDefrstSts "Feedback remote defrost status to HMI/Telematics";
CM_ SG_ 643 RemClimaHvSts "Climate request high voltage status.";
CM_ SG_ 643 RemVentActvSts "Report remote ventilation activation status.";
CM_ SG_ 643 RemVentReqRspnFb "Feedback to telematics whether receive remote ventilation activate/deactivate successfully.";
CM_ SG_ 643 RemVentWarnSts "Reporting actuator or energy errors during RemVent ";
CM_ SG_ 643 TgtHvacAirTForMaxTZone "Target hvac Air temperature for max Temp zone.";
CM_ SG_ 643 WinFailrStsAtPass "Report failure if Window motor is not possible to Run";
CM_ SG_ 643 WinFailrStsAtReRi "Report failure if Window motor is not possible to Run";
CM_ SG_ 882 ClimaActvAlrmSts "Siignal to inform IMS (Interior Motion Sensor) that some kind of climatisation/heating/cooling/fan running activity is ongoing.";
CM_ SG_ 882 HvacHeatElmAirMFlowEstimdFirstLe "Estimated air flow in front HVAC heater element for first row left";
CM_ SG_ 882 HvacHeatElmAirMFlowEstimdFirstRi "Estimated air flow in front HVAC heater element for first row right";
CM_ SG_ 882 HvacHeatElmAirMFlowEstimdSecLe "Estimated air flow in front HVAC heater element for second row left";
CM_ SG_ 882 HvacHexAirTHvacAirTForHeatrFrnt "Temperature";
CM_ SG_ 882 HvacHexAirTHvacAirTForHeatrFrntQf "Interpretation: 
SnsrDataNotOk - The accuracy of the data is undefinable
SnrsDataOk - The data is calculated with the specified accuracy";
CM_ SG_ 882 HwRowFrstPassFrntExtMotCtrl "Passenger Seat Front Extension Motor Control signal";
CM_ SG_ 882 HwRowFrstPassFrntHeiMotCtrl "Passenger Seat Front Height Motor Control signal";
CM_ SG_ 882 HwRowFrstPassHeiMotCtrl "Passenger Seat Height Motor Control signal";
CM_ SG_ 882 HwRowFrstPassInclMotCtrl "Passenger Seat Inclination Motor Control signal";
CM_ SG_ 882 HwRowFrstPassSldMotCtrl "Passenger Seat Slide Motor Control signal";
CM_ SG_ 882 IntrLiAmb1BnIngrd "Blue ingredient of signal";
CM_ SG_ 882 IntrLiAmb1GrnIngrd "Green ingredient of signal";
CM_ SG_ 882 IntrLiAmb1Intensty "Intensity signal";
CM_ SG_ 882 IntrLiAmb1RedIngrd "Red ingredient of signal";
CM_ SG_ 882 IntrLiAmb1SelCmd1 "Select command for the first 8 nodes";
CM_ SG_ 882 IntrLiAmb1SelCmd2 "Select command for the second group of 8 nodes";
CM_ SG_ 882 IntrLiAmb1SynchDelay "Signal for synchronization between both LIN buses.";
CM_ SG_ 882 IntrLiAmb1TargetTransitionTime "Delay in 20 ms increments";
CM_ SG_ 882 IntrLiAmb1Trigger "Signal used as a go signal for the ALM cluster";
CM_ SG_ 882 IntrLiAmb1Update "1 Used to update data in ALM. 0 Used to ignore received data.";
CM_ SG_ 882 IntrLiAmb2BnIngrd "Blue ingredient of signal";
CM_ SG_ 882 IntrLiAmb2GrnIngrd "Green ingredient of signal";
CM_ SG_ 882 IntrLiAmb2Intensty "Intensity signal";
CM_ SG_ 882 IntrLiAmb2RedIngrd "Red ingredient of signal";
CM_ SG_ 882 IntrLiAmb2SelCmd1 "Select command for the first 8 nodes";
CM_ SG_ 882 IntrLiAmb2SelCmd2 "Select command for the second group of 8 nodes";
CM_ SG_ 882 IntrLiAmb2SynchDelay "Signal for synchronization between both LIN buses.";
CM_ SG_ 882 IntrLiAmb2TargetTransitionTime "Delay in 20 ms increments";
CM_ SG_ 882 IntrLiAmb2Trigger "Signal used as a go signal for the ALM cluster";
CM_ SG_ 882 IntrLiAmb2Update "1 is Used to update data in ALM and  0 is Used to ignore received data.";
CM_ SG_ 882 WinHwSwtPassDoor "Signal from the passenger door hardwired switch to the door control modules containing the state of the window switches.  ";
CM_ SG_ 882 WinHwSwtPassReDoor "Signal from the passenger door hardwired switch to the door control modules containing the state of the window switches. ";
CM_ SG_ 451 BkpOfDstTrvldFromVehCom "Saved backupvalue";
CM_ SG_ 451 CCMFragraCh1AvlTiPrec "Percentage of time available for Channel 1 air fragrances from CCM.";
CM_ SG_ 451 CCMFragraCh2AvlTiPrec "Percentage of time available for Channel 2 air fragrances from CCM.";
CM_ SG_ 451 CCMFragraCh3AvlTiPrec "Percentage of time available for Channel 3 air fragrances from CCM.";
CM_ SG_ 451 CCMFragraCh4AvlTiPrec "Percentage of time available for Channel 4 air fragrances from CCM.";
CM_ SG_ 451 CCMFragraCh5AvlTiPrec "Percentage of time available for Channel 5 air fragrances from CCM.";
CM_ SG_ 451 CCMHvahFltIndcn "HVAH high voltage fault indication from CCM";
CM_ SG_ 451 ClimaOvrHeatProActvSts "Feedback over heat protection function enable/disable.";
CM_ SG_ 451 ClimaPwrCns "Actual current consumption of electric climate loads";
CM_ SG_ 451 ClimaPwrCritDes "Critical power level needed for electric climate loads";
CM_ SG_ 451 ClimaPwrNormDes "Desired power wanted for electric climate loads";
CM_ SG_ 451 DstTrvldVldFromVehCom "Indication if the transmitted backupvalue is valid or not";
CM_ SG_ 451 EcoClimaSts "Eco climate status.";
CM_ SG_ 451 ElecAirVentnDrvrAvlStsLotus "Electrical air ventilation motor on, off, error status.";
CM_ SG_ 451 ElecAirVentnPassAvlStsLotus "Electrical air ventilation motor on, off, error status.";
CM_ SG_ 451 ElecAirVentnReLeAvlStsLotus "Electrical air ventilation motor on, off, error status.";
CM_ SG_ 451 ElecAirVentnReRiAvlStsLotus "Electrical air ventilation motor on, off, error status.";
CM_ SG_ 451 FltOfFrntTurnIndcrLe "Light source failure (open load or short circuit) indication to driver, left front direction indicator.";
CM_ SG_ 451 FltOfFrntTurnIndcrRi "Light source failure (open load or short circuit) indication to driver, right front direction indicator.";
CM_ SG_ 451 FltOfReTurnIndcrLe "Light source failure (open load or short circuit) indication to driver, left rear direction indicator.";
CM_ SG_ 451 FltOfReTurnIndcrRi "Light source failure (open load or short circuit) indication to driver, right rear direction indicator.";
CM_ SG_ 451 FrntClimaManModCmftSts "Front climate manual mode comfort status";
CM_ SG_ 451 FuSnsrActvSideFuLvlSnsrRawVal "Fuel sensor value in ohm from the Active side sensor. Fuel level sensor raw value";
CM_ SG_ 451 FuSnsrActvSideGenQF "Fuel sensor value in ohm from the Passive side sensor QF for fuel level raw sensorn value";
CM_ SG_ 451 FuSnsrPasSideFuLvlSnsrRawVal "Fuel sensor value in ohm from the Passive side sensor Fuel level sensor raw value";
CM_ SG_ 451 FuSnsrPasSideGenQF "Fuel sensor value in ohm from the Passive side sensor QF for fuel level raw sensorn value";
CM_ SG_ 451 HvacFanLvlFbFrnt "Front Hvac Fan level feedback ";
CM_ SG_ 451 HvacFanLvlFbRe "Rear Hvac Fan level feedback";
CM_ SG_ 451 HvacRecircAct "Amount of recirculated air in front HVAC. ";
CM_ SG_ 451 IntLightPasSideDoorSupply "PWM control status signal of Passenger Side step lights illumination";
CM_ SG_ 451 IntLightPasSideSupply "PWM control status signal of Passenger (Front and Rear) Side step lights illumination .";
CM_ SG_ 451 IntLightRePasDoorSupply "PWM control status signal of Passenger Side rear door step lights illumination .";
CM_ SG_ 451 IntLightRePasSideSupply "PWM control status signal of Passenger Rear Side step lights illumination .";
CM_ SG_ 451 PassMassgRunng "Seat Massage Running Row First Passager";
CM_ SG_ 451 PassSeatActvSpplFct "Passenger Seat Active Multifunction (indicates which function is currently controlled by the multifunction switch)";
CM_ SG_ 451 PassSeatAutMovmtSts "Passenger Seat Automatic Movement Status Feedback";
CM_ SG_ 451 PassSeatHeatgLvlSts "Seat heating level for first row passenger seat.";
CM_ SG_ 451 PassSeatSwtSts2PassSeatSwtAdjmtOfSpplFctHozlSts "Horizontal Multifunction";
CM_ SG_ 451 PassSeatSwtSts2PassSeatSwtAdjmtOfSpplFctVerSts "Vertical Multifunction";
CM_ SG_ 451 PassSeatSwtSts2PassSeatSwtHdrstHozlSts "Headrest Horizontal Status";
CM_ SG_ 451 PassSeatSwtSts2PassSeatSwtHdrstVertSts "Headrest Vertical Status";
CM_ SG_ 451 PassSeatSwtSts2PassSeatSwtHeiFrntSts "Front Height Status";
CM_ SG_ 451 PassSeatSwtSts2PassSeatSwtHeiSts "Height Status";
CM_ SG_ 451 PassSeatSwtSts2PassSeatSwtInclSts "Inclination Status";
CM_ SG_ 451 PassSeatSwtSts2PassSeatSwtSelnOfSpplFctStsSts "Selector Multifunction";
CM_ SG_ 451 PassSeatSwtSts2PassSeatSwtSldSts "Slide Status";
CM_ SG_ 451 PassSeatVentnLvlSts "Seat ventilation level for first row passenger seat.";
CM_ SG_ 451 PwrEstimdAtStbForClima "Estimated power reduction in standby";
CM_ SG_ 451 ReClimaManModCmftSts "Rear climate manual mode comfort status";
CM_ SG_ 258 ClimaSts "Climatisation status";
CM_ SG_ 258 DoorPassHndlSts "To inform about passenger door handle status, i.e. unknown, opened, closed according to
DoorPassHndlSts
- Ukwn
- FullRtrctd
- MovgOut
- StopDurgDply
- FullDplyd
- MovgIn
- StopDurgRtrct
- Flt";
CM_ SG_ 258 DoorPassReLockSts "DoorPassReLockSts - Passenger Rear Door Lock Status";
CM_ SG_ 258 DoorRiReHndlSts "To inform about right rear door handle status, i.e. unknown, opened, closed according to
DoorRiReHndlSts
- Ukwn
- FullRtrctd
- MovgOut
- StopDurgDply
- FullDplyd
- MovgIn
- StopDurgRtrct
- Flt";
CM_ SG_ 258 EngRunngReqByClima "Request from climate control to start engine or inhibit stop. Used maintain a desirable comfort level in compartment.";
CM_ SG_ 258 FrntSeatPassLinFbToSecSeat "First Passenger Seat control status feedback to Second Row Seat";
CM_ SG_ 258 HvacCoolgEnaFrnt "Request cooling for front HVAC. ";
CM_ SG_ 258 HvacFanSts3HvacFanSpdFd "blower speed feedback";
CM_ SG_ 258 SeatClimaDurgClimaHmiSeatHeatgForRowThrdLe "Used to activate seat heating during parking climatisation.";
CM_ SG_ 258 SeatClimaDurgClimaHmiSeatHeatgForRowThrdRi "Used to activate seat heating during parking climatisation.";
CM_ SG_ 258 SeatClimaDurgClimaHmiSeatVentnForRowThrdLe "Used to activate seat ventilation during parking climatisation.";
CM_ SG_ 258 SeatClimaDurgClimaHmiSeatVentnForRowThrdRi "Used to activate seat ventilation during parking climatisation.";
CM_ SG_ 455 ClimaManModCmftPopUpReq "Climate maunal mode comfort information pop up request.";
CM_ SG_ 455 ClimaOffReq "Signal sent from CCM to IHU to request climate off.";
CM_ SG_ 455 ClimaOvrHeatProRspn "Response signal used to notice telematics system that climate control system already receive setting signal for over heat protection from telematics system successfully.";
CM_ SG_ 455 ClimaOvrHeatProWarn "Feedback warning of Over heat protection function";
CM_ SG_ 455 DiDblLock "Disable double lock due to increasing incar carbon dioxide concentration.";
CM_ SG_ 455 RemClimaDelaySts "remote climate delay request status feedback.";
CM_ SG_ 455 RemClimaExtnTiRspn "Remote climate delay time execution response.";
CM_ SG_ 455 RemClimaHvRspn "Remote climate high voltage request receiving response to telematics system.";
CM_ SG_ 455 RemClimaWarn "Remote climate activation failure feedback.";
CM_ SG_ 455 RemStrtClimaRspn "remote start climatization response to telematics.";
CM_ SG_ 455 RoofOpnReqFrmClima "Roof window open request from climate.";
CM_ SG_ 455 SchedCmptHeatCoolFB "Scheduled Climate Status Feedback signal";
CM_ SG_ 455 WinAndRoofReqFrmClima "To request open or close all windows and roof. 0x0: No req; 0x1: Open req; 0x2: Close req.";
CM_ SG_ 51 BodyDataTraceZCUP1Functiondevpsignalgroup1 "ZCUDP internal signal group1.";
CM_ SG_ 51 BodyDataTraceZCUP1Functiondevpsignalgroup2 "ZCUDP internal signal group2.";
CM_ SG_ 51 BodyDataTraceZCUP1Functiondevpsignalgroup3 "ZCUDP internal signal group3.";
CM_ SG_ 51 BodyDataTraceZCUP1Functiondevpsignalgroup4 "ZCUDP internal signal group4.";
CM_ SG_ 51 BodyDataTraceZCUP1Functiondevpsignalgroup5 "ZCUDP internal signal group5.";
CM_ SG_ 51 BodyDataTraceZCUP1Functiondevpsignalgroup6 "ZCUDP internal signal group6.";
CM_ SG_ 51 BodyDataTraceZCUP1Functiondevpsignalgroup7 "ZCUDP internal signal group7.";
CM_ SG_ 51 BodyDataTraceZCUP1Functiondevpsignalgroup8 "ZCUDP internal signal group8.";
CM_ SG_ 51 BodyDataTraceZCUP2Functiondevpsignalgroup1 "ZCUDP internal signal group9.";
CM_ SG_ 51 BodyDataTraceZCUP2Functiondevpsignalgroup2 "ZCUDP internal signal group10.";
CM_ SG_ 51 BodyDataTraceZCUP2Functiondevpsignalgroup3 "ZCUDP internal signal group11.";
CM_ SG_ 51 BodyDataTraceZCUP2Functiondevpsignalgroup4 "ZCUDP internal signal group12.";
CM_ SG_ 51 BodyDataTraceZCUP2Functiondevpsignalgroup5 "ZCUDP internal signal group13.";
CM_ SG_ 51 BodyDataTraceZCUP2Functiondevpsignalgroup6 "ZCUDP internal signal group14.";
CM_ SG_ 51 BodyDataTraceZCUP2Functiondevpsignalgroup7 "ZCUDP internal signal group15.";
CM_ SG_ 51 BodyDataTraceZCUP2Functiondevpsignalgroup8 "ZCUDP internal signal group16.";
CM_ SG_ 51 BodyDataTraceZCUP3Functiondevpsignalgroup1 "ZCUDP internal signal group17.";
CM_ SG_ 51 BodyDataTraceZCUP3Functiondevpsignalgroup2 "ZCUDP internal signal group18.";
CM_ SG_ 51 BodyDataTraceZCUP3Functiondevpsignalgroup3 "ZCUDP internal signal group19.";
CM_ SG_ 51 BodyDataTraceZCUP3Functiondevpsignalgroup4 "ZCUDP internal signal group20.";
CM_ SG_ 51 BodyDataTraceZCUP3Functiondevpsignalgroup5 "ZCUDP internal signal group21.";
CM_ SG_ 51 BodyDataTraceZCUP3Functiondevpsignalgroup6 "ZCUDP internal signal group22.";
CM_ SG_ 51 BodyDataTraceZCUP3Functiondevpsignalgroup7 "ZCUDP internal signal group23.";
CM_ SG_ 51 BodyDataTraceZCUP3Functiondevpsignalgroup8 "ZCUDP internal signal group24.";
CM_ SG_ 51 BodyDataTraceZCUP4Functiondevpsignalgroup1 "ZCUDP internal signal group25.";
CM_ SG_ 51 BodyDataTraceZCUP4Functiondevpsignalgroup2 "ZCUDP internal signal group26.";
CM_ SG_ 51 BodyDataTraceZCUP4Functiondevpsignalgroup3 "ZCUDP internal signal group27.";
CM_ SG_ 51 BodyDataTraceZCUP4Functiondevpsignalgroup4 "ZCUDP internal signal group28.";
CM_ SG_ 51 BodyDataTraceZCUP4Functiondevpsignalgroup5 "ZCUDP internal signal group29.";
CM_ SG_ 51 BodyDataTraceZCUP4Functiondevpsignalgroup6 "ZCUDP internal signal group30.";
CM_ SG_ 51 BodyDataTraceZCUP4Functiondevpsignalgroup7 "ZCUDP internal signal group31.";
CM_ SG_ 51 BodyDataTraceZCUP4Functiondevpsignalgroup8 "ZCUDP internal signal group32.";
CM_ SG_ 51 BodyDataTraceZCUP5Functiondevpsignalgroup1 "ZCUDP internal signal group33.";
CM_ SG_ 51 BodyDataTraceZCUP5Functiondevpsignalgroup2 "ZCUDP internal signal group34.";
CM_ SG_ 51 BodyDataTraceZCUP5Functiondevpsignalgroup3 "ZCUDP internal signal group35.";
CM_ SG_ 51 BodyDataTraceZCUP5Functiondevpsignalgroup4 "ZCUDP internal signal group36.";
CM_ SG_ 51 BodyDataTraceZCUP5Functiondevpsignalgroup5 "ZCUDP internal signal group37.";
CM_ SG_ 51 BodyDataTraceZCUP5Functiondevpsignalgroup6 "ZCUDP internal signal group38.";
CM_ SG_ 51 BodyDataTraceZCUP5Functiondevpsignalgroup7 "ZCUDP internal signal group39.";
CM_ SG_ 51 BodyDataTraceZCUP5Functiondevpsignalgroup8 "ZCUDP internal signal group40.";
CM_ SG_ 51 BodyDataTraceZCUP6Functiondevpsignalgroup1 "ZCUDP internal signal group41.";
CM_ SG_ 51 BodyDataTraceZCUP6Functiondevpsignalgroup2 "ZCUDP internal signal group42.";
CM_ SG_ 51 BodyDataTraceZCUP6Functiondevpsignalgroup3 "ZCUDP internal signal group43.";
CM_ SG_ 51 BodyDataTraceZCUP6Functiondevpsignalgroup4 "ZCUDP internal signal group44.";
CM_ SG_ 51 BodyDataTraceZCUP6Functiondevpsignalgroup5 "ZCUDP internal signal group45.";
CM_ SG_ 51 BodyDataTraceZCUP6Functiondevpsignalgroup6 "ZCUDP internal signal group46.";
CM_ SG_ 51 BodyDataTraceZCUP6Functiondevpsignalgroup7 "ZCUDP internal signal group47.";
CM_ SG_ 51 BodyDataTraceZCUP6Functiondevpsignalgroup8 "ZCUDP internal signal group48.";
CM_ SG_ 51 BodyDataTraceZCUP7Functiondevpsignalgroup1 "ZCUDP internal signal group49.";
CM_ SG_ 51 BodyDataTraceZCUP7Functiondevpsignalgroup2 "ZCUDP internal signal group50.";
CM_ SG_ 51 BodyDataTraceZCUP7Functiondevpsignalgroup3 "ZCUDP internal signal group51.";
CM_ SG_ 51 BodyDataTraceZCUP7Functiondevpsignalgroup4 "ZCUDP internal signal group52.";
CM_ SG_ 51 BodyDataTraceZCUP7Functiondevpsignalgroup5 "ZCUDP internal signal group53.";
CM_ SG_ 51 BodyDataTraceZCUP7Functiondevpsignalgroup6 "ZCUDP internal signal group54.";
CM_ SG_ 51 BodyDataTraceZCUP7Functiondevpsignalgroup7 "ZCUDP internal signal group55.";
CM_ SG_ 51 BodyDataTraceZCUP7Functiondevpsignalgroup8 "ZCUDP internal signal group56.";
CM_ SG_ 1350 VFCVectorZCUPBlockID "BlockID";
CM_ SG_ 1350 VFCVectorZCUPVFCid0 "SettingsComfort";
CM_ SG_ 1350 VFCVectorZCUPVFCid1 "ParkingDrivingClimatization";
CM_ SG_ 1350 VFCVectorZCUPVFCid10 "ExteriorLighting";
CM_ SG_ 1350 VFCVectorZCUPVFCid11 "VFC11";
CM_ SG_ 1350 VFCVectorZCUPVFCid12 "Alarm";
CM_ SG_ 1350 VFCVectorZCUPVFCid13 "VFC13";
CM_ SG_ 1350 VFCVectorZCUPVFCid14 "InteriorLighting";
CM_ SG_ 1350 VFCVectorZCUPVFCid15 "VFC15";
CM_ SG_ 1350 VFCVectorZCUPVFCid16 "Locking";
CM_ SG_ 1350 VFCVectorZCUPVFCid17 "RemoteKeyFunctionality";
CM_ SG_ 1350 VFCVectorZCUPVFCid18 "PropulsionStart";
CM_ SG_ 1350 VFCVectorZCUPVFCid19 "VFC19";
CM_ SG_ 1350 VFCVectorZCUPVFCid2 "PostClimatisation";
CM_ SG_ 1350 VFCVectorZCUPVFCid20 "VFC20";
CM_ SG_ 1350 VFCVectorZCUPVFCid21 "PowerClosures";
CM_ SG_ 1350 VFCVectorZCUPVFCid22 "VehicleDriving";
CM_ SG_ 1350 VFCVectorZCUPVFCid23 "VFCid23";
CM_ SG_ 1350 VFCVectorZCUPVFCid24 "SettingsProfile";
CM_ SG_ 1350 VFCVectorZCUPVFCid25 "SeatComfortFunctions";
CM_ SG_ 1350 VFCVectorZCUPVFCid26 "Brake";
CM_ SG_ 1350 VFCVectorZCUPVFCid27 "InfotainmentPoll";
CM_ SG_ 1350 VFCVectorZCUPVFCid28 "HVEnergyStorage";
CM_ SG_ 1350 VFCVectorZCUPVFCid29 "VFC29";
CM_ SG_ 1350 VFCVectorZCUPVFCid3 "PowertrainParkingClimatization";
CM_ SG_ 1350 VFCVectorZCUPVFCid30 "TelematicsConnectivity";
CM_ SG_ 1350 VFCVectorZCUPVFCid31 "VFC31";
CM_ SG_ 1350 VFCVectorZCUPVFCid32 "VFC32";
CM_ SG_ 1350 VFCVectorZCUPVFCid33 "Diagnostics";
CM_ SG_ 1350 VFCVectorZCUPVFCid34 "VehicleModeManagement";
CM_ SG_ 1350 VFCVectorZCUPVFCid35 "TrailerCaravanFunctions";
CM_ SG_ 1350 VFCVectorZCUPVFCid36 "Immobilizer";
CM_ SG_ 1350 VFCVectorZCUPVFCid37 "Windows";
CM_ SG_ 1350 VFCVectorZCUPVFCid38 "Visibility";
CM_ SG_ 1350 VFCVectorZCUPVFCid39 "VFC39";
CM_ SG_ 1350 VFCVectorZCUPVFCid4 "VFC4";
CM_ SG_ 1350 VFCVectorZCUPVFCid40 "VFC40";
CM_ SG_ 1350 VFCVectorZCUPVFCid41 "InfotainmentPush";
CM_ SG_ 1350 VFCVectorZCUPVFCid42 "ChargingHV";
CM_ SG_ 1350 VFCVectorZCUPVFCid43 "BodyPreClimatisation";
CM_ SG_ 1350 VFCVectorZCUPVFCid44 "Crash";
CM_ SG_ 1350 VFCVectorZCUPVFCid45 "GlobalShortDuration";
CM_ SG_ 1350 VFCVectorZCUPVFCid46 "ExteriorLightsHazard";
CM_ SG_ 1350 VFCVectorZCUPVFCid47 "VFC47";
CM_ SG_ 1350 VFCVectorZCUPVFCid48 "DoorOpenWarning";
CM_ SG_ 1350 VFCVectorZCUPVFCid49 "ChargingLVInit";
CM_ SG_ 1350 VFCVectorZCUPVFCid5 "VFC5";
CM_ SG_ 1350 VFCVectorZCUPVFCid50 "VFC50";
CM_ SG_ 1350 VFCVectorZCUPVFCid51 "VFC51";
CM_ SG_ 1350 VFCVectorZCUPVFCid52 "HVBatteryThermalEventWarning";
CM_ SG_ 1350 VFCVectorZCUPVFCid53 "VisualAssist";
CM_ SG_ 1350 VFCVectorZCUPVFCid54 "PassiveSafety";
CM_ SG_ 1350 VFCVectorZCUPVFCid55 "LifeDetection";
CM_ SG_ 1350 VFCVectorZCUPVFCid56 "BackboneFlexray";
CM_ SG_ 1350 VFCVectorZCUPVFCid57 "Functionmarket";
CM_ SG_ 1350 VFCVectorZCUPVFCid58 "VFCid58";
CM_ SG_ 1350 VFCVectorZCUPVFCid59 "VFCid59";
CM_ SG_ 1350 VFCVectorZCUPVFCid6 "SettingsVehicle";
CM_ SG_ 1350 VFCVectorZCUPVFCid60 "VFCid60";
CM_ SG_ 1350 VFCVectorZCUPVFCid61 "VFCid61";
CM_ SG_ 1350 VFCVectorZCUPVFCid7 "VFCid7";
CM_ SG_ 1350 VFCVectorZCUPVFCid8 "VFCid8";
CM_ SG_ 1350 VFCVectorZCUPVFCid9 "IPWakeup";
BA_DEF_ BO_ "CANFD_BRS" ENUM "0","1";
BA_DEF_ BO_ "GenMsgCycleTime" INT 0 65536; // [ms]
BA_DEF_ BO_ "GenMsgDelayTime" INT 0 65536; // [ms]
BA_DEF_ BO_ "GenMsgSendType" ENUM "cyclic", "spontaneous", "not-used", "not-used", "not-used", "cyclicAndSpontaneous", "not-used", "cyclicIfActive", "NoMsgSendType"; // [us]
BA_DEF_ BO_ "GenMsgStartDelayTime" INT 0 65536; // [ms]
BA_DEF_ BO_ "VFrameFormat" ENUM "StandardCAN","ExtendedCAN","reserved","J1939PG","reserved","reserved","reserved","reserved","reserved","reserved","reserved","reserved","reserved","reserved","StandardCAN_FD","ExtendedCAN_FD";
BA_DEF_ SG_ "GenSigSendType" ENUM "Cyclic","OnWrite","OnWriteWithRepetition","OnChange","OnChangeWithRepetition","IfActive","IfActiveWithRepetition","NoSigSendType";
BA_DEF_ SG_ "GenSigStartValue" HEX 0 80000000;
BA_DEF_ BO_ "GenMsgILSupport" ENUM "No","Yes";
BA_DEF_ BO_ "NmAsrMessage" ENUM "No","Yes";
BA_DEF_ SG_ "GenSigFuncType" ENUM "NoFunction","n/a","n/a","n/a","n/a","n/a","n/a","n/a","n/a","n/a","n/a","n/a","n/a","n/a","n/a","CHK","CNTR","n/a","n/a","n/a","CNTR_AR_01","CRC_AR_01_BOTH","CRC_AR_01_ALT","CRC_AR_01_LOW","CRC_AR_01_NIBBLE","CNTR_AR_04","CRC_AR_04A","CNTR_AR_05","CRC_AR_05";
BA_DEF_ SG_ "GenSigDataID" STRING;
BA_DEF_DEF_ "CANFD_BRS" "1";
BA_DEF_DEF_ "GenSigStartValue" 0;
BA_DEF_DEF_ "VFrameFormat" "J1939PG";
BA_DEF_DEF_ "GenSigSendType" "NoSigSendType";
BA_DEF_DEF_ "GenMsgCycleTime" 0;
BA_DEF_DEF_ "GenMsgDelayTime" 0;
BA_DEF_DEF_ "GenMsgStartDelayTime" 0;
BA_DEF_DEF_ "GenMsgSendType" "NoMsgSendType";
BA_DEF_DEF_ "GenMsgILSupport" "Yes";
BA_DEF_DEF_ "NmAsrMessage" "No";
BA_DEF_DEF_ "GenSigFuncType" "NoFunction";
BA_DEF_DEF_ "GenSigDataID" "";
// Frame: ZcupZCUCANFD2Fr09
BA_ "GenMsgCycleTime" BO_ 643 350.000;
BA_ "GenMsgSendType" BO_ 643 0;
BA_ "VFrameFormat" BO_ 643 14;
// Frame: ZcupZCUCANFD2Fr10
BA_ "GenMsgCycleTime" BO_ 882 700.000;
BA_ "GenMsgSendType" BO_ 882 0;
BA_ "VFrameFormat" BO_ 882 14;
// Frame: ZcupZCUCANFD2Fr11
BA_ "GenMsgCycleTime" BO_ 451 150.000;
BA_ "GenMsgSendType" BO_ 451 0;
BA_ "VFrameFormat" BO_ 451 14;
// Frame: ZcupZCUCANFD2Fr12
BA_ "GenMsgCycleTime" BO_ 258 20.000;
BA_ "GenMsgSendType" BO_ 258 0;
BA_ "VFrameFormat" BO_ 258 14;
// Frame: ZcupZCUCANFD2Fr15
BA_ "GenMsgDelayTime" BO_ 455 50.000;
BA_ "GenMsgSendType" BO_ 455 1;
BA_ "VFrameFormat" BO_ 455 14;
// Frame: ZcupZCUCANFD2Fr16
BA_ "GenMsgDelayTime" BO_ 51 10.000;
BA_ "GenMsgSendType" BO_ 51 1;
BA_ "VFrameFormat" BO_ 51 14;
// Frame: ZcupZCUCANFD2VFCVectorFr
BA_ "GenMsgCycleTime" BO_ 1350 1000.000;
BA_ "GenMsgSendType" BO_ 1350 0;
BA_ "VFrameFormat" BO_ 1350 0;
BA_ "GenSigSendType" SG_ 451 BkpOfDstTrvldFromVehCom 0;
BA_ "GenSigSendType" SG_ 51 BodyDataTraceZCUP1Functiondevpsignalgroup1 1;
BA_ "GenSigSendType" SG_ 51 BodyDataTraceZCUP1Functiondevpsignalgroup2 1;
BA_ "GenSigSendType" SG_ 51 BodyDataTraceZCUP1Functiondevpsignalgroup3 1;
BA_ "GenSigSendType" SG_ 51 BodyDataTraceZCUP1Functiondevpsignalgroup4 1;
BA_ "GenSigSendType" SG_ 51 BodyDataTraceZCUP1Functiondevpsignalgroup5 1;
BA_ "GenSigSendType" SG_ 51 BodyDataTraceZCUP1Functiondevpsignalgroup6 1;
BA_ "GenSigSendType" SG_ 51 BodyDataTraceZCUP1Functiondevpsignalgroup7 1;
BA_ "GenSigSendType" SG_ 51 BodyDataTraceZCUP1Functiondevpsignalgroup8 1;
BA_ "GenSigSendType" SG_ 51 BodyDataTraceZCUP2Functiondevpsignalgroup1 1;
BA_ "GenSigSendType" SG_ 51 BodyDataTraceZCUP2Functiondevpsignalgroup2 1;
BA_ "GenSigSendType" SG_ 51 BodyDataTraceZCUP2Functiondevpsignalgroup3 1;
BA_ "GenSigSendType" SG_ 51 BodyDataTraceZCUP2Functiondevpsignalgroup4 1;
BA_ "GenSigSendType" SG_ 51 BodyDataTraceZCUP2Functiondevpsignalgroup5 1;
BA_ "GenSigSendType" SG_ 51 BodyDataTraceZCUP2Functiondevpsignalgroup6 1;
BA_ "GenSigSendType" SG_ 51 BodyDataTraceZCUP2Functiondevpsignalgroup7 1;
BA_ "GenSigSendType" SG_ 51 BodyDataTraceZCUP2Functiondevpsignalgroup8 1;
BA_ "GenSigSendType" SG_ 51 BodyDataTraceZCUP3Functiondevpsignalgroup1 1;
BA_ "GenSigSendType" SG_ 51 BodyDataTraceZCUP3Functiondevpsignalgroup2 1;
BA_ "GenSigSendType" SG_ 51 BodyDataTraceZCUP3Functiondevpsignalgroup3 1;
BA_ "GenSigSendType" SG_ 51 BodyDataTraceZCUP3Functiondevpsignalgroup4 1;
BA_ "GenSigSendType" SG_ 51 BodyDataTraceZCUP3Functiondevpsignalgroup5 1;
BA_ "GenSigSendType" SG_ 51 BodyDataTraceZCUP3Functiondevpsignalgroup6 1;
BA_ "GenSigSendType" SG_ 51 BodyDataTraceZCUP3Functiondevpsignalgroup7 1;
BA_ "GenSigSendType" SG_ 51 BodyDataTraceZCUP3Functiondevpsignalgroup8 1;
BA_ "GenSigSendType" SG_ 51 BodyDataTraceZCUP4Functiondevpsignalgroup1 1;
BA_ "GenSigSendType" SG_ 51 BodyDataTraceZCUP4Functiondevpsignalgroup2 1;
BA_ "GenSigSendType" SG_ 51 BodyDataTraceZCUP4Functiondevpsignalgroup3 1;
BA_ "GenSigSendType" SG_ 51 BodyDataTraceZCUP4Functiondevpsignalgroup4 1;
BA_ "GenSigSendType" SG_ 51 BodyDataTraceZCUP4Functiondevpsignalgroup5 1;
BA_ "GenSigSendType" SG_ 51 BodyDataTraceZCUP4Functiondevpsignalgroup6 1;
BA_ "GenSigSendType" SG_ 51 BodyDataTraceZCUP4Functiondevpsignalgroup7 1;
BA_ "GenSigSendType" SG_ 51 BodyDataTraceZCUP4Functiondevpsignalgroup8 1;
BA_ "GenSigSendType" SG_ 51 BodyDataTraceZCUP5Functiondevpsignalgroup1 1;
BA_ "GenSigSendType" SG_ 51 BodyDataTraceZCUP5Functiondevpsignalgroup2 1;
BA_ "GenSigSendType" SG_ 51 BodyDataTraceZCUP5Functiondevpsignalgroup3 1;
BA_ "GenSigSendType" SG_ 51 BodyDataTraceZCUP5Functiondevpsignalgroup4 1;
BA_ "GenSigSendType" SG_ 51 BodyDataTraceZCUP5Functiondevpsignalgroup5 1;
BA_ "GenSigSendType" SG_ 51 BodyDataTraceZCUP5Functiondevpsignalgroup6 1;
BA_ "GenSigSendType" SG_ 51 BodyDataTraceZCUP5Functiondevpsignalgroup7 1;
BA_ "GenSigSendType" SG_ 51 BodyDataTraceZCUP5Functiondevpsignalgroup8 1;
BA_ "GenSigSendType" SG_ 51 BodyDataTraceZCUP6Functiondevpsignalgroup1 1;
BA_ "GenSigSendType" SG_ 51 BodyDataTraceZCUP6Functiondevpsignalgroup2 1;
BA_ "GenSigSendType" SG_ 51 BodyDataTraceZCUP6Functiondevpsignalgroup3 1;
BA_ "GenSigSendType" SG_ 51 BodyDataTraceZCUP6Functiondevpsignalgroup4 1;
BA_ "GenSigSendType" SG_ 51 BodyDataTraceZCUP6Functiondevpsignalgroup5 1;
BA_ "GenSigSendType" SG_ 51 BodyDataTraceZCUP6Functiondevpsignalgroup6 1;
BA_ "GenSigSendType" SG_ 51 BodyDataTraceZCUP6Functiondevpsignalgroup7 1;
BA_ "GenSigSendType" SG_ 51 BodyDataTraceZCUP6Functiondevpsignalgroup8 1;
BA_ "GenSigSendType" SG_ 51 BodyDataTraceZCUP7Functiondevpsignalgroup1 1;
BA_ "GenSigSendType" SG_ 51 BodyDataTraceZCUP7Functiondevpsignalgroup2 1;
BA_ "GenSigSendType" SG_ 51 BodyDataTraceZCUP7Functiondevpsignalgroup3 1;
BA_ "GenSigSendType" SG_ 51 BodyDataTraceZCUP7Functiondevpsignalgroup4 1;
BA_ "GenSigSendType" SG_ 51 BodyDataTraceZCUP7Functiondevpsignalgroup5 1;
BA_ "GenSigSendType" SG_ 51 BodyDataTraceZCUP7Functiondevpsignalgroup6 1;
BA_ "GenSigSendType" SG_ 51 BodyDataTraceZCUP7Functiondevpsignalgroup7 1;
BA_ "GenSigSendType" SG_ 51 BodyDataTraceZCUP7Functiondevpsignalgroup8 1;
BA_ "GenSigSendType" SG_ 451 CCMFragraCh1AvlTiPrec 0;
BA_ "GenSigSendType" SG_ 451 CCMFragraCh2AvlTiPrec 0;
BA_ "GenSigSendType" SG_ 451 CCMFragraCh3AvlTiPrec 0;
BA_ "GenSigSendType" SG_ 451 CCMFragraCh4AvlTiPrec 0;
BA_ "GenSigSendType" SG_ 451 CCMFragraCh5AvlTiPrec 0;
BA_ "GenSigSendType" SG_ 451 CCMHvahFltIndcn 0;
BA_ "GenSigSendType" SG_ 643 CdsParkgClimaActv 0;
BA_ "GenSigSendType" SG_ 882 ClimaActvAlrmSts 0;
BA_ "GenSigSendType" SG_ 455 ClimaManModCmftPopUpReq 1;
BA_ "GenSigSendType" SG_ 455 ClimaOffReq 1;
BA_ "GenSigSendType" SG_ 643 ClimaOvrHeatProActv 0;
BA_ "GenSigSendType" SG_ 451 ClimaOvrHeatProActvSts 0;
BA_ "GenSigSendType" SG_ 455 ClimaOvrHeatProRspn 1;
BA_ "GenSigSendType" SG_ 455 ClimaOvrHeatProWarn 1;
BA_ "GenSigSendType" SG_ 451 ClimaPwrCns 0;
BA_ "GenSigSendType" SG_ 451 ClimaPwrCritDes 0;
BA_ "GenSigSendType" SG_ 451 ClimaPwrNormDes 0;
BA_ "GenSigSendType" SG_ 258 ClimaSts 0;
BA_ "GenSigStartValue" SG_ 258 ClimaSts 1;
BA_ "GenSigSendType" SG_ 643 CmptmtAirDistbnRspAirDistbnDrvr 0;
BA_ "GenSigSendType" SG_ 643 CmptmtAirDistbnRspAirDistbnPass 0;
BA_ "GenSigSendType" SG_ 643 CmptmtAirDistbnRspAirDistbnSecLe 0;
BA_ "GenSigSendType" SG_ 643 CmptmtAirDistbnRspAirDistbnSecRi 0;
BA_ "GenSigSendType" SG_ 643 CmptmtAirDistbnRspAirDistbnThrd 0;
BA_ "GenSigSendType" SG_ 455 DiDblLock 1;
BA_ "GenSigSendType" SG_ 643 DoorPassCinhIntFailInfCinchFlt1 0;
BA_ "GenSigSendType" SG_ 643 DoorPassCinhIntFailInfCinchRestFlt 0;
BA_ "GenSigSendType" SG_ 258 DoorPassHndlSts 0;
BA_ "GenSigSendType" SG_ 258 DoorPassReLockSts 0;
BA_ "GenSigSendType" SG_ 643 DoorPassRelsFailCinchOverTimed 0;
BA_ "GenSigSendType" SG_ 643 DoorPassRelsFailFailure1 0;
BA_ "GenSigSendType" SG_ 643 DoorPassRelsFailMechRels 0;
BA_ "GenSigSendType" SG_ 643 DoorRiReCinhIntFailInfCinchFlt1 0;
BA_ "GenSigSendType" SG_ 643 DoorRiReCinhIntFailInfCinchRestFlt 0;
BA_ "GenSigSendType" SG_ 258 DoorRiReHndlSts 0;
BA_ "GenSigSendType" SG_ 643 DoorRiReRelsFailCinchOverTimed 0;
BA_ "GenSigSendType" SG_ 643 DoorRiReRelsFailFailure1 0;
BA_ "GenSigSendType" SG_ 643 DoorRiReRelsFailMechRels 0;
BA_ "GenSigSendType" SG_ 451 DstTrvldVldFromVehCom 0;
BA_ "GenSigSendType" SG_ 451 EcoClimaSts 0;
BA_ "GenSigSendType" SG_ 451 ElecAirVentnDrvrAvlStsLotus 0;
BA_ "GenSigSendType" SG_ 451 ElecAirVentnPassAvlStsLotus 0;
BA_ "GenSigSendType" SG_ 451 ElecAirVentnReLeAvlStsLotus 0;
BA_ "GenSigSendType" SG_ 451 ElecAirVentnReRiAvlStsLotus 0;
BA_ "GenSigSendType" SG_ 258 EngRunngReqByClima 0;
BA_ "GenSigSendType" SG_ 451 FltOfFrntTurnIndcrLe 0;
BA_ "GenSigSendType" SG_ 451 FltOfFrntTurnIndcrRi 0;
BA_ "GenSigSendType" SG_ 451 FltOfReTurnIndcrLe 0;
BA_ "GenSigSendType" SG_ 451 FltOfReTurnIndcrRi 0;
BA_ "GenSigSendType" SG_ 451 FrntClimaManModCmftSts 0;
BA_ "GenSigSendType" SG_ 258 FrntSeatPassLinFbToSecSeat 0;
BA_ "GenSigSendType" SG_ 451 FuSnsrActvSideFuLvlSnsrRawVal 0;
BA_ "GenSigSendType" SG_ 451 FuSnsrActvSideGenQF 0;
BA_ "GenSigSendType" SG_ 451 FuSnsrPasSideFuLvlSnsrRawVal 0;
BA_ "GenSigSendType" SG_ 451 FuSnsrPasSideGenQF 0;
BA_ "GenSigSendType" SG_ 643 HvacAirTForMaxTZoneEvaprTFrnt 0;
BA_ "GenSigSendType" SG_ 643 HvacAirTForMaxTZoneEvaprTQf 0;
BA_ "GenSigStartValue" SG_ 643 HvacAirTForMaxTZoneEvaprTQf 1;
BA_ "GenSigSendType" SG_ 258 HvacCoolgEnaFrnt 0;
BA_ "GenSigSendType" SG_ 451 HvacFanLvlFbFrnt 0;
BA_ "GenSigSendType" SG_ 451 HvacFanLvlFbRe 0;
BA_ "GenSigSendType" SG_ 882 HvacHeatElmAirMFlowEstimdFirstLe 0;
BA_ "GenSigSendType" SG_ 882 HvacHeatElmAirMFlowEstimdFirstRi 0;
BA_ "GenSigSendType" SG_ 882 HvacHeatElmAirMFlowEstimdSecLe 0;
BA_ "GenSigSendType" SG_ 643 HvacHeatgReq 0;
BA_ "GenSigSendType" SG_ 882 HvacHexAirTHvacAirTForHeatrFrnt 0;
BA_ "GenSigSendType" SG_ 882 HvacHexAirTHvacAirTForHeatrFrntQf 0;
BA_ "GenSigStartValue" SG_ 882 HvacHexAirTHvacAirTForHeatrFrntQf 1;
BA_ "GenSigSendType" SG_ 451 HvacRecircAct 0;
BA_ "GenSigSendType" SG_ 643 HvahAirTsp 0;
BA_ "GenSigStartValue" SG_ 643 HvahAirTsp 600;
BA_ "GenSigSendType" SG_ 882 HwRowFrstPassFrntExtMotCtrl 0;
BA_ "GenSigSendType" SG_ 882 HwRowFrstPassFrntHeiMotCtrl 0;
BA_ "GenSigSendType" SG_ 882 HwRowFrstPassHeiMotCtrl 0;
BA_ "GenSigSendType" SG_ 882 HwRowFrstPassInclMotCtrl 0;
BA_ "GenSigSendType" SG_ 882 HwRowFrstPassSldMotCtrl 0;
BA_ "GenSigSendType" SG_ 451 IntLightPasSideDoorSupply 0;
BA_ "GenSigSendType" SG_ 451 IntLightPasSideSupply 0;
BA_ "GenSigSendType" SG_ 451 IntLightRePasDoorSupply 0;
BA_ "GenSigSendType" SG_ 451 IntLightRePasSideSupply 0;
BA_ "GenSigSendType" SG_ 643 IntPm25LvlFrmClima 0;
BA_ "GenSigSendType" SG_ 643 IntPm25VluFrmClima 0;
BA_ "GenSigSendType" SG_ 882 IntrLiAmb1BnIngrd 0;
BA_ "GenSigSendType" SG_ 882 IntrLiAmb1GrnIngrd 0;
BA_ "GenSigSendType" SG_ 882 IntrLiAmb1Intensty 0;
BA_ "GenSigSendType" SG_ 882 IntrLiAmb1RedIngrd 0;
BA_ "GenSigSendType" SG_ 882 IntrLiAmb1SelCmd1 0;
BA_ "GenSigSendType" SG_ 882 IntrLiAmb1SelCmd2 0;
BA_ "GenSigSendType" SG_ 882 IntrLiAmb1SynchDelay 0;
BA_ "GenSigSendType" SG_ 882 IntrLiAmb1TargetTransitionTime 0;
BA_ "GenSigSendType" SG_ 882 IntrLiAmb1Trigger 0;
BA_ "GenSigSendType" SG_ 882 IntrLiAmb1Update 0;
BA_ "GenSigSendType" SG_ 882 IntrLiAmb2BnIngrd 0;
BA_ "GenSigSendType" SG_ 882 IntrLiAmb2GrnIngrd 0;
BA_ "GenSigSendType" SG_ 882 IntrLiAmb2Intensty 0;
BA_ "GenSigSendType" SG_ 882 IntrLiAmb2RedIngrd 0;
BA_ "GenSigSendType" SG_ 882 IntrLiAmb2SelCmd1 0;
BA_ "GenSigSendType" SG_ 882 IntrLiAmb2SelCmd2 0;
BA_ "GenSigSendType" SG_ 882 IntrLiAmb2SynchDelay 0;
BA_ "GenSigSendType" SG_ 882 IntrLiAmb2TargetTransitionTime 0;
BA_ "GenSigSendType" SG_ 882 IntrLiAmb2Trigger 0;
BA_ "GenSigSendType" SG_ 882 IntrLiAmb2Update 0;
BA_ "GenSigSendType" SG_ 643 OutdPm25LvlFrmClima 0;
BA_ "GenSigSendType" SG_ 643 OutdPm25VluFrmClima 0;
BA_ "GenSigSendType" SG_ 451 PassMassgRunng 0;
BA_ "GenSigSendType" SG_ 451 PassSeatActvSpplFct 0;
BA_ "GenSigSendType" SG_ 451 PassSeatAutMovmtSts 0;
BA_ "GenSigSendType" SG_ 643 PassSeatHeatgAutoSts 0;
BA_ "GenSigSendType" SG_ 643 PassSeatHeatgAvlSts 0;
BA_ "GenSigSendType" SG_ 451 PassSeatHeatgLvlSts 0;
BA_ "GenSigSendType" SG_ 451 PassSeatSwtSts2PassSeatSwtAdjmtOfSpplFctHozlSts 0;
BA_ "GenSigSendType" SG_ 451 PassSeatSwtSts2PassSeatSwtAdjmtOfSpplFctVerSts 0;
BA_ "GenSigSendType" SG_ 451 PassSeatSwtSts2PassSeatSwtHdrstHozlSts 0;
BA_ "GenSigSendType" SG_ 451 PassSeatSwtSts2PassSeatSwtHdrstVertSts 0;
BA_ "GenSigSendType" SG_ 451 PassSeatSwtSts2PassSeatSwtHeiFrntSts 0;
BA_ "GenSigSendType" SG_ 451 PassSeatSwtSts2PassSeatSwtHeiSts 0;
BA_ "GenSigSendType" SG_ 451 PassSeatSwtSts2PassSeatSwtInclSts 0;
BA_ "GenSigSendType" SG_ 451 PassSeatSwtSts2PassSeatSwtSelnOfSpplFctStsSts 0;
BA_ "GenSigSendType" SG_ 451 PassSeatSwtSts2PassSeatSwtSldSts 0;
BA_ "GenSigSendType" SG_ 643 PassSeatVentnAutoSts 0;
BA_ "GenSigSendType" SG_ 451 PassSeatVentnLvlSts 0;
BA_ "GenSigSendType" SG_ 451 PwrEstimdAtStbForClima 0;
BA_ "GenSigSendType" SG_ 451 ReClimaManModCmftSts 0;
BA_ "GenSigSendType" SG_ 643 RemClimaDefrstSts 0;
BA_ "GenSigSendType" SG_ 455 RemClimaDelaySts 1;
BA_ "GenSigSendType" SG_ 455 RemClimaExtnTiRspn 1;
BA_ "GenSigSendType" SG_ 455 RemClimaHvRspn 1;
BA_ "GenSigSendType" SG_ 643 RemClimaHvSts 0;
BA_ "GenSigSendType" SG_ 455 RemClimaWarn 1;
BA_ "GenSigSendType" SG_ 455 RemStrtClimaRspn 1;
BA_ "GenSigSendType" SG_ 643 RemVentActvSts 0;
BA_ "GenSigSendType" SG_ 643 RemVentReqRspnFb 0;
BA_ "GenSigSendType" SG_ 643 RemVentWarnSts 0;
BA_ "GenSigSendType" SG_ 455 RoofOpnReqFrmClima 1;
BA_ "GenSigSendType" SG_ 455 SchedCmptHeatCoolFB 1;
BA_ "GenSigSendType" SG_ 258 SeatClimaDurgClimaHmiSeatHeatgForRowThrdLe 0;
BA_ "GenSigSendType" SG_ 258 SeatClimaDurgClimaHmiSeatHeatgForRowThrdRi 0;
BA_ "GenSigSendType" SG_ 258 SeatClimaDurgClimaHmiSeatVentnForRowThrdLe 0;
BA_ "GenSigSendType" SG_ 258 SeatClimaDurgClimaHmiSeatVentnForRowThrdRi 0;
BA_ "GenSigSendType" SG_ 643 TgtHvacAirTForMaxTZone 0;
BA_ "GenSigStartValue" SG_ 643 TgtHvacAirTForMaxTZone 250;
BA_ "GenSigSendType" SG_ 1350 VFCVectorZCUPBlockID 0;
BA_ "GenSigSendType" SG_ 1350 VFCVectorZCUPVFCid0 0;
BA_ "GenSigSendType" SG_ 1350 VFCVectorZCUPVFCid1 0;
BA_ "GenSigSendType" SG_ 1350 VFCVectorZCUPVFCid10 0;
BA_ "GenSigSendType" SG_ 1350 VFCVectorZCUPVFCid11 0;
BA_ "GenSigSendType" SG_ 1350 VFCVectorZCUPVFCid12 0;
BA_ "GenSigSendType" SG_ 1350 VFCVectorZCUPVFCid13 0;
BA_ "GenSigSendType" SG_ 1350 VFCVectorZCUPVFCid14 0;
BA_ "GenSigSendType" SG_ 1350 VFCVectorZCUPVFCid15 0;
BA_ "GenSigSendType" SG_ 1350 VFCVectorZCUPVFCid16 0;
BA_ "GenSigSendType" SG_ 1350 VFCVectorZCUPVFCid17 0;
BA_ "GenSigSendType" SG_ 1350 VFCVectorZCUPVFCid18 0;
BA_ "GenSigSendType" SG_ 1350 VFCVectorZCUPVFCid19 0;
BA_ "GenSigSendType" SG_ 1350 VFCVectorZCUPVFCid2 0;
BA_ "GenSigSendType" SG_ 1350 VFCVectorZCUPVFCid20 0;
BA_ "GenSigSendType" SG_ 1350 VFCVectorZCUPVFCid21 0;
BA_ "GenSigSendType" SG_ 1350 VFCVectorZCUPVFCid22 0;
BA_ "GenSigSendType" SG_ 1350 VFCVectorZCUPVFCid23 0;
BA_ "GenSigSendType" SG_ 1350 VFCVectorZCUPVFCid24 0;
BA_ "GenSigSendType" SG_ 1350 VFCVectorZCUPVFCid25 0;
BA_ "GenSigSendType" SG_ 1350 VFCVectorZCUPVFCid26 0;
BA_ "GenSigSendType" SG_ 1350 VFCVectorZCUPVFCid27 0;
BA_ "GenSigSendType" SG_ 1350 VFCVectorZCUPVFCid28 0;
BA_ "GenSigSendType" SG_ 1350 VFCVectorZCUPVFCid29 0;
BA_ "GenSigSendType" SG_ 1350 VFCVectorZCUPVFCid3 0;
BA_ "GenSigSendType" SG_ 1350 VFCVectorZCUPVFCid30 0;
BA_ "GenSigSendType" SG_ 1350 VFCVectorZCUPVFCid31 0;
BA_ "GenSigSendType" SG_ 1350 VFCVectorZCUPVFCid32 0;
BA_ "GenSigSendType" SG_ 1350 VFCVectorZCUPVFCid33 0;
BA_ "GenSigSendType" SG_ 1350 VFCVectorZCUPVFCid34 0;
BA_ "GenSigSendType" SG_ 1350 VFCVectorZCUPVFCid35 0;
BA_ "GenSigSendType" SG_ 1350 VFCVectorZCUPVFCid36 0;
BA_ "GenSigSendType" SG_ 1350 VFCVectorZCUPVFCid37 0;
BA_ "GenSigSendType" SG_ 1350 VFCVectorZCUPVFCid38 0;
BA_ "GenSigSendType" SG_ 1350 VFCVectorZCUPVFCid39 0;
BA_ "GenSigSendType" SG_ 1350 VFCVectorZCUPVFCid4 0;
BA_ "GenSigSendType" SG_ 1350 VFCVectorZCUPVFCid40 0;
BA_ "GenSigSendType" SG_ 1350 VFCVectorZCUPVFCid41 0;
BA_ "GenSigSendType" SG_ 1350 VFCVectorZCUPVFCid42 0;
BA_ "GenSigSendType" SG_ 1350 VFCVectorZCUPVFCid43 0;
BA_ "GenSigSendType" SG_ 1350 VFCVectorZCUPVFCid44 0;
BA_ "GenSigSendType" SG_ 1350 VFCVectorZCUPVFCid45 0;
BA_ "GenSigSendType" SG_ 1350 VFCVectorZCUPVFCid46 0;
BA_ "GenSigSendType" SG_ 1350 VFCVectorZCUPVFCid47 0;
BA_ "GenSigSendType" SG_ 1350 VFCVectorZCUPVFCid48 0;
BA_ "GenSigSendType" SG_ 1350 VFCVectorZCUPVFCid49 0;
BA_ "GenSigSendType" SG_ 1350 VFCVectorZCUPVFCid5 0;
BA_ "GenSigSendType" SG_ 1350 VFCVectorZCUPVFCid50 0;
BA_ "GenSigSendType" SG_ 1350 VFCVectorZCUPVFCid51 0;
BA_ "GenSigSendType" SG_ 1350 VFCVectorZCUPVFCid52 0;
BA_ "GenSigSendType" SG_ 1350 VFCVectorZCUPVFCid53 0;
BA_ "GenSigSendType" SG_ 1350 VFCVectorZCUPVFCid54 0;
BA_ "GenSigSendType" SG_ 1350 VFCVectorZCUPVFCid55 0;
BA_ "GenSigSendType" SG_ 1350 VFCVectorZCUPVFCid56 0;
BA_ "GenSigSendType" SG_ 1350 VFCVectorZCUPVFCid57 0;
BA_ "GenSigSendType" SG_ 1350 VFCVectorZCUPVFCid58 0;
BA_ "GenSigSendType" SG_ 1350 VFCVectorZCUPVFCid59 0;
BA_ "GenSigSendType" SG_ 1350 VFCVectorZCUPVFCid6 0;
BA_ "GenSigSendType" SG_ 1350 VFCVectorZCUPVFCid60 0;
BA_ "GenSigSendType" SG_ 1350 VFCVectorZCUPVFCid61 0;
BA_ "GenSigSendType" SG_ 1350 VFCVectorZCUPVFCid7 0;
BA_ "GenSigSendType" SG_ 1350 VFCVectorZCUPVFCid8 0;
BA_ "GenSigSendType" SG_ 1350 VFCVectorZCUPVFCid9 0;
BA_ "GenSigSendType" SG_ 455 WinAndRoofReqFrmClima 1;
BA_ "GenSigSendType" SG_ 643 WinFailrStsAtPass 0;
BA_ "GenSigSendType" SG_ 643 WinFailrStsAtReRi 0;
BA_ "GenSigSendType" SG_ 882 WinHwSwtPassDoor 0;
BA_ "GenSigSendType" SG_ 882 WinHwSwtPassReDoor 0;
VAL_ 643 CdsParkgClimaActv 0 "OnOff1_Off" 1 "OnOff1_On";
VAL_ 643 ClimaOvrHeatProActv 0 "OnOff1_Off" 1 "OnOff1_On";
VAL_ 643 CmptmtAirDistbnRspAirDistbnDrvr 0 "HmiCmptmtAirDistbnFrnt_Flr" 1 "HmiCmptmtAirDistbnFrnt_Vent" 2 "HmiCmptmtAirDistbnFrnt_Defrst" 3 "HmiCmptmtAirDistbnFrnt_FlrDefrst" 4 "HmiCmptmtAirDistbnFrnt_FlrVent" 5 "HmiCmptmtAirDistbnFrnt_VentDefrst" 6 "HmiCmptmtAirDistbnFrnt_FlrVentDefrst" 7 "HmiCmptmtAirDistbnFrnt_Aut";
VAL_ 643 CmptmtAirDistbnRspAirDistbnPass 0 "HmiCmptmtAirDistbnFrnt_Flr" 1 "HmiCmptmtAirDistbnFrnt_Vent" 2 "HmiCmptmtAirDistbnFrnt_Defrst" 3 "HmiCmptmtAirDistbnFrnt_FlrDefrst" 4 "HmiCmptmtAirDistbnFrnt_FlrVent" 5 "HmiCmptmtAirDistbnFrnt_VentDefrst" 6 "HmiCmptmtAirDistbnFrnt_FlrVentDefrst" 7 "HmiCmptmtAirDistbnFrnt_Aut";
VAL_ 643 CmptmtAirDistbnRspAirDistbnSecLe 0 "HmiCmptmtAirDistbnFrnt_Flr" 1 "HmiCmptmtAirDistbnFrnt_Vent" 2 "HmiCmptmtAirDistbnFrnt_Defrst" 3 "HmiCmptmtAirDistbnFrnt_FlrDefrst" 4 "HmiCmptmtAirDistbnFrnt_FlrVent" 5 "HmiCmptmtAirDistbnFrnt_VentDefrst" 6 "HmiCmptmtAirDistbnFrnt_FlrVentDefrst" 7 "HmiCmptmtAirDistbnFrnt_Aut";
VAL_ 643 CmptmtAirDistbnRspAirDistbnSecRi 0 "HmiCmptmtAirDistbnFrnt_Flr" 1 "HmiCmptmtAirDistbnFrnt_Vent" 2 "HmiCmptmtAirDistbnFrnt_Defrst" 3 "HmiCmptmtAirDistbnFrnt_FlrDefrst" 4 "HmiCmptmtAirDistbnFrnt_FlrVent" 5 "HmiCmptmtAirDistbnFrnt_VentDefrst" 6 "HmiCmptmtAirDistbnFrnt_FlrVentDefrst" 7 "HmiCmptmtAirDistbnFrnt_Aut";
VAL_ 643 CmptmtAirDistbnRspAirDistbnThrd 0 "HmiCmptmtAirDistbnFrnt_Flr" 1 "HmiCmptmtAirDistbnFrnt_Vent" 2 "HmiCmptmtAirDistbnFrnt_Defrst" 3 "HmiCmptmtAirDistbnFrnt_FlrDefrst" 4 "HmiCmptmtAirDistbnFrnt_FlrVent" 5 "HmiCmptmtAirDistbnFrnt_VentDefrst" 6 "HmiCmptmtAirDistbnFrnt_FlrVentDefrst" 7 "HmiCmptmtAirDistbnFrnt_Aut";
VAL_ 643 DoorPassCinhIntFailInfCinchFlt1 0 "Boolean_FALSE" 1 "Boolean_TRUE";
VAL_ 643 DoorPassCinhIntFailInfCinchRestFlt 0 "Boolean_FALSE" 1 "Boolean_TRUE";
VAL_ 643 DoorPassRelsFailCinchOverTimed 0 "Boolean_FALSE" 1 "Boolean_TRUE";
VAL_ 643 DoorPassRelsFailFailure1 0 "Boolean_FALSE" 1 "Boolean_TRUE";
VAL_ 643 DoorPassRelsFailMechRels 0 "Boolean_FALSE" 1 "Boolean_TRUE";
VAL_ 643 DoorRiReCinhIntFailInfCinchFlt1 0 "Boolean_FALSE" 1 "Boolean_TRUE";
VAL_ 643 DoorRiReCinhIntFailInfCinchRestFlt 0 "Boolean_FALSE" 1 "Boolean_TRUE";
VAL_ 643 DoorRiReRelsFailCinchOverTimed 0 "Boolean_FALSE" 1 "Boolean_TRUE";
VAL_ 643 DoorRiReRelsFailFailure1 0 "Boolean_FALSE" 1 "Boolean_TRUE";
VAL_ 643 DoorRiReRelsFailMechRels 0 "Boolean_FALSE" 1 "Boolean_TRUE";
VAL_ 643 HvacAirTForMaxTZoneEvaprTQf 0 "HvacTIfQf_SnsrDataNotOk" 1 "HvacTIfQf_SnsrDataOk";
VAL_ 643 HvacHeatgReq 0 "OnOff1_Off" 1 "OnOff1_On";
VAL_ 643 IntPm25LvlFrmClima 0 "CmpmtAirPmLvl_Level1" 1 "CmpmtAirPmLvl_Level2" 2 "CmpmtAirPmLvl_Level3" 3 "CmpmtAirPmLvl_Level4" 4 "CmpmtAirPmLvl_Level5" 5 "CmpmtAirPmLvl_Level6" 6 "CmpmtAirPmLvl_Reserved" 7 "CmpmtAirPmLvl_Invalid";
VAL_ 643 OutdPm25LvlFrmClima 0 "CmpmtAirPmLvl_Level1" 1 "CmpmtAirPmLvl_Level2" 2 "CmpmtAirPmLvl_Level3" 3 "CmpmtAirPmLvl_Level4" 4 "CmpmtAirPmLvl_Level5" 5 "CmpmtAirPmLvl_Level6" 6 "CmpmtAirPmLvl_Reserved" 7 "CmpmtAirPmLvl_Invalid";
VAL_ 643 PassSeatHeatgAutoSts 0 "OffOnErrInvalid_Off" 1 "OffOnErrInvalid_On" 2 "OffOnErrInvalid_Err" 3 "OffOnErrInvalid_Invalid";
VAL_ 643 PassSeatHeatgAvlSts 0 "StsFd_None" 1 "StsFd_On" 2 "StsFd_Off" 3 "StsFd_Error" 4 "StsFd_Functionallimit" 5 "StsFd_Energylimit" 6 "StsFd_Resvd1" 7 "StsFd_Resvd2";
VAL_ 643 PassSeatVentnAutoSts 0 "OffOnErrInvalid_Off" 1 "OffOnErrInvalid_On" 2 "OffOnErrInvalid_Err" 3 "OffOnErrInvalid_Invalid";
VAL_ 643 RemClimaDefrstSts 0 "OnOff1_Off" 1 "OnOff1_On";
VAL_ 643 RemClimaHvSts 0 "OnOff1_Off" 1 "OnOff1_On";
VAL_ 643 RemVentActvSts 0 "OnOff1_Off" 1 "OnOff1_On";
VAL_ 643 RemVentReqRspnFb 0 "OnOff1_Off" 1 "OnOff1_On";
VAL_ 643 RemVentWarnSts 0 "RemVentWarningSts_NoErr" 1 "RemVentWarningSts_Err" 2 "RemVentWarningSts_PwrNotAllwd" 3 "RemVentWarningSts_EgyNotAllwd";
VAL_ 643 WinFailrStsAtPass 0 "Flt_NoFault" 1 "Flt_Fault";
VAL_ 643 WinFailrStsAtReRi 0 "Flt_NoFault" 1 "Flt_Fault";
VAL_ 882 ClimaActvAlrmSts 0 "OnOff1_Off" 1 "OnOff1_On";
VAL_ 882 HvacHexAirTHvacAirTForHeatrFrntQf 0 "OkNotOk_NotOk" 1 "OkNotOk_Ok";
VAL_ 882 HwRowFrstPassFrntExtMotCtrl 0 "SwtVertSts1_Idle" 1 "SwtVertSts1_Up" 2 "SwtVertSts1_Dwn";
VAL_ 882 HwRowFrstPassFrntHeiMotCtrl 0 "SwtVertSts1_Idle" 1 "SwtVertSts1_Up" 2 "SwtVertSts1_Dwn";
VAL_ 882 HwRowFrstPassHeiMotCtrl 0 "SwtVertSts1_Idle" 1 "SwtVertSts1_Up" 2 "SwtVertSts1_Dwn";
VAL_ 882 HwRowFrstPassInclMotCtrl 0 "SwtHozlSts1_Idle" 1 "SwtHozlSts1_Fwd" 2 "SwtHozlSts1_Backw";
VAL_ 882 HwRowFrstPassSldMotCtrl 0 "SwtHozlSts1_Idle" 1 "SwtHozlSts1_Fwd" 2 "SwtHozlSts1_Backw";
VAL_ 882 IntrLiAmb1Trigger 0 "Boolean_FALSE" 1 "Boolean_TRUE";
VAL_ 882 IntrLiAmb1Update 0 "Boolean_FALSE" 1 "Boolean_TRUE";
VAL_ 882 IntrLiAmb2Trigger 0 "Boolean_FALSE" 1 "Boolean_TRUE";
VAL_ 882 IntrLiAmb2Update 0 "Boolean_FALSE" 1 "Boolean_TRUE";
VAL_ 882 WinHwSwtPassDoor 0 "WinPosnReq_Idle" 1 "WinPosnReq_UpMan" 2 "WinPosnReq_UpAut" 3 "WinPosnReq_DwnMan" 4 "WinPosnReq_DwnAut" 5 "WinPosnReq_NotDefd";
VAL_ 882 WinHwSwtPassReDoor 0 "WinPosnReq_Idle" 1 "WinPosnReq_UpMan" 2 "WinPosnReq_UpAut" 3 "WinPosnReq_DwnMan" 4 "WinPosnReq_DwnAut" 5 "WinPosnReq_NotDefd";
VAL_ 451 CCMHvahFltIndcn 0 "Flg1_Rst" 1 "Flg1_Set";
VAL_ 451 ClimaOvrHeatProActvSts 0 "OnOff1_Off" 1 "OnOff1_On";
VAL_ 451 DstTrvldVldFromVehCom 0 "InvldVld1_Invld" 1 "InvldVld1_Vld";
VAL_ 451 EcoClimaSts 0 "OnOff1_Off" 1 "OnOff1_On";
VAL_ 451 ElecAirVentnDrvrAvlStsLotus 0 "StsFd_None" 1 "StsFd_On" 2 "StsFd_Off" 3 "StsFd_Error" 4 "StsFd_Functionallimit" 5 "StsFd_Energylimit" 6 "StsFd_Resvd1" 7 "StsFd_Resvd2";
VAL_ 451 ElecAirVentnPassAvlStsLotus 0 "StsFd_None" 1 "StsFd_On" 2 "StsFd_Off" 3 "StsFd_Error" 4 "StsFd_Functionallimit" 5 "StsFd_Energylimit" 6 "StsFd_Resvd1" 7 "StsFd_Resvd2";
VAL_ 451 ElecAirVentnReLeAvlStsLotus 0 "StsFd_None" 1 "StsFd_On" 2 "StsFd_Off" 3 "StsFd_Error" 4 "StsFd_Functionallimit" 5 "StsFd_Energylimit" 6 "StsFd_Resvd1" 7 "StsFd_Resvd2";
VAL_ 451 ElecAirVentnReRiAvlStsLotus 0 "StsFd_None" 1 "StsFd_On" 2 "StsFd_Off" 3 "StsFd_Error" 4 "StsFd_Functionallimit" 5 "StsFd_Energylimit" 6 "StsFd_Resvd1" 7 "StsFd_Resvd2";
VAL_ 451 FltOfFrntTurnIndcrLe 0 "DevErrSts2_NoFlt" 1 "DevErrSts2_Flt";
VAL_ 451 FltOfFrntTurnIndcrRi 0 "DevErrSts2_NoFlt" 1 "DevErrSts2_Flt";
VAL_ 451 FltOfReTurnIndcrLe 0 "DevErrSts2_NoFlt" 1 "DevErrSts2_Flt";
VAL_ 451 FltOfReTurnIndcrRi 0 "DevErrSts2_NoFlt" 1 "DevErrSts2_Flt";
VAL_ 451 FrntClimaManModCmftSts 0 "ClimaManModCmftSts_None" 1 "ClimaManModCmftSts_AvoidColdWind" 2 "ClimaManModCmftSts_AvoidHotWind" 3 "ClimaManModCmftSts_Resd";
VAL_ 451 FuSnsrActvSideGenQF 0 "GenQf1_UndefindDataAccur" 1 "GenQf1_TmpUndefdData" 2 "GenQf1_DataAccurNotWithinSpcn" 3 "GenQf1_AccurData";
VAL_ 451 FuSnsrPasSideGenQF 0 "GenQf1_UndefindDataAccur" 1 "GenQf1_TmpUndefdData" 2 "GenQf1_DataAccurNotWithinSpcn" 3 "GenQf1_AccurData";
VAL_ 451 HvacFanLvlFbFrnt 0 "HmiHvacFanLvl_Off" 1 "HmiHvacFanLvl_LvlMan1" 2 "HmiHvacFanLvl_LvlMan2" 3 "HmiHvacFanLvl_LvlMan3" 4 "HmiHvacFanLvl_LvlMan4" 5 "HmiHvacFanLvl_LvlMan5" 6 "HmiHvacFanLvl_LvlMan6" 7 "HmiHvacFanLvl_LvlMan7" 8 "HmiHvacFanLvl_LvlMan8" 9 "HmiHvacFanLvl_LvlMan9" 10 "HmiHvacFanLvl_LvlAutMinusMinus" 11 "HmiHvacFanLvl_LvlAutMinus" 12 "HmiHvacFanLvl_LvlAutNorm" 13 "HmiHvacFanLvl_LvlAutPlus" 14 "HmiHvacFanLvl_LvlAutPlusPlus" 15 "HmiHvacFanLvl_Reserved";
VAL_ 451 HvacFanLvlFbRe 0 "HmiHvacFanLvl_Off" 1 "HmiHvacFanLvl_LvlMan1" 2 "HmiHvacFanLvl_LvlMan2" 3 "HmiHvacFanLvl_LvlMan3" 4 "HmiHvacFanLvl_LvlMan4" 5 "HmiHvacFanLvl_LvlMan5" 6 "HmiHvacFanLvl_LvlMan6" 7 "HmiHvacFanLvl_LvlMan7" 8 "HmiHvacFanLvl_LvlMan8" 9 "HmiHvacFanLvl_LvlMan9" 10 "HmiHvacFanLvl_LvlAutMinusMinus" 11 "HmiHvacFanLvl_LvlAutMinus" 12 "HmiHvacFanLvl_LvlAutNorm" 13 "HmiHvacFanLvl_LvlAutPlus" 14 "HmiHvacFanLvl_LvlAutPlusPlus" 15 "HmiHvacFanLvl_Reserved";
VAL_ 451 PassMassgRunng 0 "OnOff1_Off" 1 "OnOff1_On";
VAL_ 451 PassSeatActvSpplFct 0 "SeatActvSpplFct1_NotAvl" 1 "SeatActvSpplFct1_LumExtnAndLumHei" 2 "SeatActvSpplFct1_BackBlster" 3 "SeatActvSpplFct1_CushExtn" 4 "SeatActvSpplFct1_HdrestHeiAndHdrestTilt" 5 "SeatActvSpplFct1_MassgFct" 6 "SeatActvSpplFct1_ShoulderFct" 7 "SeatActvSpplFct1_LegrestFct";
VAL_ 451 PassSeatAutMovmtSts 0 "Sts_Resd" 1 "Sts_Err" 2 "Sts_CmplOk" 3 "Sts_InProgs";
VAL_ 451 PassSeatHeatgLvlSts 0 "SeatClimaLvl_Off" 1 "SeatClimaLvl_Lvl1" 2 "SeatClimaLvl_Lvl2" 3 "SeatClimaLvl_Lvl3";
VAL_ 451 PassSeatSwtSts2PassSeatSwtAdjmtOfSpplFctHozlSts 0 "SwtHozlSts1_Idle" 1 "SwtHozlSts1_Fwd" 2 "SwtHozlSts1_Backw";
VAL_ 451 PassSeatSwtSts2PassSeatSwtAdjmtOfSpplFctVerSts 0 "SwtVertSts1_Idle" 1 "SwtVertSts1_Up" 2 "SwtVertSts1_Dwn";
VAL_ 451 PassSeatSwtSts2PassSeatSwtHdrstHozlSts 0 "SwtHozlSts1_Idle" 1 "SwtHozlSts1_Fwd" 2 "SwtHozlSts1_Backw";
VAL_ 451 PassSeatSwtSts2PassSeatSwtHdrstVertSts 0 "SwtVertSts1_Idle" 1 "SwtVertSts1_Up" 2 "SwtVertSts1_Dwn";
VAL_ 451 PassSeatSwtSts2PassSeatSwtHeiFrntSts 0 "SwtVertSts1_Idle" 1 "SwtVertSts1_Up" 2 "SwtVertSts1_Dwn";
VAL_ 451 PassSeatSwtSts2PassSeatSwtHeiSts 0 "SwtVertSts1_Idle" 1 "SwtVertSts1_Up" 2 "SwtVertSts1_Dwn";
VAL_ 451 PassSeatSwtSts2PassSeatSwtInclSts 0 "SwtHozlSts1_Idle" 1 "SwtHozlSts1_Fwd" 2 "SwtHozlSts1_Backw";
VAL_ 451 PassSeatSwtSts2PassSeatSwtSelnOfSpplFctStsSts 0 "SwtVertSts1_Idle" 1 "SwtVertSts1_Up" 2 "SwtVertSts1_Dwn";
VAL_ 451 PassSeatSwtSts2PassSeatSwtSldSts 0 "SwtHozlSts1_Idle" 1 "SwtHozlSts1_Fwd" 2 "SwtHozlSts1_Backw";
VAL_ 451 PassSeatVentnLvlSts 0 "SeatClimaLvl_Off" 1 "SeatClimaLvl_Lvl1" 2 "SeatClimaLvl_Lvl2" 3 "SeatClimaLvl_Lvl3";
VAL_ 451 ReClimaManModCmftSts 0 "ClimaManModCmftSts_None" 1 "ClimaManModCmftSts_AvoidColdWind" 2 "ClimaManModCmftSts_AvoidHotWind" 3 "ClimaManModCmftSts_Resd";
VAL_ 258 ClimaSts 0 "ClimaSts_Start" 1 "ClimaSts_Finish";
VAL_ 258 DoorPassHndlSts 0 "DoorHndlSts_Ukwn" 1 "DoorHndlSts_FullRtrctd" 2 "DoorHndlSts_MovgOut" 3 "DoorHndlSts_StopDurgDply" 4 "DoorHndlSts_FullDplyd" 5 "DoorHndlSts_MovgIn" 6 "DoorHndlSts_StopDurgRtrct" 7 "DoorHndlSts_Flt";
VAL_ 258 DoorPassReLockSts 0 "LockSts2_LockStsUkwn" 1 "LockSts2_Unlckd" 2 "LockSts2_Lockd" 3 "LockSts2_SafeLockd";
VAL_ 258 DoorRiReHndlSts 0 "DoorHndlSts_Ukwn" 1 "DoorHndlSts_FullRtrctd" 2 "DoorHndlSts_MovgOut" 3 "DoorHndlSts_StopDurgDply" 4 "DoorHndlSts_FullDplyd" 5 "DoorHndlSts_MovgIn" 6 "DoorHndlSts_StopDurgRtrct" 7 "DoorHndlSts_Flt";
VAL_ 258 EngRunngReqByClima 0 "EngRunngReq_Dft" 1 "EngRunngReq_StopInhb" 2 "EngRunngReq_RunReq" 3 "EngRunngReq_Resd";
VAL_ 258 FrntSeatPassLinFbToSecSeat 0 "SeatCtrlFbSts_Idle" 1 "SeatCtrlFbSts_MoveInProg" 2 "SeatCtrlFbSts_MoveComplete" 3 "SeatCtrlFbSts_ReturnInProg" 4 "SeatCtrlFbSts_ReturnComplete" 5 "SeatCtrlFbSts_Quit";
VAL_ 258 HvacCoolgEnaFrnt 0 "OnOff1_Off" 1 "OnOff1_On";
VAL_ 258 SeatClimaDurgClimaHmiSeatHeatgForRowThrdLe 0 "SeatClimaLvl_Off" 1 "SeatClimaLvl_Lvl1" 2 "SeatClimaLvl_Lvl2" 3 "SeatClimaLvl_Lvl3";
VAL_ 258 SeatClimaDurgClimaHmiSeatHeatgForRowThrdRi 0 "SeatClimaLvl_Off" 1 "SeatClimaLvl_Lvl1" 2 "SeatClimaLvl_Lvl2" 3 "SeatClimaLvl_Lvl3";
VAL_ 258 SeatClimaDurgClimaHmiSeatVentnForRowThrdLe 0 "SeatClimaLvl_Off" 1 "SeatClimaLvl_Lvl1" 2 "SeatClimaLvl_Lvl2" 3 "SeatClimaLvl_Lvl3";
VAL_ 258 SeatClimaDurgClimaHmiSeatVentnForRowThrdRi 0 "SeatClimaLvl_Off" 1 "SeatClimaLvl_Lvl1" 2 "SeatClimaLvl_Lvl2" 3 "SeatClimaLvl_Lvl3";
VAL_ 455 ClimaManModCmftPopUpReq 0 "PopUpReq_NoReq" 1 "PopUpReq_AvoidColdWind" 2 "PopUpReq_AvoidHotWind" 3 "PopUpReq_ReAvoidColdWind" 4 "PopUpReq_ReAvoidHotWind" 5 "PopUpReq_Resd1" 6 "PopUpReq_Resd2" 7 "PopUpReq_Resd3";
VAL_ 455 ClimaOffReq 0 "ClimaOffReq_NoReq" 1 "ClimaOffReq_SecRowOffReq" 2 "ClimaOffReq_TrdRowOffReq" 3 "ClimaOffReq_ClimaOff";
VAL_ 455 ClimaOvrHeatProRspn 0 "OnOff1_Off" 1 "OnOff1_On";
VAL_ 455 ClimaOvrHeatProWarn 0 "ClimaOvrheatProWarnSts_NoWarn" 1 "ClimaOvrheatProWarnSts_Err" 2 "ClimaOvrheatProWarnSts_PwrLo" 3 "ClimaOvrheatProWarnSts_Tout";
VAL_ 455 DiDblLock 0 "EnableDisableCoding_Disabled" 1 "EnableDisableCoding_Enabled";
VAL_ 455 RemClimaDelaySts 0 "OnOff1_Off" 1 "OnOff1_On";
VAL_ 455 RemClimaExtnTiRspn 0 "OnOff1_Off" 1 "OnOff1_On";
VAL_ 455 RemClimaHvRspn 0 "OnOff1_Off" 1 "OnOff1_On";
VAL_ 455 RemClimaWarn 0 "ClimaWarn_NoWarn" 1 "ClimaWarn_FuLo" 2 "ClimaWarn_BattLo" 3 "ClimaWarn_FuAndBattLo" 4 "ClimaWarn_TLo" 5 "ClimaWarn_THi" 6 "ClimaWarn_Error" 7 "ClimaWarn_HVError" 8 "ClimaWarn_ActvnLimd";
VAL_ 455 RemStrtClimaRspn 0 "OnOff1_Off" 1 "OnOff1_On";
VAL_ 455 RoofOpnReqFrmClima 0 "OnOff1_Off" 1 "OnOff1_On";
VAL_ 455 SchedCmptHeatCoolFB 0 "SchedCmptHeatCoolFB_NoReq" 1 "SchedCmptHeatCoolFB_ON" 2 "SchedCmptHeatCoolFB_OFF" 3 "SchedCmptHeatCoolFB_Reserved";
VAL_ 455 WinAndRoofReqFrmClima 0 "WinOpenClsGlbReqFromTelm_Idle" 1 "WinOpenClsGlbReqFromTelm_Open" 2 "WinOpenClsGlbReqFromTelm_Close";
VAL_ 1350 VFCVectorZCUPVFCid0 0 "VFCOnOff_Off" 1 "VFCOnOff_On";
VAL_ 1350 VFCVectorZCUPVFCid1 0 "VFCOnOff_Off" 1 "VFCOnOff_On";
VAL_ 1350 VFCVectorZCUPVFCid10 0 "VFCOnOff_Off" 1 "VFCOnOff_On";
VAL_ 1350 VFCVectorZCUPVFCid11 0 "VFCOnOff_Off" 1 "VFCOnOff_On";
VAL_ 1350 VFCVectorZCUPVFCid12 0 "VFCOnOff_Off" 1 "VFCOnOff_On";
VAL_ 1350 VFCVectorZCUPVFCid13 0 "VFCOnOff_Off" 1 "VFCOnOff_On";
VAL_ 1350 VFCVectorZCUPVFCid14 0 "VFCOnOff_Off" 1 "VFCOnOff_On";
VAL_ 1350 VFCVectorZCUPVFCid15 0 "VFCOnOff_Off" 1 "VFCOnOff_On";
VAL_ 1350 VFCVectorZCUPVFCid16 0 "VFCOnOff_Off" 1 "VFCOnOff_On";
VAL_ 1350 VFCVectorZCUPVFCid17 0 "VFCOnOff_Off" 1 "VFCOnOff_On";
VAL_ 1350 VFCVectorZCUPVFCid18 0 "VFCOnOff_Off" 1 "VFCOnOff_On";
VAL_ 1350 VFCVectorZCUPVFCid19 0 "VFCOnOff_Off" 1 "VFCOnOff_On";
VAL_ 1350 VFCVectorZCUPVFCid2 0 "VFCOnOff_Off" 1 "VFCOnOff_On";
VAL_ 1350 VFCVectorZCUPVFCid20 0 "VFCOnOff_Off" 1 "VFCOnOff_On";
VAL_ 1350 VFCVectorZCUPVFCid21 0 "VFCOnOff_Off" 1 "VFCOnOff_On";
VAL_ 1350 VFCVectorZCUPVFCid22 0 "VFCOnOff_Off" 1 "VFCOnOff_On";
VAL_ 1350 VFCVectorZCUPVFCid23 0 "VFCOnOff_Off" 1 "VFCOnOff_On";
VAL_ 1350 VFCVectorZCUPVFCid24 0 "VFCOnOff_Off" 1 "VFCOnOff_On";
VAL_ 1350 VFCVectorZCUPVFCid25 0 "VFCOnOff_Off" 1 "VFCOnOff_On";
VAL_ 1350 VFCVectorZCUPVFCid26 0 "VFCOnOff_Off" 1 "VFCOnOff_On";
VAL_ 1350 VFCVectorZCUPVFCid27 0 "VFCOnOff_Off" 1 "VFCOnOff_On";
VAL_ 1350 VFCVectorZCUPVFCid28 0 "VFCOnOff_Off" 1 "VFCOnOff_On";
VAL_ 1350 VFCVectorZCUPVFCid29 0 "VFCOnOff_Off" 1 "VFCOnOff_On";
VAL_ 1350 VFCVectorZCUPVFCid3 0 "VFCOnOff_Off" 1 "VFCOnOff_On";
VAL_ 1350 VFCVectorZCUPVFCid30 0 "VFCOnOff_Off" 1 "VFCOnOff_On";
VAL_ 1350 VFCVectorZCUPVFCid31 0 "VFCOnOff_Off" 1 "VFCOnOff_On";
VAL_ 1350 VFCVectorZCUPVFCid32 0 "VFCOnOff_Off" 1 "VFCOnOff_On";
VAL_ 1350 VFCVectorZCUPVFCid33 0 "VFCOnOff_Off" 1 "VFCOnOff_On";
VAL_ 1350 VFCVectorZCUPVFCid34 0 "VFCOnOff_Off" 1 "VFCOnOff_On";
VAL_ 1350 VFCVectorZCUPVFCid35 0 "VFCOnOff_Off" 1 "VFCOnOff_On";
VAL_ 1350 VFCVectorZCUPVFCid36 0 "VFCOnOff_Off" 1 "VFCOnOff_On";
VAL_ 1350 VFCVectorZCUPVFCid37 0 "VFCOnOff_Off" 1 "VFCOnOff_On";
VAL_ 1350 VFCVectorZCUPVFCid38 0 "VFCOnOff_Off" 1 "VFCOnOff_On";
VAL_ 1350 VFCVectorZCUPVFCid39 0 "VFCOnOff_Off" 1 "VFCOnOff_On";
VAL_ 1350 VFCVectorZCUPVFCid4 0 "VFCOnOff_Off" 1 "VFCOnOff_On";
VAL_ 1350 VFCVectorZCUPVFCid40 0 "VFCOnOff_Off" 1 "VFCOnOff_On";
VAL_ 1350 VFCVectorZCUPVFCid41 0 "VFCOnOff_Off" 1 "VFCOnOff_On";
VAL_ 1350 VFCVectorZCUPVFCid42 0 "VFCOnOff_Off" 1 "VFCOnOff_On";
VAL_ 1350 VFCVectorZCUPVFCid43 0 "VFCOnOff_Off" 1 "VFCOnOff_On";
VAL_ 1350 VFCVectorZCUPVFCid44 0 "VFCOnOff_Off" 1 "VFCOnOff_On";
VAL_ 1350 VFCVectorZCUPVFCid45 0 "VFCOnOff_Off" 1 "VFCOnOff_On";
VAL_ 1350 VFCVectorZCUPVFCid46 0 "VFCOnOff_Off" 1 "VFCOnOff_On";
VAL_ 1350 VFCVectorZCUPVFCid47 0 "VFCOnOff_Off" 1 "VFCOnOff_On";
VAL_ 1350 VFCVectorZCUPVFCid48 0 "VFCOnOff_Off" 1 "VFCOnOff_On";
VAL_ 1350 VFCVectorZCUPVFCid49 0 "VFCOnOff_Off" 1 "VFCOnOff_On";
VAL_ 1350 VFCVectorZCUPVFCid5 0 "VFCOnOff_Off" 1 "VFCOnOff_On";
VAL_ 1350 VFCVectorZCUPVFCid50 0 "VFCOnOff_Off" 1 "VFCOnOff_On";
VAL_ 1350 VFCVectorZCUPVFCid51 0 "VFCOnOff_Off" 1 "VFCOnOff_On";
VAL_ 1350 VFCVectorZCUPVFCid52 0 "VFCOnOff_Off" 1 "VFCOnOff_On";
VAL_ 1350 VFCVectorZCUPVFCid53 0 "VFCOnOff_Off" 1 "VFCOnOff_On";
VAL_ 1350 VFCVectorZCUPVFCid54 0 "VFCOnOff_Off" 1 "VFCOnOff_On";
VAL_ 1350 VFCVectorZCUPVFCid55 0 "VFCOnOff_Off" 1 "VFCOnOff_On";
VAL_ 1350 VFCVectorZCUPVFCid56 0 "VFCOnOff_Off" 1 "VFCOnOff_On";
VAL_ 1350 VFCVectorZCUPVFCid57 0 "VFCOnOff_Off" 1 "VFCOnOff_On";
VAL_ 1350 VFCVectorZCUPVFCid58 0 "VFCOnOff_Off" 1 "VFCOnOff_On";
VAL_ 1350 VFCVectorZCUPVFCid59 0 "VFCOnOff_Off" 1 "VFCOnOff_On";
VAL_ 1350 VFCVectorZCUPVFCid6 0 "VFCOnOff_Off" 1 "VFCOnOff_On";
VAL_ 1350 VFCVectorZCUPVFCid60 0 "VFCOnOff_Off" 1 "VFCOnOff_On";
VAL_ 1350 VFCVectorZCUPVFCid61 0 "VFCOnOff_Off" 1 "VFCOnOff_On";
VAL_ 1350 VFCVectorZCUPVFCid7 0 "VFCOnOff_Off" 1 "VFCOnOff_On";
VAL_ 1350 VFCVectorZCUPVFCid8 0 "VFCOnOff_Off" 1 "VFCOnOff_On";
VAL_ 1350 VFCVectorZCUPVFCid9 0 "VFCOnOff_Off" 1 "VFCOnOff_On";
SIG_GROUP_ 51 BodyDataTraceZCUP1 1 : BodyDataTraceZCUP1Functiondevpsignalgroup1 BodyDataTraceZCUP1Functiondevpsignalgroup2 BodyDataTraceZCUP1Functiondevpsignalgroup3 BodyDataTraceZCUP1Functiondevpsignalgroup4 BodyDataTraceZCUP1Functiondevpsignalgroup5 BodyDataTraceZCUP1Functiondevpsignalgroup6 BodyDataTraceZCUP1Functiondevpsignalgroup7 BodyDataTraceZCUP1Functiondevpsignalgroup8;
SIG_GROUP_ 51 BodyDataTraceZCUP2 1 : BodyDataTraceZCUP2Functiondevpsignalgroup1 BodyDataTraceZCUP2Functiondevpsignalgroup2 BodyDataTraceZCUP2Functiondevpsignalgroup3 BodyDataTraceZCUP2Functiondevpsignalgroup4 BodyDataTraceZCUP2Functiondevpsignalgroup5 BodyDataTraceZCUP2Functiondevpsignalgroup6 BodyDataTraceZCUP2Functiondevpsignalgroup7 BodyDataTraceZCUP2Functiondevpsignalgroup8;
SIG_GROUP_ 51 BodyDataTraceZCUP3 1 : BodyDataTraceZCUP3Functiondevpsignalgroup1 BodyDataTraceZCUP3Functiondevpsignalgroup2 BodyDataTraceZCUP3Functiondevpsignalgroup3 BodyDataTraceZCUP3Functiondevpsignalgroup4 BodyDataTraceZCUP3Functiondevpsignalgroup5 BodyDataTraceZCUP3Functiondevpsignalgroup6 BodyDataTraceZCUP3Functiondevpsignalgroup7 BodyDataTraceZCUP3Functiondevpsignalgroup8;
SIG_GROUP_ 51 BodyDataTraceZCUP4 1 : BodyDataTraceZCUP4Functiondevpsignalgroup1 BodyDataTraceZCUP4Functiondevpsignalgroup2 BodyDataTraceZCUP4Functiondevpsignalgroup3 BodyDataTraceZCUP4Functiondevpsignalgroup4 BodyDataTraceZCUP4Functiondevpsignalgroup5 BodyDataTraceZCUP4Functiondevpsignalgroup6 BodyDataTraceZCUP4Functiondevpsignalgroup7 BodyDataTraceZCUP4Functiondevpsignalgroup8;
SIG_GROUP_ 51 BodyDataTraceZCUP5 1 : BodyDataTraceZCUP5Functiondevpsignalgroup1 BodyDataTraceZCUP5Functiondevpsignalgroup2 BodyDataTraceZCUP5Functiondevpsignalgroup3 BodyDataTraceZCUP5Functiondevpsignalgroup4 BodyDataTraceZCUP5Functiondevpsignalgroup5 BodyDataTraceZCUP5Functiondevpsignalgroup6 BodyDataTraceZCUP5Functiondevpsignalgroup7 BodyDataTraceZCUP5Functiondevpsignalgroup8;
SIG_GROUP_ 51 BodyDataTraceZCUP6 1 : BodyDataTraceZCUP6Functiondevpsignalgroup1 BodyDataTraceZCUP6Functiondevpsignalgroup2 BodyDataTraceZCUP6Functiondevpsignalgroup3 BodyDataTraceZCUP6Functiondevpsignalgroup4 BodyDataTraceZCUP6Functiondevpsignalgroup5 BodyDataTraceZCUP6Functiondevpsignalgroup6 BodyDataTraceZCUP6Functiondevpsignalgroup7 BodyDataTraceZCUP6Functiondevpsignalgroup8;
SIG_GROUP_ 51 BodyDataTraceZCUP7 1 : BodyDataTraceZCUP7Functiondevpsignalgroup1 BodyDataTraceZCUP7Functiondevpsignalgroup2 BodyDataTraceZCUP7Functiondevpsignalgroup3 BodyDataTraceZCUP7Functiondevpsignalgroup4 BodyDataTraceZCUP7Functiondevpsignalgroup5 BodyDataTraceZCUP7Functiondevpsignalgroup6 BodyDataTraceZCUP7Functiondevpsignalgroup7 BodyDataTraceZCUP7Functiondevpsignalgroup8;
SIG_GROUP_ 643 CmptmtAirDistbnRsp 1 : CmptmtAirDistbnRspAirDistbnDrvr CmptmtAirDistbnRspAirDistbnPass CmptmtAirDistbnRspAirDistbnSecLe CmptmtAirDistbnRspAirDistbnSecRi CmptmtAirDistbnRspAirDistbnThrd;
SIG_GROUP_ 643 DoorPassCinhIntFailInf 1 : DoorPassCinhIntFailInfCinchFlt1 DoorPassCinhIntFailInfCinchRestFlt;
SIG_GROUP_ 643 DoorPassRelsFail 1 : DoorPassRelsFailCinchOverTimed DoorPassRelsFailFailure1 DoorPassRelsFailMechRels;
SIG_GROUP_ 643 DoorRiReCinhIntFailInf 1 : DoorRiReCinhIntFailInfCinchFlt1 DoorRiReCinhIntFailInfCinchRestFlt;
SIG_GROUP_ 643 DoorRiReRelsFail 1 : DoorRiReRelsFailCinchOverTimed DoorRiReRelsFailFailure1 DoorRiReRelsFailMechRels;
SIG_GROUP_ 451 FuSnsrActvSide 1 : FuSnsrActvSideFuLvlSnsrRawVal FuSnsrActvSideGenQF;
SIG_GROUP_ 451 FuSnsrPasSide 1 : FuSnsrPasSideFuLvlSnsrRawVal FuSnsrPasSideGenQF;
SIG_GROUP_ 643 HvacAirTForMaxTZone 1 : HvacAirTForMaxTZoneEvaprTFrnt HvacAirTForMaxTZoneEvaprTQf;
SIG_GROUP_ 882 HvacHexAirT 1 : HvacHexAirTHvacAirTForHeatrFrnt HvacHexAirTHvacAirTForHeatrFrntQf;
SIG_GROUP_ 882 IntrLiAmb1 1 : IntrLiAmb1BnIngrd IntrLiAmb1GrnIngrd IntrLiAmb1Intensty IntrLiAmb1RedIngrd IntrLiAmb1SelCmd1 IntrLiAmb1SelCmd2 IntrLiAmb1SynchDelay IntrLiAmb1TargetTransitionTime IntrLiAmb1Trigger IntrLiAmb1Update;
SIG_GROUP_ 882 IntrLiAmb2 1 : IntrLiAmb2BnIngrd IntrLiAmb2GrnIngrd IntrLiAmb2Intensty IntrLiAmb2RedIngrd IntrLiAmb2SelCmd1 IntrLiAmb2SelCmd2 IntrLiAmb2SynchDelay IntrLiAmb2TargetTransitionTime IntrLiAmb2Trigger IntrLiAmb2Update;
SIG_GROUP_ 451 PassSeatSwtSts2 1 : PassSeatSwtSts2PassSeatSwtAdjmtOfSpplFctHozlSts PassSeatSwtSts2PassSeatSwtAdjmtOfSpplFctVerSts PassSeatSwtSts2PassSeatSwtHdrstHozlSts PassSeatSwtSts2PassSeatSwtHdrstVertSts PassSeatSwtSts2PassSeatSwtHeiFrntSts PassSeatSwtSts2PassSeatSwtHeiSts PassSeatSwtSts2PassSeatSwtInclSts PassSeatSwtSts2PassSeatSwtSelnOfSpplFctStsSts PassSeatSwtSts2PassSeatSwtSldSts;
SIG_GROUP_ 1350 VFCVectorZCUP 1 : VFCVectorZCUPBlockID VFCVectorZCUPVFCid0 VFCVectorZCUPVFCid1 VFCVectorZCUPVFCid10 VFCVectorZCUPVFCid11 VFCVectorZCUPVFCid12 VFCVectorZCUPVFCid13 VFCVectorZCUPVFCid14 VFCVectorZCUPVFCid15 VFCVectorZCUPVFCid16 VFCVectorZCUPVFCid17 VFCVectorZCUPVFCid18 VFCVectorZCUPVFCid19 VFCVectorZCUPVFCid2 VFCVectorZCUPVFCid20 VFCVectorZCUPVFCid21 VFCVectorZCUPVFCid22 VFCVectorZCUPVFCid23 VFCVectorZCUPVFCid24 VFCVectorZCUPVFCid25 VFCVectorZCUPVFCid26 VFCVectorZCUPVFCid27 VFCVectorZCUPVFCid28 VFCVectorZCUPVFCid29 VFCVectorZCUPVFCid3 VFCVectorZCUPVFCid30 VFCVectorZCUPVFCid31 VFCVectorZCUPVFCid32 VFCVectorZCUPVFCid33 VFCVectorZCUPVFCid34 VFCVectorZCUPVFCid35 VFCVectorZCUPVFCid36 VFCVectorZCUPVFCid37 VFCVectorZCUPVFCid38 VFCVectorZCUPVFCid39 VFCVectorZCUPVFCid4 VFCVectorZCUPVFCid40 VFCVectorZCUPVFCid41 VFCVectorZCUPVFCid42 VFCVectorZCUPVFCid43 VFCVectorZCUPVFCid44 VFCVectorZCUPVFCid45 VFCVectorZCUPVFCid46 VFCVectorZCUPVFCid47 VFCVectorZCUPVFCid48 VFCVectorZCUPVFCid49 VFCVectorZCUPVFCid5 VFCVectorZCUPVFCid50 VFCVectorZCUPVFCid51 VFCVectorZCUPVFCid52 VFCVectorZCUPVFCid53 VFCVectorZCUPVFCid54 VFCVectorZCUPVFCid55 VFCVectorZCUPVFCid56 VFCVectorZCUPVFCid57 VFCVectorZCUPVFCid58 VFCVectorZCUPVFCid59 VFCVectorZCUPVFCid6 VFCVectorZCUPVFCid60 VFCVectorZCUPVFCid61 VFCVectorZCUPVFCid7 VFCVectorZCUPVFCid8 VFCVectorZCUPVFCid9;
