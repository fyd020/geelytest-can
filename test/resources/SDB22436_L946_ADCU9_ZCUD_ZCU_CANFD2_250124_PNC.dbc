// *************************************************************************** *
// *                                                                           *
// * Description:         CANDB File                                           *
// * Generated at:        2025-01-24 14:38                                     *
// * System:              SDB22436                                             *
// * Variant:             L946_ADCU9_ZCUD                                      *
// * Network:             ZCU_CANFD2                                           *
// *                                                                           *
// *************************************************************************** *
VERSION "ZCU_CANFD2"

NS_ :

BS_ :

BU_ :  ETC IHU ZCUD ZCUP

BO_ 800 ZCUDZCUCANFD2Fr16 : 64 ZCUD
 SG_ CmprSpdAct : 7|8@0+ (50.0,0.0) [0.0|12700.0] "rpm" IHU,ZCUP
 SG_ CmprSpdAct_UB : 231|1@0+ (1,0) [0|1] "" IHU,ZCUP
 SG_ EngCrashFb : 26|2@0+ (1,0) [0|3] "" IHU
 SG_ EngCrashFb_UB : 232|1@0+ (1,0) [0|1] "" IHU
 SG_ HvCooltHeatrEnadWhE2E_UB : 235|1@0+ (1,0) [0|1] "" IHU,ZCUP
 SG_ HvCooltHeatrEnadWhE2EChks : 23|8@0+ (1.0,0.0) [0.0|255.0] "Unitless" IHU,ZCUP
 SG_ HvCooltHeatrEnadWhE2ECntr : 31|4@0+ (1.0,0.0) [0.0|15.0] "Unitless" IHU,ZCUP
 SG_ HvCooltHeatrEnadWhE2EHvchEnad : 27|1@0+ (1,0) [0|1] "" IHU,ZCUP
 SG_ HwRowThrdLeSldMotCtrl : 229|2@0+ (1,0) [0|3] "" IHU
 SG_ HwRowThrdLeSldMotCtrl_UB : 227|1@0+ (1,0) [0|1] "" IHU
 SG_ HwRowThrdRiSldMotCtrl : 225|2@0+ (1,0) [0|3] "" IHU
 SG_ HwRowThrdRiSldMotCtrl_UB : 226|1@0+ (1,0) [0|1] "" IHU
 SG_ ReEvapVlvReq : 234|1@0+ (1,0) [0|1] "" IHU,ZCUP
 SG_ ReEvapVlvReq_UB : 233|1@0+ (1,0) [0|1] "" IHU,ZCUP
 SG_ SafetyCrashFb : 13|2@0+ (1,0) [0|3] "" IHU
 SG_ SafetyCrashFb_UB : 14|1@0+ (1,0) [0|1] "" IHU
 SG_ VFCVectorPOT_UB : 237|1@0+ (1,0) [0|1] "" IHU
 SG_ VFCVectorPOTBlockID : 97|2@0+ (1.0,0.0) [0.0|3.0] "Unitless" IHU
 SG_ VFCVectorPOTVFCid0 : 98|1@0+ (1,0) [0|1] "" IHU
 SG_ VFCVectorPOTVFCid1 : 99|1@0+ (1,0) [0|1] "" IHU
 SG_ VFCVectorPOTVFCid10 : 108|1@0+ (1,0) [0|1] "" IHU
 SG_ VFCVectorPOTVFCid11 : 109|1@0+ (1,0) [0|1] "" IHU
 SG_ VFCVectorPOTVFCid12 : 110|1@0+ (1,0) [0|1] "" IHU
 SG_ VFCVectorPOTVFCid13 : 111|1@0+ (1,0) [0|1] "" IHU
 SG_ VFCVectorPOTVFCid14 : 112|1@0+ (1,0) [0|1] "" IHU
 SG_ VFCVectorPOTVFCid15 : 113|1@0+ (1,0) [0|1] "" IHU
 SG_ VFCVectorPOTVFCid16 : 114|1@0+ (1,0) [0|1] "" IHU
 SG_ VFCVectorPOTVFCid17 : 115|1@0+ (1,0) [0|1] "" IHU
 SG_ VFCVectorPOTVFCid18 : 116|1@0+ (1,0) [0|1] "" IHU
 SG_ VFCVectorPOTVFCid19 : 117|1@0+ (1,0) [0|1] "" IHU
 SG_ VFCVectorPOTVFCid2 : 100|1@0+ (1,0) [0|1] "" IHU
 SG_ VFCVectorPOTVFCid20 : 118|1@0+ (1,0) [0|1] "" IHU
 SG_ VFCVectorPOTVFCid21 : 119|1@0+ (1,0) [0|1] "" IHU
 SG_ VFCVectorPOTVFCid22 : 120|1@0+ (1,0) [0|1] "" IHU
 SG_ VFCVectorPOTVFCid23 : 121|1@0+ (1,0) [0|1] "" IHU
 SG_ VFCVectorPOTVFCid24 : 122|1@0+ (1,0) [0|1] "" IHU
 SG_ VFCVectorPOTVFCid25 : 123|1@0+ (1,0) [0|1] "" IHU
 SG_ VFCVectorPOTVFCid26 : 124|1@0+ (1,0) [0|1] "" IHU
 SG_ VFCVectorPOTVFCid27 : 125|1@0+ (1,0) [0|1] "" IHU
 SG_ VFCVectorPOTVFCid28 : 126|1@0+ (1,0) [0|1] "" IHU
 SG_ VFCVectorPOTVFCid29 : 127|1@0+ (1,0) [0|1] "" IHU
 SG_ VFCVectorPOTVFCid3 : 101|1@0+ (1,0) [0|1] "" IHU
 SG_ VFCVectorPOTVFCid30 : 128|1@0+ (1,0) [0|1] "" IHU
 SG_ VFCVectorPOTVFCid31 : 129|1@0+ (1,0) [0|1] "" IHU
 SG_ VFCVectorPOTVFCid32 : 130|1@0+ (1,0) [0|1] "" IHU
 SG_ VFCVectorPOTVFCid33 : 131|1@0+ (1,0) [0|1] "" IHU
 SG_ VFCVectorPOTVFCid34 : 132|1@0+ (1,0) [0|1] "" IHU
 SG_ VFCVectorPOTVFCid35 : 133|1@0+ (1,0) [0|1] "" IHU
 SG_ VFCVectorPOTVFCid36 : 134|1@0+ (1,0) [0|1] "" IHU
 SG_ VFCVectorPOTVFCid37 : 135|1@0+ (1,0) [0|1] "" IHU
 SG_ VFCVectorPOTVFCid38 : 136|1@0+ (1,0) [0|1] "" IHU
 SG_ VFCVectorPOTVFCid39 : 137|1@0+ (1,0) [0|1] "" IHU
 SG_ VFCVectorPOTVFCid4 : 102|1@0+ (1,0) [0|1] "" IHU
 SG_ VFCVectorPOTVFCid40 : 138|1@0+ (1,0) [0|1] "" IHU
 SG_ VFCVectorPOTVFCid41 : 139|1@0+ (1,0) [0|1] "" IHU
 SG_ VFCVectorPOTVFCid42 : 140|1@0+ (1,0) [0|1] "" IHU
 SG_ VFCVectorPOTVFCid43 : 141|1@0+ (1,0) [0|1] "" IHU
 SG_ VFCVectorPOTVFCid44 : 142|1@0+ (1,0) [0|1] "" IHU
 SG_ VFCVectorPOTVFCid45 : 143|1@0+ (1,0) [0|1] "" IHU
 SG_ VFCVectorPOTVFCid46 : 144|1@0+ (1,0) [0|1] "" IHU
 SG_ VFCVectorPOTVFCid47 : 145|1@0+ (1,0) [0|1] "" IHU
 SG_ VFCVectorPOTVFCid48 : 146|1@0+ (1,0) [0|1] "" IHU
 SG_ VFCVectorPOTVFCid49 : 147|1@0+ (1,0) [0|1] "" IHU
 SG_ VFCVectorPOTVFCid5 : 103|1@0+ (1,0) [0|1] "" IHU
 SG_ VFCVectorPOTVFCid50 : 148|1@0+ (1,0) [0|1] "" IHU
 SG_ VFCVectorPOTVFCid51 : 149|1@0+ (1,0) [0|1] "" IHU
 SG_ VFCVectorPOTVFCid52 : 150|1@0+ (1,0) [0|1] "" IHU
 SG_ VFCVectorPOTVFCid53 : 151|1@0+ (1,0) [0|1] "" IHU
 SG_ VFCVectorPOTVFCid54 : 152|1@0+ (1,0) [0|1] "" IHU
 SG_ VFCVectorPOTVFCid55 : 153|1@0+ (1,0) [0|1] "" IHU
 SG_ VFCVectorPOTVFCid56 : 154|1@0+ (1,0) [0|1] "" IHU
 SG_ VFCVectorPOTVFCid57 : 155|1@0+ (1,0) [0|1] "" IHU
 SG_ VFCVectorPOTVFCid58 : 156|1@0+ (1,0) [0|1] "" IHU
 SG_ VFCVectorPOTVFCid59 : 157|1@0+ (1,0) [0|1] "" IHU
 SG_ VFCVectorPOTVFCid6 : 104|1@0+ (1,0) [0|1] "" IHU
 SG_ VFCVectorPOTVFCid60 : 158|1@0+ (1,0) [0|1] "" IHU
 SG_ VFCVectorPOTVFCid61 : 159|1@0+ (1,0) [0|1] "" IHU
 SG_ VFCVectorPOTVFCid7 : 105|1@0+ (1,0) [0|1] "" IHU
 SG_ VFCVectorPOTVFCid8 : 106|1@0+ (1,0) [0|1] "" IHU
 SG_ VFCVectorPOTVFCid9 : 107|1@0+ (1,0) [0|1] "" IHU
 SG_ VFCVectorRBCM_UB : 230|1@0+ (1,0) [0|1] "" IHU
 SG_ VFCVectorRBCMBlockID : 433|2@0+ (1.0,0.0) [0.0|3.0] "Unitless" IHU
 SG_ VFCVectorRBCMVFCid0 : 434|1@0+ (1,0) [0|1] "" IHU
 SG_ VFCVectorRBCMVFCid1 : 435|1@0+ (1,0) [0|1] "" IHU
 SG_ VFCVectorRBCMVFCid10 : 444|1@0+ (1,0) [0|1] "" IHU
 SG_ VFCVectorRBCMVFCid11 : 445|1@0+ (1,0) [0|1] "" IHU
 SG_ VFCVectorRBCMVFCid12 : 446|1@0+ (1,0) [0|1] "" IHU
 SG_ VFCVectorRBCMVFCid13 : 447|1@0+ (1,0) [0|1] "" IHU
 SG_ VFCVectorRBCMVFCid14 : 448|1@0+ (1,0) [0|1] "" IHU
 SG_ VFCVectorRBCMVFCid15 : 449|1@0+ (1,0) [0|1] "" IHU
 SG_ VFCVectorRBCMVFCid16 : 450|1@0+ (1,0) [0|1] "" IHU
 SG_ VFCVectorRBCMVFCid17 : 451|1@0+ (1,0) [0|1] "" IHU
 SG_ VFCVectorRBCMVFCid18 : 452|1@0+ (1,0) [0|1] "" IHU
 SG_ VFCVectorRBCMVFCid19 : 453|1@0+ (1,0) [0|1] "" IHU
 SG_ VFCVectorRBCMVFCid2 : 436|1@0+ (1,0) [0|1] "" IHU
 SG_ VFCVectorRBCMVFCid20 : 454|1@0+ (1,0) [0|1] "" IHU
 SG_ VFCVectorRBCMVFCid21 : 455|1@0+ (1,0) [0|1] "" IHU
 SG_ VFCVectorRBCMVFCid22 : 456|1@0+ (1,0) [0|1] "" IHU
 SG_ VFCVectorRBCMVFCid23 : 457|1@0+ (1,0) [0|1] "" IHU
 SG_ VFCVectorRBCMVFCid24 : 458|1@0+ (1,0) [0|1] "" IHU
 SG_ VFCVectorRBCMVFCid25 : 459|1@0+ (1,0) [0|1] "" IHU
 SG_ VFCVectorRBCMVFCid26 : 460|1@0+ (1,0) [0|1] "" IHU
 SG_ VFCVectorRBCMVFCid27 : 461|1@0+ (1,0) [0|1] "" IHU
 SG_ VFCVectorRBCMVFCid28 : 462|1@0+ (1,0) [0|1] "" IHU
 SG_ VFCVectorRBCMVFCid29 : 463|1@0+ (1,0) [0|1] "" IHU
 SG_ VFCVectorRBCMVFCid3 : 437|1@0+ (1,0) [0|1] "" IHU
 SG_ VFCVectorRBCMVFCid30 : 464|1@0+ (1,0) [0|1] "" IHU
 SG_ VFCVectorRBCMVFCid31 : 465|1@0+ (1,0) [0|1] "" IHU
 SG_ VFCVectorRBCMVFCid32 : 466|1@0+ (1,0) [0|1] "" IHU
 SG_ VFCVectorRBCMVFCid33 : 467|1@0+ (1,0) [0|1] "" IHU
 SG_ VFCVectorRBCMVFCid34 : 468|1@0+ (1,0) [0|1] "" IHU
 SG_ VFCVectorRBCMVFCid35 : 469|1@0+ (1,0) [0|1] "" IHU
 SG_ VFCVectorRBCMVFCid36 : 470|1@0+ (1,0) [0|1] "" IHU
 SG_ VFCVectorRBCMVFCid37 : 471|1@0+ (1,0) [0|1] "" IHU
 SG_ VFCVectorRBCMVFCid38 : 472|1@0+ (1,0) [0|1] "" IHU
 SG_ VFCVectorRBCMVFCid39 : 473|1@0+ (1,0) [0|1] "" IHU
 SG_ VFCVectorRBCMVFCid4 : 438|1@0+ (1,0) [0|1] "" IHU
 SG_ VFCVectorRBCMVFCid40 : 474|1@0+ (1,0) [0|1] "" IHU
 SG_ VFCVectorRBCMVFCid41 : 475|1@0+ (1,0) [0|1] "" IHU
 SG_ VFCVectorRBCMVFCid42 : 476|1@0+ (1,0) [0|1] "" IHU
 SG_ VFCVectorRBCMVFCid43 : 477|1@0+ (1,0) [0|1] "" IHU
 SG_ VFCVectorRBCMVFCid44 : 478|1@0+ (1,0) [0|1] "" IHU
 SG_ VFCVectorRBCMVFCid45 : 479|1@0+ (1,0) [0|1] "" IHU
 SG_ VFCVectorRBCMVFCid46 : 480|1@0+ (1,0) [0|1] "" IHU
 SG_ VFCVectorRBCMVFCid47 : 481|1@0+ (1,0) [0|1] "" IHU
 SG_ VFCVectorRBCMVFCid48 : 482|1@0+ (1,0) [0|1] "" IHU
 SG_ VFCVectorRBCMVFCid49 : 483|1@0+ (1,0) [0|1] "" IHU
 SG_ VFCVectorRBCMVFCid5 : 439|1@0+ (1,0) [0|1] "" IHU
 SG_ VFCVectorRBCMVFCid50 : 484|1@0+ (1,0) [0|1] "" IHU
 SG_ VFCVectorRBCMVFCid51 : 485|1@0+ (1,0) [0|1] "" IHU
 SG_ VFCVectorRBCMVFCid52 : 486|1@0+ (1,0) [0|1] "" IHU
 SG_ VFCVectorRBCMVFCid53 : 487|1@0+ (1,0) [0|1] "" IHU
 SG_ VFCVectorRBCMVFCid54 : 488|1@0+ (1,0) [0|1] "" IHU
 SG_ VFCVectorRBCMVFCid55 : 489|1@0+ (1,0) [0|1] "" IHU
 SG_ VFCVectorRBCMVFCid56 : 490|1@0+ (1,0) [0|1] "" IHU
 SG_ VFCVectorRBCMVFCid57 : 491|1@0+ (1,0) [0|1] "" IHU
 SG_ VFCVectorRBCMVFCid58 : 492|1@0+ (1,0) [0|1] "" IHU
 SG_ VFCVectorRBCMVFCid59 : 493|1@0+ (1,0) [0|1] "" IHU
 SG_ VFCVectorRBCMVFCid6 : 440|1@0+ (1,0) [0|1] "" IHU
 SG_ VFCVectorRBCMVFCid60 : 494|1@0+ (1,0) [0|1] "" IHU
 SG_ VFCVectorRBCMVFCid61 : 495|1@0+ (1,0) [0|1] "" IHU
 SG_ VFCVectorRBCMVFCid7 : 441|1@0+ (1,0) [0|1] "" IHU
 SG_ VFCVectorRBCMVFCid8 : 442|1@0+ (1,0) [0|1] "" IHU
 SG_ VFCVectorRBCMVFCid9 : 443|1@0+ (1,0) [0|1] "" IHU
 SG_ VFCVectorSRS_UB : 238|1@0+ (1,0) [0|1] "" IHU
 SG_ VFCVectorSRSBlockID : 161|2@0+ (1.0,0.0) [0.0|3.0] "Unitless" IHU
 SG_ VFCVectorSRSVFCid0 : 162|1@0+ (1,0) [0|1] "" IHU
 SG_ VFCVectorSRSVFCid1 : 163|1@0+ (1,0) [0|1] "" IHU
 SG_ VFCVectorSRSVFCid10 : 172|1@0+ (1,0) [0|1] "" IHU
 SG_ VFCVectorSRSVFCid11 : 173|1@0+ (1,0) [0|1] "" IHU
 SG_ VFCVectorSRSVFCid12 : 174|1@0+ (1,0) [0|1] "" IHU
 SG_ VFCVectorSRSVFCid13 : 175|1@0+ (1,0) [0|1] "" IHU
 SG_ VFCVectorSRSVFCid14 : 176|1@0+ (1,0) [0|1] "" IHU
 SG_ VFCVectorSRSVFCid15 : 177|1@0+ (1,0) [0|1] "" IHU
 SG_ VFCVectorSRSVFCid16 : 178|1@0+ (1,0) [0|1] "" IHU
 SG_ VFCVectorSRSVFCid17 : 179|1@0+ (1,0) [0|1] "" IHU
 SG_ VFCVectorSRSVFCid18 : 180|1@0+ (1,0) [0|1] "" IHU
 SG_ VFCVectorSRSVFCid19 : 181|1@0+ (1,0) [0|1] "" IHU
 SG_ VFCVectorSRSVFCid2 : 164|1@0+ (1,0) [0|1] "" IHU
 SG_ VFCVectorSRSVFCid20 : 182|1@0+ (1,0) [0|1] "" IHU
 SG_ VFCVectorSRSVFCid21 : 183|1@0+ (1,0) [0|1] "" IHU
 SG_ VFCVectorSRSVFCid22 : 184|1@0+ (1,0) [0|1] "" IHU
 SG_ VFCVectorSRSVFCid23 : 185|1@0+ (1,0) [0|1] "" IHU
 SG_ VFCVectorSRSVFCid24 : 186|1@0+ (1,0) [0|1] "" IHU
 SG_ VFCVectorSRSVFCid25 : 187|1@0+ (1,0) [0|1] "" IHU
 SG_ VFCVectorSRSVFCid26 : 188|1@0+ (1,0) [0|1] "" IHU
 SG_ VFCVectorSRSVFCid27 : 189|1@0+ (1,0) [0|1] "" IHU
 SG_ VFCVectorSRSVFCid28 : 190|1@0+ (1,0) [0|1] "" IHU
 SG_ VFCVectorSRSVFCid29 : 191|1@0+ (1,0) [0|1] "" IHU
 SG_ VFCVectorSRSVFCid3 : 165|1@0+ (1,0) [0|1] "" IHU
 SG_ VFCVectorSRSVFCid30 : 192|1@0+ (1,0) [0|1] "" IHU
 SG_ VFCVectorSRSVFCid31 : 193|1@0+ (1,0) [0|1] "" IHU
 SG_ VFCVectorSRSVFCid32 : 194|1@0+ (1,0) [0|1] "" IHU
 SG_ VFCVectorSRSVFCid33 : 195|1@0+ (1,0) [0|1] "" IHU
 SG_ VFCVectorSRSVFCid34 : 196|1@0+ (1,0) [0|1] "" IHU
 SG_ VFCVectorSRSVFCid35 : 197|1@0+ (1,0) [0|1] "" IHU
 SG_ VFCVectorSRSVFCid36 : 198|1@0+ (1,0) [0|1] "" IHU
 SG_ VFCVectorSRSVFCid37 : 199|1@0+ (1,0) [0|1] "" IHU
 SG_ VFCVectorSRSVFCid38 : 200|1@0+ (1,0) [0|1] "" IHU
 SG_ VFCVectorSRSVFCid39 : 201|1@0+ (1,0) [0|1] "" IHU
 SG_ VFCVectorSRSVFCid4 : 166|1@0+ (1,0) [0|1] "" IHU
 SG_ VFCVectorSRSVFCid40 : 202|1@0+ (1,0) [0|1] "" IHU
 SG_ VFCVectorSRSVFCid41 : 203|1@0+ (1,0) [0|1] "" IHU
 SG_ VFCVectorSRSVFCid42 : 204|1@0+ (1,0) [0|1] "" IHU
 SG_ VFCVectorSRSVFCid43 : 205|1@0+ (1,0) [0|1] "" IHU
 SG_ VFCVectorSRSVFCid44 : 206|1@0+ (1,0) [0|1] "" IHU
 SG_ VFCVectorSRSVFCid45 : 207|1@0+ (1,0) [0|1] "" IHU
 SG_ VFCVectorSRSVFCid46 : 208|1@0+ (1,0) [0|1] "" IHU
 SG_ VFCVectorSRSVFCid47 : 209|1@0+ (1,0) [0|1] "" IHU
 SG_ VFCVectorSRSVFCid48 : 210|1@0+ (1,0) [0|1] "" IHU
 SG_ VFCVectorSRSVFCid49 : 211|1@0+ (1,0) [0|1] "" IHU
 SG_ VFCVectorSRSVFCid5 : 167|1@0+ (1,0) [0|1] "" IHU
 SG_ VFCVectorSRSVFCid50 : 212|1@0+ (1,0) [0|1] "" IHU
 SG_ VFCVectorSRSVFCid51 : 213|1@0+ (1,0) [0|1] "" IHU
 SG_ VFCVectorSRSVFCid52 : 214|1@0+ (1,0) [0|1] "" IHU
 SG_ VFCVectorSRSVFCid53 : 215|1@0+ (1,0) [0|1] "" IHU
 SG_ VFCVectorSRSVFCid54 : 216|1@0+ (1,0) [0|1] "" IHU
 SG_ VFCVectorSRSVFCid55 : 217|1@0+ (1,0) [0|1] "" IHU
 SG_ VFCVectorSRSVFCid56 : 218|1@0+ (1,0) [0|1] "" IHU
 SG_ VFCVectorSRSVFCid57 : 219|1@0+ (1,0) [0|1] "" IHU
 SG_ VFCVectorSRSVFCid58 : 220|1@0+ (1,0) [0|1] "" IHU
 SG_ VFCVectorSRSVFCid59 : 221|1@0+ (1,0) [0|1] "" IHU
 SG_ VFCVectorSRSVFCid6 : 168|1@0+ (1,0) [0|1] "" IHU
 SG_ VFCVectorSRSVFCid60 : 222|1@0+ (1,0) [0|1] "" IHU
 SG_ VFCVectorSRSVFCid61 : 223|1@0+ (1,0) [0|1] "" IHU
 SG_ VFCVectorSRSVFCid7 : 169|1@0+ (1,0) [0|1] "" IHU
 SG_ VFCVectorSRSVFCid8 : 170|1@0+ (1,0) [0|1] "" IHU
 SG_ VFCVectorSRSVFCid9 : 171|1@0+ (1,0) [0|1] "" IHU
 SG_ VFCVectorSUM_UB : 15|1@0+ (1,0) [0|1] "" IHU
 SG_ VFCVectorSUMBlockID : 305|2@0+ (1.0,0.0) [0.0|3.0] "Unitless" IHU
 SG_ VFCVectorSUMVFCid0 : 306|1@0+ (1,0) [0|1] "" IHU
 SG_ VFCVectorSUMVFCid1 : 307|1@0+ (1,0) [0|1] "" IHU
 SG_ VFCVectorSUMVFCid10 : 316|1@0+ (1,0) [0|1] "" IHU
 SG_ VFCVectorSUMVFCid11 : 317|1@0+ (1,0) [0|1] "" IHU
 SG_ VFCVectorSUMVFCid12 : 318|1@0+ (1,0) [0|1] "" IHU
 SG_ VFCVectorSUMVFCid13 : 319|1@0+ (1,0) [0|1] "" IHU
 SG_ VFCVectorSUMVFCid14 : 320|1@0+ (1,0) [0|1] "" IHU
 SG_ VFCVectorSUMVFCid15 : 321|1@0+ (1,0) [0|1] "" IHU
 SG_ VFCVectorSUMVFCid16 : 322|1@0+ (1,0) [0|1] "" IHU
 SG_ VFCVectorSUMVFCid17 : 323|1@0+ (1,0) [0|1] "" IHU
 SG_ VFCVectorSUMVFCid18 : 324|1@0+ (1,0) [0|1] "" IHU
 SG_ VFCVectorSUMVFCid19 : 325|1@0+ (1,0) [0|1] "" IHU
 SG_ VFCVectorSUMVFCid2 : 308|1@0+ (1,0) [0|1] "" IHU
 SG_ VFCVectorSUMVFCid20 : 326|1@0+ (1,0) [0|1] "" IHU
 SG_ VFCVectorSUMVFCid21 : 327|1@0+ (1,0) [0|1] "" IHU
 SG_ VFCVectorSUMVFCid22 : 328|1@0+ (1,0) [0|1] "" IHU
 SG_ VFCVectorSUMVFCid23 : 329|1@0+ (1,0) [0|1] "" IHU
 SG_ VFCVectorSUMVFCid24 : 330|1@0+ (1,0) [0|1] "" IHU
 SG_ VFCVectorSUMVFCid25 : 331|1@0+ (1,0) [0|1] "" IHU
 SG_ VFCVectorSUMVFCid26 : 332|1@0+ (1,0) [0|1] "" IHU
 SG_ VFCVectorSUMVFCid27 : 333|1@0+ (1,0) [0|1] "" IHU
 SG_ VFCVectorSUMVFCid28 : 334|1@0+ (1,0) [0|1] "" IHU
 SG_ VFCVectorSUMVFCid29 : 335|1@0+ (1,0) [0|1] "" IHU
 SG_ VFCVectorSUMVFCid3 : 309|1@0+ (1,0) [0|1] "" IHU
 SG_ VFCVectorSUMVFCid30 : 336|1@0+ (1,0) [0|1] "" IHU
 SG_ VFCVectorSUMVFCid31 : 337|1@0+ (1,0) [0|1] "" IHU
 SG_ VFCVectorSUMVFCid32 : 338|1@0+ (1,0) [0|1] "" IHU
 SG_ VFCVectorSUMVFCid33 : 339|1@0+ (1,0) [0|1] "" IHU
 SG_ VFCVectorSUMVFCid34 : 340|1@0+ (1,0) [0|1] "" IHU
 SG_ VFCVectorSUMVFCid35 : 341|1@0+ (1,0) [0|1] "" IHU
 SG_ VFCVectorSUMVFCid36 : 342|1@0+ (1,0) [0|1] "" IHU
 SG_ VFCVectorSUMVFCid37 : 343|1@0+ (1,0) [0|1] "" IHU
 SG_ VFCVectorSUMVFCid38 : 344|1@0+ (1,0) [0|1] "" IHU
 SG_ VFCVectorSUMVFCid39 : 345|1@0+ (1,0) [0|1] "" IHU
 SG_ VFCVectorSUMVFCid4 : 310|1@0+ (1,0) [0|1] "" IHU
 SG_ VFCVectorSUMVFCid40 : 346|1@0+ (1,0) [0|1] "" IHU
 SG_ VFCVectorSUMVFCid41 : 347|1@0+ (1,0) [0|1] "" IHU
 SG_ VFCVectorSUMVFCid42 : 348|1@0+ (1,0) [0|1] "" IHU
 SG_ VFCVectorSUMVFCid43 : 349|1@0+ (1,0) [0|1] "" IHU
 SG_ VFCVectorSUMVFCid44 : 350|1@0+ (1,0) [0|1] "" IHU
 SG_ VFCVectorSUMVFCid45 : 351|1@0+ (1,0) [0|1] "" IHU
 SG_ VFCVectorSUMVFCid46 : 352|1@0+ (1,0) [0|1] "" IHU
 SG_ VFCVectorSUMVFCid47 : 353|1@0+ (1,0) [0|1] "" IHU
 SG_ VFCVectorSUMVFCid48 : 354|1@0+ (1,0) [0|1] "" IHU
 SG_ VFCVectorSUMVFCid49 : 355|1@0+ (1,0) [0|1] "" IHU
 SG_ VFCVectorSUMVFCid5 : 311|1@0+ (1,0) [0|1] "" IHU
 SG_ VFCVectorSUMVFCid50 : 356|1@0+ (1,0) [0|1] "" IHU
 SG_ VFCVectorSUMVFCid51 : 357|1@0+ (1,0) [0|1] "" IHU
 SG_ VFCVectorSUMVFCid52 : 358|1@0+ (1,0) [0|1] "" IHU
 SG_ VFCVectorSUMVFCid53 : 359|1@0+ (1,0) [0|1] "" IHU
 SG_ VFCVectorSUMVFCid54 : 360|1@0+ (1,0) [0|1] "" IHU
 SG_ VFCVectorSUMVFCid55 : 361|1@0+ (1,0) [0|1] "" IHU
 SG_ VFCVectorSUMVFCid56 : 362|1@0+ (1,0) [0|1] "" IHU
 SG_ VFCVectorSUMVFCid57 : 363|1@0+ (1,0) [0|1] "" IHU
 SG_ VFCVectorSUMVFCid58 : 364|1@0+ (1,0) [0|1] "" IHU
 SG_ VFCVectorSUMVFCid59 : 365|1@0+ (1,0) [0|1] "" IHU
 SG_ VFCVectorSUMVFCid6 : 312|1@0+ (1,0) [0|1] "" IHU
 SG_ VFCVectorSUMVFCid60 : 366|1@0+ (1,0) [0|1] "" IHU
 SG_ VFCVectorSUMVFCid61 : 367|1@0+ (1,0) [0|1] "" IHU
 SG_ VFCVectorSUMVFCid7 : 313|1@0+ (1,0) [0|1] "" IHU
 SG_ VFCVectorSUMVFCid8 : 314|1@0+ (1,0) [0|1] "" IHU
 SG_ VFCVectorSUMVFCid9 : 315|1@0+ (1,0) [0|1] "" IHU

BO_ 264 ZCUDZCUCANFD2Fr17 : 64 ZCUD
 SG_ AdjSpdLimnActvnOk : 86|1@0+ (1,0) [0|1] "" IHU
 SG_ AdjSpdLimnActvnOk_UB : 85|1@0+ (1,0) [0|1] "" IHU
 SG_ AdjSpdLimnMsg : 84|2@0+ (1,0) [0|3] "" IHU
 SG_ AdjSpdLimnMsg_UB : 103|1@0+ (1,0) [0|1] "" IHU
 SG_ AdjSpdLimnStbOk : 102|1@0+ (1,0) [0|1] "" IHU
 SG_ AdjSpdLimnStbOk_UB : 101|1@0+ (1,0) [0|1] "" IHU
 SG_ AdjSpdLimnSts : 100|3@0+ (1,0) [0|7] "" IHU
 SG_ AdjSpdLimnSts_UB : 97|1@0+ (1,0) [0|1] "" IHU
 SG_ ChdPrtnLeftSwReq : 151|1@0+ (1,0) [0|1] "" IHU
 SG_ ChdPrtnLeftSwReq_UB : 150|1@0+ (1,0) [0|1] "" IHU
 SG_ ChdPrtnRightSwReq : 149|1@0+ (1,0) [0|1] "" IHU
 SG_ ChdPrtnRightSwReq_UB : 148|1@0+ (1,0) [0|1] "" IHU
 SG_ DispBattEgyIn : 39|8@0+ (0.5,0.0) [0.0|127.5] "Wh" IHU
 SG_ DispBattEgyIn_UB : 55|1@0+ (1,0) [0|1] "" IHU
 SG_ DispBattEgyOut : 47|8@0+ (0.5,0.0) [0.0|127.5] "Wh" IHU
 SG_ DispBattEgyOut_UB : 54|1@0+ (1,0) [0|1] "" IHU
 SG_ DoorLeOpenWarnReq : 215|1@0+ (1,0) [0|1] "" IHU,ZCUP
 SG_ DoorLeOpenWarnReq_UB : 214|1@0+ (1,0) [0|1] "" IHU,ZCUP
 SG_ DoorRiOpenWarnReq : 213|1@0+ (1,0) [0|1] "" IHU,ZCUP
 SG_ DoorRiOpenWarnReq_UB : 212|1@0+ (1,0) [0|1] "" IHU,ZCUP
 SG_ DrvrSeatSnsrSts : 79|2@0+ (1,0) [0|3] "" IHU,ZCUP
 SG_ DrvrSeatSnsrSts_UB : 77|1@0+ (1,0) [0|1] "" IHU,ZCUP
 SG_ DrvrSeatSwtCushExtSts : 211|2@0+ (1,0) [0|3] "" IHU
 SG_ DrvrSeatSwtCushExtSts_UB : 209|1@0+ (1,0) [0|1] "" IHU
 SG_ ElecMot2ActvDampgModReq : 185|2@0+ (1,0) [0|3] "" IHU
 SG_ ElecMot2ActvDampgModReq_UB : 186|1@0+ (1,0) [0|1] "" IHU
 SG_ ElecMot2ModSts : 191|4@0+ (1,0) [0|15] "" IHU
 SG_ ElecMot2ModSts_UB : 187|1@0+ (1,0) [0|1] "" IHU
 SG_ EngSpdDispd : 7|15@0+ (0.5,0.0) [0.0|16383.5] "rpm" IHU
 SG_ EngSpdDispd_UB : 8|1@0+ (1,0) [0|1] "" IHU
 SG_ EngSpdMaxDispd : 23|15@0+ (0.5,0.0) [0.0|16383.5] "rpm" IHU
 SG_ EngSpdMaxDispd_UB : 24|1@0+ (1,0) [0|1] "" IHU
 SG_ EngTqIntvReqFast : 218|11@0+ (1.0,-1024.0) [-1024.0|1023.0] "NewtonMeter" IHU
 SG_ EngTqIntvReqFast_UB : 219|1@0+ (1,0) [0|1] "" IHU
 SG_ FrntSeatCmftCtrlReSeatLe : 76|2@0+ (1,0) [0|3] "" IHU,ZCUP
 SG_ FrntSeatCmftCtrlReSeatLe_UB : 74|1@0+ (1,0) [0|1] "" IHU,ZCUP
 SG_ FrntSeatCmftCtrlReSeatRi : 73|2@0+ (1,0) [0|3] "" IHU,ZCUP
 SG_ FrntSeatCmftCtrlReSeatRi_UB : 87|1@0+ (1,0) [0|1] "" IHU,ZCUP
 SG_ GearMovmtFlg : 111|2@0+ (1,0) [0|3] "" IHU
 SG_ GearMovmtFlg_UB : 96|1@0+ (1,0) [0|1] "" IHU
 SG_ LimSts : 109|2@0+ (1,0) [0|3] "" IHU
 SG_ LimSts_UB : 131|1@0+ (1,0) [0|1] "" IHU
 SG_ LowrTailgAntiPnch : 355|1@0+ (1,0) [0|1] "" IHU
 SG_ LowrTailgAntiPnch_UB : 354|1@0+ (1,0) [0|1] "" IHU
 SG_ LowrTailgObstclDetn : 353|1@0+ (1,0) [0|1] "" IHU
 SG_ LowrTailgObstclDetn_UB : 352|1@0+ (1,0) [0|1] "" IHU
 SG_ LowrTailgOpenerSts : 375|4@0+ (1,0) [0|15] "" IHU
 SG_ LowrTailgOpenerSts_UB : 371|1@0+ (1,0) [0|1] "" IHU
 SG_ LowrTailgOpenPosn : 367|7@0+ (1.0,0.0) [0.0|101.0] "%" IHU
 SG_ LowrTailgOpenPosn_UB : 360|1@0+ (1,0) [0|1] "" IHU
 SG_ MirrAdjVceAtPassCmd : 383|3@0+ (1,0) [0|7] "" ZCUP
 SG_ MirrAdjVceAtPassCmd_UB : 380|1@0+ (1,0) [0|1] "" ZCUP
 SG_ MirrAtDrvrForVce : 379|3@0+ (1,0) [0|7] "" IHU
 SG_ MirrAtDrvrForVce_UB : 376|1@0+ (1,0) [0|1] "" IHU
 SG_ MotDynCtrlStsReLe_UB : 221|1@0+ (1,0) [0|1] "" IHU
 SG_ MotDynCtrlStsReLeChks : 279|8@0+ (1.0,0.0) [0.0|255.0] "Unitless" IHU
 SG_ MotDynCtrlStsReLeCntr : 267|4@0+ (1.0,0.0) [0.0|15.0] "Unitless" IHU
 SG_ MotDynCtrlStsReLeDmcActAppTarTq : 239|16@0- (1.0,0.0) [-30000.0|30000.0] "NewtonMeter" IHU
 SG_ MotDynCtrlStsReLeDmcSts : 271|4@0+ (1,0) [0|15] "" IHU
 SG_ MotDynCtrlStsReLeDmcSWInfo : 255|16@0+ (1.0,0.0) [0.0|65535.0] "Unitless" IHU
 SG_ MotDynCtrlStsReRi_UB : 220|1@0+ (1,0) [0|1] "" IHU
 SG_ MotDynCtrlStsReRiChks : 327|8@0+ (1.0,0.0) [0.0|255.0] "Unitless" IHU
 SG_ MotDynCtrlStsReRiCntr : 315|4@0+ (1.0,0.0) [0.0|15.0] "Unitless" IHU
 SG_ MotDynCtrlStsReRiDmcActAppTarTq : 287|16@0- (1.0,0.0) [-30000.0|30000.0] "NewtonMeter" IHU
 SG_ MotDynCtrlStsReRiDmcSts : 319|4@0+ (1,0) [0|15] "" IHU
 SG_ MotDynCtrlStsReRiDmcSWInfo : 303|16@0+ (1.0,0.0) [0.0|65535.0] "Unitless" IHU
 SG_ PtCluTqReq : 338|11@0+ (1.0,-1024.0) [-1024.0|1023.0] "NewtonMeter" IHU
 SG_ PtCluTqReq_UB : 359|1@0+ (1,0) [0|1] "" IHU
 SG_ PtVehSpdMax_UB : 130|1@0+ (1,0) [0|1] "" IHU
 SG_ PtVehSpdMaxChks : 119|8@0+ (1.0,0.0) [0.0|255.0] "Unitless" IHU
 SG_ PtVehSpdMaxCntr : 135|4@0+ (1.0,0.0) [0.0|15.0] "Unitless" IHU
 SG_ PtVehSpdMaxReq : 127|8@0+ (0.4,0.0) [0.0|102.0] "m/s" IHU
 SG_ RoadSgnInfoSts : 106|3@0+ (1,0) [0|7] "" IHU
 SG_ RoadSgnInfoSts_UB : 107|1@0+ (1,0) [0|1] "" IHU
 SG_ RowSecLeFldRsdSts : 391|3@0+ (1,0) [0|7] "" IHU
 SG_ RowSecLeFldRsdSts_UB : 388|1@0+ (1,0) [0|1] "" IHU
 SG_ RowSecLeFldRsdWarn : 387|1@0+ (1,0) [0|1] "" IHU
 SG_ RowSecLeFldRsdWarn_UB : 386|1@0+ (1,0) [0|1] "" IHU
 SG_ RowSecLeMassgRunng : 71|1@0+ (1,0) [0|1] "" IHU
 SG_ RowSecLeMassgRunng_UB : 70|1@0+ (1,0) [0|1] "" IHU
 SG_ RowSecLeSeatActvSpplFct : 59|3@0+ (1,0) [0|7] "" IHU
 SG_ RowSecLeSeatActvSpplFct_UB : 56|1@0+ (1,0) [0|1] "" IHU
 SG_ RowSecLeSeatRotRmn : 385|1@0+ (1,0) [0|1] "" IHU
 SG_ RowSecLeSeatRotRmn_UB : 384|1@0+ (1,0) [0|1] "" IHU
 SG_ RowSecRiFldRsdWarn : 399|1@0+ (1,0) [0|1] "" IHU
 SG_ RowSecRiFldRsdWarn_UB : 398|1@0+ (1,0) [0|1] "" IHU
 SG_ RowSecRiMassgRunng : 65|1@0+ (1,0) [0|1] "" IHU
 SG_ RowSecRiMassgRunng_UB : 64|1@0+ (1,0) [0|1] "" IHU
 SG_ RowSecRiSeatActvSpplFct : 69|3@0+ (1,0) [0|7] "" IHU
 SG_ RowSecRiSeatActvSpplFct_UB : 66|1@0+ (1,0) [0|1] "" IHU
 SG_ RowSecRiSeatRotRmn : 397|1@0+ (1,0) [0|1] "" IHU
 SG_ RowSecRiSeatRotRmn_UB : 396|1@0+ (1,0) [0|1] "" IHU
 SG_ SbWSyncStsH1_UB : 222|1@0+ (1,0) [0|1] "" IHU
 SG_ SbWSyncStsH1Chks : 335|8@0+ (1.0,0.0) [0.0|255.0] "Unitless" IHU
 SG_ SbWSyncStsH1Cntr : 343|4@0+ (1.0,0.0) [0.0|15.0] "Unitless" IHU
 SG_ SbWSyncStsH1HWASyncSts : 339|1@0+ (1,0) [0|1] "" IHU
 SG_ SeatMassgFctRowSecLe_UB : 415|1@0+ (1,0) [0|1] "" IHU
 SG_ SeatMassgFctRowSecLeMassgInten : 407|2@0+ (1,0) [0|3] "" IHU
 SG_ SeatMassgFctRowSecLeMassgProg : 395|3@0+ (1,0) [0|7] "" IHU
 SG_ SeatMassgFctRowSecLeOnOff : 392|1@0+ (1,0) [0|1] "" IHU
 SG_ SeatMassgFctRowSecRi_UB : 414|1@0+ (1,0) [0|1] "" IHU
 SG_ SeatMassgFctRowSecRiMassgInten : 405|2@0+ (1,0) [0|3] "" IHU
 SG_ SeatMassgFctRowSecRiMassgProg : 403|3@0+ (1,0) [0|7] "" IHU
 SG_ SeatMassgFctRowSecRiOnOff : 400|1@0+ (1,0) [0|1] "" IHU
 SG_ SpdLimFirst : 143|8@0+ (1.0,0.0) [0.0|255.0] "Unitless" IHU
 SG_ SpdLimFirst_UB : 129|1@0+ (1,0) [0|1] "" IHU
 SG_ TCSCmprStrtFlt : 63|1@0+ (1,0) [0|1] "" IHU
 SG_ TCSCmprStrtFlt_UB : 48|1@0+ (1,0) [0|1] "" IHU
 SG_ TCSFltSts : 53|4@0+ (1.0,0.0) [0.0|15.0] "Unitless" IHU
 SG_ TCSFltSts_UB : 49|1@0+ (1,0) [0|1] "" IHU
 SG_ TCSModSwtSts : 62|2@0+ (1,0) [0|3] "" IHU
 SG_ TCSModSwtSts_UB : 60|1@0+ (1,0) [0|1] "" IHU
 SG_ TrlrPrmntPwrActv : 208|1@0+ (1,0) [0|1] "" IHU
 SG_ TrlrPrmntPwrActv_UB : 223|1@0+ (1,0) [0|1] "" IHU
 SG_ TrOpenerByFootOperSts : 203|1@0+ (1,0) [0|1] "" IHU
 SG_ TrOpenerByFootOperSts_UB : 202|1@0+ (1,0) [0|1] "" IHU
 SG_ TrsmCluTqCpMaxOfClu0 : 199|11@0+ (1.0,-1024.0) [-1024.0|1023.0] "NewtonMeter" IHU
 SG_ TrsmCluTqCpMaxOfClu0_UB : 204|1@0+ (1,0) [0|1] "" IHU
 SG_ TrsmReqForPfmncRedn3 : 200|1@0+ (1,0) [0|1] "" IHU
 SG_ TrsmReqForPfmncRedn3_UB : 201|1@0+ (1,0) [0|1] "" IHU
 SG_ TrsmWhlProtnMaxTq : 159|16@0- (1.0,0.0) [-20000.0|20000.0] "NewtonMeter" IHU
 SG_ TrsmWhlProtnMaxTq_UB : 145|1@0+ (1,0) [0|1] "" IHU
 SG_ TrsmWhlProtnMinTq : 175|16@0- (1.0,0.0) [-20000.0|20000.0] "NewtonMeter" IHU
 SG_ TrsmWhlProtnMinTq_UB : 144|1@0+ (1,0) [0|1] "" IHU
 SG_ UpprLowrTailgCtrlInhbFb : 357|2@0+ (1.0,0.0) [0.0|3.0] "Unitless" IHU
 SG_ UpprLowrTailgCtrlInhbFb_UB : 358|1@0+ (1,0) [0|1] "" IHU

BO_ 67 ZCUDZCUCANFD2Fr18 : 64 ZCUD
 SG_ BookTrvlFltSts : 7|1@0+ (1,0) [0|1] "" IHU
 SG_ BookTrvlFltSts_UB : 6|1@0+ (1,0) [0|1] "" IHU
 SG_ BookTrvlSetResponse : 5|2@0+ (1,0) [0|3] "" IHU
 SG_ BookTrvlSetResponse_UB : 3|1@0+ (1,0) [0|1] "" IHU
 SG_ BookTrvlTiSetReq_UB : 19|1@0+ (1,0) [0|1] "" IHU
 SG_ BookTrvlTiSetReqBookTrvlChrgnTi : 15|11@0+ (1.0,0.0) [0.0|2047.0] "Mins" IHU
 SG_ BookTrvlTiSetReqBookTrvlTiSetReq : 20|1@0+ (1,0) [0|1] "" IHU
 SG_ CrashSts2 : 1|2@0+ (1,0) [0|3] "" IHU
 SG_ CrashSts2_UB : 2|1@0+ (1,0) [0|1] "" IHU
 SG_ DchaStopByTarDrvrIndcn : 18|1@0+ (1,0) [0|1] "" IHU
 SG_ DchaStopByTarDrvrIndcn_UB : 17|1@0+ (1,0) [0|1] "" IHU
 SG_ PrpsnDataEvtA_UB : 359|1@0+ (1,0) [0|1] "" IHU
 SG_ PrpsnDataEvtACnt : 358|7@0+ (1.0,0.0) [0.0|127.0] "Unitless" IHU
 SG_ PrpsnDataEvtAData1 : 367|8@0+ (1.0,0.0) [0.0|255.0] "Unitless" IHU
 SG_ PrpsnDataEvtAData2 : 375|8@0+ (1.0,0.0) [0.0|255.0] "Unitless" IHU
 SG_ PrpsnDataEvtAData3 : 383|8@0+ (1.0,0.0) [0.0|255.0] "Unitless" IHU
 SG_ PrpsnDataEvtAData4 : 391|8@0+ (1.0,0.0) [0.0|255.0] "Unitless" IHU
 SG_ PrpsnDataEvtAData5 : 399|8@0+ (1.0,0.0) [0.0|255.0] "Unitless" IHU
 SG_ PrpsnDataEvtAData6 : 407|8@0+ (1.0,0.0) [0.0|255.0] "Unitless" IHU
 SG_ PrpsnDataEvtAID : 415|8@0+ (1.0,0.0) [0.0|255.0] "Unitless" IHU
 SG_ PrpsnDataEvtB_UB : 423|1@0+ (1,0) [0|1] "" IHU
 SG_ PrpsnDataEvtBCnt : 422|7@0+ (1.0,0.0) [0.0|127.0] "Unitless" IHU
 SG_ PrpsnDataEvtBData1 : 431|8@0+ (1.0,0.0) [0.0|255.0] "Unitless" IHU
 SG_ PrpsnDataEvtBData2 : 439|8@0+ (1.0,0.0) [0.0|255.0] "Unitless" IHU
 SG_ PrpsnDataEvtBData3 : 447|8@0+ (1.0,0.0) [0.0|255.0] "Unitless" IHU
 SG_ PrpsnDataEvtBData4 : 455|8@0+ (1.0,0.0) [0.0|255.0] "Unitless" IHU
 SG_ PrpsnDataEvtBData5 : 463|8@0+ (1.0,0.0) [0.0|255.0] "Unitless" IHU
 SG_ PrpsnDataEvtBData6 : 471|8@0+ (1.0,0.0) [0.0|255.0] "Unitless" IHU
 SG_ PrpsnDataEvtBID : 479|8@0+ (1.0,0.0) [0.0|255.0] "Unitless" IHU

BO_ 1161 ZCUDZCUCANFD2Fr19 : 64 ZCUD
 SG_ DmcStsFrntToEsc_UB : 97|1@0+ (1,0) [0|1] "" IHU
 SG_ DmcStsFrntToEscChks : 143|8@0+ (1.0,0.0) [0.0|255.0] "Unitless" IHU
 SG_ DmcStsFrntToEscCntr : 151|4@0+ (1.0,0.0) [0.0|15.0] "Unitless" IHU
 SG_ DmcStsFrntToEscDmcActAppTarTq : 159|16@0- (1.0,0.0) [-30000.0|30000.0] "NewtonMeter" IHU
 SG_ DmcStsFrntToEscDmcSts : 147|4@0+ (1,0) [0|15] "" IHU
 SG_ DmcStsFrntToEscDmcSWInfo : 175|16@0+ (1.0,0.0) [0.0|65535.0] "Unitless" IHU
 SG_ DrvrSteerActv_UB : 209|1@0+ (1,0) [0|1] "" IHU
 SG_ DrvrSteerActvChks : 223|8@0+ (1.0,0.0) [0.0|255.0] "Unitless" IHU
 SG_ DrvrSteerActvCntr : 231|4@0+ (1.0,0.0) [0.0|15.0] "Unitless" IHU
 SG_ DrvrSteerActvDrvrSteerActv : 208|1@0+ (1,0) [0|1] "" IHU
 SG_ ElecMot2IDc : 247|14@0+ (0.1,-818.8) [-818.8|819.2] "A" IHU
 SG_ ElecMot2IDc_UB : 79|1@0+ (1,0) [0|1] "" IHU
 SG_ EngN2 : 263|15@0+ (0.5,0.0) [0.0|16383.5] "rpm" IHU
 SG_ EngN2_UB : 78|1@0+ (1,0) [0|1] "" IHU
 SG_ EpbAvlSec_UB : 484|1@0+ (1,0) [0|1] "" IHU
 SG_ EpbAvlSecChks : 495|8@0+ (1.0,0.0) [0.0|255.0] "Unitless" IHU
 SG_ EpbAvlSecCntr : 483|4@0+ (1.0,0.0) [0.0|15.0] "Unitless" IHU
 SG_ EpbAvlSecCommunicationAvailable : 503|1@0+ (1,0) [0|1] "" IHU
 SG_ EpbAvlSecHostAvailabilityFull : 502|1@0+ (1,0) [0|1] "" IHU
 SG_ EpbAvlSecHostAvailabilityRelOnly : 501|1@0+ (1,0) [0|1] "" IHU
 SG_ EpbAvlSecReserved1 : 500|1@0+ (1,0) [0|1] "" IHU
 SG_ EpbAvlSecReserved2 : 499|1@0+ (1,0) [0|1] "" IHU
 SG_ EpbAvlSecReserved3 : 498|1@0+ (1,0) [0|1] "" IHU
 SG_ EpbAvlSecReserved4 : 497|1@0+ (1,0) [0|1] "" IHU
 SG_ EpbAvlSecReserved5 : 496|1@0+ (1,0) [0|1] "" IHU
 SG_ EpbAvlSecReserved6 : 511|1@0+ (1,0) [0|1] "" IHU
 SG_ EpbAvlSecReserved7 : 510|1@0+ (1,0) [0|1] "" IHU
 SG_ IsgErrIndcnReq : 11|1@0+ (1,0) [0|1] "" IHU
 SG_ IsgErrIndcnReq_UB : 10|1@0+ (1,0) [0|1] "" IHU
 SG_ IsgLimnIndcn : 63|16@0+ (1.0,0.0) [0.0|65535.0] "Unitless" IHU
 SG_ IsgLimnIndcn_UB : 48|1@0+ (1,0) [0|1] "" IHU
 SG_ IsgSpdActSgnSafe_UB : 472|1@0+ (1,0) [0|1] "" IHU
 SG_ IsgSpdActSgnSafeChks : 207|8@0+ (1.0,0.0) [0.0|255.0] "Unitless" IHU
 SG_ IsgSpdActSgnSafeCntr : 215|4@0+ (1.0,0.0) [0.0|15.0] "Unitless" IHU
 SG_ IsgSpdActSgnSafeIsgSpdActSgn800 : 191|16@0+ (1.0,-20000.0) [-20000.0|45535.0] "rpm" IHU
 SG_ IsgSpdActSgnSafeQF : 211|2@0+ (1,0) [0|3] "" IHU
 SG_ IsgTqAvl_UB : 9|1@0+ (1,0) [0|1] "" IHU
 SG_ IsgTqAvlMax : 77|14@0+ (1.0,-8188.0) [-8188.0|8192.0] "NewtonMeter" IHU
 SG_ IsgTqAvlMin : 95|14@0+ (1.0,-8188.0) [-8188.0|8192.0] "NewtonMeter" IHU
 SG_ Mot1ReqSafe_UB : 249|1@0+ (1,0) [0|1] "" IHU
 SG_ Mot1ReqSafeChks : 279|8@0+ (1.0,0.0) [0.0|255.0] "Unitless" IHU
 SG_ Mot1ReqSafeCntr : 287|4@0+ (1.0,0.0) [0.0|15.0] "Unitless" IHU
 SG_ Mot1ReqSafemod : 283|4@0+ (1,0) [0|15] "" IHU
 SG_ Mot1ReqSafeRsv : 327|4@0+ (1.0,0.0) [0.0|15.0] "Unitless" IHU
 SG_ Mot1ReqSafespd : 295|15@0- (1.0,0.0) [-16384.0|16383.0] "rpm" IHU
 SG_ Mot1ReqSafetq : 311|14@0+ (1.0,-8188.0) [-8188.0|8192.0] "NewtonMeter" IHU
 SG_ Mot3ReqSafe_UB : 248|1@0+ (1,0) [0|1] "" IHU
 SG_ Mot3ReqSafeChks : 335|8@0+ (1.0,0.0) [0.0|255.0] "Unitless" IHU
 SG_ Mot3ReqSafeCntr : 343|4@0+ (1.0,0.0) [0.0|15.0] "Unitless" IHU
 SG_ Mot3ReqSafemod : 339|4@0+ (1,0) [0|15] "" IHU
 SG_ Mot3ReqSafeRsv : 323|4@0+ (1.0,0.0) [0.0|15.0] "Unitless" IHU
 SG_ Mot3ReqSafespd : 351|15@0- (1.0,0.0) [-16384.0|16383.0] "rpm" IHU
 SG_ Mot3ReqSafetq : 367|14@0+ (1.0,-8188.0) [-8188.0|8192.0] "NewtonMeter" IHU
 SG_ PtClu0TqReq : 369|10@0+ (1.0,0.0) [0.0|1023.0] "Unitless" IHU
 SG_ PtClu0TqReq_UB : 227|1@0+ (1,0) [0|1] "" IHU
 SG_ PtCluTq_UB : 226|1@0+ (1,0) [0|1] "" IHU
 SG_ PtCluTq2Req : 391|11@0+ (1.0,-1024.0) [-1024.0|1023.0] "NewtonMeter" IHU
 SG_ PtCluTq2Req_UB : 225|1@0+ (1,0) [0|1] "" IHU
 SG_ PtCluTqDyn : 394|11@0+ (1.0,-1024.0) [-1024.0|1023.0] "NewtonMeter" IHU
 SG_ PtCluTqPtCluTq : 415|11@0+ (1.0,-1024.0) [-1024.0|1023.0] "NewtonMeter" IHU
 SG_ PtCluTqQly : 420|3@0+ (1,0) [0|7] "" IHU
 SG_ PtGearTarReq : 396|2@0+ (1,0) [0|3] "" IHU
 SG_ PtGearTarReq_UB : 224|1@0+ (1,0) [0|1] "" IHU
 SG_ PtParkReqToWhlsRe : 479|1@0+ (1,0) [0|1] "" IHU
 SG_ PtParkReqToWhlsRe_UB : 131|1@0+ (1,0) [0|1] "" IHU
 SG_ SteerExtFctSts_UB : 446|1@0+ (1,0) [0|1] "" IHU
 SG_ SteerExtFctStsChks : 431|8@0+ (1.0,0.0) [0.0|255.0] "Unitless" IHU
 SG_ SteerExtFctStsCntr : 439|4@0+ (1.0,0.0) [0.0|15.0] "Unitless" IHU
 SG_ SteerExtFctStsDrvrSteerOvrd : 417|1@0+ (1,0) [0|1] "" IHU
 SG_ SteerExtFctStsExtFctLowerLimActive : 416|1@0+ (1,0) [0|1] "" IHU
 SG_ SteerExtFctStsExtFctRateLimActive : 435|1@0+ (1,0) [0|1] "" IHU
 SG_ SteerExtFctStsExtFctUpperLimActive : 434|1@0+ (1,0) [0|1] "" IHU
 SG_ SteerExtFctStsExtSafeLimActive : 433|1@0+ (1,0) [0|1] "" IHU
 SG_ SteerExtFctStsLatAgReqNotInRange : 432|1@0+ (1,0) [0|1] "" IHU
 SG_ SteerExtFctStsLatCtrlReqNotInRange : 447|1@0+ (1,0) [0|1] "" IHU
 SG_ SteerLockSts_UB : 8|1@0+ (1,0) [0|1] "" IHU
 SG_ SteerLockStsBolt : 111|2@0+ (1,0) [0|3] "" IHU
 SG_ SteerLockStsFault : 109|2@0+ (1,0) [0|3] "" IHU
 SG_ SteerLockStsSafety : 107|2@0+ (1,0) [0|3] "" IHU
 SG_ SteerLockStsUnit : 105|2@0+ (1,0) [0|3] "" IHU
 SG_ SuspFailrSts_UB : 96|1@0+ (1,0) [0|1] "" IHU
 SG_ SuspFailrStsChks : 119|8@0+ (1.0,0.0) [0.0|255.0] "Unitless" IHU
 SG_ SuspFailrStsCntr : 127|4@0+ (1.0,0.0) [0.0|15.0] "Unitless" IHU
 SG_ SuspFailrStsSuspFailrSts : 123|3@0+ (1,0) [0|7] "" IHU
 SG_ SuspFailrStsTypQf : 135|2@0+ (1,0) [0|3] "" IHU
 SG_ TqAssAddl : 445|14@0- (0.00390625,0.0) [-30.0|30.0] "NewtonMeter" IHU
 SG_ TqAssAddl_UB : 128|1@0+ (1,0) [0|1] "" IHU
 SG_ TrlrModVMMFltSts : 130|1@0+ (1,0) [0|1] "" IHU
 SG_ TrlrModVMMFltSts_UB : 129|1@0+ (1,0) [0|1] "" IHU
 SG_ TrsmActrPosnSafeAux_UB : 464|1@0+ (1,0) [0|1] "" IHU
 SG_ TrsmActrPosnSafeAuxTrsmActrPosn : 467|3@0+ (1,0) [0|7] "" IHU
 SG_ TrsmActrPosnSafeAuxTrsmActrPosnChks : 463|8@0+ (1.0,0.0) [0.0|255.0] "Unitless" IHU
 SG_ TrsmActrPosnSafeAuxTrsmActrPosnCntr : 471|4@0+ (1.0,0.0) [0.0|15.0] "Unitless" IHU
 SG_ TrsmModNotAvlSts : 7|8@0+ (1.0,0.0) [0.0|255.0] "Unitless" IHU
 SG_ TrsmModNotAvlSts_UB : 14|1@0+ (1,0) [0|1] "" IHU
 SG_ TrsmNeutFailr : 15|1@0+ (1,0) [0|1] "" IHU
 SG_ TrsmNeutFailr_UB : 13|1@0+ (1,0) [0|1] "" IHU
 SG_ TrsmOilT : 23|8@0+ (1.0,-60.0) [-60.0|195.0] "degC" IHU
 SG_ TrsmOilT_UB : 12|1@0+ (1,0) [0|1] "" IHU
 SG_ TrsmTqLoss_UB : 49|1@0+ (1,0) [0|1] "" IHU
 SG_ TrsmTqLossChks : 31|8@0+ (1.0,0.0) [0.0|255.0] "Unitless" IHU
 SG_ TrsmTqLossCntr : 53|4@0+ (1.0,0.0) [0.0|15.0] "Unitless" IHU
 SG_ TrsmTqLossTrsmTqEff : 47|10@0+ (0.1,0.0) [0.0|100.0] "%" IHU
 SG_ TrsmTqLossTrsmTqLoss : 39|8@0+ (0.5,0.0) [0.0|127.0] "Unitless" IHU
 SG_ WrmUpCyc : 133|1@0+ (1,0) [0|1] "" IHU
 SG_ WrmUpCyc_UB : 132|1@0+ (1,0) [0|1] "" IHU

BO_ 1173 ZCUDZCUCANFD2Fr20 : 64 ZCUD
 SG_ BswRstAddress : 447|32@0+ (1.0,0.0) [0.0|4294967295.0] "Unitless" IHU
 SG_ BswRstAddress_UB : 439|1@0+ (1,0) [0|1] "" IHU
 SG_ BswRstReason : 19|3@0+ (1,0) [0|7] "" IHU
 SG_ BswRstReason_UB : 16|1@0+ (1,0) [0|1] "" IHU
 SG_ CarLoctrToExtrLiVisReq : 7|8@0+ (1,0) [0|255] "" IHU
 SG_ CarLoctrToExtrLiVisReq_UB : 15|1@0+ (1,0) [0|1] "" IHU
 SG_ DiagcSigSWM : 14|2@0+ (1,0) [0|3] "" IHU
 SG_ DiagcSigSWM_UB : 12|1@0+ (1,0) [0|1] "" IHU
 SG_ EnaOfflineMonitor : 9|1@0+ (1,0) [0|1] "" IHU
 SG_ EnaOfflineMonitor_UB : 8|1@0+ (1,0) [0|1] "" IHU
 SG_ EngLoadReqElec : 31|16@0- (1.0,0.0) [-32768.0|32767.0] "W" IHU
 SG_ EngLoadReqElec_UB : 11|1@0+ (1,0) [0|1] "" IHU
 SG_ EngNSafe_UB : 10|1@0+ (1,0) [0|1] "" ZCUP
 SG_ EngNSafeEngN : 71|15@0+ (0.5,0.0) [0.0|16383.5] "rpm" ZCUP
 SG_ EngNSafeEngNChks : 63|8@0+ (1.0,0.0) [0.0|255.0] "Unitless" ZCUP
 SG_ EngNSafeEngNCntr : 87|4@0+ (1.0,0.0) [0.0|15.0] "Unitless" ZCUP
 SG_ EngNSafeEngNGrdt : 47|16@0- (1.0,0.0) [-30000.0|32767.0] "RpmPerSec" ZCUP
 SG_ EngRunngReqByVehModMgr_UB : 83|1@0+ (1,0) [0|1] "" IHU
 SG_ EngRunngReqByVehModMgrChassie : 111|1@0+ (1,0) [0|1] "" IHU
 SG_ EngRunngReqByVehModMgrClimate : 110|1@0+ (1,0) [0|1] "" IHU
 SG_ EngRunngReqByVehModMgrElectricalSystem : 109|1@0+ (1,0) [0|1] "" IHU
 SG_ EngRunngReqByVehModMgrTrailerPrsnt : 108|1@0+ (1,0) [0|1] "" IHU
 SG_ EngSt1WdSts1 : 107|4@0+ (1,0) [0|15] "" IHU
 SG_ EngSt1WdSts1_UB : 124|1@0+ (1,0) [0|1] "" IHU
 SG_ FltOfBeamHiDrv : 23|1@0+ (1,0) [0|1] "" IHU
 SG_ FltOfBeamHiDrv_UB : 22|1@0+ (1,0) [0|1] "" IHU
 SG_ FltOfBeamLoDrv : 21|1@0+ (1,0) [0|1] "" IHU
 SG_ FltOfBeamLoDrv_UB : 20|1@0+ (1,0) [0|1] "" IHU
 SG_ FltOfCenHiMntdStopLamp : 287|1@0+ (1,0) [0|1] "" IHU
 SG_ FltOfCenHiMntdStopLamp_UB : 286|1@0+ (1,0) [0|1] "" IHU
 SG_ FltOfCenHiMntdStopLamp1 : 285|1@0+ (1,0) [0|1] "" IHU
 SG_ FltOfCenHiMntdStopLamp1_UB : 284|1@0+ (1,0) [0|1] "" IHU
 SG_ FltOfDaytiRunngLampDrv : 283|1@0+ (1,0) [0|1] "" IHU
 SG_ FltOfDaytiRunngLampDrv_UB : 282|1@0+ (1,0) [0|1] "" IHU
 SG_ FltOfFrntFogLampDrv : 281|1@0+ (1,0) [0|1] "" IHU
 SG_ FltOfFrntFogLampDrv_UB : 280|1@0+ (1,0) [0|1] "" IHU
 SG_ FltOfFrntPosnLampDrv : 295|1@0+ (1,0) [0|1] "" IHU
 SG_ FltOfFrntPosnLampDrv_UB : 294|1@0+ (1,0) [0|1] "" IHU
 SG_ FltOfRePosnLampDrv : 293|1@0+ (1,0) [0|1] "" IHU
 SG_ FltOfRePosnLampDrv_UB : 292|1@0+ (1,0) [0|1] "" IHU
 SG_ FltOfStopLampDrv : 291|1@0+ (1,0) [0|1] "" IHU
 SG_ FltOfStopLampDrv_UB : 290|1@0+ (1,0) [0|1] "" IHU
 SG_ FltOfStopLampPass : 289|1@0+ (1,0) [0|1] "" IHU
 SG_ FltOfStopLampPass_UB : 288|1@0+ (1,0) [0|1] "" IHU
 SG_ FrLeReadLiReq : 479|8@0+ (1.0,0.0) [0.0|100.0] "%" IHU
 SG_ FrLeReadLiReq_UB : 511|1@0+ (1,0) [0|1] "" IHU
 SG_ FrRiReadLiReq : 487|8@0+ (1.0,0.0) [0.0|100.0] "%" IHU
 SG_ FrRiReadLiReq_UB : 510|1@0+ (1,0) [0|1] "" IHU
 SG_ HornSwitchSts : 221|1@0+ (1,0) [0|1] "" IHU
 SG_ HornSwitchSts_UB : 220|1@0+ (1,0) [0|1] "" IHU
 SG_ HvActvForVehModReq : 147|1@0+ (1,0) [0|1] "" IHU
 SG_ HvActvForVehModReq_UB : 120|1@0+ (1,0) [0|1] "" IHU
 SG_ HvActvSts : 146|2@0+ (1,0) [0|3] "" IHU
 SG_ HvActvSts_UB : 144|1@0+ (1,0) [0|1] "" IHU
 SG_ HvCoolgPwrAllwd : 119|10@0+ (20.0,0.0) [0.0|20460.0] "W" IHU
 SG_ HvCoolgPwrAllwd_UB : 125|1@0+ (1,0) [0|1] "" IHU
 SG_ HvHeatgPwrAllwd : 143|10@0+ (20.0,0.0) [0.0|20460.0] "W" IHU
 SG_ HvHeatgPwrAllwd_UB : 149|1@0+ (1,0) [0|1] "" IHU
 SG_ HwRowFrstDrvrFrntHeiMotCtrl : 135|2@0+ (1,0) [0|3] "" IHU
 SG_ HwRowFrstDrvrFrntHeiMotCtrl_UB : 148|1@0+ (1,0) [0|1] "" IHU
 SG_ HwRowFrstDrvrHeiMotCtrl : 133|2@0+ (1,0) [0|3] "" IHU
 SG_ HwRowFrstDrvrHeiMotCtrl_UB : 123|1@0+ (1,0) [0|1] "" IHU
 SG_ HwRowFrstDrvrInclMotCtrl : 131|2@0+ (1,0) [0|3] "" IHU
 SG_ HwRowFrstDrvrInclMotCtrl_UB : 122|1@0+ (1,0) [0|1] "" IHU
 SG_ HwRowFrstDrvrSldMotCtrl : 129|2@0+ (1,0) [0|3] "" IHU
 SG_ HwRowFrstDrvrSldMotCtrl_UB : 121|1@0+ (1,0) [0|1] "" IHU
 SG_ IndicatorIntensityLvl : 95|8@0+ (1.0,0.0) [0.0|100.0] "%" IHU
 SG_ IndicatorIntensityLvl_UB : 80|1@0+ (1,0) [0|1] "" IHU
 SG_ IntLightTreadPlateSupply : 103|7@0+ (1.0,0.0) [0.0|100.0] "Unitless" IHU
 SG_ IntLightTreadPlateSupply_UB : 96|1@0+ (1,0) [0|1] "" IHU
 SG_ IntrBriStsFromIf : 507|4@0+ (1.0,0.0) [0.0|15.0] "Unitless" IHU
 SG_ IntrBriStsFromIf_UB : 437|1@0+ (1,0) [0|1] "" IHU
 SG_ IntrLiRoofAUTOIndication : 82|1@0+ (1,0) [0|1] "" IHU
 SG_ IntrLiRoofAUTOIndication_UB : 81|1@0+ (1,0) [0|1] "" IHU
 SG_ IntrMirrCmd_UB : 347|1@0+ (1,0) [0|1] "" IHU
 SG_ IntrMirrCmdDrvrSide : 335|1@0+ (1,0) [0|1] "" IHU
 SG_ IntrMirrCmdIntrMirrAsyFanCmpMag : 334|1@0+ (1,0) [0|1] "" IHU
 SG_ IntrMirrCmdIntrMirrDiagcRst : 333|1@0+ (1,0) [0|1] "" IHU
 SG_ IntrMirrCmdIntrMirrDimSnvty : 332|2@0+ (1,0) [0|3] "" IHU
 SG_ IntrMirrCmdIntrMirrEna : 330|1@0+ (1,0) [0|1] "" IHU
 SG_ IntrMirrCmdIntrMirrInhbDim : 329|1@0+ (1,0) [0|1] "" IHU
 SG_ IntrMirrCmdIntrMirrWindHeatrCmpMag : 328|1@0+ (1,0) [0|1] "" IHU
 SG_ LatCtrlModCfmd_UB : 216|1@0+ (1,0) [0|1] "" IHU
 SG_ LatCtrlModCfmdChks : 239|8@0+ (1.0,0.0) [0.0|255.0] "Unitless" IHU
 SG_ LatCtrlModCfmdCntr : 247|4@0+ (1.0,0.0) [0.0|15.0] "Unitless" IHU
 SG_ LatCtrlModCfmdLatCtrlMod : 243|4@0+ (1,0) [0|15] "" IHU
 SG_ MirrDefrstAtDrvrCmd : 346|1@0+ (1,0) [0|1] "" IHU
 SG_ MirrDefrstAtDrvrCmd_UB : 345|1@0+ (1,0) [0|1] "" IHU
 SG_ MirrSeldIndcn : 308|2@0+ (1,0) [0|3] "" IHU
 SG_ MirrSeldIndcn_UB : 310|1@0+ (1,0) [0|1] "" IHU
 SG_ PanicAlrmAcoustReq : 207|8@0+ (1,0) [0|255] "" IHU
 SG_ PanicAlrmAcoustReq_UB : 223|1@0+ (1,0) [0|1] "" IHU
 SG_ PanicAlrmToExtrLiVisReq : 215|8@0+ (1,0) [0|255] "" IHU
 SG_ PanicAlrmToExtrLiVisReq_UB : 222|1@0+ (1,0) [0|1] "" IHU
 SG_ PropsEnabfromAlcoLock : 219|1@0+ (1,0) [0|1] "" IHU
 SG_ PropsEnabfromAlcoLock_UB : 218|1@0+ (1,0) [0|1] "" IHU
 SG_ PtActvnReq1WdPtActvnReq : 273|2@0+ (1,0) [0|3] "" IHU
 SG_ PtActvnReq1WdPtActvnReq_UB : 309|1@0+ (1,0) [0|1] "" IHU
 SG_ PwrCnsVisy : 159|11@0+ (1.0,0.0) [0.0|2047.0] "W" IHU
 SG_ PwrCnsVisy_UB : 164|1@0+ (1,0) [0|1] "" IHU
 SG_ PwrCritDesVisy : 162|11@0+ (1.0,0.0) [0.0|2047.0] "W" IHU
 SG_ PwrCritDesVisy_UB : 163|1@0+ (1,0) [0|1] "" IHU
 SG_ PwrEstimdAtStbForVisy : 183|11@0+ (1.0,0.0) [0.0|2047.0] "W" IHU
 SG_ PwrEstimdAtStbForVisy_UB : 188|1@0+ (1,0) [0|1] "" IHU
 SG_ PwrNormDesVisy : 186|11@0+ (1.0,0.0) [0.0|2047.0] "W" IHU
 SG_ PwrNormDesVisy_UB : 187|1@0+ (1,0) [0|1] "" IHU
 SG_ RainSensActvn : 410|1@0+ (1,0) [0|1] "" IHU
 SG_ RainSensActvn_UB : 409|1@0+ (1,0) [0|1] "" IHU
 SG_ ReAdaptReq : 253|1@0+ (1,0) [0|1] "" IHU
 SG_ ReAdaptReq_UB : 252|1@0+ (1,0) [0|1] "" IHU
 SG_ RelHumSnsrErr : 303|1@0+ (1,0) [0|1] "" IHU
 SG_ RelHumSnsrErr_UB : 296|1@0+ (1,0) [0|1] "" IHU
 SG_ RemStrtMsgToDrvr_UB : 311|1@0+ (1,0) [0|1] "" IHU
 SG_ RemStrtMsgToDrvrRemStrtBlkd1 : 302|4@0+ (1,0) [0|15] "" IHU
 SG_ RemStrtMsgToDrvrRemStrtDev1 : 298|2@0+ (1,0) [0|3] "" IHU
 SG_ RlyActvnForRoofCurtClsAut : 368|1@0+ (1,0) [0|1] "" IHU
 SG_ RlyActvnForRoofCurtClsAut_UB : 376|1@0+ (1,0) [0|1] "" IHU
 SG_ SecRowLeReadLiReq : 495|8@0+ (1.0,0.0) [0.0|100.0] "%" IHU
 SG_ SecRowLeReadLiReq_UB : 509|1@0+ (1,0) [0|1] "" IHU
 SG_ SecRowRiReadLiReq : 503|8@0+ (1.0,0.0) [0.0|100.0] "%" IHU
 SG_ SecRowRiReadLiReq_UB : 508|1@0+ (1,0) [0|1] "" IHU
 SG_ SteerLockEnagOfPrpsn : 425|2@0+ (1,0) [0|3] "" IHU
 SG_ SteerLockEnagOfPrpsn_UB : 432|1@0+ (1,0) [0|1] "" IHU
 SG_ SteerWhlTqAddl : 319|14@0- (0.00390625,0.0) [-30.0|30.0] "NewtonMeter" IHU
 SG_ SteerWhlTqAddl_UB : 377|1@0+ (1,0) [0|1] "" IHU
 SG_ StsOfLedHiBeamLe : 306|2@0+ (1,0) [0|3] "" IHU
 SG_ StsOfLedHiBeamLe_UB : 304|1@0+ (1,0) [0|1] "" IHU
 SG_ StsOfLedHiBeamRi : 321|2@0+ (1,0) [0|3] "" IHU
 SG_ StsOfLedHiBeamRi_UB : 408|1@0+ (1,0) [0|1] "" IHU
 SG_ StsOfLedLoBeamLe : 343|2@0+ (1,0) [0|3] "" IHU
 SG_ StsOfLedLoBeamLe_UB : 417|1@0+ (1,0) [0|1] "" IHU
 SG_ StsOfLedLoBeamRi : 341|2@0+ (1,0) [0|3] "" IHU
 SG_ StsOfLedLoBeamRi_UB : 431|1@0+ (1,0) [0|1] "" IHU
 SG_ StsOfSwvlgLe : 339|2@0+ (1,0) [0|3] "" IHU
 SG_ StsOfSwvlgLe_UB : 429|1@0+ (1,0) [0|1] "" IHU
 SG_ StsOfSwvlgRi : 337|2@0+ (1,0) [0|3] "" IHU
 SG_ StsOfSwvlgRi_UB : 416|1@0+ (1,0) [0|1] "" IHU
 SG_ SunCurtEna : 353|2@0+ (1,0) [0|3] "" IHU
 SG_ SunCurtEna_UB : 354|1@0+ (1,0) [0|1] "" IHU
 SG_ SunRoofAndCurtExtCmd : 359|4@0+ (1,0) [0|15] "" IHU
 SG_ SunRoofAndCurtExtCmd_UB : 355|1@0+ (1,0) [0|1] "" IHU
 SG_ SwtBeamHi : 351|2@0+ (1,0) [0|3] "" IHU
 SG_ SwtBeamHi_UB : 430|1@0+ (1,0) [0|1] "" IHU
 SG_ SwtLiHzrdWarn : 349|1@0+ (1,0) [0|1] "" IHU
 SG_ SwtLiHzrdWarn_UB : 428|1@0+ (1,0) [0|1] "" IHU
 SG_ TankFlapReqFromSwtIntrFild : 348|1@0+ (1,0) [0|1] "" IHU
 SG_ TankFlapReqFromSwtIntrFild_UB : 427|1@0+ (1,0) [0|1] "" IHU
 SG_ TrOpenerReq_UB : 426|1@0+ (1,0) [0|1] "" IHU
 SG_ TrOpenerReqTrigSrc : 383|3@0+ (1,0) [0|7] "" IHU
 SG_ TrOpenerReqTrOpenerReq : 380|3@0+ (1,0) [0|7] "" IHU
 SG_ TrsmParkLockSt : 371|2@0+ (1,0) [0|3] "" IHU
 SG_ TrsmParkLockSt_UB : 438|1@0+ (1,0) [0|1] "" IHU
 SG_ TrsmTqRat : 367|12@0+ (0.01,0.0) [0.0|40.95] "Unitless" IHU
 SG_ TrsmTqRat_UB : 436|1@0+ (1,0) [0|1] "" IHU
 SG_ WiprActv : 344|1@0+ (1,0) [0|1] "" IHU
 SG_ WiprActv_UB : 435|1@0+ (1,0) [0|1] "" IHU
 SG_ WiprInWipgAr : 369|1@0+ (1,0) [0|1] "" IHU
 SG_ WiprInWipgAr_UB : 434|1@0+ (1,0) [0|1] "" IHU
 SG_ WiprMotFrntLvrCmdSafe_UB : 433|1@0+ (1,0) [0|1] "" IHU
 SG_ WiprMotFrntLvrCmdSafeLvrInHiSpdPosnSafe : 423|2@0+ (1,0) [0|3] "" IHU
 SG_ WiprMotFrntLvrCmdSafeLvrInIntlPosn : 421|1@0+ (1,0) [0|1] "" IHU
 SG_ WiprMotFrntLvrCmdSafeLvrInLoSpdPosnSafe : 420|2@0+ (1,0) [0|3] "" IHU
 SG_ WiprMotFrntLvrCmdSafeLvrInSnglStrokePos : 418|1@0+ (1,0) [0|1] "" IHU

BO_ 81 ZCUDZCUCANFD2Fr21 : 64 ZCUD
 SG_ ClsdDueToRain : 307|2@0+ (1,0) [0|3] "" IHU
 SG_ ClsdDueToRain_UB : 76|1@0+ (1,0) [0|1] "" IHU
 SG_ DKDataFromCEM_UB : 75|1@0+ (1,0) [0|1] "" IHU
 SG_ DKDataFromCEMAcknowledgment : 391|8@0+ (1.0,0.0) [0.0|255.0] "Unitless" IHU
 SG_ DKDataFromCEMDKDataByte1 : 399|8@0+ (1.0,0.0) [0.0|255.0] "Unitless" IHU
 SG_ DKDataFromCEMDKDataByte2 : 407|8@0+ (1.0,0.0) [0.0|255.0] "Unitless" IHU
 SG_ DKDataFromCEMDKDataByte3 : 415|8@0+ (1.0,0.0) [0.0|255.0] "Unitless" IHU
 SG_ DKDataFromCEMDKDataByte4 : 423|8@0+ (1.0,0.0) [0.0|255.0] "Unitless" IHU
 SG_ DKDataFromCEMDKDataByte5 : 431|8@0+ (1.0,0.0) [0.0|255.0] "Unitless" IHU
 SG_ DKDataFromCEMDKDataByte6 : 439|8@0+ (1.0,0.0) [0.0|255.0] "Unitless" IHU
 SG_ DKDataFromCEMHeader : 447|8@0+ (1.0,0.0) [0.0|255.0] "Unitless" IHU

BO_ 659 ZCUDZCUCANFD2Fr23 : 64 ZCUD
 SG_ AcCmprVlvICns : 191|8@0+ (0.05,0.0) [0.0|12.600000000000001] "A" IHU
 SG_ AcCmprVlvICns_UB : 180|1@0+ (1,0) [0|1] "" IHU
 SG_ AlrmTrsnMode : 136|1@0+ (1,0) [0|1] "" IHU
 SG_ AlrmTrsnMode_UB : 151|1@0+ (1,0) [0|1] "" IHU
 SG_ DiagFrameForECM_UB : 174|1@0+ (1,0) [0|1] "" IHU,ZCUP
 SG_ DiagFrameForECMByte0 : 263|8@0+ (1.0,0.0) [0.0|255.0] "Unitless" IHU,ZCUP
 SG_ DiagFrameForECMByte1 : 271|8@0+ (1.0,0.0) [0.0|255.0] "Unitless" IHU,ZCUP
 SG_ DiagFrameForECMByte2 : 279|8@0+ (1.0,0.0) [0.0|255.0] "Unitless" IHU,ZCUP
 SG_ DiagFrameForECMByte3 : 287|8@0+ (1.0,0.0) [0.0|255.0] "Unitless" IHU,ZCUP
 SG_ DiagFrameForECMByte4 : 295|8@0+ (1.0,0.0) [0.0|255.0] "Unitless" IHU,ZCUP
 SG_ DiagFrameForECMByte5 : 303|8@0+ (1.0,0.0) [0.0|255.0] "Unitless" IHU,ZCUP
 SG_ DiagFrameForECMByte6 : 311|8@0+ (1.0,0.0) [0.0|255.0] "Unitless" IHU,ZCUP
 SG_ DiagFrameForECMByte7 : 319|8@0+ (1.0,0.0) [0.0|255.0] "Unitless" IHU,ZCUP
 SG_ DstEstimdToEmptyForDrvgElecPred : 327|10@0+ (1.0,0.0) [0.0|1023.0] "KiloMtr" IHU
 SG_ DstEstimdToEmptyForDrvgElecPred_UB : 181|1@0+ (1,0) [0|1] "" IHU
 SG_ EngAmbTCalcd : 400|9@0+ (0.5,-60.0) [-60.0|195.5] "Unitless" IHU
 SG_ EngAmbTCalcd_UB : 401|1@0+ (1,0) [0|1] "" IHU
 SG_ HeatrPmpIAct : 351|8@0+ (0.2,0.0) [0.0|50.800000000000004] "A" IHU
 SG_ HeatrPmpIAct_UB : 333|1@0+ (1,0) [0|1] "" IHU
 SG_ HeatrPmpPwrCns : 331|12@0+ (1.0,0.0) [0.0|4095.0] "W" IHU
 SG_ HeatrPmpPwrCns_UB : 332|1@0+ (1,0) [0|1] "" IHU
 SG_ HeatrPmpUAct : 359|8@0+ (0.1,0.0) [0.0|25.0] "Volt" IHU
 SG_ HeatrPmpUAct_UB : 219|1@0+ (1,0) [0|1] "" IHU
 SG_ HvBattPmpPwrCns : 199|12@0+ (1.0,0.0) [0.0|4095.0] "W" IHU
 SG_ HvBattPmpPwrCns_UB : 160|1@0+ (1,0) [0|1] "" IHU
 SG_ HvBattThermInfoCorrInFuture_UB : 218|1@0+ (1,0) [0|1] "" IHU
 SG_ HvBattThermInfoCorrInFuturePwrAtTime : 367|16@0+ (50.0,-25000.0) [-25000.0|25000.0] "W" IHU
 SG_ HvBattThermInfoCorrInFutureSequenceNo : 383|5@0+ (1.0,0.0) [0.0|31.0] "Unitless" IHU
 SG_ HvBattThermInfoCorrInFutureTempAtTime : 391|8@0+ (1.0,-50.0) [-50.0|205.0] "degC" IHU
 SG_ HvBattThermInfoCorrInFutureThermModAtTime : 378|3@0+ (1,0) [0|7] "" IHU
 SG_ HvBattThermInfoCorrInFutureTime : 399|8@0+ (1.0,0.0) [0.0|255.0] "Unitless" IHU
 SG_ HvBattThermInfoCorrInFutureVersionNo : 407|3@0+ (1.0,0.0) [0.0|7.0] "Unitless" IHU
 SG_ HvWtrHeatrWtrTDes : 215|8@0+ (1.0,-40.0) [-40.0|215.0] "degC" IHU
 SG_ HvWtrHeatrWtrTDes_UB : 161|1@0+ (1,0) [0|1] "" IHU
 SG_ IsgCooltFlowMinReq2 : 247|10@0+ (0.02,0.0) [0.0|20.46] "L / min" IHU
 SG_ IsgCooltFlowMinReq2_UB : 153|1@0+ (1,0) [0|1] "" IHU
 SG_ IsgHeatPwrAct : 423|8@0+ (50.0,0.0) [0.0|12750.0] "W" IHU
 SG_ IsgHeatPwrAct_UB : 217|1@0+ (1,0) [0|1] "" IHU
 SG_ IsgHeatPwrMax : 431|8@0+ (50.0,0.0) [0.0|12750.0] "W" IHU
 SG_ IsgHeatPwrMax_UB : 216|1@0+ (1,0) [0|1] "" IHU
 SG_ LiBattInPWLock : 404|1@0+ (1,0) [0|1] "" IHU
 SG_ LiBattInPWLock_UB : 403|1@0+ (1,0) [0|1] "" IHU
 SG_ MirrPosnAdjFromSetTarPosnDrvr_UB : 402|1@0+ (1,0) [0|1] "" IHU
 SG_ MirrPosnAdjFromSetTarPosnDrvrMirrAdjLeRi : 485|14@0+ (1.0,0.0) [0.0|10000.0] "Unitless" IHU
 SG_ MirrPosnAdjFromSetTarPosnDrvrMirrAdjUpDown : 503|14@0+ (1.0,0.0) [0.0|10000.0] "Unitless" IHU
 SG_ PrpsnDataPrdA_UB : 7|1@0+ (1,0) [0|1] "" IHU
 SG_ PrpsnDataPrdACnt : 6|7@0+ (1.0,0.0) [0.0|127.0] "Unitless" IHU
 SG_ PrpsnDataPrdAData1 : 15|8@0+ (1.0,0.0) [0.0|255.0] "Unitless" IHU
 SG_ PrpsnDataPrdAData2 : 23|8@0+ (1.0,0.0) [0.0|255.0] "Unitless" IHU
 SG_ PrpsnDataPrdAData3 : 31|8@0+ (1.0,0.0) [0.0|255.0] "Unitless" IHU
 SG_ PrpsnDataPrdAData4 : 39|8@0+ (1.0,0.0) [0.0|255.0] "Unitless" IHU
 SG_ PrpsnDataPrdAData5 : 47|8@0+ (1.0,0.0) [0.0|255.0] "Unitless" IHU
 SG_ PrpsnDataPrdAData6 : 55|8@0+ (1.0,0.0) [0.0|255.0] "Unitless" IHU
 SG_ PrpsnDataPrdAData7 : 63|8@0+ (1.0,0.0) [0.0|255.0] "Unitless" IHU
 SG_ PrpsnDataPrdB_UB : 71|1@0+ (1,0) [0|1] "" IHU
 SG_ PrpsnDataPrdBCnt : 70|7@0+ (1.0,0.0) [0.0|127.0] "Unitless" IHU
 SG_ PrpsnDataPrdBData1 : 79|8@0+ (1.0,0.0) [0.0|255.0] "Unitless" IHU
 SG_ PrpsnDataPrdBData2 : 87|8@0+ (1.0,0.0) [0.0|255.0] "Unitless" IHU
 SG_ PrpsnDataPrdBData3 : 95|8@0+ (1.0,0.0) [0.0|255.0] "Unitless" IHU
 SG_ PrpsnDataPrdBData4 : 103|8@0+ (1.0,0.0) [0.0|255.0] "Unitless" IHU
 SG_ PrpsnDataPrdBData5 : 111|8@0+ (1.0,0.0) [0.0|255.0] "Unitless" IHU
 SG_ PrpsnDataPrdBData6 : 119|8@0+ (1.0,0.0) [0.0|255.0] "Unitless" IHU
 SG_ PrpsnDataPrdBData7 : 127|8@0+ (1.0,0.0) [0.0|255.0] "Unitless" IHU
 SG_ PtCoolgPostRunActv : 145|1@0+ (1,0) [0|1] "" IHU
 SG_ PtCoolgPostRunActv_UB : 169|1@0+ (1,0) [0|1] "" IHU
 SG_ PtTotBrkTqReq_UB : 182|1@0+ (1,0) [0|1] "" IHU
 SG_ PtTotBrkTqReqPtTotBrkTqEna : 231|1@0+ (1,0) [0|1] "" IHU
 SG_ PtTotBrkTqReqPtTotBrkTqReq : 230|15@0- (1.0,0.0) [-16384.0|16380.0] "NewtonMeter" IHU
 SG_ RainSnsrActvnErrToHmi : 144|1@0+ (1,0) [0|1] "" IHU
 SG_ RainSnsrActvnErrToHmi_UB : 170|1@0+ (1,0) [0|1] "" IHU
 SG_ ResrvdSigForCCM1 : 439|8@0+ (1.0,0.0) [0.0|255.0] "Unitless" IHU,ZCUP
 SG_ ResrvdSigForCCM1_UB : 146|1@0+ (1,0) [0|1] "" IHU,ZCUP
 SG_ ResrvdSigForCCM2 : 447|8@0+ (1.0,0.0) [0.0|255.0] "Unitless" IHU,ZCUP
 SG_ ResrvdSigForCCM2_UB : 147|1@0+ (1,0) [0|1] "" IHU,ZCUP
 SG_ ResrvdSigForCCM3 : 455|16@0+ (1.0,0.0) [0.0|65535.0] "Unitless" IHU,ZCUP
 SG_ ResrvdSigForCCM3_UB : 148|1@0+ (1,0) [0|1] "" IHU,ZCUP
 SG_ ResrvdSigForCCM4 : 471|16@0+ (1.0,0.0) [0.0|65535.0] "Unitless" IHU,ZCUP
 SG_ ResrvdSigForCCM4_UB : 149|1@0+ (1,0) [0|1] "" IHU,ZCUP
 SG_ StandStillReqForCmftToBrkgForEPedl : 150|1@0+ (1,0) [0|1] "" IHU
 SG_ StandStillReqForCmftToBrkgForEPedl_UB : 253|1@0+ (1,0) [0|1] "" IHU
 SG_ SteerLockMgrWarnIndcn : 158|3@0+ (1,0) [0|7] "" IHU
 SG_ SteerLockMgrWarnIndcn_UB : 172|1@0+ (1,0) [0|1] "" IHU
 SG_ StrtRemSts1WdStrtRemSts : 155|2@0+ (1,0) [0|3] "" IHU,ZCUP
 SG_ StrtRemSts1WdStrtRemSts_UB : 173|1@0+ (1,0) [0|1] "" IHU,ZCUP
 SG_ VehPropSts : 152|1@0+ (1,0) [0|1] "" IHU
 SG_ VehPropSts_UB : 176|1@0+ (1,0) [0|1] "" IHU
 SG_ WiprSysFailrDetdSafe : 164|2@0+ (1,0) [0|3] "" IHU
 SG_ WiprSysFailrDetdSafe_UB : 178|1@0+ (1,0) [0|1] "" IHU
 SG_ WshrFldTankStsToHMI : 162|1@0+ (1,0) [0|1] "" IHU
 SG_ WshrFldTankStsToHMI_UB : 179|1@0+ (1,0) [0|1] "" IHU

BO_ 569 ZCUDZCUCANFD2Fr24 : 64 ZCUD
 SG_ ConvPwrRelsForb_UB : 219|1@0+ (1,0) [0|1] "" IHU
 SG_ ConvPwrRelsForbRelsFrbn1 : 187|1@0+ (1,0) [0|1] "" IHU
 SG_ ConvPwrRelsForbRelsMtnFrbn : 186|1@0+ (1,0) [0|1] "" IHU
 SG_ HeatrPmpStat_UB : 58|1@0+ (1,0) [0|1] "" IHU
 SG_ HeatrPmpStatCooltPmpDryErr : 7|2@0+ (1,0) [0|3] "" IHU
 SG_ HeatrPmpStatCooltPmpEmgyModSts : 5|2@0+ (1,0) [0|3] "" IHU
 SG_ HeatrPmpStatCooltPmpErrSts : 3|2@0+ (1,0) [0|3] "" IHU
 SG_ HeatrPmpStatCooltPmpI : 23|8@0+ (0.2,0.0) [0.0|50.800000000000004] "A" IHU
 SG_ HeatrPmpStatCooltPmpIErr : 1|2@0+ (1,0) [0|3] "" IHU
 SG_ HeatrPmpStatCooltPmpMonrSpd : 15|2@0+ (1,0) [0|3] "" IHU
 SG_ HeatrPmpStatCooltPmpPostRunSts : 13|2@0+ (1,0) [0|3] "" IHU
 SG_ HeatrPmpStatCooltPmpSetPostRunReq : 63|3@0+ (1,0) [0|7] "" IHU
 SG_ HeatrPmpStatCooltPmpSetSpdReq : 31|8@0+ (1.0,0.0) [0.0|254.0] "Unitless" IHU
 SG_ HeatrPmpStatCooltPmpSpd : 39|8@0+ (1.0,0.0) [0.0|254.0] "Unitless" IHU
 SG_ HeatrPmpStatCooltPmpT : 47|8@0+ (1.0,-50.0) [-50.0|200.0] "degC" IHU
 SG_ HeatrPmpStatCooltPmpTErr : 11|2@0+ (1,0) [0|3] "" IHU
 SG_ HeatrPmpStatCooltPmpU : 55|8@0+ (0.1,0.0) [0.0|25.0] "Volt" IHU
 SG_ HeatrPmpStatCooltPmpUErr : 9|2@0+ (1,0) [0|3] "" IHU
 SG_ HeatrPmpStatCooltPmpUnstallSts : 60|2@0+ (1,0) [0|3] "" IHU
 SG_ SldngdoorLeReAntiPnchFault_UB : 256|1@0+ (1,0) [0|1] "" IHU
 SG_ SldngdoorLeReAntiPnchFaultFltMovngEvnt : 184|1@0+ (1,0) [0|1] "" IHU
 SG_ SldngdoorLeReAntiPnchFaultPinchEvnt : 185|1@0+ (1,0) [0|1] "" IHU
 SG_ SldngDoorLeRePos : 311|7@0+ (1.0,0.0) [0.0|127.0] "%" IHU
 SG_ SldngDoorLeRePos_UB : 304|1@0+ (1,0) [0|1] "" IHU
 SG_ SldngdoorRiReAntiPnchFault_UB : 257|1@0+ (1,0) [0|1] "" IHU
 SG_ SldngdoorRiReAntiPnchFaultFltMovngEvnt : 259|1@0+ (1,0) [0|1] "" IHU
 SG_ SldngdoorRiReAntiPnchFaultPinchEvnt : 258|1@0+ (1,0) [0|1] "" IHU
 SG_ SldngDoorRiRePos : 303|7@0+ (1.0,0.0) [0.0|127.0] "%" IHU
 SG_ SldngDoorRiRePos_UB : 296|1@0+ (1,0) [0|1] "" IHU
 SG_ SldngLeReWarnInd_UB : 326|1@0+ (1,0) [0|1] "" IHU
 SG_ SldngLeReWarnIndDisSldngDoorWarn : 319|1@0+ (1,0) [0|1] "" IHU
 SG_ SldngLeReWarnIndDriveOpnDoorWarn : 318|1@0+ (1,0) [0|1] "" IHU
 SG_ SldngLeReWarnIndDurngDoorMovWarn : 317|1@0+ (1,0) [0|1] "" IHU
 SG_ SldngLeReWarnIndEndNotSuccssWarn : 316|1@0+ (1,0) [0|1] "" IHU
 SG_ SldngLeReWarnIndFltAndPitchWarn : 315|1@0+ (1,0) [0|1] "" IHU
 SG_ SldngLeReWarnIndFltngDoorWarn : 314|1@0+ (1,0) [0|1] "" IHU
 SG_ SldngLeReWarnIndPreConNotFulfil : 313|1@0+ (1,0) [0|1] "" IHU
 SG_ SldngLeReWarnIndStpDurngMovWarn : 312|1@0+ (1,0) [0|1] "" IHU
 SG_ SldngLeReWarnIndStrMovngWarn : 327|1@0+ (1,0) [0|1] "" IHU
 SG_ SldngRiReWarnInd_UB : 325|1@0+ (1,0) [0|1] "" IHU
 SG_ SldngRiReWarnIndDisSldngDoorWarn : 324|1@0+ (1,0) [0|1] "" IHU
 SG_ SldngRiReWarnIndDriveOpnDoorWarn : 323|1@0+ (1,0) [0|1] "" IHU
 SG_ SldngRiReWarnIndDurngDoorMovWarn : 322|1@0+ (1,0) [0|1] "" IHU
 SG_ SldngRiReWarnIndEndNotSuccssWarn : 321|1@0+ (1,0) [0|1] "" IHU
 SG_ SldngRiReWarnIndFltAndPitchWarn : 320|1@0+ (1,0) [0|1] "" IHU
 SG_ SldngRiReWarnIndFltngDoorWarn : 335|1@0+ (1,0) [0|1] "" IHU
 SG_ SldngRiReWarnIndPreConNotFulfil : 334|1@0+ (1,0) [0|1] "" IHU
 SG_ SldngRiReWarnIndStpDurngMovWarn : 333|1@0+ (1,0) [0|1] "" IHU
 SG_ SldngRiReWarnIndStrMovngWarn : 332|1@0+ (1,0) [0|1] "" IHU

BO_ 82 ZCUDZCUCANFD2Fr25 : 64 ZCUD
 SG_ NFCAndBLEKeyDiReq_UB : 504|1@0+ (1,0) [0|1] "" IHU
 SG_ NFCAndBLEKeyDiReqData1 : 7|8@0+ (1.0,0.0) [0.0|255.0] "Unitless" IHU
 SG_ NFCAndBLEKeyDiReqData10 : 15|8@0+ (1.0,0.0) [0.0|255.0] "Unitless" IHU
 SG_ NFCAndBLEKeyDiReqData11 : 23|8@0+ (1.0,0.0) [0.0|255.0] "Unitless" IHU
 SG_ NFCAndBLEKeyDiReqData12 : 31|8@0+ (1.0,0.0) [0.0|255.0] "Unitless" IHU
 SG_ NFCAndBLEKeyDiReqData13 : 39|8@0+ (1.0,0.0) [0.0|255.0] "Unitless" IHU
 SG_ NFCAndBLEKeyDiReqData14 : 47|8@0+ (1.0,0.0) [0.0|255.0] "Unitless" IHU
 SG_ NFCAndBLEKeyDiReqData15 : 55|8@0+ (1.0,0.0) [0.0|255.0] "Unitless" IHU
 SG_ NFCAndBLEKeyDiReqData16 : 63|8@0+ (1.0,0.0) [0.0|255.0] "Unitless" IHU
 SG_ NFCAndBLEKeyDiReqData2 : 71|8@0+ (1.0,0.0) [0.0|255.0] "Unitless" IHU
 SG_ NFCAndBLEKeyDiReqData3 : 79|8@0+ (1.0,0.0) [0.0|255.0] "Unitless" IHU
 SG_ NFCAndBLEKeyDiReqData4 : 87|8@0+ (1.0,0.0) [0.0|255.0] "Unitless" IHU
 SG_ NFCAndBLEKeyDiReqData5 : 95|8@0+ (1.0,0.0) [0.0|255.0] "Unitless" IHU
 SG_ NFCAndBLEKeyDiReqData6 : 103|8@0+ (1.0,0.0) [0.0|255.0] "Unitless" IHU
 SG_ NFCAndBLEKeyDiReqData7 : 111|8@0+ (1.0,0.0) [0.0|255.0] "Unitless" IHU
 SG_ NFCAndBLEKeyDiReqData8 : 119|8@0+ (1.0,0.0) [0.0|255.0] "Unitless" IHU
 SG_ NFCAndBLEKeyDiReqData9 : 127|8@0+ (1.0,0.0) [0.0|255.0] "Unitless" IHU
 SG_ NFCKeySearchReq_UB : 505|1@0+ (1,0) [0|1] "" IHU
 SG_ NFCKeySearchReqKeyLocn : 135|4@0+ (1,0) [0|15] "" IHU
 SG_ NFCKeySearchReqTirgger : 131|4@0+ (1,0) [0|15] "" IHU

CM_ SG_ 800 CmprSpdAct "Electrical compressor actual speed";
CM_ SG_ 800 EngCrashFb "Propulsion shall set EngCrashFb depending on the status of leakage detection after a crash have occured.";
CM_ SG_ 800 HvCooltHeatrEnadWhE2EChks "Checksum for E2E.";
CM_ SG_ 800 HvCooltHeatrEnadWhE2ECntr "Counter for E2E.";
CM_ SG_ 800 HvCooltHeatrEnadWhE2EHvchEnad "HVHC enable.";
CM_ SG_ 800 HwRowThrdLeSldMotCtrl "Third Row Left Seat Slide Motor Control signal";
CM_ SG_ 800 HwRowThrdRiSldMotCtrl "Third Row Right Seat Slide Motor Control signal";
CM_ SG_ 800 ReEvapVlvReq "Request to open shut off valve of rear evaporator.";
CM_ SG_ 800 SafetyCrashFb "If brake pedal has been disconnected after a crash it is NOK, else OK after crash.";
CM_ SG_ 800 VFCVectorPOTBlockID "BlockID";
CM_ SG_ 800 VFCVectorPOTVFCid0 "SettingsComfort";
CM_ SG_ 800 VFCVectorPOTVFCid1 "ParkingDrivingClimatization";
CM_ SG_ 800 VFCVectorPOTVFCid10 "ExteriorLighting";
CM_ SG_ 800 VFCVectorPOTVFCid11 "VFCid11";
CM_ SG_ 800 VFCVectorPOTVFCid12 "Alarm";
CM_ SG_ 800 VFCVectorPOTVFCid13 "VFCid13";
CM_ SG_ 800 VFCVectorPOTVFCid14 "InteriorLighting";
CM_ SG_ 800 VFCVectorPOTVFCid15 "VFCid15";
CM_ SG_ 800 VFCVectorPOTVFCid16 "Locking";
CM_ SG_ 800 VFCVectorPOTVFCid17 "RemoteKeyFunctionality";
CM_ SG_ 800 VFCVectorPOTVFCid18 "PropulsionStart";
CM_ SG_ 800 VFCVectorPOTVFCid19 "VFCid19";
CM_ SG_ 800 VFCVectorPOTVFCid2 "PostClimatisation";
CM_ SG_ 800 VFCVectorPOTVFCid20 "VFCid20";
CM_ SG_ 800 VFCVectorPOTVFCid21 "PowerClosures";
CM_ SG_ 800 VFCVectorPOTVFCid22 "VehicleDriving";
CM_ SG_ 800 VFCVectorPOTVFCid23 "VFCid23";
CM_ SG_ 800 VFCVectorPOTVFCid24 "SettingsProfile";
CM_ SG_ 800 VFCVectorPOTVFCid25 "SeatComfortFunctions";
CM_ SG_ 800 VFCVectorPOTVFCid26 "Brake";
CM_ SG_ 800 VFCVectorPOTVFCid27 "InfotainmentPoll";
CM_ SG_ 800 VFCVectorPOTVFCid28 "HVEnergyStorage";
CM_ SG_ 800 VFCVectorPOTVFCid29 "VFCid29";
CM_ SG_ 800 VFCVectorPOTVFCid3 "PowertrainParkingClimatization";
CM_ SG_ 800 VFCVectorPOTVFCid30 "TelematicsConnectivity";
CM_ SG_ 800 VFCVectorPOTVFCid31 "VFCid31";
CM_ SG_ 800 VFCVectorPOTVFCid32 "VFCid32";
CM_ SG_ 800 VFCVectorPOTVFCid33 "Diagnostics";
CM_ SG_ 800 VFCVectorPOTVFCid34 "VehicleModeManagement";
CM_ SG_ 800 VFCVectorPOTVFCid35 "TrailerCaravanFunctions";
CM_ SG_ 800 VFCVectorPOTVFCid36 "Immobilizer";
CM_ SG_ 800 VFCVectorPOTVFCid37 "Windows";
CM_ SG_ 800 VFCVectorPOTVFCid38 "Visibility";
CM_ SG_ 800 VFCVectorPOTVFCid39 "VFCid39";
CM_ SG_ 800 VFCVectorPOTVFCid4 "VFCid4";
CM_ SG_ 800 VFCVectorPOTVFCid40 "VFCid40";
CM_ SG_ 800 VFCVectorPOTVFCid41 "InfotainmentPush";
CM_ SG_ 800 VFCVectorPOTVFCid42 "ChargingHV";
CM_ SG_ 800 VFCVectorPOTVFCid43 "BodyPreClimatisation";
CM_ SG_ 800 VFCVectorPOTVFCid44 "Crash";
CM_ SG_ 800 VFCVectorPOTVFCid45 "GlobalShortDuration";
CM_ SG_ 800 VFCVectorPOTVFCid46 "ExteriorLightsHazard";
CM_ SG_ 800 VFCVectorPOTVFCid47 "VFCid47";
CM_ SG_ 800 VFCVectorPOTVFCid48 "DoorOpenWarning";
CM_ SG_ 800 VFCVectorPOTVFCid49 "ChargingLVInit";
CM_ SG_ 800 VFCVectorPOTVFCid5 "VFCid5";
CM_ SG_ 800 VFCVectorPOTVFCid50 "VFCid50";
CM_ SG_ 800 VFCVectorPOTVFCid51 "VFCid51";
CM_ SG_ 800 VFCVectorPOTVFCid52 "HVBatteryThermalEventWarning";
CM_ SG_ 800 VFCVectorPOTVFCid53 "VisualAssist";
CM_ SG_ 800 VFCVectorPOTVFCid54 "PassiveSafety";
CM_ SG_ 800 VFCVectorPOTVFCid55 "LifeDetection";
CM_ SG_ 800 VFCVectorPOTVFCid56 "BackboneFlexray";
CM_ SG_ 800 VFCVectorPOTVFCid57 "Functionmarket";
CM_ SG_ 800 VFCVectorPOTVFCid58 "VFCid58";
CM_ SG_ 800 VFCVectorPOTVFCid59 "VFCid59";
CM_ SG_ 800 VFCVectorPOTVFCid6 "SettingsVehicle";
CM_ SG_ 800 VFCVectorPOTVFCid60 "VFCid60";
CM_ SG_ 800 VFCVectorPOTVFCid61 "VFCid61";
CM_ SG_ 800 VFCVectorPOTVFCid7 "VFCid7";
CM_ SG_ 800 VFCVectorPOTVFCid8 "VFCid8";
CM_ SG_ 800 VFCVectorPOTVFCid9 "IPWakeup";
CM_ SG_ 800 VFCVectorRBCMBlockID "BlockID";
CM_ SG_ 800 VFCVectorRBCMVFCid0 "SettingsComfort";
CM_ SG_ 800 VFCVectorRBCMVFCid1 "ParkingDrivingClimatization";
CM_ SG_ 800 VFCVectorRBCMVFCid10 "ExteriorLighting";
CM_ SG_ 800 VFCVectorRBCMVFCid11 "VFCid11";
CM_ SG_ 800 VFCVectorRBCMVFCid12 "Alarm";
CM_ SG_ 800 VFCVectorRBCMVFCid13 "VFCid13";
CM_ SG_ 800 VFCVectorRBCMVFCid14 "InteriorLighting";
CM_ SG_ 800 VFCVectorRBCMVFCid15 "VFCid15";
CM_ SG_ 800 VFCVectorRBCMVFCid16 "Locking";
CM_ SG_ 800 VFCVectorRBCMVFCid17 "RemoteKeyFunctionality";
CM_ SG_ 800 VFCVectorRBCMVFCid18 "PropulsionStart";
CM_ SG_ 800 VFCVectorRBCMVFCid19 "VFCid19";
CM_ SG_ 800 VFCVectorRBCMVFCid2 "PostClimatisation";
CM_ SG_ 800 VFCVectorRBCMVFCid20 "VFCid20";
CM_ SG_ 800 VFCVectorRBCMVFCid21 "PowerClosures";
CM_ SG_ 800 VFCVectorRBCMVFCid22 "VehicleDriving";
CM_ SG_ 800 VFCVectorRBCMVFCid23 "VFCid23";
CM_ SG_ 800 VFCVectorRBCMVFCid24 "SettingsProfile";
CM_ SG_ 800 VFCVectorRBCMVFCid25 "SeatComfortFunctions";
CM_ SG_ 800 VFCVectorRBCMVFCid26 "Brake";
CM_ SG_ 800 VFCVectorRBCMVFCid27 "InfotainmentPoll";
CM_ SG_ 800 VFCVectorRBCMVFCid28 "HVEnergyStorage";
CM_ SG_ 800 VFCVectorRBCMVFCid29 "VFCid29";
CM_ SG_ 800 VFCVectorRBCMVFCid3 "PowertrainParkingClimatization";
CM_ SG_ 800 VFCVectorRBCMVFCid30 "TelematicsConnectivity";
CM_ SG_ 800 VFCVectorRBCMVFCid31 "VFCid31";
CM_ SG_ 800 VFCVectorRBCMVFCid32 "VFCid32";
CM_ SG_ 800 VFCVectorRBCMVFCid33 "Diagnostics";
CM_ SG_ 800 VFCVectorRBCMVFCid34 "VehicleModeManagement";
CM_ SG_ 800 VFCVectorRBCMVFCid35 "TrailerCaravanFunctions";
CM_ SG_ 800 VFCVectorRBCMVFCid36 "Immobilizer";
CM_ SG_ 800 VFCVectorRBCMVFCid37 "Windows";
CM_ SG_ 800 VFCVectorRBCMVFCid38 "Visibility";
CM_ SG_ 800 VFCVectorRBCMVFCid39 "VFCid39";
CM_ SG_ 800 VFCVectorRBCMVFCid4 "VFCid4";
CM_ SG_ 800 VFCVectorRBCMVFCid40 "VFCid40";
CM_ SG_ 800 VFCVectorRBCMVFCid41 "InfotainmentPush";
CM_ SG_ 800 VFCVectorRBCMVFCid42 "ChargingHV";
CM_ SG_ 800 VFCVectorRBCMVFCid43 "BodyPreClimatisation";
CM_ SG_ 800 VFCVectorRBCMVFCid44 "Crash";
CM_ SG_ 800 VFCVectorRBCMVFCid45 "GlobalShortDuration";
CM_ SG_ 800 VFCVectorRBCMVFCid46 "ExteriorLightsHazard";
CM_ SG_ 800 VFCVectorRBCMVFCid47 "VFCid47";
CM_ SG_ 800 VFCVectorRBCMVFCid48 "DoorOpenWarning";
CM_ SG_ 800 VFCVectorRBCMVFCid49 "ChargingLVInit";
CM_ SG_ 800 VFCVectorRBCMVFCid5 "VFCid5";
CM_ SG_ 800 VFCVectorRBCMVFCid50 "VFCid50";
CM_ SG_ 800 VFCVectorRBCMVFCid51 "VFCid51";
CM_ SG_ 800 VFCVectorRBCMVFCid52 "HVBatteryThermalEventWarning";
CM_ SG_ 800 VFCVectorRBCMVFCid53 "VisualAssist";
CM_ SG_ 800 VFCVectorRBCMVFCid54 "PassiveSafety";
CM_ SG_ 800 VFCVectorRBCMVFCid55 "LifeDetection";
CM_ SG_ 800 VFCVectorRBCMVFCid56 "BackboneFlexray";
CM_ SG_ 800 VFCVectorRBCMVFCid57 "Functionmarket";
CM_ SG_ 800 VFCVectorRBCMVFCid58 "VFCid58";
CM_ SG_ 800 VFCVectorRBCMVFCid59 "VFCid59";
CM_ SG_ 800 VFCVectorRBCMVFCid6 "SettingsVehicle";
CM_ SG_ 800 VFCVectorRBCMVFCid60 "VFCid60";
CM_ SG_ 800 VFCVectorRBCMVFCid61 "VFCid61";
CM_ SG_ 800 VFCVectorRBCMVFCid7 "VFCid7";
CM_ SG_ 800 VFCVectorRBCMVFCid8 "VFCid8";
CM_ SG_ 800 VFCVectorRBCMVFCid9 "IPWakeup";
CM_ SG_ 800 VFCVectorSRSBlockID "BlockID";
CM_ SG_ 800 VFCVectorSRSVFCid0 "SettingsComfort";
CM_ SG_ 800 VFCVectorSRSVFCid1 "ParkingDrivingClimatization";
CM_ SG_ 800 VFCVectorSRSVFCid10 "ExteriorLighting";
CM_ SG_ 800 VFCVectorSRSVFCid11 "VFC11";
CM_ SG_ 800 VFCVectorSRSVFCid12 "Alarm";
CM_ SG_ 800 VFCVectorSRSVFCid13 "VFC13";
CM_ SG_ 800 VFCVectorSRSVFCid14 "InteriorLighting";
CM_ SG_ 800 VFCVectorSRSVFCid15 "VFC15";
CM_ SG_ 800 VFCVectorSRSVFCid16 "Locking";
CM_ SG_ 800 VFCVectorSRSVFCid17 "RemoteKeyFunctionality";
CM_ SG_ 800 VFCVectorSRSVFCid18 "PropulsionStart";
CM_ SG_ 800 VFCVectorSRSVFCid19 "VFC19";
CM_ SG_ 800 VFCVectorSRSVFCid2 "PostClimatisation";
CM_ SG_ 800 VFCVectorSRSVFCid20 "VFC20";
CM_ SG_ 800 VFCVectorSRSVFCid21 "PowerClosures";
CM_ SG_ 800 VFCVectorSRSVFCid22 "VehicleDriving";
CM_ SG_ 800 VFCVectorSRSVFCid23 "VFC23";
CM_ SG_ 800 VFCVectorSRSVFCid24 "SettingsProfile";
CM_ SG_ 800 VFCVectorSRSVFCid25 "SeatComfortFunctions";
CM_ SG_ 800 VFCVectorSRSVFCid26 "Brake";
CM_ SG_ 800 VFCVectorSRSVFCid27 "InfotainmentPoll";
CM_ SG_ 800 VFCVectorSRSVFCid28 "HVEnergyStorage";
CM_ SG_ 800 VFCVectorSRSVFCid29 "VFC29";
CM_ SG_ 800 VFCVectorSRSVFCid3 "PowertrainParkingClimatization";
CM_ SG_ 800 VFCVectorSRSVFCid30 "TelematicsConnectivity";
CM_ SG_ 800 VFCVectorSRSVFCid31 "VFC31";
CM_ SG_ 800 VFCVectorSRSVFCid32 "VFC32";
CM_ SG_ 800 VFCVectorSRSVFCid33 "Diagnostics";
CM_ SG_ 800 VFCVectorSRSVFCid34 "VehicleModeManagement";
CM_ SG_ 800 VFCVectorSRSVFCid35 "TrailerCaravanFunctions";
CM_ SG_ 800 VFCVectorSRSVFCid36 "Immobilizer";
CM_ SG_ 800 VFCVectorSRSVFCid37 "Windows";
CM_ SG_ 800 VFCVectorSRSVFCid38 "Visibility";
CM_ SG_ 800 VFCVectorSRSVFCid39 "VFC39";
CM_ SG_ 800 VFCVectorSRSVFCid4 "VFC4";
CM_ SG_ 800 VFCVectorSRSVFCid40 "VFC40";
CM_ SG_ 800 VFCVectorSRSVFCid41 "InfotainmentPush";
CM_ SG_ 800 VFCVectorSRSVFCid42 "ChargingHV";
CM_ SG_ 800 VFCVectorSRSVFCid43 "BodyPreClimatisation";
CM_ SG_ 800 VFCVectorSRSVFCid44 "Crash";
CM_ SG_ 800 VFCVectorSRSVFCid45 "GlobalShortDuration";
CM_ SG_ 800 VFCVectorSRSVFCid46 "ExteriorLightsHazard";
CM_ SG_ 800 VFCVectorSRSVFCid47 "VFC47";
CM_ SG_ 800 VFCVectorSRSVFCid48 "DoorOpenWarning";
CM_ SG_ 800 VFCVectorSRSVFCid49 "ChargingLVInit";
CM_ SG_ 800 VFCVectorSRSVFCid5 "VFC5";
CM_ SG_ 800 VFCVectorSRSVFCid50 "VFC50";
CM_ SG_ 800 VFCVectorSRSVFCid51 "VFC51";
CM_ SG_ 800 VFCVectorSRSVFCid52 "HVBatteryThermalEventWarning";
CM_ SG_ 800 VFCVectorSRSVFCid53 "VisualAssist";
CM_ SG_ 800 VFCVectorSRSVFCid54 "PassiveSafety";
CM_ SG_ 800 VFCVectorSRSVFCid55 "LifeDetection";
CM_ SG_ 800 VFCVectorSRSVFCid56 "BackboneFlexray";
CM_ SG_ 800 VFCVectorSRSVFCid57 "Functionmarket";
CM_ SG_ 800 VFCVectorSRSVFCid58 "VFC58";
CM_ SG_ 800 VFCVectorSRSVFCid59 "VFC59";
CM_ SG_ 800 VFCVectorSRSVFCid6 "SettingsVehicle";
CM_ SG_ 800 VFCVectorSRSVFCid60 "VFC60";
CM_ SG_ 800 VFCVectorSRSVFCid61 "VFC61";
CM_ SG_ 800 VFCVectorSRSVFCid7 "VFC7";
CM_ SG_ 800 VFCVectorSRSVFCid8 "VFC8";
CM_ SG_ 800 VFCVectorSRSVFCid9 "IPWakeup";
CM_ SG_ 800 VFCVectorSUMBlockID "BlockID";
CM_ SG_ 800 VFCVectorSUMVFCid0 "SettingsComfort";
CM_ SG_ 800 VFCVectorSUMVFCid1 "ParkingDrivingClimatization";
CM_ SG_ 800 VFCVectorSUMVFCid10 "ExteriorLighting";
CM_ SG_ 800 VFCVectorSUMVFCid11 "VFC11";
CM_ SG_ 800 VFCVectorSUMVFCid12 "Alarm";
CM_ SG_ 800 VFCVectorSUMVFCid13 "VFC13";
CM_ SG_ 800 VFCVectorSUMVFCid14 "InteriorLighting";
CM_ SG_ 800 VFCVectorSUMVFCid15 "VFC15";
CM_ SG_ 800 VFCVectorSUMVFCid16 "Locking";
CM_ SG_ 800 VFCVectorSUMVFCid17 "RemoteKeyFunctionality";
CM_ SG_ 800 VFCVectorSUMVFCid18 "PropulsionStart";
CM_ SG_ 800 VFCVectorSUMVFCid19 "VFC19";
CM_ SG_ 800 VFCVectorSUMVFCid2 "PostClimatisation";
CM_ SG_ 800 VFCVectorSUMVFCid20 "VFC20";
CM_ SG_ 800 VFCVectorSUMVFCid21 "PowerClosures";
CM_ SG_ 800 VFCVectorSUMVFCid22 "VehicleDriving";
CM_ SG_ 800 VFCVectorSUMVFCid23 "VFC23";
CM_ SG_ 800 VFCVectorSUMVFCid24 "SettingsProfile";
CM_ SG_ 800 VFCVectorSUMVFCid25 "SeatComfortFunctions";
CM_ SG_ 800 VFCVectorSUMVFCid26 "Brake";
CM_ SG_ 800 VFCVectorSUMVFCid27 "InfotainmentPoll";
CM_ SG_ 800 VFCVectorSUMVFCid28 "HVEnergyStorage";
CM_ SG_ 800 VFCVectorSUMVFCid29 "VFC29";
CM_ SG_ 800 VFCVectorSUMVFCid3 "PowertrainParkingClimatization";
CM_ SG_ 800 VFCVectorSUMVFCid30 "TelematicsConnectivity";
CM_ SG_ 800 VFCVectorSUMVFCid31 "VFC31";
CM_ SG_ 800 VFCVectorSUMVFCid32 "VFC32";
CM_ SG_ 800 VFCVectorSUMVFCid33 "Diagnostics";
CM_ SG_ 800 VFCVectorSUMVFCid34 "VehicleModeManagement";
CM_ SG_ 800 VFCVectorSUMVFCid35 "TrailerCaravanFunctions";
CM_ SG_ 800 VFCVectorSUMVFCid36 "Immobilizer";
CM_ SG_ 800 VFCVectorSUMVFCid37 "Windows";
CM_ SG_ 800 VFCVectorSUMVFCid38 "Visibility";
CM_ SG_ 800 VFCVectorSUMVFCid39 "VFC39";
CM_ SG_ 800 VFCVectorSUMVFCid4 "VFC4";
CM_ SG_ 800 VFCVectorSUMVFCid40 "VFC40";
CM_ SG_ 800 VFCVectorSUMVFCid41 "InfotainmentPush";
CM_ SG_ 800 VFCVectorSUMVFCid42 "ChargingHV";
CM_ SG_ 800 VFCVectorSUMVFCid43 "BodyPreClimatisation";
CM_ SG_ 800 VFCVectorSUMVFCid44 "Crash";
CM_ SG_ 800 VFCVectorSUMVFCid45 "GlobalShortDuration";
CM_ SG_ 800 VFCVectorSUMVFCid46 "ExteriorLightsHazard";
CM_ SG_ 800 VFCVectorSUMVFCid47 "VFC47";
CM_ SG_ 800 VFCVectorSUMVFCid48 "DoorOpenWarning";
CM_ SG_ 800 VFCVectorSUMVFCid49 "ChargingLVInit";
CM_ SG_ 800 VFCVectorSUMVFCid5 "VFC5";
CM_ SG_ 800 VFCVectorSUMVFCid50 "VFC50";
CM_ SG_ 800 VFCVectorSUMVFCid51 "VFC51";
CM_ SG_ 800 VFCVectorSUMVFCid52 "HVBatteryThermalEventWarning";
CM_ SG_ 800 VFCVectorSUMVFCid53 "VisualAssist";
CM_ SG_ 800 VFCVectorSUMVFCid54 "PassiveSafety";
CM_ SG_ 800 VFCVectorSUMVFCid55 "LifeDetection";
CM_ SG_ 800 VFCVectorSUMVFCid56 "BackboneFlexray";
CM_ SG_ 800 VFCVectorSUMVFCid57 "Functionmarket";
CM_ SG_ 800 VFCVectorSUMVFCid58 "VFC58";
CM_ SG_ 800 VFCVectorSUMVFCid59 "VFC59";
CM_ SG_ 800 VFCVectorSUMVFCid6 "SettingsVehicle";
CM_ SG_ 800 VFCVectorSUMVFCid60 "VFC60";
CM_ SG_ 800 VFCVectorSUMVFCid61 "VFC61";
CM_ SG_ 800 VFCVectorSUMVFCid7 "VFC7";
CM_ SG_ 800 VFCVectorSUMVFCid8 "VFC8";
CM_ SG_ 800 VFCVectorSUMVFCid9 "IPWakeup";
CM_ SG_ 264 AdjSpdLimnActvnOk "The signal informs if Speed Limiter (ASL/AVSL) can be activated or not. Primarily used by HMI to know if Speed Limiter activation requests by driver should be ignored or not.";
CM_ SG_ 264 AdjSpdLimnMsg "The signal triggers visual messages in DIM to inform the driver relevant information about the Speed Limiter (ASL/AVSL)";
CM_ SG_ 264 AdjSpdLimnStbOk "The signal informs if Speed Limiter (ASL/AVSL) can be set to standby or not.
";
CM_ SG_ 264 AdjSpdLimnSts "The signal indicates the status (or state) of the Speed Limiter (ASL/AVSL); Off, Standby, Actv etc.";
CM_ SG_ 264 ChdPrtnLeftSwReq "Signal from the Driver door switchpack to the Driver Door module containing the status of the function LED for the left rear Power window disable-child lock switch";
CM_ SG_ 264 ChdPrtnRightSwReq "Signal from the Driver door switchpack to the Driver Door module containing the status of the function LED for the right rear Power window disable or child lock switch";
CM_ SG_ 264 DispBattEgyIn "Electric battery energy absorbed by the HV Battery. NB: Only power flowing into HV battery is integrated. Energy=integral( max( battery power flowing in , 0) ).";
CM_ SG_ 264 DispBattEgyOut "Electric battery energy delivered by the HV Battery. NB: Only power flowing out of the HV battery is integrated. Energy=integral( max( battery power flowing out , 0) ).";
CM_ SG_ 264 DoorLeOpenWarnReq "Left Door Open Warning Request";
CM_ SG_ 264 DoorRiOpenWarnReq "Right Door Open Warning Request";
CM_ SG_ 264 DrvrSeatSnsrSts "Informs if there is a fault on the driver seat sensor is detected through electrical measurements, or plausibility judgement. NotOk means sensor is judged as faulty. Di means that the sensor is not configured.";
CM_ SG_ 264 DrvrSeatSwtCushExtSts "Driver Seat Cushion Extension Switch Status";
CM_ SG_ 264 ElecMot2ActvDampgModReq "Generator motor active damping mode request
0 = No damping
1 = Low damping
2 = Medium damping
3 = High damping";
CM_ SG_ 264 ElecMot2ModSts "Inverter mode status";
CM_ SG_ 264 EngSpdDispd "Engine speed value for engine speed meter in the driver information display. Note that this speed value may differ from the real actual engine speed.";
CM_ SG_ 264 EngSpdMaxDispd "Maximum engine speed value for engine speed meter in the driver information display. Note that this maximum engine speed value may differ from the real maximum possible engine speed that the engine can be produced by the engine.";
CM_ SG_ 264 EngTqIntvReqFast "Engine torque intervention request fast";
CM_ SG_ 264 FrntSeatCmftCtrlReSeatLe "Signal to control Front Seat from Second Row Left Seat";
CM_ SG_ 264 FrntSeatCmftCtrlReSeatRi "Signal to control Front Seat from Second Row Right Seat";
CM_ SG_ 264 GearMovmtFlg "A signal flag to make DHU control the ASL&ACC function open or close.";
CM_ SG_ 264 LimSts "auto/manual LIM founction states";
CM_ SG_ 264 LowrTailgAntiPnch "Infor if the lower tailgate motor anti-pinch is activated or not while closing.";
CM_ SG_ 264 LowrTailgObstclDetn "Infor if obstacle is detected while the lower tailgate is closing.";
CM_ SG_ 264 LowrTailgOpenerSts "Lower Tailgate/Bootlid status. moving, opened, closed...";
CM_ SG_ 264 LowrTailgOpenPosn "Indicates the actual open state of the lower tailgate";
CM_ SG_ 264 MirrAdjVceAtPassCmd "Mirror Position Adjust Command from voice";
CM_ SG_ 264 MirrAtDrvrForVce "Feedback to the voice system about the position of the mirrors";
CM_ SG_ 264 MotDynCtrlStsReLeChks "The status of the DMC.";
CM_ SG_ 264 MotDynCtrlStsReLeCntr "The status of the DMC.";
CM_ SG_ 264 MotDynCtrlStsReLeDmcActAppTarTq "The status of the DMC.";
CM_ SG_ 264 MotDynCtrlStsReLeDmcSts "The status of the DMC.";
CM_ SG_ 264 MotDynCtrlStsReLeDmcSWInfo "The status of the DMC.";
CM_ SG_ 264 MotDynCtrlStsReRiChks "The status of the DMC.";
CM_ SG_ 264 MotDynCtrlStsReRiCntr "The status of the DMC.";
CM_ SG_ 264 MotDynCtrlStsReRiDmcActAppTarTq "The status of the DMC.";
CM_ SG_ 264 MotDynCtrlStsReRiDmcSts "The status of the DMC.";
CM_ SG_ 264 MotDynCtrlStsReRiDmcSWInfo "The status of the DMC.";
CM_ SG_ 264 PtCluTqReq "Requested crank shaft torque.";
CM_ SG_ 264 PtVehSpdMaxChks "Checksum of PtVehSpdMax";
CM_ SG_ 264 PtVehSpdMaxCntr "Counter of PtVehSpdMax";
CM_ SG_ 264 PtVehSpdMaxReq " The signal shall limit the vehicle speed for e.g. reverse with electric engine and manipulation of the speed signal.";
CM_ SG_ 264 RoadSgnInfoSts "Indicates the TSR function status.";
CM_ SG_ 264 RowSecLeFldRsdSts "Second Row Left Seat Fold Raised Status";
CM_ SG_ 264 RowSecLeFldRsdWarn "Second Row Left Seat Fold Raised Warning Signal";
CM_ SG_ 264 RowSecLeMassgRunng "second row left seat massage module running status";
CM_ SG_ 264 RowSecLeSeatActvSpplFct "Active Multifunction";
CM_ SG_ 264 RowSecLeSeatRotRmn "Second Row Left Seat Rotation Reminder";
CM_ SG_ 264 RowSecRiFldRsdWarn "Second Row Right Seat Fold Raised Warning Signal";
CM_ SG_ 264 RowSecRiMassgRunng "second row right seat massage module running status";
CM_ SG_ 264 RowSecRiSeatActvSpplFct "Active Multifunction";
CM_ SG_ 264 RowSecRiSeatRotRmn "Second Row Right Seat Rotation Reminder";
CM_ SG_ 264 SbWSyncStsH1Chks "Checksum";
CM_ SG_ 264 SbWSyncStsH1Cntr "Counter";
CM_ SG_ 264 SbWSyncStsH1HWASyncSts "To indicate whether the steering wheel and road wheel is synchronized.";
CM_ SG_ 264 SeatMassgFctRowSecLeMassgInten "Seat Massage Intensity Selection Row Second Left";
CM_ SG_ 264 SeatMassgFctRowSecLeMassgProg "Seat Massage Program Selection Row Second Left";
CM_ SG_ 264 SeatMassgFctRowSecLeOnOff "Seat Massage On or Off Row Second Left";
CM_ SG_ 264 SeatMassgFctRowSecRiMassgInten "Seat Massage Intensity Selection Row Second Right";
CM_ SG_ 264 SeatMassgFctRowSecRiMassgProg "Seat Massage Program Selection Row Second Right";
CM_ SG_ 264 SeatMassgFctRowSecRiOnOff "Seat Massage On or Off Row Second Right";
CM_ SG_ 264 SpdLimFirst "The speed limit for DIM and HUD to display.";
CM_ SG_ 264 TCSCmprStrtFlt "TCSCmprStrtFlt";
CM_ SG_ 264 TCSFltSts "TCSFltSts";
CM_ SG_ 264 TCSModSwtSts "TCSModSwtSts";
CM_ SG_ 264 TrlrPrmntPwrActv "YES - Power supply with KL-30.
NO - Power off.";
CM_ SG_ 264 TrOpenerByFootOperSts "TrOpenerByFootOperSts - FMDM kick detection status
When a valid kick has been detected by FMDM, this signal will be set to On for a specified amount of time/frames and then revert back to Off.";
CM_ SG_ 264 TrsmCluTqCpMaxOfClu0 "Clutch capacity max of clutch 0";
CM_ SG_ 264 TrsmReqForPfmncRedn3 "TCM uses signal Transmission Request For Performance Reduction to send requests to ECM to activate the functionality Intended System Degradation (ISD). ISD will stage by stage reduce the maximum allowed torque for the engine over a number of driving cycles. Default signal - 0 (false)";
CM_ SG_ 264 TrsmWhlProtnMaxTq "Transmission  wheel protection max  torque";
CM_ SG_ 264 TrsmWhlProtnMinTq "Transmission wheel protection min torque";
CM_ SG_ 264 UpprLowrTailgCtrlInhbFb "Lower tailgate control inhibition feedback.";
CM_ SG_ 67 BookTrvlFltSts "ECM shall send fault status to TCAM ";
CM_ SG_ 67 BookTrvlSetResponse "ECM shall feedback status when receives the request to enter book charging mode";
CM_ SG_ 67 BookTrvlTiSetReqBookTrvlChrgnTi "The charging time to target SOC";
CM_ SG_ 67 BookTrvlTiSetReqBookTrvlTiSetReq "ECM shall send the request to calculate charging initial time to TCAM";
CM_ SG_ 67 CrashSts2 "Information if a crash or slight crash has been detected by SRS.";
CM_ SG_ 67 DchaStopByTarDrvrIndcn "Driver indication signal of discharging function stopped due to remaining distance/SOC target reached.";
CM_ SG_ 67 PrpsnDataEvtACnt "Counter";
CM_ SG_ 67 PrpsnDataEvtAData1 "Data - Record data A by event trigger";
CM_ SG_ 67 PrpsnDataEvtAData2 "Data - Record data A by event trigger";
CM_ SG_ 67 PrpsnDataEvtAData3 "Data - Record data A by event trigger";
CM_ SG_ 67 PrpsnDataEvtAData4 "Data - Record data A by event trigger";
CM_ SG_ 67 PrpsnDataEvtAData5 "Data - Record data A by event trigger";
CM_ SG_ 67 PrpsnDataEvtAData6 "Data - Record data A by event trigger";
CM_ SG_ 67 PrpsnDataEvtAID "ID - Record data A by event trigger";
CM_ SG_ 67 PrpsnDataEvtBCnt "Counter";
CM_ SG_ 67 PrpsnDataEvtBData1 "Data - Record data B by event trigger";
CM_ SG_ 67 PrpsnDataEvtBData2 "Data - Record data B by event trigger";
CM_ SG_ 67 PrpsnDataEvtBData3 "Data - Record data B by event trigger";
CM_ SG_ 67 PrpsnDataEvtBData4 "Data - Record data B by event trigger";
CM_ SG_ 67 PrpsnDataEvtBData5 "Data - Record data B by event trigger";
CM_ SG_ 67 PrpsnDataEvtBData6 "Data - Record data B by event trigger";
CM_ SG_ 67 PrpsnDataEvtBID "ID - Record data B by event trigger";
CM_ SG_ 1161 DmcStsFrntToEscChks "Chks";
CM_ SG_ 1161 DmcStsFrntToEscCntr "Cntr
";
CM_ SG_ 1161 DmcStsFrntToEscDmcActAppTarTq "DMC actual appTarTq";
CM_ SG_ 1161 DmcStsFrntToEscDmcSts "DMC frint status
";
CM_ SG_ 1161 DmcStsFrntToEscDmcSWInfo "DmcSWinfo";
CM_ SG_ 1161 DrvrSteerActvChks "Confirmation of driver steer actively Checksum";
CM_ SG_ 1161 DrvrSteerActvCntr "Confirmation of driver steer actively Counter";
CM_ SG_ 1161 DrvrSteerActvDrvrSteerActv "Indicates if the driver steers actively";
CM_ SG_ 1161 ElecMot2IDc "DC current measured by the front inverter";
CM_ SG_ 1161 EngN2 "Engine Speed [rpm]";
CM_ SG_ 1161 EpbAvlSecChks "checksum";
CM_ SG_ 1161 EpbAvlSecCntr "counter";
CM_ SG_ 1161 EpbAvlSecCommunicationAvailable "Host and slave communication is avaliable";
CM_ SG_ 1161 EpbAvlSecHostAvailabilityFull "Host fully available";
CM_ SG_ 1161 EpbAvlSecHostAvailabilityRelOnly "Host Available - release only";
CM_ SG_ 1161 EpbAvlSecReserved1 "reserve";
CM_ SG_ 1161 EpbAvlSecReserved2 "reserve";
CM_ SG_ 1161 EpbAvlSecReserved3 "reserve";
CM_ SG_ 1161 EpbAvlSecReserved4 "reserve";
CM_ SG_ 1161 EpbAvlSecReserved5 "reserve";
CM_ SG_ 1161 EpbAvlSecReserved6 "reserve";
CM_ SG_ 1161 EpbAvlSecReserved7 "reserve";
CM_ SG_ 1161 IsgErrIndcnReq "MIL ilumination req from IGM";
CM_ SG_ 1161 IsgLimnIndcn "LOS signal";
CM_ SG_ 1161 IsgSpdActSgnSafeChks "checksum";
CM_ SG_ 1161 IsgSpdActSgnSafeCntr "counter";
CM_ SG_ 1161 IsgSpdActSgnSafeIsgSpdActSgn800 "Safe EM motor shaft speed.";
CM_ SG_ 1161 IsgSpdActSgnSafeQF "quality factor";
CM_ SG_ 1161 IsgTqAvlMax "Max available torque";
CM_ SG_ 1161 IsgTqAvlMin "Min available torque";
CM_ SG_ 1161 Mot1ReqSafeChks "Checksum";
CM_ SG_ 1161 Mot1ReqSafeCntr "Rolling Counter";
CM_ SG_ 1161 Mot1ReqSafemod "P1 mode request";
CM_ SG_ 1161 Mot1ReqSafeRsv "Reserved for FuSa";
CM_ SG_ 1161 Mot1ReqSafespd "P1 speed  request";
CM_ SG_ 1161 Mot1ReqSafetq "P1 torque  request";
CM_ SG_ 1161 Mot3ReqSafeChks "Checksum";
CM_ SG_ 1161 Mot3ReqSafeCntr "Rolling Counter";
CM_ SG_ 1161 Mot3ReqSafemod "P3 mode request";
CM_ SG_ 1161 Mot3ReqSafeRsv "Reserved for FuSa";
CM_ SG_ 1161 Mot3ReqSafespd "P3 speed  request";
CM_ SG_ 1161 Mot3ReqSafetq "P3 torque  request";
CM_ SG_ 1161 PtClu0TqReq "Clutch C0 torque request (Unit: Nm)";
CM_ SG_ 1161 PtCluTq2Req "Requset crank shaft torque";
CM_ SG_ 1161 PtCluTqDyn "Acual crank shaft torque. Crankshaft torque dynamic";
CM_ SG_ 1161 PtCluTqPtCluTq "Acual crank shaft torque. Crankshaft torque";
CM_ SG_ 1161 PtCluTqQly "Acual crank shaft torque. Crankshaft torque quality factor";
CM_ SG_ 1161 PtGearTarReq "DHT Gear target request";
CM_ SG_ 1161 PtParkReqToWhlsRe "Powertrain park request to rear axle to park/hold the vehicle";
CM_ SG_ 1161 SteerExtFctStsChks "Confirmation of steer external function status Checksum";
CM_ SG_ 1161 SteerExtFctStsCntr "Confirmation of steer external function status Counter";
CM_ SG_ 1161 SteerExtFctStsDrvrSteerOvrd "Steering request of asking driver to take over";
CM_ SG_ 1161 SteerExtFctStsExtFctLowerLimActive "Column  Torque Lower Limit ";
CM_ SG_ 1161 SteerExtFctStsExtFctRateLimActive "External function rate Limit ";
CM_ SG_ 1161 SteerExtFctStsExtFctUpperLimActive "Column Torque Upper Limit ";
CM_ SG_ 1161 SteerExtFctStsExtSafeLimActive "External function torque output vs defined safety limiters ";
CM_ SG_ 1161 SteerExtFctStsLatAgReqNotInRange "Pinion angle /current trajectory between primary and fall back ";
CM_ SG_ 1161 SteerExtFctStsLatCtrlReqNotInRange "Lateral Ctrl request and primary and fall back ";
CM_ SG_ 1161 SteerLockStsBolt "Status information from SCL to CEM regarding bolt position, failure, SCL evaluation of safety reqs and SCL unit status";
CM_ SG_ 1161 SteerLockStsFault "Status information from SCL to CEM regarding bolt position, failure, SCL evaluation of safety reqs and SCL unit status";
CM_ SG_ 1161 SteerLockStsSafety "Status information from SCL to CEM regarding bolt position, failure, SCL evaluation of safety reqs and SCL unit status";
CM_ SG_ 1161 SteerLockStsUnit "Status information from SCL to CEM regarding bolt position, failure, SCL evaluation of safety reqs and SCL unit status";
CM_ SG_ 1161 SuspFailrStsChks "This DATA-Element is used by the air suspension to inform that a severe error is present in the system. Checksum";
CM_ SG_ 1161 SuspFailrStsCntr "This DATA-Element is used by the air suspension to inform that a severe error is present in the system. Counter";
CM_ SG_ 1161 SuspFailrStsSuspFailrSts "This DATA-Element is used by the air suspension to inform that a severe error is present in the system. Error type.";
CM_ SG_ 1161 SuspFailrStsTypQf "This DATA-Element is used by the air suspension to inform that a severe error is present in the system. Quality Factor";
CM_ SG_ 1161 TqAssAddl "Total torque at motor";
CM_ SG_ 1161 TrlrModVMMFltSts "trailer mode VMM usage mode transition fault status.
0: No fault;
1: Fault.";
CM_ SG_ 1161 TrsmActrPosnSafeAuxTrsmActrPosn "Transmission measured gear lever position";
CM_ SG_ 1161 TrsmActrPosnSafeAuxTrsmActrPosnChks "Transmission measured gear lever position";
CM_ SG_ 1161 TrsmActrPosnSafeAuxTrsmActrPosnCntr "Transmission measured gear lever position";
CM_ SG_ 1161 TrsmModNotAvlSts "TCM uses signal Transmissions Mode Not Available Status to inform ECM which modes are unavailable (Neutral, Reverse, Drive, LockUp stuck-Off or LockUp stuck-On). Default value - 0 (no modes unavailable). Bit 0-7";
CM_ SG_ 1161 TrsmNeutFailr "Transmission Neutral Failiure. Neutral not possible flag. 0 - Neutral possible, 1 - Neutral not possible. ";
CM_ SG_ 1161 TrsmOilT "Transmission oil temperature";
CM_ SG_ 1161 TrsmTqLossChks "Actual torque losses in the transmission";
CM_ SG_ 1161 TrsmTqLossCntr "Actual torque losses in the transmission";
CM_ SG_ 1161 TrsmTqLossTrsmTqEff "Actual torque losses in the transmission";
CM_ SG_ 1161 TrsmTqLossTrsmTqLoss "Actual torque losses in the transmission";
CM_ SG_ 1161 WrmUpCyc "Transition from 0 to 1 indicates a start of a warm up cycle";
CM_ SG_ 1173 BswRstAddress "Last reset address

";
CM_ SG_ 1173 BswRstReason "Last reset reason

";
CM_ SG_ 1173 CarLoctrToExtrLiVisReq "Request from Car Locator to Exterior light to flash exterior lights when vehicle search is active.";
CM_ SG_ 1173 DiagcSigSWM "internal ECU errors";
CM_ SG_ 1173 EnaOfflineMonitor "Rain monitoring if car is Off.";
CM_ SG_ 1173 EngLoadReqElec "Request to Dynamic load control to increase or decrease electrical loads";
CM_ SG_ 1173 EngNSafeEngN "Engine Speed [rpm] and Engine Speed derivative [rpm/s]";
CM_ SG_ 1173 EngNSafeEngNChks "Engine Speed [rpm] and Engine Speed derivative [rpm/s]";
CM_ SG_ 1173 EngNSafeEngNCntr "Engine Speed [rpm] and Engine Speed derivative [rpm/s]";
CM_ SG_ 1173 EngNSafeEngNGrdt "Engine Speed [rpm] and Engine Speed derivative [rpm/s]";
CM_ SG_ 1173 EngRunngReqByVehModMgrChassie "Chassie caused engine restart during start stop.";
CM_ SG_ 1173 EngRunngReqByVehModMgrClimate "Climate caused engine restart during start stop.";
CM_ SG_ 1173 EngRunngReqByVehModMgrElectricalSystem "ElectricalSystem Chassie caused engine restart during start stop.";
CM_ SG_ 1173 EngRunngReqByVehModMgrTrailerPrsnt "TrailerPrsnt caused engine restart during start stop.";
CM_ SG_ 1173 EngSt1WdSts1 "Signaling the state of the powerpack(without E2E)";
CM_ SG_ 1173 FltOfBeamHiDrv "Fault status of high beam of driver side";
CM_ SG_ 1173 FltOfBeamLoDrv "Fault status of low beam of driver side";
CM_ SG_ 1173 FltOfCenHiMntdStopLamp "Fault status of Central High Mounted Stop Lamp.";
CM_ SG_ 1173 FltOfCenHiMntdStopLamp1 "Fault status of Central High Mounted Stop Lamp for Lotus";
CM_ SG_ 1173 FltOfDaytiRunngLampDrv "Fault status of DRL Lamp of driver side";
CM_ SG_ 1173 FltOfFrntFogLampDrv "Fault status of front fog Lamp of driver side";
CM_ SG_ 1173 FltOfFrntPosnLampDrv "Fault status of front position Lamp of driver side";
CM_ SG_ 1173 FltOfRePosnLampDrv "Fault status of rear position Lamp of driver side";
CM_ SG_ 1173 FltOfStopLampDrv "Fault status of stop Lamp of driver side";
CM_ SG_ 1173 FltOfStopLampPass "Fault status of stop Lamp of passenger side";
CM_ SG_ 1173 FrLeReadLiReq "The Front Row Left side reading light request with intensity level.";
CM_ SG_ 1173 FrRiReadLiReq "The Front Row Right side reading light request with intensity level.";
CM_ SG_ 1173 HornSwitchSts "The status of the switch in the wheel that controls the horn";
CM_ SG_ 1173 HvActvForVehModReq "This signal is used to request activation of the HV system.";
CM_ SG_ 1173 HvActvSts "Indicate HV avtivation status.";
CM_ SG_ 1173 HvCoolgPwrAllwd "Power available for cooling in real time. From wall socket if plugged in, from propulsion or high voltage battery.";
CM_ SG_ 1173 HvHeatgPwrAllwd "Power available for heating in real time. From wall socket if plugged in, from propulsion or high voltage battery.";
CM_ SG_ 1173 HwRowFrstDrvrFrntHeiMotCtrl "Driver Seat Front Height Motor Control";
CM_ SG_ 1173 HwRowFrstDrvrHeiMotCtrl "Driver Seat Height Motor Control";
CM_ SG_ 1173 HwRowFrstDrvrInclMotCtrl "Driver Seat Inclination Motor Control";
CM_ SG_ 1173 HwRowFrstDrvrSldMotCtrl "Driver Seat Slide Motor Control";
CM_ SG_ 1173 IndicatorIntensityLvl "The Global Function indicator intensity level .
This is broadcast by ZCUD, and the receive ECU shall follow the signal value to adjust the function indicator intensity level.";
CM_ SG_ 1173 IntLightTreadPlateSupply "Interface for the TreadPlateIllmnSupply output. 
HW interface.";
CM_ SG_ 1173 IntrBriStsFromIf "interior Brightnes status from inteface.";
CM_ SG_ 1173 IntrLiRoofAUTOIndication "Interior lght auto swictch indication";
CM_ SG_ 1173 IntrMirrCmdDrvrSide "Command signals from CEM (master) to IRMM (slave). Left/Right side driver: 0 = Right side driver, 1 = Left side driver";
CM_ SG_ 1173 IntrMirrCmdIntrMirrAsyFanCmpMag "Command signals from CEM (master) to IRMM (slave). Magnetic compensation for the compass with respect to ASDM cooling fan: 0 = Off, 1 = On";
CM_ SG_ 1173 IntrMirrCmdIntrMirrDiagcRst "Command signals from CEM (master) to IRMM (slave). Diagnostic reset: 0 = Normal operation, 1 = Clear internal failure, perform diagnostic reset";
CM_ SG_ 1173 IntrMirrCmdIntrMirrDimSnvty "Command signals from CEM (master) to IRMM (slave). EC Sensitivity: 0 = Normal, 1 = Dark, 2 = Light, 3 = Inhibit";
CM_ SG_ 1173 IntrMirrCmdIntrMirrEna "Command signals from CEM (master) to IRMM (slave). Enable mode: 0 = Disable autodim and compass, 1 = Enable autodim and compass";
CM_ SG_ 1173 IntrMirrCmdIntrMirrInhbDim "Command signals from CEM (master) to IRMM (slave). EC Inhibit: 0 = Normal operation, 1 = Inhibit EC operation";
CM_ SG_ 1173 IntrMirrCmdIntrMirrWindHeatrCmpMag "Command signals from CEM (master) to IRMM (slave). Magnetic compensation for the compass with respect to window defroster: 0 = Off, 1 = On";
CM_ SG_ 1173 LatCtrlModCfmdChks "Confirmation of lateral control request Confirmed lateral mode";
CM_ SG_ 1173 LatCtrlModCfmdCntr "Confirmation of lateral control request Confirmed lateral mode";
CM_ SG_ 1173 LatCtrlModCfmdLatCtrlMod "Confirmation of lateral control request Confirmed lateral mode";
CM_ SG_ 1173 MirrDefrstAtDrvrCmd "Activation signal exterior rear view mirror electrical defroster driver side.";
CM_ SG_ 1173 MirrSeldIndcn "Tells the DDS which mirror function LED shall be activated/deactivated.";
CM_ SG_ 1173 PanicAlrmAcoustReq "Request from Panic Alarm to Sound Signaling to sound the vehicle horn when PA active.";
CM_ SG_ 1173 PanicAlrmToExtrLiVisReq "Request from Panic Alarm to Exterior light to flash exterior lights when PA active.";
CM_ SG_ 1173 PropsEnabfromAlcoLock "Propulsion enabled/disabled from Alcohol Lock";
CM_ SG_ 1173 PtActvnReq1WdPtActvnReq "Request to activate drivline sent to powertrain.";
CM_ SG_ 1173 PwrCnsVisy "Info about the total power consumed by the loads Mirror, Rear Window and Windscreen Defroster";
CM_ SG_ 1173 PwrCritDesVisy "The total amount of power that the loads (Front windscreen defroster, Rear window defroster, Rear view mirror defrosters) would consume to be active and identified.";
CM_ SG_ 1173 PwrEstimdAtStbForVisy "Power required by visibility at engine standby (applicable for start and stop)";
CM_ SG_ 1173 PwrNormDesVisy "The total amount of power that the loads requested to be activated would consume if turned on.";
CM_ SG_ 1173 RainSensActvn "Rain sensor function activation command to the rain sensor and the wiper motor.";
CM_ SG_ 1173 ReAdaptReq "Re-adaption request signal";
CM_ SG_ 1173 RelHumSnsrErr "compartment relative humidity sensor error information.";
CM_ SG_ 1173 RemStrtMsgToDrvrRemStrtBlkd1 "Messages from EngineRemoteStart to DIM.";
CM_ SG_ 1173 RemStrtMsgToDrvrRemStrtDev1 "Messages from EngineRemoteStart to DIM.";
CM_ SG_ 1173 RlyActvnForRoofCurtClsAut "Activation of Relay for Roof Curtain";
CM_ SG_ 1173 SecRowLeReadLiReq "The Second Row Left side reading light request include ON/OFF and intensity level.";
CM_ SG_ 1173 SecRowRiReadLiReq "The Second Row Right side reading light request with intensity level.";
CM_ SG_ 1173 SteerLockEnagOfPrpsn "CEM ECM message, information if propulsion shall be allowed or inhibited depending on steering column unlock or lock.";
CM_ SG_ 1173 SteerWhlTqAddl "Overlay torque from external requests";
CM_ SG_ 1173 StsOfLedHiBeamLe "Status of Led High Beam Left.";
CM_ SG_ 1173 StsOfLedHiBeamRi "Status of High Beam Led Right.";
CM_ SG_ 1173 StsOfLedLoBeamLe "Status of Led Low Beam Left.";
CM_ SG_ 1173 StsOfLedLoBeamRi "Status of Low Beam Led Right";
CM_ SG_ 1173 StsOfSwvlgLe "Status of Bending Light Left.";
CM_ SG_ 1173 StsOfSwvlgRi "Status of Bending Light Right.";
CM_ SG_ 1173 SunCurtEna "Authorization for the sun curtain to move";
CM_ SG_ 1173 SunRoofAndCurtExtCmd "Commands to move the curtain and panel, also used for initialization";
CM_ SG_ 1173 SwtBeamHi "The signal shall be distributed periodically.
0-Neutral(middle, neutral), 1-Flash(pull 1step, monostabile), 2-Hi Beam ON(push, monostabile), 3-Hi beam OFF(pull 2step, monostabile).";
CM_ SG_ 1173 SwtLiHzrdWarn "Hazard warning light switch signal.
0-not pressed, 1-pressed";
CM_ SG_ 1173 TankFlapReqFromSwtIntrFild "TankFlapReqFromSwtIntFild - Tank Flap Request From Interior Switch (Filtered)";
CM_ SG_ 1173 TrOpenerReqTrigSrc "TrOpenerReq - Tailgate or Bootlid Opener Request
Request signal to POT ECU. Signal contains type of request and trig source of request.";
CM_ SG_ 1173 TrOpenerReqTrOpenerReq "TrOpenerReq - Tailgate or Bootlid Opener Request
Request signal to POT ECU. Signal contains type of request and trig source of request";
CM_ SG_ 1173 TrsmParkLockSt "Transmission park lock state";
CM_ SG_ 1173 TrsmTqRat "Transmission Torque Ratio. Actual ratio between the input and the output torque of the transmission and torque converter This includes torque converter effects, clutch slip effects, and all gearing effects including final drive.";
CM_ SG_ 1173 WiprActv "Information regarding if the wiper is active or not.";
CM_ SG_ 1173 WiprInWipgAr "Information regarding wiper position on the windscreen.";
CM_ SG_ 1173 WiprMotFrntLvrCmdSafeLvrInHiSpdPosnSafe "Signals requesting different wiping modes depending on the positions of the wiper stalk.  Wiper lever in high speed position (2-bit coded)";
CM_ SG_ 1173 WiprMotFrntLvrCmdSafeLvrInIntlPosn "Signals requesting different wiping modes depending on the positions of the wiper stalk.  Wiper lever in interval position";
CM_ SG_ 1173 WiprMotFrntLvrCmdSafeLvrInLoSpdPosnSafe "Signals requesting different wiping modes depending on the positions of the wiper stalk.  Wiper lever in low speed position (2-bit coded)";
CM_ SG_ 1173 WiprMotFrntLvrCmdSafeLvrInSnglStrokePos "Signals requesting different wiping modes depending on the positions of the wiper stalk.  Wiper lever in single stroke position";
CM_ SG_ 81 ClsdDueToRain "Signal to telematics that the sunroof was successully closed due to rain";
CM_ SG_ 81 DKDataFromCEMAcknowledgment "Packet received acknowledgement";
CM_ SG_ 81 DKDataFromCEMDKDataByte1 "Byte number 1";
CM_ SG_ 81 DKDataFromCEMDKDataByte2 "Byte number 2";
CM_ SG_ 81 DKDataFromCEMDKDataByte3 "Byte number 3";
CM_ SG_ 81 DKDataFromCEMDKDataByte4 "Byte number 4";
CM_ SG_ 81 DKDataFromCEMDKDataByte5 "Byte number 5";
CM_ SG_ 81 DKDataFromCEMDKDataByte6 "Byte number 6";
CM_ SG_ 81 DKDataFromCEMHeader "Packet Header";
CM_ SG_ 659 AcCmprVlvICns "Ac variable displacement valve current consumption.";
CM_ SG_ 659 AlrmTrsnMode "SIgnal from CEM to IMS with information if the Car Mode is Transport OR not";
CM_ SG_ 659 DiagFrameForECMByte0 "Sequence number.";
CM_ SG_ 659 DiagFrameForECMByte1 "ECM diagnostic message1.";
CM_ SG_ 659 DiagFrameForECMByte2 "ECM diagnostic message2.";
CM_ SG_ 659 DiagFrameForECMByte3 "ECM diagnostic message3.";
CM_ SG_ 659 DiagFrameForECMByte4 "ECM diagnostic message4.";
CM_ SG_ 659 DiagFrameForECMByte5 "ECM diagnostic message5.";
CM_ SG_ 659 DiagFrameForECMByte6 "ECM diagnostic message6.";
CM_ SG_ 659 DiagFrameForECMByte7 "ECM diagnostic message7.";
CM_ SG_ 659 DstEstimdToEmptyForDrvgElecPred "Predicted distance till empty in economic driving behavior (e.g. shut down AC)";
CM_ SG_ 659 EngAmbTCalcd "Ambient Temparature calculated by ECM using engine temperature sensors";
CM_ SG_ 659 HeatrPmpIAct "Heater pump actual current.";
CM_ SG_ 659 HeatrPmpPwrCns "Heater pump actual power consumption.";
CM_ SG_ 659 HeatrPmpUAct "Heater pump actual voltage.";
CM_ SG_ 659 HvBattPmpPwrCns "Coolant pump power consumption in battery cooling circuit.";
CM_ SG_ 659 HvBattThermInfoCorrInFuturePwrAtTime "Corrected battery power request at time in the future. ";
CM_ SG_ 659 HvBattThermInfoCorrInFutureSequenceNo "Sequence number";
CM_ SG_ 659 HvBattThermInfoCorrInFutureTempAtTime "Correct battery temperature at time in the future.";
CM_ SG_ 659 HvBattThermInfoCorrInFutureThermModAtTime "Corrected battery thermal mode at time in the future.";
CM_ SG_ 659 HvBattThermInfoCorrInFutureTime "Corrected time in the future";
CM_ SG_ 659 HvBattThermInfoCorrInFutureVersionNo "Version number";
CM_ SG_ 659 HvWtrHeatrWtrTDes "Water temperature desired from heating manager.";
CM_ SG_ 659 IsgCooltFlowMinReq2 "Minimum coolant flow required by EDS";
CM_ SG_ 659 IsgHeatPwrAct "The actual electrical energy consumption for active heating of front motor";
CM_ SG_ 659 IsgHeatPwrMax "The actual electrical energy consumption for active heating of rear motor";
CM_ SG_ 659 LiBattInPWLock "Li-ion battery power locking enable signal
When BMS2 sends BattFltStsPrim=15,set LiBattInPWLock=1, indicating that the Li-ion battery power is about to be locked, and LiBattInPWLock=0, indicating that the lithium battery power is not locked.

";
CM_ SG_ 659 MirrPosnAdjFromSetTarPosnDrvrMirrAdjLeRi "Horizontal position adjustment of mirror";
CM_ SG_ 659 MirrPosnAdjFromSetTarPosnDrvrMirrAdjUpDown "vertical position adjustment of mirror";
CM_ SG_ 659 PrpsnDataPrdACnt "Counter";
CM_ SG_ 659 PrpsnDataPrdAData1 "Data - Record data A for period gathering";
CM_ SG_ 659 PrpsnDataPrdAData2 "Data - Record data A for period gathering";
CM_ SG_ 659 PrpsnDataPrdAData3 "Data - Record data A for period gathering";
CM_ SG_ 659 PrpsnDataPrdAData4 "Data - Record data A for period gathering";
CM_ SG_ 659 PrpsnDataPrdAData5 "Data - Record data A for period gathering";
CM_ SG_ 659 PrpsnDataPrdAData6 "Data - Record data A for period gathering";
CM_ SG_ 659 PrpsnDataPrdAData7 "Data - Record data A for period gathering";
CM_ SG_ 659 PrpsnDataPrdBCnt "Counter";
CM_ SG_ 659 PrpsnDataPrdBData1 "Data - Record data B for period gathering";
CM_ SG_ 659 PrpsnDataPrdBData2 "Data - Record data B for period gathering";
CM_ SG_ 659 PrpsnDataPrdBData3 "Data - Record data B for period gathering";
CM_ SG_ 659 PrpsnDataPrdBData4 "Data - Record data B for period gathering";
CM_ SG_ 659 PrpsnDataPrdBData5 "Data - Record data B for period gathering";
CM_ SG_ 659 PrpsnDataPrdBData6 "Data - Record data B for period gathering";
CM_ SG_ 659 PrpsnDataPrdBData7 "Data - Record data B for period gathering";
CM_ SG_ 659 PtCoolgPostRunActv "Flag to request Usage Mode Inactive for powertrain cooling need.";
CM_ SG_ 659 PtTotBrkTqReqPtTotBrkTqEna "Enable signal indicating VDDM whether it needs to execute e-pedal torque request from ECM";
CM_ SG_ 659 PtTotBrkTqReqPtTotBrkTqReq "Total brake torque request for e-Pedal";
CM_ SG_ 659 RainSnsrActvnErrToHmi "Rain sensor function error is detected";
CM_ SG_ 659 ResrvdSigForCCM1 "Reserved signal 1 for CCM.";
CM_ SG_ 659 ResrvdSigForCCM2 "Reserved signal 2 for CCM.";
CM_ SG_ 659 ResrvdSigForCCM3 "Reserved signal 3 for CCM.";
CM_ SG_ 659 ResrvdSigForCCM4 "Reserved signal 4 for CCM.";
CM_ SG_ 659 StandStillReqForCmftToBrkgForEPedl "Standstill request indicating needing to stop the vehicle when vehicle speed is low during e-Pedal mode.";
CM_ SG_ 659 SteerLockMgrWarnIndcn "SCL warning message to be shown in DIM";
CM_ SG_ 659 StrtRemSts1WdStrtRemSts "Status signal for EngineRemoteStart send to climate for control of climatization.";
CM_ SG_ 659 VehPropSts "Vehicle propulsion status indicating vehicle is propulsive or not";
CM_ SG_ 659 WiprSysFailrDetdSafe "Cleaning (wiping and washing) system failure present.";
CM_ SG_ 659 WshrFldTankStsToHMI "Information regarding if the washer fluid level is low.";
CM_ SG_ 569 ConvPwrRelsForbRelsFrbn1 "Signal used to notify HMI if the Conventional Door Power Release has been forbidden after a request
Boolean 1 = [RelsMtnFrbn] 
Boolean 2 = [RelsFrbn1]";
CM_ SG_ 569 ConvPwrRelsForbRelsMtnFrbn "Signal used to notify HMI if the Conventional Door Power Release has been forbidden after a request
Boolean 1 = [RelsMtnFrbn] 
Boolean 2 = [RelsFrbn1]";
CM_ SG_ 569 HeatrPmpStatCooltPmpDryErr "water pump MT Dryrun error";
CM_ SG_ 569 HeatrPmpStatCooltPmpEmgyModSts "water pump MT, Status Emergency mode";
CM_ SG_ 569 HeatrPmpStatCooltPmpErrSts "water pump error status";
CM_ SG_ 569 HeatrPmpStatCooltPmpI "Actual current consumption";
CM_ SG_ 569 HeatrPmpStatCooltPmpIErr "water pump MT current error";
CM_ SG_ 569 HeatrPmpStatCooltPmpMonrSpd "water pump MT, RPM Monitoring";
CM_ SG_ 569 HeatrPmpStatCooltPmpPostRunSts "water pump post run status";
CM_ SG_ 569 HeatrPmpStatCooltPmpSetPostRunReq "water pump set post run speed request";
CM_ SG_ 569 HeatrPmpStatCooltPmpSetSpdReq "water pump MT Set speed";
CM_ SG_ 569 HeatrPmpStatCooltPmpSpd "Actual speed from coolant pump";
CM_ SG_ 569 HeatrPmpStatCooltPmpT "water pump MT Temperature";
CM_ SG_ 569 HeatrPmpStatCooltPmpTErr "water pump MT temperature error";
CM_ SG_ 569 HeatrPmpStatCooltPmpU "water pump MT Voltage";
CM_ SG_ 569 HeatrPmpStatCooltPmpUErr "water pump MT voltage error";
CM_ SG_ 569 HeatrPmpStatCooltPmpUnstallSts "water pump MT, Deblocking";
CM_ SG_ 569 SldngdoorLeReAntiPnchFaultFltMovngEvnt "Falut event while Left Rear door movement";
CM_ SG_ 569 SldngdoorLeReAntiPnchFaultPinchEvnt "Pinch event for Left Rear sliding doors";
CM_ SG_ 569 SldngDoorLeRePos "Describes the current position of the Left rear Sliding door  from 0-100% ( 0 = fully open AND 100= Fully closed)  - 101 undef -  any other value not described is invalid (Same as undefined. ";
CM_ SG_ 569 SldngdoorRiReAntiPnchFaultFltMovngEvnt "Fault event for Right Rear sliding door movement";
CM_ SG_ 569 SldngdoorRiReAntiPnchFaultPinchEvnt "Pinch event for Right Rear sliding door movement";
CM_ SG_ 569 SldngDoorRiRePos "Describes the current position of the Right rear Sliding door  from 0-100% ( 0 = fully open AND 100= Fully closed)  - 101  undef -  any other value not described is invalid (Same ads undefined). ";
CM_ SG_ 569 SldngLeReWarnIndDisSldngDoorWarn "Power Sliding doors are disabled before operation request OR during operation";
CM_ SG_ 569 SldngLeReWarnIndDriveOpnDoorWarn "IF Door any power sliding door is open and vehicle start to drive a warning must be given";
CM_ SG_ 569 SldngLeReWarnIndDurngDoorMovWarn "Continues sound during the Power Sliding door movement";
CM_ SG_ 569 SldngLeReWarnIndEndNotSuccssWarn "Request to close power sliding door is received but door finish operation unsuccessfully, without any event intervention";
CM_ SG_ 569 SldngLeReWarnIndFltAndPitchWarn "Power sliding doors detects a fault OR a anti-pinch event before moving OR during moving";
CM_ SG_ 569 SldngLeReWarnIndFltngDoorWarn "IF the door has remain in a position: NOT fully  closed OR Not Fully Open for more than 3 minutes then user must be notified through a warning";
CM_ SG_ 569 SldngLeReWarnIndPreConNotFulfil "User request an operation but the preconditions are not fulfilled";
CM_ SG_ 569 SldngLeReWarnIndStpDurngMovWarn "User request stop during door movement";
CM_ SG_ 569 SldngLeReWarnIndStrMovngWarn "Warning used when Specific Power Sliding door start to move";
CM_ SG_ 569 SldngRiReWarnIndDisSldngDoorWarn "Power Sliding doors are disabled before operation request OR during operation";
CM_ SG_ 569 SldngRiReWarnIndDriveOpnDoorWarn "IF Door any power sliding door is open and vehicle start to drive a warning must be given";
CM_ SG_ 569 SldngRiReWarnIndDurngDoorMovWarn "Continues sound during the Power Sliding door movement";
CM_ SG_ 569 SldngRiReWarnIndEndNotSuccssWarn "Request to close power sliding door is received but door finish operation unsuccessfully, without any event intervention";
CM_ SG_ 569 SldngRiReWarnIndFltAndPitchWarn "Power sliding doors detects a fault OR a anti-pinch event before moving OR during moving";
CM_ SG_ 569 SldngRiReWarnIndFltngDoorWarn "IF the door has remain in a position: NOT fully  closed OR Not Fully Open for more than 3 minutes then user must be notified through a warning";
CM_ SG_ 569 SldngRiReWarnIndPreConNotFulfil "User request an operation but the preconditions are not fulfilled";
CM_ SG_ 569 SldngRiReWarnIndStpDurngMovWarn "User request stop during door movement";
CM_ SG_ 569 SldngRiReWarnIndStrMovngWarn "Warning used when Specific Power Sliding door start to move";
CM_ SG_ 82 NFCAndBLEKeyDiReqData1 "data";
CM_ SG_ 82 NFCAndBLEKeyDiReqData10 "data";
CM_ SG_ 82 NFCAndBLEKeyDiReqData11 "data";
CM_ SG_ 82 NFCAndBLEKeyDiReqData12 "data";
CM_ SG_ 82 NFCAndBLEKeyDiReqData13 "data";
CM_ SG_ 82 NFCAndBLEKeyDiReqData14 "data";
CM_ SG_ 82 NFCAndBLEKeyDiReqData15 "data";
CM_ SG_ 82 NFCAndBLEKeyDiReqData16 "data";
CM_ SG_ 82 NFCAndBLEKeyDiReqData2 "data";
CM_ SG_ 82 NFCAndBLEKeyDiReqData3 "data";
CM_ SG_ 82 NFCAndBLEKeyDiReqData4 "data";
CM_ SG_ 82 NFCAndBLEKeyDiReqData5 "data";
CM_ SG_ 82 NFCAndBLEKeyDiReqData6 "data";
CM_ SG_ 82 NFCAndBLEKeyDiReqData7 "data";
CM_ SG_ 82 NFCAndBLEKeyDiReqData8 "data";
CM_ SG_ 82 NFCAndBLEKeyDiReqData9 "data";
CM_ SG_ 82 NFCKeySearchReqKeyLocn "the zone of key search ";
CM_ SG_ 82 NFCKeySearchReqTirgger "which triggered key search";
BA_DEF_ BO_ "CANFD_BRS" ENUM "0","1";
BA_DEF_ BO_ "GenMsgCycleTime" INT 0 65536; // [ms]
BA_DEF_ BO_ "GenMsgDelayTime" INT 0 65536; // [ms]
BA_DEF_ BO_ "GenMsgSendType" ENUM "cyclic", "spontaneous", "not-used", "not-used", "not-used", "cyclicAndSpontaneous", "not-used", "cyclicIfActive", "NoMsgSendType"; // [us]
BA_DEF_ BO_ "GenMsgStartDelayTime" INT 0 65536; // [ms]
BA_DEF_ BO_ "VFrameFormat" ENUM "StandardCAN","ExtendedCAN","reserved","J1939PG","reserved","reserved","reserved","reserved","reserved","reserved","reserved","reserved","reserved","reserved","StandardCAN_FD","ExtendedCAN_FD";
BA_DEF_ SG_ "GenSigSendType" ENUM "Cyclic","OnWrite","OnWriteWithRepetition","OnChange","OnChangeWithRepetition","IfActive","IfActiveWithRepetition","NoSigSendType";
BA_DEF_ SG_ "GenSigStartValue" HEX 0 80000000;
BA_DEF_ BO_ "GenMsgILSupport" ENUM "No","Yes";
BA_DEF_ BO_ "NmAsrMessage" ENUM "No","Yes";
BA_DEF_ SG_ "GenSigFuncType" ENUM "NoFunction","n/a","n/a","n/a","n/a","n/a","n/a","n/a","n/a","n/a","n/a","n/a","n/a","n/a","n/a","CHK","CNTR","n/a","n/a","n/a","CNTR_AR_01","CRC_AR_01_BOTH","CRC_AR_01_ALT","CRC_AR_01_LOW","CRC_AR_01_NIBBLE","CNTR_AR_04","CRC_AR_04A","CNTR_AR_05","CRC_AR_05";
BA_DEF_ SG_ "GenSigDataID" STRING;
BA_DEF_DEF_ "CANFD_BRS" "1";
BA_DEF_DEF_ "GenSigStartValue" 0;
BA_DEF_DEF_ "VFrameFormat" "J1939PG";
BA_DEF_DEF_ "GenSigSendType" "NoSigSendType";
BA_DEF_DEF_ "GenMsgCycleTime" 0;
BA_DEF_DEF_ "GenMsgDelayTime" 0;
BA_DEF_DEF_ "GenMsgStartDelayTime" 0;
BA_DEF_DEF_ "GenMsgSendType" "NoMsgSendType";
BA_DEF_DEF_ "GenMsgILSupport" "Yes";
BA_DEF_DEF_ "NmAsrMessage" "No";
BA_DEF_DEF_ "GenSigFuncType" "NoFunction";
BA_DEF_DEF_ "GenSigDataID" "";
// Frame: ZCUDZCUCANFD2Fr16
BA_ "GenMsgCycleTime" BO_ 800 500.000;
BA_ "GenMsgSendType" BO_ 800 0;
BA_ "VFrameFormat" BO_ 800 14;
// Frame: ZCUDZCUCANFD2Fr17
BA_ "GenMsgCycleTime" BO_ 264 20.000;
BA_ "GenMsgSendType" BO_ 264 0;
BA_ "VFrameFormat" BO_ 264 14;
// Frame: ZCUDZCUCANFD2Fr18
BA_ "GenMsgDelayTime" BO_ 67 10.000;
BA_ "GenMsgSendType" BO_ 67 1;
BA_ "VFrameFormat" BO_ 67 14;
// Frame: ZCUDZCUCANFD2Fr19
BA_ "GenMsgCycleTime" BO_ 1161 900.000;
BA_ "GenMsgSendType" BO_ 1161 0;
BA_ "VFrameFormat" BO_ 1161 14;
// Frame: ZCUDZCUCANFD2Fr20
BA_ "GenMsgCycleTime" BO_ 1173 1000.000;
BA_ "GenMsgSendType" BO_ 1173 0;
BA_ "VFrameFormat" BO_ 1173 14;
// Frame: ZCUDZCUCANFD2Fr21
BA_ "GenMsgDelayTime" BO_ 81 10.000;
BA_ "GenMsgSendType" BO_ 81 1;
BA_ "VFrameFormat" BO_ 81 14;
// Frame: ZCUDZCUCANFD2Fr23
BA_ "GenMsgCycleTime" BO_ 659 400.000;
BA_ "GenMsgSendType" BO_ 659 0;
BA_ "VFrameFormat" BO_ 659 14;
// Frame: ZCUDZCUCANFD2Fr24
BA_ "GenMsgCycleTime" BO_ 569 300.000;
BA_ "GenMsgSendType" BO_ 569 0;
BA_ "VFrameFormat" BO_ 569 14;
// Frame: ZCUDZCUCANFD2Fr25
BA_ "GenMsgDelayTime" BO_ 82 10.000;
BA_ "GenMsgSendType" BO_ 82 1;
BA_ "VFrameFormat" BO_ 82 14;
BA_ "GenSigSendType" SG_ 659 AcCmprVlvICns 0;
BA_ "GenSigSendType" SG_ 264 AdjSpdLimnActvnOk 0;
BA_ "GenSigSendType" SG_ 264 AdjSpdLimnMsg 0;
BA_ "GenSigSendType" SG_ 264 AdjSpdLimnStbOk 0;
BA_ "GenSigSendType" SG_ 264 AdjSpdLimnSts 0;
BA_ "GenSigStartValue" SG_ 264 AdjSpdLimnSts 1;
BA_ "GenSigSendType" SG_ 659 AlrmTrsnMode 0;
BA_ "GenSigStartValue" SG_ 67 BookTrvlTiSetReqBookTrvlChrgnTi 2047;
BA_ "GenSigSendType" SG_ 1173 CarLoctrToExtrLiVisReq 0;
BA_ "GenSigSendType" SG_ 264 ChdPrtnLeftSwReq 0;
BA_ "GenSigSendType" SG_ 264 ChdPrtnRightSwReq 0;
BA_ "GenSigSendType" SG_ 81 ClsdDueToRain 1;
BA_ "GenSigSendType" SG_ 800 CmprSpdAct 0;
BA_ "GenSigSendType" SG_ 569 ConvPwrRelsForbRelsFrbn1 0;
BA_ "GenSigSendType" SG_ 569 ConvPwrRelsForbRelsMtnFrbn 0;
BA_ "GenSigSendType" SG_ 67 CrashSts2 1;
BA_ "GenSigSendType" SG_ 81 DKDataFromCEMAcknowledgment 1;
BA_ "GenSigSendType" SG_ 81 DKDataFromCEMDKDataByte1 1;
BA_ "GenSigSendType" SG_ 81 DKDataFromCEMDKDataByte2 1;
BA_ "GenSigSendType" SG_ 81 DKDataFromCEMDKDataByte3 1;
BA_ "GenSigSendType" SG_ 81 DKDataFromCEMDKDataByte4 1;
BA_ "GenSigSendType" SG_ 81 DKDataFromCEMDKDataByte5 1;
BA_ "GenSigSendType" SG_ 81 DKDataFromCEMDKDataByte6 1;
BA_ "GenSigSendType" SG_ 81 DKDataFromCEMHeader 1;
BA_ "GenSigSendType" SG_ 67 DchaStopByTarDrvrIndcn 1;
BA_ "GenSigSendType" SG_ 1173 DiagcSigSWM 0;
BA_ "GenSigSendType" SG_ 264 DispBattEgyIn 0;
BA_ "GenSigSendType" SG_ 264 DispBattEgyOut 0;
BA_ "GenSigSendType" SG_ 264 DoorLeOpenWarnReq 0;
BA_ "GenSigSendType" SG_ 264 DoorRiOpenWarnReq 0;
BA_ "GenSigSendType" SG_ 264 DrvrSeatSnsrSts 0;
BA_ "GenSigSendType" SG_ 264 DrvrSeatSwtCushExtSts 0;
BA_ "GenSigDataID" SG_ 1161 DrvrSteerActvChks "0xBC";
BA_ "GenSigFuncType" SG_ 1161 DrvrSteerActvChks 15;
BA_ "GenSigSendType" SG_ 1161 DrvrSteerActvChks 0;
BA_ "GenSigFuncType" SG_ 1161 DrvrSteerActvCntr 16;
BA_ "GenSigSendType" SG_ 1161 DrvrSteerActvCntr 0;
BA_ "GenSigSendType" SG_ 1161 DrvrSteerActvDrvrSteerActv 0;
BA_ "GenSigSendType" SG_ 264 ElecMot2ActvDampgModReq 0;
BA_ "GenSigSendType" SG_ 1161 ElecMot2IDc 0;
BA_ "GenSigStartValue" SG_ 1161 ElecMot2IDc 8188;
BA_ "GenSigSendType" SG_ 264 ElecMot2ModSts 0;
BA_ "GenSigSendType" SG_ 1173 EnaOfflineMonitor 0;
BA_ "GenSigSendType" SG_ 659 EngAmbTCalcd 0;
BA_ "GenSigStartValue" SG_ 659 EngAmbTCalcd 120;
BA_ "GenSigSendType" SG_ 800 EngCrashFb 0;
BA_ "GenSigSendType" SG_ 1173 EngLoadReqElec 0;
BA_ "GenSigSendType" SG_ 1161 EngN2 0;
BA_ "GenSigSendType" SG_ 1173 EngNSafeEngN 0;
BA_ "GenSigDataID" SG_ 1173 EngNSafeEngNChks "0x44";
BA_ "GenSigFuncType" SG_ 1173 EngNSafeEngNChks 15;
BA_ "GenSigSendType" SG_ 1173 EngNSafeEngNChks 0;
BA_ "GenSigFuncType" SG_ 1173 EngNSafeEngNCntr 16;
BA_ "GenSigSendType" SG_ 1173 EngNSafeEngNCntr 0;
BA_ "GenSigSendType" SG_ 1173 EngNSafeEngNGrdt 0;
BA_ "GenSigSendType" SG_ 1173 EngRunngReqByVehModMgrChassie 0;
BA_ "GenSigSendType" SG_ 1173 EngRunngReqByVehModMgrClimate 0;
BA_ "GenSigSendType" SG_ 1173 EngRunngReqByVehModMgrElectricalSystem 0;
BA_ "GenSigSendType" SG_ 1173 EngRunngReqByVehModMgrTrailerPrsnt 0;
BA_ "GenSigSendType" SG_ 264 EngSpdDispd 0;
BA_ "GenSigSendType" SG_ 264 EngSpdMaxDispd 0;
BA_ "GenSigSendType" SG_ 1173 EngSt1WdSts1 0;
BA_ "GenSigSendType" SG_ 264 EngTqIntvReqFast 0;
BA_ "GenSigStartValue" SG_ 264 EngTqIntvReqFast 1024;
BA_ "GenSigDataID" SG_ 1161 EpbAvlSecChks "0x464";
BA_ "GenSigFuncType" SG_ 1161 EpbAvlSecChks 15;
BA_ "GenSigSendType" SG_ 1161 EpbAvlSecChks 0;
BA_ "GenSigFuncType" SG_ 1161 EpbAvlSecCntr 16;
BA_ "GenSigSendType" SG_ 1161 EpbAvlSecCntr 0;
BA_ "GenSigSendType" SG_ 1161 EpbAvlSecCommunicationAvailable 0;
BA_ "GenSigSendType" SG_ 1161 EpbAvlSecHostAvailabilityFull 0;
BA_ "GenSigSendType" SG_ 1161 EpbAvlSecHostAvailabilityRelOnly 0;
BA_ "GenSigSendType" SG_ 1161 EpbAvlSecReserved1 0;
BA_ "GenSigSendType" SG_ 1161 EpbAvlSecReserved2 0;
BA_ "GenSigSendType" SG_ 1161 EpbAvlSecReserved3 0;
BA_ "GenSigSendType" SG_ 1161 EpbAvlSecReserved4 0;
BA_ "GenSigSendType" SG_ 1161 EpbAvlSecReserved5 0;
BA_ "GenSigSendType" SG_ 1161 EpbAvlSecReserved6 0;
BA_ "GenSigSendType" SG_ 1161 EpbAvlSecReserved7 0;
BA_ "GenSigSendType" SG_ 1173 FltOfBeamHiDrv 0;
BA_ "GenSigSendType" SG_ 1173 FltOfBeamLoDrv 0;
BA_ "GenSigSendType" SG_ 1173 FltOfCenHiMntdStopLamp 0;
BA_ "GenSigSendType" SG_ 1173 FltOfCenHiMntdStopLamp1 0;
BA_ "GenSigSendType" SG_ 1173 FltOfDaytiRunngLampDrv 0;
BA_ "GenSigSendType" SG_ 1173 FltOfFrntFogLampDrv 0;
BA_ "GenSigSendType" SG_ 1173 FltOfFrntPosnLampDrv 0;
BA_ "GenSigSendType" SG_ 1173 FltOfRePosnLampDrv 0;
BA_ "GenSigSendType" SG_ 1173 FltOfStopLampDrv 0;
BA_ "GenSigSendType" SG_ 1173 FltOfStopLampPass 0;
BA_ "GenSigSendType" SG_ 1173 FrLeReadLiReq 0;
BA_ "GenSigSendType" SG_ 1173 FrRiReadLiReq 0;
BA_ "GenSigSendType" SG_ 264 FrntSeatCmftCtrlReSeatLe 0;
BA_ "GenSigSendType" SG_ 264 FrntSeatCmftCtrlReSeatRi 0;
BA_ "GenSigSendType" SG_ 264 GearMovmtFlg 0;
BA_ "GenSigStartValue" SG_ 569 HeatrPmpStatCooltPmpT 100;
BA_ "GenSigSendType" SG_ 1173 HornSwitchSts 0;
BA_ "GenSigSendType" SG_ 1173 HvActvForVehModReq 0;
BA_ "GenSigSendType" SG_ 1173 HvActvSts 0;
BA_ "GenSigSendType" SG_ 659 HvBattPmpPwrCns 0;
BA_ "GenSigStartValue" SG_ 659 HvBattThermInfoCorrInFuturePwrAtTime 500;
BA_ "GenSigStartValue" SG_ 659 HvBattThermInfoCorrInFutureTempAtTime 50;
BA_ "GenSigSendType" SG_ 659 HvWtrHeatrWtrTDes 0;
BA_ "GenSigStartValue" SG_ 659 HvWtrHeatrWtrTDes 40;
BA_ "GenSigSendType" SG_ 1173 HwRowFrstDrvrFrntHeiMotCtrl 0;
BA_ "GenSigSendType" SG_ 1173 HwRowFrstDrvrHeiMotCtrl 0;
BA_ "GenSigSendType" SG_ 1173 HwRowFrstDrvrInclMotCtrl 0;
BA_ "GenSigSendType" SG_ 1173 HwRowFrstDrvrSldMotCtrl 0;
BA_ "GenSigSendType" SG_ 800 HwRowThrdLeSldMotCtrl 0;
BA_ "GenSigSendType" SG_ 800 HwRowThrdRiSldMotCtrl 0;
BA_ "GenSigSendType" SG_ 1173 IndicatorIntensityLvl 0;
BA_ "GenSigStartValue" SG_ 1173 IndicatorIntensityLvl 100;
BA_ "GenSigSendType" SG_ 1173 IntLightTreadPlateSupply 0;
BA_ "GenSigSendType" SG_ 1173 IntrBriStsFromIf 0;
BA_ "GenSigSendType" SG_ 1173 IntrLiRoofAUTOIndication 0;
BA_ "GenSigSendType" SG_ 1173 IntrMirrCmdDrvrSide 0;
BA_ "GenSigSendType" SG_ 1173 IntrMirrCmdIntrMirrAsyFanCmpMag 0;
BA_ "GenSigSendType" SG_ 1173 IntrMirrCmdIntrMirrDiagcRst 0;
BA_ "GenSigStartValue" SG_ 1173 IntrMirrCmdIntrMirrDiagcRst 1;
BA_ "GenSigSendType" SG_ 1173 IntrMirrCmdIntrMirrDimSnvty 0;
BA_ "GenSigSendType" SG_ 1173 IntrMirrCmdIntrMirrEna 0;
BA_ "GenSigSendType" SG_ 1173 IntrMirrCmdIntrMirrInhbDim 0;
BA_ "GenSigSendType" SG_ 1173 IntrMirrCmdIntrMirrWindHeatrCmpMag 0;
BA_ "GenSigSendType" SG_ 659 IsgCooltFlowMinReq2 0;
BA_ "GenSigSendType" SG_ 1161 IsgErrIndcnReq 0;
BA_ "GenSigSendType" SG_ 1161 IsgLimnIndcn 0;
BA_ "GenSigStartValue" SG_ 1161 IsgSpdActSgnSafeCntr 1;
BA_ "GenSigStartValue" SG_ 1161 IsgSpdActSgnSafeIsgSpdActSgn800 20000;
BA_ "GenSigSendType" SG_ 1161 IsgTqAvlMax 0;
BA_ "GenSigStartValue" SG_ 1161 IsgTqAvlMax 8188;
BA_ "GenSigSendType" SG_ 1161 IsgTqAvlMin 0;
BA_ "GenSigStartValue" SG_ 1161 IsgTqAvlMin 8188;
BA_ "GenSigDataID" SG_ 1173 LatCtrlModCfmdChks "0x3A";
BA_ "GenSigFuncType" SG_ 1173 LatCtrlModCfmdChks 15;
BA_ "GenSigSendType" SG_ 1173 LatCtrlModCfmdChks 0;
BA_ "GenSigFuncType" SG_ 1173 LatCtrlModCfmdCntr 16;
BA_ "GenSigSendType" SG_ 1173 LatCtrlModCfmdCntr 0;
BA_ "GenSigSendType" SG_ 1173 LatCtrlModCfmdLatCtrlMod 0;
BA_ "GenSigSendType" SG_ 659 LiBattInPWLock 0;
BA_ "GenSigSendType" SG_ 264 LimSts 0;
BA_ "GenSigSendType" SG_ 264 LowrTailgAntiPnch 0;
BA_ "GenSigSendType" SG_ 264 LowrTailgObstclDetn 0;
BA_ "GenSigSendType" SG_ 264 LowrTailgOpenPosn 0;
BA_ "GenSigStartValue" SG_ 264 LowrTailgOpenPosn 101;
BA_ "GenSigSendType" SG_ 264 LowrTailgOpenerSts 0;
BA_ "GenSigSendType" SG_ 264 MirrAdjVceAtPassCmd 0;
BA_ "GenSigSendType" SG_ 264 MirrAtDrvrForVce 0;
BA_ "GenSigSendType" SG_ 1173 MirrDefrstAtDrvrCmd 0;
BA_ "GenSigSendType" SG_ 659 MirrPosnAdjFromSetTarPosnDrvrMirrAdjLeRi 0;
BA_ "GenSigStartValue" SG_ 659 MirrPosnAdjFromSetTarPosnDrvrMirrAdjLeRi 5000;
BA_ "GenSigSendType" SG_ 659 MirrPosnAdjFromSetTarPosnDrvrMirrAdjUpDown 0;
BA_ "GenSigStartValue" SG_ 659 MirrPosnAdjFromSetTarPosnDrvrMirrAdjUpDown 5000;
BA_ "GenSigSendType" SG_ 1173 MirrSeldIndcn 0;
BA_ "GenSigDataID" SG_ 1161 Mot1ReqSafeChks "0x1787";
BA_ "GenSigFuncType" SG_ 1161 Mot1ReqSafeChks 15;
BA_ "GenSigSendType" SG_ 1161 Mot1ReqSafeChks 0;
BA_ "GenSigFuncType" SG_ 1161 Mot1ReqSafeCntr 16;
BA_ "GenSigSendType" SG_ 1161 Mot1ReqSafeCntr 0;
BA_ "GenSigSendType" SG_ 1161 Mot1ReqSafeRsv 0;
BA_ "GenSigSendType" SG_ 1161 Mot1ReqSafemod 0;
BA_ "GenSigSendType" SG_ 1161 Mot1ReqSafespd 0;
BA_ "GenSigSendType" SG_ 1161 Mot1ReqSafetq 0;
BA_ "GenSigStartValue" SG_ 1161 Mot1ReqSafetq 8188;
BA_ "GenSigDataID" SG_ 1161 Mot3ReqSafeChks "0x1788";
BA_ "GenSigFuncType" SG_ 1161 Mot3ReqSafeChks 15;
BA_ "GenSigSendType" SG_ 1161 Mot3ReqSafeChks 0;
BA_ "GenSigFuncType" SG_ 1161 Mot3ReqSafeCntr 16;
BA_ "GenSigSendType" SG_ 1161 Mot3ReqSafeCntr 0;
BA_ "GenSigSendType" SG_ 1161 Mot3ReqSafeRsv 0;
BA_ "GenSigSendType" SG_ 1161 Mot3ReqSafemod 0;
BA_ "GenSigSendType" SG_ 1161 Mot3ReqSafespd 0;
BA_ "GenSigSendType" SG_ 1161 Mot3ReqSafetq 0;
BA_ "GenSigStartValue" SG_ 1161 Mot3ReqSafetq 8188;
BA_ "GenSigDataID" SG_ 264 MotDynCtrlStsReLeChks "0x1A06";
BA_ "GenSigFuncType" SG_ 264 MotDynCtrlStsReLeChks 15;
BA_ "GenSigSendType" SG_ 264 MotDynCtrlStsReLeChks 0;
BA_ "GenSigFuncType" SG_ 264 MotDynCtrlStsReLeCntr 16;
BA_ "GenSigSendType" SG_ 264 MotDynCtrlStsReLeCntr 0;
BA_ "GenSigSendType" SG_ 264 MotDynCtrlStsReLeDmcActAppTarTq 0;
BA_ "GenSigSendType" SG_ 264 MotDynCtrlStsReLeDmcSWInfo 0;
BA_ "GenSigSendType" SG_ 264 MotDynCtrlStsReLeDmcSts 0;
BA_ "GenSigDataID" SG_ 264 MotDynCtrlStsReRiChks "0x1A07";
BA_ "GenSigFuncType" SG_ 264 MotDynCtrlStsReRiChks 15;
BA_ "GenSigSendType" SG_ 264 MotDynCtrlStsReRiChks 0;
BA_ "GenSigFuncType" SG_ 264 MotDynCtrlStsReRiCntr 16;
BA_ "GenSigSendType" SG_ 264 MotDynCtrlStsReRiCntr 0;
BA_ "GenSigSendType" SG_ 264 MotDynCtrlStsReRiDmcActAppTarTq 0;
BA_ "GenSigSendType" SG_ 264 MotDynCtrlStsReRiDmcSWInfo 0;
BA_ "GenSigSendType" SG_ 264 MotDynCtrlStsReRiDmcSts 0;
BA_ "GenSigSendType" SG_ 82 NFCAndBLEKeyDiReqData1 1;
BA_ "GenSigSendType" SG_ 82 NFCAndBLEKeyDiReqData10 1;
BA_ "GenSigSendType" SG_ 82 NFCAndBLEKeyDiReqData11 1;
BA_ "GenSigSendType" SG_ 82 NFCAndBLEKeyDiReqData12 1;
BA_ "GenSigSendType" SG_ 82 NFCAndBLEKeyDiReqData13 1;
BA_ "GenSigSendType" SG_ 82 NFCAndBLEKeyDiReqData14 1;
BA_ "GenSigSendType" SG_ 82 NFCAndBLEKeyDiReqData15 1;
BA_ "GenSigSendType" SG_ 82 NFCAndBLEKeyDiReqData16 1;
BA_ "GenSigSendType" SG_ 82 NFCAndBLEKeyDiReqData2 1;
BA_ "GenSigSendType" SG_ 82 NFCAndBLEKeyDiReqData3 1;
BA_ "GenSigSendType" SG_ 82 NFCAndBLEKeyDiReqData4 1;
BA_ "GenSigSendType" SG_ 82 NFCAndBLEKeyDiReqData5 1;
BA_ "GenSigSendType" SG_ 82 NFCAndBLEKeyDiReqData6 1;
BA_ "GenSigSendType" SG_ 82 NFCAndBLEKeyDiReqData7 1;
BA_ "GenSigSendType" SG_ 82 NFCAndBLEKeyDiReqData8 1;
BA_ "GenSigSendType" SG_ 82 NFCAndBLEKeyDiReqData9 1;
BA_ "GenSigSendType" SG_ 82 NFCKeySearchReqKeyLocn 1;
BA_ "GenSigSendType" SG_ 82 NFCKeySearchReqTirgger 1;
BA_ "GenSigSendType" SG_ 1173 PanicAlrmAcoustReq 0;
BA_ "GenSigSendType" SG_ 1173 PanicAlrmToExtrLiVisReq 0;
BA_ "GenSigSendType" SG_ 1173 PropsEnabfromAlcoLock 0;
BA_ "GenSigSendType" SG_ 67 PrpsnDataEvtACnt 1;
BA_ "GenSigSendType" SG_ 67 PrpsnDataEvtAData1 1;
BA_ "GenSigSendType" SG_ 67 PrpsnDataEvtAData2 1;
BA_ "GenSigSendType" SG_ 67 PrpsnDataEvtAData3 1;
BA_ "GenSigSendType" SG_ 67 PrpsnDataEvtAData4 1;
BA_ "GenSigSendType" SG_ 67 PrpsnDataEvtAData5 1;
BA_ "GenSigSendType" SG_ 67 PrpsnDataEvtAData6 1;
BA_ "GenSigSendType" SG_ 67 PrpsnDataEvtAID 1;
BA_ "GenSigSendType" SG_ 67 PrpsnDataEvtBCnt 1;
BA_ "GenSigSendType" SG_ 67 PrpsnDataEvtBData1 1;
BA_ "GenSigSendType" SG_ 67 PrpsnDataEvtBData2 1;
BA_ "GenSigSendType" SG_ 67 PrpsnDataEvtBData3 1;
BA_ "GenSigSendType" SG_ 67 PrpsnDataEvtBData4 1;
BA_ "GenSigSendType" SG_ 67 PrpsnDataEvtBData5 1;
BA_ "GenSigSendType" SG_ 67 PrpsnDataEvtBData6 1;
BA_ "GenSigSendType" SG_ 67 PrpsnDataEvtBID 1;
BA_ "GenSigSendType" SG_ 659 PrpsnDataPrdACnt 0;
BA_ "GenSigSendType" SG_ 659 PrpsnDataPrdAData1 0;
BA_ "GenSigSendType" SG_ 659 PrpsnDataPrdAData2 0;
BA_ "GenSigSendType" SG_ 659 PrpsnDataPrdAData3 0;
BA_ "GenSigSendType" SG_ 659 PrpsnDataPrdAData4 0;
BA_ "GenSigSendType" SG_ 659 PrpsnDataPrdAData5 0;
BA_ "GenSigSendType" SG_ 659 PrpsnDataPrdAData6 0;
BA_ "GenSigSendType" SG_ 659 PrpsnDataPrdAData7 0;
BA_ "GenSigSendType" SG_ 659 PrpsnDataPrdBCnt 0;
BA_ "GenSigSendType" SG_ 659 PrpsnDataPrdBData1 0;
BA_ "GenSigSendType" SG_ 659 PrpsnDataPrdBData2 0;
BA_ "GenSigSendType" SG_ 659 PrpsnDataPrdBData3 0;
BA_ "GenSigSendType" SG_ 659 PrpsnDataPrdBData4 0;
BA_ "GenSigSendType" SG_ 659 PrpsnDataPrdBData5 0;
BA_ "GenSigSendType" SG_ 659 PrpsnDataPrdBData6 0;
BA_ "GenSigSendType" SG_ 659 PrpsnDataPrdBData7 0;
BA_ "GenSigSendType" SG_ 1173 PtActvnReq1WdPtActvnReq 0;
BA_ "GenSigSendType" SG_ 1161 PtClu0TqReq 0;
BA_ "GenSigSendType" SG_ 1161 PtCluTq2Req 0;
BA_ "GenSigStartValue" SG_ 1161 PtCluTq2Req 1024;
BA_ "GenSigSendType" SG_ 1161 PtCluTqDyn 0;
BA_ "GenSigStartValue" SG_ 1161 PtCluTqDyn 1024;
BA_ "GenSigSendType" SG_ 1161 PtCluTqPtCluTq 0;
BA_ "GenSigStartValue" SG_ 1161 PtCluTqPtCluTq 1024;
BA_ "GenSigSendType" SG_ 1161 PtCluTqQly 0;
BA_ "GenSigSendType" SG_ 264 PtCluTqReq 0;
BA_ "GenSigStartValue" SG_ 264 PtCluTqReq 1024;
BA_ "GenSigSendType" SG_ 659 PtCoolgPostRunActv 0;
BA_ "GenSigSendType" SG_ 1161 PtGearTarReq 0;
BA_ "GenSigSendType" SG_ 1161 PtParkReqToWhlsRe 0;
BA_ "GenSigSendType" SG_ 659 PtTotBrkTqReqPtTotBrkTqEna 0;
BA_ "GenSigSendType" SG_ 659 PtTotBrkTqReqPtTotBrkTqReq 0;
BA_ "GenSigSendType" SG_ 264 PtVehSpdMaxChks 0;
BA_ "GenSigSendType" SG_ 264 PtVehSpdMaxCntr 0;
BA_ "GenSigSendType" SG_ 264 PtVehSpdMaxReq 0;
BA_ "GenSigStartValue" SG_ 264 PtVehSpdMaxReq 250;
BA_ "GenSigSendType" SG_ 1173 PwrCnsVisy 0;
BA_ "GenSigSendType" SG_ 1173 PwrCritDesVisy 0;
BA_ "GenSigSendType" SG_ 1173 PwrEstimdAtStbForVisy 0;
BA_ "GenSigSendType" SG_ 1173 PwrNormDesVisy 0;
BA_ "GenSigSendType" SG_ 1173 RainSensActvn 0;
BA_ "GenSigSendType" SG_ 659 RainSnsrActvnErrToHmi 0;
BA_ "GenSigSendType" SG_ 1173 ReAdaptReq 0;
BA_ "GenSigSendType" SG_ 800 ReEvapVlvReq 0;
BA_ "GenSigSendType" SG_ 1173 RelHumSnsrErr 0;
BA_ "GenSigSendType" SG_ 1173 RemStrtMsgToDrvrRemStrtBlkd1 0;
BA_ "GenSigSendType" SG_ 1173 RemStrtMsgToDrvrRemStrtDev1 0;
BA_ "GenSigSendType" SG_ 1173 RlyActvnForRoofCurtClsAut 0;
BA_ "GenSigSendType" SG_ 264 RoadSgnInfoSts 0;
BA_ "GenSigSendType" SG_ 264 RowSecLeFldRsdSts 0;
BA_ "GenSigSendType" SG_ 264 RowSecLeFldRsdWarn 0;
BA_ "GenSigSendType" SG_ 264 RowSecLeMassgRunng 0;
BA_ "GenSigSendType" SG_ 264 RowSecLeSeatActvSpplFct 0;
BA_ "GenSigSendType" SG_ 264 RowSecLeSeatRotRmn 0;
BA_ "GenSigSendType" SG_ 264 RowSecRiFldRsdWarn 0;
BA_ "GenSigSendType" SG_ 264 RowSecRiMassgRunng 0;
BA_ "GenSigSendType" SG_ 264 RowSecRiSeatActvSpplFct 0;
BA_ "GenSigSendType" SG_ 264 RowSecRiSeatRotRmn 0;
BA_ "GenSigSendType" SG_ 800 SafetyCrashFb 0;
BA_ "GenSigSendType" SG_ 264 SeatMassgFctRowSecLeMassgInten 0;
BA_ "GenSigSendType" SG_ 264 SeatMassgFctRowSecLeMassgProg 0;
BA_ "GenSigSendType" SG_ 264 SeatMassgFctRowSecLeOnOff 0;
BA_ "GenSigSendType" SG_ 264 SeatMassgFctRowSecRiMassgInten 0;
BA_ "GenSigSendType" SG_ 264 SeatMassgFctRowSecRiMassgProg 0;
BA_ "GenSigSendType" SG_ 264 SeatMassgFctRowSecRiOnOff 0;
BA_ "GenSigSendType" SG_ 1173 SecRowLeReadLiReq 0;
BA_ "GenSigSendType" SG_ 1173 SecRowRiReadLiReq 0;
BA_ "GenSigStartValue" SG_ 569 SldngDoorLeRePos 101;
BA_ "GenSigStartValue" SG_ 569 SldngDoorRiRePos 101;
BA_ "GenSigSendType" SG_ 264 SpdLimFirst 0;
BA_ "GenSigSendType" SG_ 1161 SteerExtFctStsChks 0;
BA_ "GenSigSendType" SG_ 1161 SteerExtFctStsCntr 0;
BA_ "GenSigSendType" SG_ 1161 SteerExtFctStsDrvrSteerOvrd 0;
BA_ "GenSigSendType" SG_ 1161 SteerExtFctStsExtFctLowerLimActive 0;
BA_ "GenSigSendType" SG_ 1161 SteerExtFctStsExtFctRateLimActive 0;
BA_ "GenSigSendType" SG_ 1161 SteerExtFctStsExtFctUpperLimActive 0;
BA_ "GenSigSendType" SG_ 1161 SteerExtFctStsExtSafeLimActive 0;
BA_ "GenSigSendType" SG_ 1161 SteerExtFctStsLatAgReqNotInRange 0;
BA_ "GenSigSendType" SG_ 1161 SteerExtFctStsLatCtrlReqNotInRange 0;
BA_ "GenSigSendType" SG_ 1173 SteerLockEnagOfPrpsn 0;
BA_ "GenSigSendType" SG_ 659 SteerLockMgrWarnIndcn 0;
BA_ "GenSigSendType" SG_ 1173 SteerWhlTqAddl 0;
BA_ "GenSigSendType" SG_ 659 StrtRemSts1WdStrtRemSts 0;
BA_ "GenSigSendType" SG_ 1173 StsOfLedHiBeamLe 0;
BA_ "GenSigSendType" SG_ 1173 StsOfLedHiBeamRi 0;
BA_ "GenSigSendType" SG_ 1173 StsOfLedLoBeamLe 0;
BA_ "GenSigSendType" SG_ 1173 StsOfLedLoBeamRi 0;
BA_ "GenSigSendType" SG_ 1173 StsOfSwvlgLe 0;
BA_ "GenSigSendType" SG_ 1173 StsOfSwvlgRi 0;
BA_ "GenSigSendType" SG_ 1173 SunCurtEna 0;
BA_ "GenSigSendType" SG_ 1173 SunRoofAndCurtExtCmd 0;
BA_ "GenSigDataID" SG_ 1161 SuspFailrStsChks "0x5A";
BA_ "GenSigFuncType" SG_ 1161 SuspFailrStsChks 15;
BA_ "GenSigSendType" SG_ 1161 SuspFailrStsChks 0;
BA_ "GenSigFuncType" SG_ 1161 SuspFailrStsCntr 16;
BA_ "GenSigSendType" SG_ 1161 SuspFailrStsCntr 0;
BA_ "GenSigSendType" SG_ 1161 SuspFailrStsSuspFailrSts 0;
BA_ "GenSigSendType" SG_ 1161 SuspFailrStsTypQf 0;
BA_ "GenSigStartValue" SG_ 1161 SuspFailrStsTypQf 1;
BA_ "GenSigSendType" SG_ 1173 SwtBeamHi 0;
BA_ "GenSigSendType" SG_ 1173 SwtLiHzrdWarn 0;
BA_ "GenSigSendType" SG_ 264 TCSCmprStrtFlt 0;
BA_ "GenSigSendType" SG_ 264 TCSFltSts 0;
BA_ "GenSigSendType" SG_ 264 TCSModSwtSts 0;
BA_ "GenSigSendType" SG_ 1173 TankFlapReqFromSwtIntrFild 0;
BA_ "GenSigSendType" SG_ 1161 TqAssAddl 0;
BA_ "GenSigSendType" SG_ 264 TrOpenerByFootOperSts 0;
BA_ "GenSigSendType" SG_ 1173 TrOpenerReqTrOpenerReq 0;
BA_ "GenSigSendType" SG_ 1173 TrOpenerReqTrigSrc 0;
BA_ "GenSigSendType" SG_ 1161 TrlrModVMMFltSts 0;
BA_ "GenSigSendType" SG_ 264 TrlrPrmntPwrActv 0;
BA_ "GenSigStartValue" SG_ 264 TrlrPrmntPwrActv 1;
BA_ "GenSigSendType" SG_ 1161 TrsmActrPosnSafeAuxTrsmActrPosn 0;
BA_ "GenSigStartValue" SG_ 1161 TrsmActrPosnSafeAuxTrsmActrPosn 7;
BA_ "GenSigDataID" SG_ 1161 TrsmActrPosnSafeAuxTrsmActrPosnChks "0x78";
BA_ "GenSigFuncType" SG_ 1161 TrsmActrPosnSafeAuxTrsmActrPosnChks 15;
BA_ "GenSigSendType" SG_ 1161 TrsmActrPosnSafeAuxTrsmActrPosnChks 0;
BA_ "GenSigFuncType" SG_ 1161 TrsmActrPosnSafeAuxTrsmActrPosnCntr 16;
BA_ "GenSigSendType" SG_ 1161 TrsmActrPosnSafeAuxTrsmActrPosnCntr 0;
BA_ "GenSigSendType" SG_ 264 TrsmCluTqCpMaxOfClu0 0;
BA_ "GenSigStartValue" SG_ 264 TrsmCluTqCpMaxOfClu0 1024;
BA_ "GenSigSendType" SG_ 1161 TrsmModNotAvlSts 0;
BA_ "GenSigSendType" SG_ 1161 TrsmNeutFailr 0;
BA_ "GenSigSendType" SG_ 1161 TrsmOilT 0;
BA_ "GenSigStartValue" SG_ 1161 TrsmOilT 60;
BA_ "GenSigSendType" SG_ 1173 TrsmParkLockSt 0;
BA_ "GenSigDataID" SG_ 1161 TrsmTqLossChks "0x6B";
BA_ "GenSigFuncType" SG_ 1161 TrsmTqLossChks 15;
BA_ "GenSigSendType" SG_ 1161 TrsmTqLossChks 0;
BA_ "GenSigFuncType" SG_ 1161 TrsmTqLossCntr 16;
BA_ "GenSigSendType" SG_ 1161 TrsmTqLossCntr 0;
BA_ "GenSigSendType" SG_ 1161 TrsmTqLossTrsmTqEff 0;
BA_ "GenSigSendType" SG_ 1161 TrsmTqLossTrsmTqLoss 0;
BA_ "GenSigSendType" SG_ 1173 TrsmTqRat 0;
BA_ "GenSigSendType" SG_ 264 TrsmWhlProtnMaxTq 0;
BA_ "GenSigSendType" SG_ 264 TrsmWhlProtnMinTq 0;
BA_ "GenSigStartValue" SG_ 264 TrsmWhlProtnMinTq -20000;
BA_ "GenSigSendType" SG_ 264 UpprLowrTailgCtrlInhbFb 0;
BA_ "GenSigSendType" SG_ 800 VFCVectorPOTBlockID 0;
BA_ "GenSigSendType" SG_ 800 VFCVectorPOTVFCid0 0;
BA_ "GenSigSendType" SG_ 800 VFCVectorPOTVFCid1 0;
BA_ "GenSigSendType" SG_ 800 VFCVectorPOTVFCid10 0;
BA_ "GenSigSendType" SG_ 800 VFCVectorPOTVFCid11 0;
BA_ "GenSigSendType" SG_ 800 VFCVectorPOTVFCid12 0;
BA_ "GenSigSendType" SG_ 800 VFCVectorPOTVFCid13 0;
BA_ "GenSigSendType" SG_ 800 VFCVectorPOTVFCid14 0;
BA_ "GenSigSendType" SG_ 800 VFCVectorPOTVFCid15 0;
BA_ "GenSigSendType" SG_ 800 VFCVectorPOTVFCid16 0;
BA_ "GenSigSendType" SG_ 800 VFCVectorPOTVFCid17 0;
BA_ "GenSigSendType" SG_ 800 VFCVectorPOTVFCid18 0;
BA_ "GenSigSendType" SG_ 800 VFCVectorPOTVFCid19 0;
BA_ "GenSigSendType" SG_ 800 VFCVectorPOTVFCid2 0;
BA_ "GenSigSendType" SG_ 800 VFCVectorPOTVFCid20 0;
BA_ "GenSigSendType" SG_ 800 VFCVectorPOTVFCid21 0;
BA_ "GenSigSendType" SG_ 800 VFCVectorPOTVFCid22 0;
BA_ "GenSigSendType" SG_ 800 VFCVectorPOTVFCid23 0;
BA_ "GenSigSendType" SG_ 800 VFCVectorPOTVFCid24 0;
BA_ "GenSigSendType" SG_ 800 VFCVectorPOTVFCid25 0;
BA_ "GenSigSendType" SG_ 800 VFCVectorPOTVFCid26 0;
BA_ "GenSigSendType" SG_ 800 VFCVectorPOTVFCid27 0;
BA_ "GenSigSendType" SG_ 800 VFCVectorPOTVFCid28 0;
BA_ "GenSigSendType" SG_ 800 VFCVectorPOTVFCid29 0;
BA_ "GenSigSendType" SG_ 800 VFCVectorPOTVFCid3 0;
BA_ "GenSigSendType" SG_ 800 VFCVectorPOTVFCid30 0;
BA_ "GenSigSendType" SG_ 800 VFCVectorPOTVFCid31 0;
BA_ "GenSigSendType" SG_ 800 VFCVectorPOTVFCid32 0;
BA_ "GenSigSendType" SG_ 800 VFCVectorPOTVFCid33 0;
BA_ "GenSigSendType" SG_ 800 VFCVectorPOTVFCid34 0;
BA_ "GenSigSendType" SG_ 800 VFCVectorPOTVFCid35 0;
BA_ "GenSigSendType" SG_ 800 VFCVectorPOTVFCid36 0;
BA_ "GenSigSendType" SG_ 800 VFCVectorPOTVFCid37 0;
BA_ "GenSigSendType" SG_ 800 VFCVectorPOTVFCid38 0;
BA_ "GenSigSendType" SG_ 800 VFCVectorPOTVFCid39 0;
BA_ "GenSigSendType" SG_ 800 VFCVectorPOTVFCid4 0;
BA_ "GenSigSendType" SG_ 800 VFCVectorPOTVFCid40 0;
BA_ "GenSigSendType" SG_ 800 VFCVectorPOTVFCid41 0;
BA_ "GenSigSendType" SG_ 800 VFCVectorPOTVFCid42 0;
BA_ "GenSigSendType" SG_ 800 VFCVectorPOTVFCid43 0;
BA_ "GenSigSendType" SG_ 800 VFCVectorPOTVFCid44 0;
BA_ "GenSigSendType" SG_ 800 VFCVectorPOTVFCid45 0;
BA_ "GenSigSendType" SG_ 800 VFCVectorPOTVFCid46 0;
BA_ "GenSigSendType" SG_ 800 VFCVectorPOTVFCid47 0;
BA_ "GenSigSendType" SG_ 800 VFCVectorPOTVFCid48 0;
BA_ "GenSigSendType" SG_ 800 VFCVectorPOTVFCid49 0;
BA_ "GenSigSendType" SG_ 800 VFCVectorPOTVFCid5 0;
BA_ "GenSigSendType" SG_ 800 VFCVectorPOTVFCid50 0;
BA_ "GenSigSendType" SG_ 800 VFCVectorPOTVFCid51 0;
BA_ "GenSigSendType" SG_ 800 VFCVectorPOTVFCid52 0;
BA_ "GenSigSendType" SG_ 800 VFCVectorPOTVFCid53 0;
BA_ "GenSigSendType" SG_ 800 VFCVectorPOTVFCid54 0;
BA_ "GenSigSendType" SG_ 800 VFCVectorPOTVFCid55 0;
BA_ "GenSigSendType" SG_ 800 VFCVectorPOTVFCid56 0;
BA_ "GenSigSendType" SG_ 800 VFCVectorPOTVFCid57 0;
BA_ "GenSigSendType" SG_ 800 VFCVectorPOTVFCid58 0;
BA_ "GenSigSendType" SG_ 800 VFCVectorPOTVFCid59 0;
BA_ "GenSigSendType" SG_ 800 VFCVectorPOTVFCid6 0;
BA_ "GenSigSendType" SG_ 800 VFCVectorPOTVFCid60 0;
BA_ "GenSigSendType" SG_ 800 VFCVectorPOTVFCid61 0;
BA_ "GenSigSendType" SG_ 800 VFCVectorPOTVFCid7 0;
BA_ "GenSigSendType" SG_ 800 VFCVectorPOTVFCid8 0;
BA_ "GenSigSendType" SG_ 800 VFCVectorPOTVFCid9 0;
BA_ "GenSigSendType" SG_ 800 VFCVectorRBCMBlockID 0;
BA_ "GenSigSendType" SG_ 800 VFCVectorRBCMVFCid0 0;
BA_ "GenSigSendType" SG_ 800 VFCVectorRBCMVFCid1 0;
BA_ "GenSigSendType" SG_ 800 VFCVectorRBCMVFCid10 0;
BA_ "GenSigSendType" SG_ 800 VFCVectorRBCMVFCid11 0;
BA_ "GenSigSendType" SG_ 800 VFCVectorRBCMVFCid12 0;
BA_ "GenSigSendType" SG_ 800 VFCVectorRBCMVFCid13 0;
BA_ "GenSigSendType" SG_ 800 VFCVectorRBCMVFCid14 0;
BA_ "GenSigSendType" SG_ 800 VFCVectorRBCMVFCid15 0;
BA_ "GenSigSendType" SG_ 800 VFCVectorRBCMVFCid16 0;
BA_ "GenSigSendType" SG_ 800 VFCVectorRBCMVFCid17 0;
BA_ "GenSigSendType" SG_ 800 VFCVectorRBCMVFCid18 0;
BA_ "GenSigSendType" SG_ 800 VFCVectorRBCMVFCid19 0;
BA_ "GenSigSendType" SG_ 800 VFCVectorRBCMVFCid2 0;
BA_ "GenSigSendType" SG_ 800 VFCVectorRBCMVFCid20 0;
BA_ "GenSigSendType" SG_ 800 VFCVectorRBCMVFCid21 0;
BA_ "GenSigSendType" SG_ 800 VFCVectorRBCMVFCid22 0;
BA_ "GenSigSendType" SG_ 800 VFCVectorRBCMVFCid23 0;
BA_ "GenSigSendType" SG_ 800 VFCVectorRBCMVFCid24 0;
BA_ "GenSigSendType" SG_ 800 VFCVectorRBCMVFCid25 0;
BA_ "GenSigSendType" SG_ 800 VFCVectorRBCMVFCid26 0;
BA_ "GenSigSendType" SG_ 800 VFCVectorRBCMVFCid27 0;
BA_ "GenSigSendType" SG_ 800 VFCVectorRBCMVFCid28 0;
BA_ "GenSigSendType" SG_ 800 VFCVectorRBCMVFCid29 0;
BA_ "GenSigSendType" SG_ 800 VFCVectorRBCMVFCid3 0;
BA_ "GenSigSendType" SG_ 800 VFCVectorRBCMVFCid30 0;
BA_ "GenSigSendType" SG_ 800 VFCVectorRBCMVFCid31 0;
BA_ "GenSigSendType" SG_ 800 VFCVectorRBCMVFCid32 0;
BA_ "GenSigSendType" SG_ 800 VFCVectorRBCMVFCid33 0;
BA_ "GenSigSendType" SG_ 800 VFCVectorRBCMVFCid34 0;
BA_ "GenSigSendType" SG_ 800 VFCVectorRBCMVFCid35 0;
BA_ "GenSigSendType" SG_ 800 VFCVectorRBCMVFCid36 0;
BA_ "GenSigSendType" SG_ 800 VFCVectorRBCMVFCid37 0;
BA_ "GenSigSendType" SG_ 800 VFCVectorRBCMVFCid38 0;
BA_ "GenSigSendType" SG_ 800 VFCVectorRBCMVFCid39 0;
BA_ "GenSigSendType" SG_ 800 VFCVectorRBCMVFCid4 0;
BA_ "GenSigSendType" SG_ 800 VFCVectorRBCMVFCid40 0;
BA_ "GenSigSendType" SG_ 800 VFCVectorRBCMVFCid41 0;
BA_ "GenSigSendType" SG_ 800 VFCVectorRBCMVFCid42 0;
BA_ "GenSigSendType" SG_ 800 VFCVectorRBCMVFCid43 0;
BA_ "GenSigSendType" SG_ 800 VFCVectorRBCMVFCid44 0;
BA_ "GenSigSendType" SG_ 800 VFCVectorRBCMVFCid45 0;
BA_ "GenSigSendType" SG_ 800 VFCVectorRBCMVFCid46 0;
BA_ "GenSigSendType" SG_ 800 VFCVectorRBCMVFCid47 0;
BA_ "GenSigSendType" SG_ 800 VFCVectorRBCMVFCid48 0;
BA_ "GenSigSendType" SG_ 800 VFCVectorRBCMVFCid49 0;
BA_ "GenSigSendType" SG_ 800 VFCVectorRBCMVFCid5 0;
BA_ "GenSigSendType" SG_ 800 VFCVectorRBCMVFCid50 0;
BA_ "GenSigSendType" SG_ 800 VFCVectorRBCMVFCid51 0;
BA_ "GenSigSendType" SG_ 800 VFCVectorRBCMVFCid52 0;
BA_ "GenSigSendType" SG_ 800 VFCVectorRBCMVFCid53 0;
BA_ "GenSigSendType" SG_ 800 VFCVectorRBCMVFCid54 0;
BA_ "GenSigSendType" SG_ 800 VFCVectorRBCMVFCid55 0;
BA_ "GenSigSendType" SG_ 800 VFCVectorRBCMVFCid56 0;
BA_ "GenSigSendType" SG_ 800 VFCVectorRBCMVFCid57 0;
BA_ "GenSigSendType" SG_ 800 VFCVectorRBCMVFCid58 0;
BA_ "GenSigSendType" SG_ 800 VFCVectorRBCMVFCid59 0;
BA_ "GenSigSendType" SG_ 800 VFCVectorRBCMVFCid6 0;
BA_ "GenSigSendType" SG_ 800 VFCVectorRBCMVFCid60 0;
BA_ "GenSigSendType" SG_ 800 VFCVectorRBCMVFCid61 0;
BA_ "GenSigSendType" SG_ 800 VFCVectorRBCMVFCid7 0;
BA_ "GenSigSendType" SG_ 800 VFCVectorRBCMVFCid8 0;
BA_ "GenSigSendType" SG_ 800 VFCVectorRBCMVFCid9 0;
BA_ "GenSigSendType" SG_ 800 VFCVectorSRSBlockID 0;
BA_ "GenSigSendType" SG_ 800 VFCVectorSRSVFCid0 0;
BA_ "GenSigSendType" SG_ 800 VFCVectorSRSVFCid1 0;
BA_ "GenSigSendType" SG_ 800 VFCVectorSRSVFCid10 0;
BA_ "GenSigSendType" SG_ 800 VFCVectorSRSVFCid11 0;
BA_ "GenSigSendType" SG_ 800 VFCVectorSRSVFCid12 0;
BA_ "GenSigSendType" SG_ 800 VFCVectorSRSVFCid13 0;
BA_ "GenSigSendType" SG_ 800 VFCVectorSRSVFCid14 0;
BA_ "GenSigSendType" SG_ 800 VFCVectorSRSVFCid15 0;
BA_ "GenSigSendType" SG_ 800 VFCVectorSRSVFCid16 0;
BA_ "GenSigSendType" SG_ 800 VFCVectorSRSVFCid17 0;
BA_ "GenSigSendType" SG_ 800 VFCVectorSRSVFCid18 0;
BA_ "GenSigSendType" SG_ 800 VFCVectorSRSVFCid19 0;
BA_ "GenSigSendType" SG_ 800 VFCVectorSRSVFCid2 0;
BA_ "GenSigSendType" SG_ 800 VFCVectorSRSVFCid20 0;
BA_ "GenSigSendType" SG_ 800 VFCVectorSRSVFCid21 0;
BA_ "GenSigSendType" SG_ 800 VFCVectorSRSVFCid22 0;
BA_ "GenSigSendType" SG_ 800 VFCVectorSRSVFCid23 0;
BA_ "GenSigSendType" SG_ 800 VFCVectorSRSVFCid24 0;
BA_ "GenSigSendType" SG_ 800 VFCVectorSRSVFCid25 0;
BA_ "GenSigSendType" SG_ 800 VFCVectorSRSVFCid26 0;
BA_ "GenSigSendType" SG_ 800 VFCVectorSRSVFCid27 0;
BA_ "GenSigSendType" SG_ 800 VFCVectorSRSVFCid28 0;
BA_ "GenSigSendType" SG_ 800 VFCVectorSRSVFCid29 0;
BA_ "GenSigSendType" SG_ 800 VFCVectorSRSVFCid3 0;
BA_ "GenSigSendType" SG_ 800 VFCVectorSRSVFCid30 0;
BA_ "GenSigSendType" SG_ 800 VFCVectorSRSVFCid31 0;
BA_ "GenSigSendType" SG_ 800 VFCVectorSRSVFCid32 0;
BA_ "GenSigSendType" SG_ 800 VFCVectorSRSVFCid33 0;
BA_ "GenSigSendType" SG_ 800 VFCVectorSRSVFCid34 0;
BA_ "GenSigSendType" SG_ 800 VFCVectorSRSVFCid35 0;
BA_ "GenSigSendType" SG_ 800 VFCVectorSRSVFCid36 0;
BA_ "GenSigSendType" SG_ 800 VFCVectorSRSVFCid37 0;
BA_ "GenSigSendType" SG_ 800 VFCVectorSRSVFCid38 0;
BA_ "GenSigSendType" SG_ 800 VFCVectorSRSVFCid39 0;
BA_ "GenSigSendType" SG_ 800 VFCVectorSRSVFCid4 0;
BA_ "GenSigSendType" SG_ 800 VFCVectorSRSVFCid40 0;
BA_ "GenSigSendType" SG_ 800 VFCVectorSRSVFCid41 0;
BA_ "GenSigSendType" SG_ 800 VFCVectorSRSVFCid42 0;
BA_ "GenSigSendType" SG_ 800 VFCVectorSRSVFCid43 0;
BA_ "GenSigSendType" SG_ 800 VFCVectorSRSVFCid44 0;
BA_ "GenSigSendType" SG_ 800 VFCVectorSRSVFCid45 0;
BA_ "GenSigSendType" SG_ 800 VFCVectorSRSVFCid46 0;
BA_ "GenSigSendType" SG_ 800 VFCVectorSRSVFCid47 0;
BA_ "GenSigSendType" SG_ 800 VFCVectorSRSVFCid48 0;
BA_ "GenSigSendType" SG_ 800 VFCVectorSRSVFCid49 0;
BA_ "GenSigSendType" SG_ 800 VFCVectorSRSVFCid5 0;
BA_ "GenSigSendType" SG_ 800 VFCVectorSRSVFCid50 0;
BA_ "GenSigSendType" SG_ 800 VFCVectorSRSVFCid51 0;
BA_ "GenSigSendType" SG_ 800 VFCVectorSRSVFCid52 0;
BA_ "GenSigSendType" SG_ 800 VFCVectorSRSVFCid53 0;
BA_ "GenSigSendType" SG_ 800 VFCVectorSRSVFCid54 0;
BA_ "GenSigSendType" SG_ 800 VFCVectorSRSVFCid55 0;
BA_ "GenSigSendType" SG_ 800 VFCVectorSRSVFCid56 0;
BA_ "GenSigSendType" SG_ 800 VFCVectorSRSVFCid57 0;
BA_ "GenSigSendType" SG_ 800 VFCVectorSRSVFCid58 0;
BA_ "GenSigSendType" SG_ 800 VFCVectorSRSVFCid59 0;
BA_ "GenSigSendType" SG_ 800 VFCVectorSRSVFCid6 0;
BA_ "GenSigSendType" SG_ 800 VFCVectorSRSVFCid60 0;
BA_ "GenSigSendType" SG_ 800 VFCVectorSRSVFCid61 0;
BA_ "GenSigSendType" SG_ 800 VFCVectorSRSVFCid7 0;
BA_ "GenSigSendType" SG_ 800 VFCVectorSRSVFCid8 0;
BA_ "GenSigSendType" SG_ 800 VFCVectorSRSVFCid9 0;
BA_ "GenSigSendType" SG_ 800 VFCVectorSUMBlockID 0;
BA_ "GenSigSendType" SG_ 800 VFCVectorSUMVFCid0 0;
BA_ "GenSigSendType" SG_ 800 VFCVectorSUMVFCid1 0;
BA_ "GenSigSendType" SG_ 800 VFCVectorSUMVFCid10 0;
BA_ "GenSigSendType" SG_ 800 VFCVectorSUMVFCid11 0;
BA_ "GenSigSendType" SG_ 800 VFCVectorSUMVFCid12 0;
BA_ "GenSigSendType" SG_ 800 VFCVectorSUMVFCid13 0;
BA_ "GenSigSendType" SG_ 800 VFCVectorSUMVFCid14 0;
BA_ "GenSigSendType" SG_ 800 VFCVectorSUMVFCid15 0;
BA_ "GenSigSendType" SG_ 800 VFCVectorSUMVFCid16 0;
BA_ "GenSigSendType" SG_ 800 VFCVectorSUMVFCid17 0;
BA_ "GenSigSendType" SG_ 800 VFCVectorSUMVFCid18 0;
BA_ "GenSigSendType" SG_ 800 VFCVectorSUMVFCid19 0;
BA_ "GenSigSendType" SG_ 800 VFCVectorSUMVFCid2 0;
BA_ "GenSigSendType" SG_ 800 VFCVectorSUMVFCid20 0;
BA_ "GenSigSendType" SG_ 800 VFCVectorSUMVFCid21 0;
BA_ "GenSigSendType" SG_ 800 VFCVectorSUMVFCid22 0;
BA_ "GenSigSendType" SG_ 800 VFCVectorSUMVFCid23 0;
BA_ "GenSigSendType" SG_ 800 VFCVectorSUMVFCid24 0;
BA_ "GenSigSendType" SG_ 800 VFCVectorSUMVFCid25 0;
BA_ "GenSigSendType" SG_ 800 VFCVectorSUMVFCid26 0;
BA_ "GenSigSendType" SG_ 800 VFCVectorSUMVFCid27 0;
BA_ "GenSigSendType" SG_ 800 VFCVectorSUMVFCid28 0;
BA_ "GenSigSendType" SG_ 800 VFCVectorSUMVFCid29 0;
BA_ "GenSigSendType" SG_ 800 VFCVectorSUMVFCid3 0;
BA_ "GenSigSendType" SG_ 800 VFCVectorSUMVFCid30 0;
BA_ "GenSigSendType" SG_ 800 VFCVectorSUMVFCid31 0;
BA_ "GenSigSendType" SG_ 800 VFCVectorSUMVFCid32 0;
BA_ "GenSigSendType" SG_ 800 VFCVectorSUMVFCid33 0;
BA_ "GenSigSendType" SG_ 800 VFCVectorSUMVFCid34 0;
BA_ "GenSigSendType" SG_ 800 VFCVectorSUMVFCid35 0;
BA_ "GenSigSendType" SG_ 800 VFCVectorSUMVFCid36 0;
BA_ "GenSigSendType" SG_ 800 VFCVectorSUMVFCid37 0;
BA_ "GenSigSendType" SG_ 800 VFCVectorSUMVFCid38 0;
BA_ "GenSigSendType" SG_ 800 VFCVectorSUMVFCid39 0;
BA_ "GenSigSendType" SG_ 800 VFCVectorSUMVFCid4 0;
BA_ "GenSigSendType" SG_ 800 VFCVectorSUMVFCid40 0;
BA_ "GenSigSendType" SG_ 800 VFCVectorSUMVFCid41 0;
BA_ "GenSigSendType" SG_ 800 VFCVectorSUMVFCid42 0;
BA_ "GenSigSendType" SG_ 800 VFCVectorSUMVFCid43 0;
BA_ "GenSigSendType" SG_ 800 VFCVectorSUMVFCid44 0;
BA_ "GenSigSendType" SG_ 800 VFCVectorSUMVFCid45 0;
BA_ "GenSigSendType" SG_ 800 VFCVectorSUMVFCid46 0;
BA_ "GenSigSendType" SG_ 800 VFCVectorSUMVFCid47 0;
BA_ "GenSigSendType" SG_ 800 VFCVectorSUMVFCid48 0;
BA_ "GenSigSendType" SG_ 800 VFCVectorSUMVFCid49 0;
BA_ "GenSigSendType" SG_ 800 VFCVectorSUMVFCid5 0;
BA_ "GenSigSendType" SG_ 800 VFCVectorSUMVFCid50 0;
BA_ "GenSigSendType" SG_ 800 VFCVectorSUMVFCid51 0;
BA_ "GenSigSendType" SG_ 800 VFCVectorSUMVFCid52 0;
BA_ "GenSigSendType" SG_ 800 VFCVectorSUMVFCid53 0;
BA_ "GenSigSendType" SG_ 800 VFCVectorSUMVFCid54 0;
BA_ "GenSigSendType" SG_ 800 VFCVectorSUMVFCid55 0;
BA_ "GenSigSendType" SG_ 800 VFCVectorSUMVFCid56 0;
BA_ "GenSigSendType" SG_ 800 VFCVectorSUMVFCid57 0;
BA_ "GenSigSendType" SG_ 800 VFCVectorSUMVFCid58 0;
BA_ "GenSigSendType" SG_ 800 VFCVectorSUMVFCid59 0;
BA_ "GenSigSendType" SG_ 800 VFCVectorSUMVFCid6 0;
BA_ "GenSigSendType" SG_ 800 VFCVectorSUMVFCid60 0;
BA_ "GenSigSendType" SG_ 800 VFCVectorSUMVFCid61 0;
BA_ "GenSigSendType" SG_ 800 VFCVectorSUMVFCid7 0;
BA_ "GenSigSendType" SG_ 800 VFCVectorSUMVFCid8 0;
BA_ "GenSigSendType" SG_ 800 VFCVectorSUMVFCid9 0;
BA_ "GenSigSendType" SG_ 659 VehPropSts 0;
BA_ "GenSigSendType" SG_ 1173 WiprActv 0;
BA_ "GenSigSendType" SG_ 1173 WiprInWipgAr 0;
BA_ "GenSigSendType" SG_ 1173 WiprMotFrntLvrCmdSafeLvrInHiSpdPosnSafe 0;
BA_ "GenSigStartValue" SG_ 1173 WiprMotFrntLvrCmdSafeLvrInHiSpdPosnSafe 1;
BA_ "GenSigSendType" SG_ 1173 WiprMotFrntLvrCmdSafeLvrInIntlPosn 0;
BA_ "GenSigSendType" SG_ 1173 WiprMotFrntLvrCmdSafeLvrInLoSpdPosnSafe 0;
BA_ "GenSigStartValue" SG_ 1173 WiprMotFrntLvrCmdSafeLvrInLoSpdPosnSafe 1;
BA_ "GenSigSendType" SG_ 1173 WiprMotFrntLvrCmdSafeLvrInSnglStrokePos 0;
BA_ "GenSigSendType" SG_ 659 WiprSysFailrDetdSafe 0;
BA_ "GenSigStartValue" SG_ 659 WiprSysFailrDetdSafe 1;
BA_ "GenSigSendType" SG_ 1161 WrmUpCyc 0;
BA_ "GenSigSendType" SG_ 659 WshrFldTankStsToHMI 0;
VAL_ 800 EngCrashFb 0 "CrashFb_Idle" 1 "CrashFb_Evln" 2 "CrashFb_Nok" 3 "CrashFb_Ok";
VAL_ 800 HvCooltHeatrEnadWhE2EHvchEnad 0 "Boolean_FALSE" 1 "Boolean_TRUE";
VAL_ 800 HwRowThrdLeSldMotCtrl 0 "SwtHozlSts1_Idle" 1 "SwtHozlSts1_Fwd" 2 "SwtHozlSts1_Backw";
VAL_ 800 HwRowThrdRiSldMotCtrl 0 "SwtHozlSts1_Idle" 1 "SwtHozlSts1_Fwd" 2 "SwtHozlSts1_Backw";
VAL_ 800 ReEvapVlvReq 0 "OnOff1_Off" 1 "OnOff1_On";
VAL_ 800 SafetyCrashFb 0 "CrashFb_Idle" 1 "CrashFb_Evln" 2 "CrashFb_Nok" 3 "CrashFb_Ok";
VAL_ 800 VFCVectorPOTVFCid0 0 "VFCOnOff_Off" 1 "VFCOnOff_On";
VAL_ 800 VFCVectorPOTVFCid1 0 "VFCOnOff_Off" 1 "VFCOnOff_On";
VAL_ 800 VFCVectorPOTVFCid10 0 "VFCOnOff_Off" 1 "VFCOnOff_On";
VAL_ 800 VFCVectorPOTVFCid11 0 "VFCOnOff_Off" 1 "VFCOnOff_On";
VAL_ 800 VFCVectorPOTVFCid12 0 "VFCOnOff_Off" 1 "VFCOnOff_On";
VAL_ 800 VFCVectorPOTVFCid13 0 "VFCOnOff_Off" 1 "VFCOnOff_On";
VAL_ 800 VFCVectorPOTVFCid14 0 "VFCOnOff_Off" 1 "VFCOnOff_On";
VAL_ 800 VFCVectorPOTVFCid15 0 "VFCOnOff_Off" 1 "VFCOnOff_On";
VAL_ 800 VFCVectorPOTVFCid16 0 "VFCOnOff_Off" 1 "VFCOnOff_On";
VAL_ 800 VFCVectorPOTVFCid17 0 "VFCOnOff_Off" 1 "VFCOnOff_On";
VAL_ 800 VFCVectorPOTVFCid18 0 "VFCOnOff_Off" 1 "VFCOnOff_On";
VAL_ 800 VFCVectorPOTVFCid19 0 "VFCOnOff_Off" 1 "VFCOnOff_On";
VAL_ 800 VFCVectorPOTVFCid2 0 "VFCOnOff_Off" 1 "VFCOnOff_On";
VAL_ 800 VFCVectorPOTVFCid20 0 "VFCOnOff_Off" 1 "VFCOnOff_On";
VAL_ 800 VFCVectorPOTVFCid21 0 "VFCOnOff_Off" 1 "VFCOnOff_On";
VAL_ 800 VFCVectorPOTVFCid22 0 "VFCOnOff_Off" 1 "VFCOnOff_On";
VAL_ 800 VFCVectorPOTVFCid23 0 "VFCOnOff_Off" 1 "VFCOnOff_On";
VAL_ 800 VFCVectorPOTVFCid24 0 "VFCOnOff_Off" 1 "VFCOnOff_On";
VAL_ 800 VFCVectorPOTVFCid25 0 "VFCOnOff_Off" 1 "VFCOnOff_On";
VAL_ 800 VFCVectorPOTVFCid26 0 "VFCOnOff_Off" 1 "VFCOnOff_On";
VAL_ 800 VFCVectorPOTVFCid27 0 "VFCOnOff_Off" 1 "VFCOnOff_On";
VAL_ 800 VFCVectorPOTVFCid28 0 "VFCOnOff_Off" 1 "VFCOnOff_On";
VAL_ 800 VFCVectorPOTVFCid29 0 "VFCOnOff_Off" 1 "VFCOnOff_On";
VAL_ 800 VFCVectorPOTVFCid3 0 "VFCOnOff_Off" 1 "VFCOnOff_On";
VAL_ 800 VFCVectorPOTVFCid30 0 "VFCOnOff_Off" 1 "VFCOnOff_On";
VAL_ 800 VFCVectorPOTVFCid31 0 "VFCOnOff_Off" 1 "VFCOnOff_On";
VAL_ 800 VFCVectorPOTVFCid32 0 "VFCOnOff_Off" 1 "VFCOnOff_On";
VAL_ 800 VFCVectorPOTVFCid33 0 "VFCOnOff_Off" 1 "VFCOnOff_On";
VAL_ 800 VFCVectorPOTVFCid34 0 "VFCOnOff_Off" 1 "VFCOnOff_On";
VAL_ 800 VFCVectorPOTVFCid35 0 "VFCOnOff_Off" 1 "VFCOnOff_On";
VAL_ 800 VFCVectorPOTVFCid36 0 "VFCOnOff_Off" 1 "VFCOnOff_On";
VAL_ 800 VFCVectorPOTVFCid37 0 "VFCOnOff_Off" 1 "VFCOnOff_On";
VAL_ 800 VFCVectorPOTVFCid38 0 "VFCOnOff_Off" 1 "VFCOnOff_On";
VAL_ 800 VFCVectorPOTVFCid39 0 "VFCOnOff_Off" 1 "VFCOnOff_On";
VAL_ 800 VFCVectorPOTVFCid4 0 "VFCOnOff_Off" 1 "VFCOnOff_On";
VAL_ 800 VFCVectorPOTVFCid40 0 "VFCOnOff_Off" 1 "VFCOnOff_On";
VAL_ 800 VFCVectorPOTVFCid41 0 "VFCOnOff_Off" 1 "VFCOnOff_On";
VAL_ 800 VFCVectorPOTVFCid42 0 "VFCOnOff_Off" 1 "VFCOnOff_On";
VAL_ 800 VFCVectorPOTVFCid43 0 "VFCOnOff_Off" 1 "VFCOnOff_On";
VAL_ 800 VFCVectorPOTVFCid44 0 "VFCOnOff_Off" 1 "VFCOnOff_On";
VAL_ 800 VFCVectorPOTVFCid45 0 "VFCOnOff_Off" 1 "VFCOnOff_On";
VAL_ 800 VFCVectorPOTVFCid46 0 "VFCOnOff_Off" 1 "VFCOnOff_On";
VAL_ 800 VFCVectorPOTVFCid47 0 "VFCOnOff_Off" 1 "VFCOnOff_On";
VAL_ 800 VFCVectorPOTVFCid48 0 "VFCOnOff_Off" 1 "VFCOnOff_On";
VAL_ 800 VFCVectorPOTVFCid49 0 "VFCOnOff_Off" 1 "VFCOnOff_On";
VAL_ 800 VFCVectorPOTVFCid5 0 "VFCOnOff_Off" 1 "VFCOnOff_On";
VAL_ 800 VFCVectorPOTVFCid50 0 "VFCOnOff_Off" 1 "VFCOnOff_On";
VAL_ 800 VFCVectorPOTVFCid51 0 "VFCOnOff_Off" 1 "VFCOnOff_On";
VAL_ 800 VFCVectorPOTVFCid52 0 "VFCOnOff_Off" 1 "VFCOnOff_On";
VAL_ 800 VFCVectorPOTVFCid53 0 "VFCOnOff_Off" 1 "VFCOnOff_On";
VAL_ 800 VFCVectorPOTVFCid54 0 "VFCOnOff_Off" 1 "VFCOnOff_On";
VAL_ 800 VFCVectorPOTVFCid55 0 "VFCOnOff_Off" 1 "VFCOnOff_On";
VAL_ 800 VFCVectorPOTVFCid56 0 "VFCOnOff_Off" 1 "VFCOnOff_On";
VAL_ 800 VFCVectorPOTVFCid57 0 "VFCOnOff_Off" 1 "VFCOnOff_On";
VAL_ 800 VFCVectorPOTVFCid58 0 "VFCOnOff_Off" 1 "VFCOnOff_On";
VAL_ 800 VFCVectorPOTVFCid59 0 "VFCOnOff_Off" 1 "VFCOnOff_On";
VAL_ 800 VFCVectorPOTVFCid6 0 "VFCOnOff_Off" 1 "VFCOnOff_On";
VAL_ 800 VFCVectorPOTVFCid60 0 "VFCOnOff_Off" 1 "VFCOnOff_On";
VAL_ 800 VFCVectorPOTVFCid61 0 "VFCOnOff_Off" 1 "VFCOnOff_On";
VAL_ 800 VFCVectorPOTVFCid7 0 "VFCOnOff_Off" 1 "VFCOnOff_On";
VAL_ 800 VFCVectorPOTVFCid8 0 "VFCOnOff_Off" 1 "VFCOnOff_On";
VAL_ 800 VFCVectorPOTVFCid9 0 "VFCOnOff_Off" 1 "VFCOnOff_On";
VAL_ 800 VFCVectorRBCMVFCid0 0 "VFCOnOff_Off" 1 "VFCOnOff_On";
VAL_ 800 VFCVectorRBCMVFCid1 0 "VFCOnOff_Off" 1 "VFCOnOff_On";
VAL_ 800 VFCVectorRBCMVFCid10 0 "VFCOnOff_Off" 1 "VFCOnOff_On";
VAL_ 800 VFCVectorRBCMVFCid11 0 "VFCOnOff_Off" 1 "VFCOnOff_On";
VAL_ 800 VFCVectorRBCMVFCid12 0 "VFCOnOff_Off" 1 "VFCOnOff_On";
VAL_ 800 VFCVectorRBCMVFCid13 0 "VFCOnOff_Off" 1 "VFCOnOff_On";
VAL_ 800 VFCVectorRBCMVFCid14 0 "VFCOnOff_Off" 1 "VFCOnOff_On";
VAL_ 800 VFCVectorRBCMVFCid15 0 "VFCOnOff_Off" 1 "VFCOnOff_On";
VAL_ 800 VFCVectorRBCMVFCid16 0 "VFCOnOff_Off" 1 "VFCOnOff_On";
VAL_ 800 VFCVectorRBCMVFCid17 0 "VFCOnOff_Off" 1 "VFCOnOff_On";
VAL_ 800 VFCVectorRBCMVFCid18 0 "VFCOnOff_Off" 1 "VFCOnOff_On";
VAL_ 800 VFCVectorRBCMVFCid19 0 "VFCOnOff_Off" 1 "VFCOnOff_On";
VAL_ 800 VFCVectorRBCMVFCid2 0 "VFCOnOff_Off" 1 "VFCOnOff_On";
VAL_ 800 VFCVectorRBCMVFCid20 0 "VFCOnOff_Off" 1 "VFCOnOff_On";
VAL_ 800 VFCVectorRBCMVFCid21 0 "VFCOnOff_Off" 1 "VFCOnOff_On";
VAL_ 800 VFCVectorRBCMVFCid22 0 "VFCOnOff_Off" 1 "VFCOnOff_On";
VAL_ 800 VFCVectorRBCMVFCid23 0 "VFCOnOff_Off" 1 "VFCOnOff_On";
VAL_ 800 VFCVectorRBCMVFCid24 0 "VFCOnOff_Off" 1 "VFCOnOff_On";
VAL_ 800 VFCVectorRBCMVFCid25 0 "VFCOnOff_Off" 1 "VFCOnOff_On";
VAL_ 800 VFCVectorRBCMVFCid26 0 "VFCOnOff_Off" 1 "VFCOnOff_On";
VAL_ 800 VFCVectorRBCMVFCid27 0 "VFCOnOff_Off" 1 "VFCOnOff_On";
VAL_ 800 VFCVectorRBCMVFCid28 0 "VFCOnOff_Off" 1 "VFCOnOff_On";
VAL_ 800 VFCVectorRBCMVFCid29 0 "VFCOnOff_Off" 1 "VFCOnOff_On";
VAL_ 800 VFCVectorRBCMVFCid3 0 "VFCOnOff_Off" 1 "VFCOnOff_On";
VAL_ 800 VFCVectorRBCMVFCid30 0 "VFCOnOff_Off" 1 "VFCOnOff_On";
VAL_ 800 VFCVectorRBCMVFCid31 0 "VFCOnOff_Off" 1 "VFCOnOff_On";
VAL_ 800 VFCVectorRBCMVFCid32 0 "VFCOnOff_Off" 1 "VFCOnOff_On";
VAL_ 800 VFCVectorRBCMVFCid33 0 "VFCOnOff_Off" 1 "VFCOnOff_On";
VAL_ 800 VFCVectorRBCMVFCid34 0 "VFCOnOff_Off" 1 "VFCOnOff_On";
VAL_ 800 VFCVectorRBCMVFCid35 0 "VFCOnOff_Off" 1 "VFCOnOff_On";
VAL_ 800 VFCVectorRBCMVFCid36 0 "VFCOnOff_Off" 1 "VFCOnOff_On";
VAL_ 800 VFCVectorRBCMVFCid37 0 "VFCOnOff_Off" 1 "VFCOnOff_On";
VAL_ 800 VFCVectorRBCMVFCid38 0 "VFCOnOff_Off" 1 "VFCOnOff_On";
VAL_ 800 VFCVectorRBCMVFCid39 0 "VFCOnOff_Off" 1 "VFCOnOff_On";
VAL_ 800 VFCVectorRBCMVFCid4 0 "VFCOnOff_Off" 1 "VFCOnOff_On";
VAL_ 800 VFCVectorRBCMVFCid40 0 "VFCOnOff_Off" 1 "VFCOnOff_On";
VAL_ 800 VFCVectorRBCMVFCid41 0 "VFCOnOff_Off" 1 "VFCOnOff_On";
VAL_ 800 VFCVectorRBCMVFCid42 0 "VFCOnOff_Off" 1 "VFCOnOff_On";
VAL_ 800 VFCVectorRBCMVFCid43 0 "VFCOnOff_Off" 1 "VFCOnOff_On";
VAL_ 800 VFCVectorRBCMVFCid44 0 "VFCOnOff_Off" 1 "VFCOnOff_On";
VAL_ 800 VFCVectorRBCMVFCid45 0 "VFCOnOff_Off" 1 "VFCOnOff_On";
VAL_ 800 VFCVectorRBCMVFCid46 0 "VFCOnOff_Off" 1 "VFCOnOff_On";
VAL_ 800 VFCVectorRBCMVFCid47 0 "VFCOnOff_Off" 1 "VFCOnOff_On";
VAL_ 800 VFCVectorRBCMVFCid48 0 "VFCOnOff_Off" 1 "VFCOnOff_On";
VAL_ 800 VFCVectorRBCMVFCid49 0 "VFCOnOff_Off" 1 "VFCOnOff_On";
VAL_ 800 VFCVectorRBCMVFCid5 0 "VFCOnOff_Off" 1 "VFCOnOff_On";
VAL_ 800 VFCVectorRBCMVFCid50 0 "VFCOnOff_Off" 1 "VFCOnOff_On";
VAL_ 800 VFCVectorRBCMVFCid51 0 "VFCOnOff_Off" 1 "VFCOnOff_On";
VAL_ 800 VFCVectorRBCMVFCid52 0 "VFCOnOff_Off" 1 "VFCOnOff_On";
VAL_ 800 VFCVectorRBCMVFCid53 0 "VFCOnOff_Off" 1 "VFCOnOff_On";
VAL_ 800 VFCVectorRBCMVFCid54 0 "VFCOnOff_Off" 1 "VFCOnOff_On";
VAL_ 800 VFCVectorRBCMVFCid55 0 "VFCOnOff_Off" 1 "VFCOnOff_On";
VAL_ 800 VFCVectorRBCMVFCid56 0 "VFCOnOff_Off" 1 "VFCOnOff_On";
VAL_ 800 VFCVectorRBCMVFCid57 0 "VFCOnOff_Off" 1 "VFCOnOff_On";
VAL_ 800 VFCVectorRBCMVFCid58 0 "VFCOnOff_Off" 1 "VFCOnOff_On";
VAL_ 800 VFCVectorRBCMVFCid59 0 "VFCOnOff_Off" 1 "VFCOnOff_On";
VAL_ 800 VFCVectorRBCMVFCid6 0 "VFCOnOff_Off" 1 "VFCOnOff_On";
VAL_ 800 VFCVectorRBCMVFCid60 0 "VFCOnOff_Off" 1 "VFCOnOff_On";
VAL_ 800 VFCVectorRBCMVFCid61 0 "VFCOnOff_Off" 1 "VFCOnOff_On";
VAL_ 800 VFCVectorRBCMVFCid7 0 "VFCOnOff_Off" 1 "VFCOnOff_On";
VAL_ 800 VFCVectorRBCMVFCid8 0 "VFCOnOff_Off" 1 "VFCOnOff_On";
VAL_ 800 VFCVectorRBCMVFCid9 0 "VFCOnOff_Off" 1 "VFCOnOff_On";
VAL_ 800 VFCVectorSRSVFCid0 0 "VFCOnOff_Off" 1 "VFCOnOff_On";
VAL_ 800 VFCVectorSRSVFCid1 0 "VFCOnOff_Off" 1 "VFCOnOff_On";
VAL_ 800 VFCVectorSRSVFCid10 0 "VFCOnOff_Off" 1 "VFCOnOff_On";
VAL_ 800 VFCVectorSRSVFCid11 0 "VFCOnOff_Off" 1 "VFCOnOff_On";
VAL_ 800 VFCVectorSRSVFCid12 0 "VFCOnOff_Off" 1 "VFCOnOff_On";
VAL_ 800 VFCVectorSRSVFCid13 0 "VFCOnOff_Off" 1 "VFCOnOff_On";
VAL_ 800 VFCVectorSRSVFCid14 0 "VFCOnOff_Off" 1 "VFCOnOff_On";
VAL_ 800 VFCVectorSRSVFCid15 0 "VFCOnOff_Off" 1 "VFCOnOff_On";
VAL_ 800 VFCVectorSRSVFCid16 0 "VFCOnOff_Off" 1 "VFCOnOff_On";
VAL_ 800 VFCVectorSRSVFCid17 0 "VFCOnOff_Off" 1 "VFCOnOff_On";
VAL_ 800 VFCVectorSRSVFCid18 0 "VFCOnOff_Off" 1 "VFCOnOff_On";
VAL_ 800 VFCVectorSRSVFCid19 0 "VFCOnOff_Off" 1 "VFCOnOff_On";
VAL_ 800 VFCVectorSRSVFCid2 0 "VFCOnOff_Off" 1 "VFCOnOff_On";
VAL_ 800 VFCVectorSRSVFCid20 0 "VFCOnOff_Off" 1 "VFCOnOff_On";
VAL_ 800 VFCVectorSRSVFCid21 0 "VFCOnOff_Off" 1 "VFCOnOff_On";
VAL_ 800 VFCVectorSRSVFCid22 0 "VFCOnOff_Off" 1 "VFCOnOff_On";
VAL_ 800 VFCVectorSRSVFCid23 0 "VFCOnOff_Off" 1 "VFCOnOff_On";
VAL_ 800 VFCVectorSRSVFCid24 0 "VFCOnOff_Off" 1 "VFCOnOff_On";
VAL_ 800 VFCVectorSRSVFCid25 0 "VFCOnOff_Off" 1 "VFCOnOff_On";
VAL_ 800 VFCVectorSRSVFCid26 0 "VFCOnOff_Off" 1 "VFCOnOff_On";
VAL_ 800 VFCVectorSRSVFCid27 0 "VFCOnOff_Off" 1 "VFCOnOff_On";
VAL_ 800 VFCVectorSRSVFCid28 0 "VFCOnOff_Off" 1 "VFCOnOff_On";
VAL_ 800 VFCVectorSRSVFCid29 0 "VFCOnOff_Off" 1 "VFCOnOff_On";
VAL_ 800 VFCVectorSRSVFCid3 0 "VFCOnOff_Off" 1 "VFCOnOff_On";
VAL_ 800 VFCVectorSRSVFCid30 0 "VFCOnOff_Off" 1 "VFCOnOff_On";
VAL_ 800 VFCVectorSRSVFCid31 0 "VFCOnOff_Off" 1 "VFCOnOff_On";
VAL_ 800 VFCVectorSRSVFCid32 0 "VFCOnOff_Off" 1 "VFCOnOff_On";
VAL_ 800 VFCVectorSRSVFCid33 0 "VFCOnOff_Off" 1 "VFCOnOff_On";
VAL_ 800 VFCVectorSRSVFCid34 0 "VFCOnOff_Off" 1 "VFCOnOff_On";
VAL_ 800 VFCVectorSRSVFCid35 0 "VFCOnOff_Off" 1 "VFCOnOff_On";
VAL_ 800 VFCVectorSRSVFCid36 0 "VFCOnOff_Off" 1 "VFCOnOff_On";
VAL_ 800 VFCVectorSRSVFCid37 0 "VFCOnOff_Off" 1 "VFCOnOff_On";
VAL_ 800 VFCVectorSRSVFCid38 0 "VFCOnOff_Off" 1 "VFCOnOff_On";
VAL_ 800 VFCVectorSRSVFCid39 0 "VFCOnOff_Off" 1 "VFCOnOff_On";
VAL_ 800 VFCVectorSRSVFCid4 0 "VFCOnOff_Off" 1 "VFCOnOff_On";
VAL_ 800 VFCVectorSRSVFCid40 0 "VFCOnOff_Off" 1 "VFCOnOff_On";
VAL_ 800 VFCVectorSRSVFCid41 0 "VFCOnOff_Off" 1 "VFCOnOff_On";
VAL_ 800 VFCVectorSRSVFCid42 0 "VFCOnOff_Off" 1 "VFCOnOff_On";
VAL_ 800 VFCVectorSRSVFCid43 0 "VFCOnOff_Off" 1 "VFCOnOff_On";
VAL_ 800 VFCVectorSRSVFCid44 0 "VFCOnOff_Off" 1 "VFCOnOff_On";
VAL_ 800 VFCVectorSRSVFCid45 0 "VFCOnOff_Off" 1 "VFCOnOff_On";
VAL_ 800 VFCVectorSRSVFCid46 0 "VFCOnOff_Off" 1 "VFCOnOff_On";
VAL_ 800 VFCVectorSRSVFCid47 0 "VFCOnOff_Off" 1 "VFCOnOff_On";
VAL_ 800 VFCVectorSRSVFCid48 0 "VFCOnOff_Off" 1 "VFCOnOff_On";
VAL_ 800 VFCVectorSRSVFCid49 0 "VFCOnOff_Off" 1 "VFCOnOff_On";
VAL_ 800 VFCVectorSRSVFCid5 0 "VFCOnOff_Off" 1 "VFCOnOff_On";
VAL_ 800 VFCVectorSRSVFCid50 0 "VFCOnOff_Off" 1 "VFCOnOff_On";
VAL_ 800 VFCVectorSRSVFCid51 0 "VFCOnOff_Off" 1 "VFCOnOff_On";
VAL_ 800 VFCVectorSRSVFCid52 0 "VFCOnOff_Off" 1 "VFCOnOff_On";
VAL_ 800 VFCVectorSRSVFCid53 0 "VFCOnOff_Off" 1 "VFCOnOff_On";
VAL_ 800 VFCVectorSRSVFCid54 0 "VFCOnOff_Off" 1 "VFCOnOff_On";
VAL_ 800 VFCVectorSRSVFCid55 0 "VFCOnOff_Off" 1 "VFCOnOff_On";
VAL_ 800 VFCVectorSRSVFCid56 0 "VFCOnOff_Off" 1 "VFCOnOff_On";
VAL_ 800 VFCVectorSRSVFCid57 0 "VFCOnOff_Off" 1 "VFCOnOff_On";
VAL_ 800 VFCVectorSRSVFCid58 0 "VFCOnOff_Off" 1 "VFCOnOff_On";
VAL_ 800 VFCVectorSRSVFCid59 0 "VFCOnOff_Off" 1 "VFCOnOff_On";
VAL_ 800 VFCVectorSRSVFCid6 0 "VFCOnOff_Off" 1 "VFCOnOff_On";
VAL_ 800 VFCVectorSRSVFCid60 0 "VFCOnOff_Off" 1 "VFCOnOff_On";
VAL_ 800 VFCVectorSRSVFCid61 0 "VFCOnOff_Off" 1 "VFCOnOff_On";
VAL_ 800 VFCVectorSRSVFCid7 0 "VFCOnOff_Off" 1 "VFCOnOff_On";
VAL_ 800 VFCVectorSRSVFCid8 0 "VFCOnOff_Off" 1 "VFCOnOff_On";
VAL_ 800 VFCVectorSRSVFCid9 0 "VFCOnOff_Off" 1 "VFCOnOff_On";
VAL_ 800 VFCVectorSUMVFCid0 0 "VFCOnOff_Off" 1 "VFCOnOff_On";
VAL_ 800 VFCVectorSUMVFCid1 0 "VFCOnOff_Off" 1 "VFCOnOff_On";
VAL_ 800 VFCVectorSUMVFCid10 0 "VFCOnOff_Off" 1 "VFCOnOff_On";
VAL_ 800 VFCVectorSUMVFCid11 0 "VFCOnOff_Off" 1 "VFCOnOff_On";
VAL_ 800 VFCVectorSUMVFCid12 0 "VFCOnOff_Off" 1 "VFCOnOff_On";
VAL_ 800 VFCVectorSUMVFCid13 0 "VFCOnOff_Off" 1 "VFCOnOff_On";
VAL_ 800 VFCVectorSUMVFCid14 0 "VFCOnOff_Off" 1 "VFCOnOff_On";
VAL_ 800 VFCVectorSUMVFCid15 0 "VFCOnOff_Off" 1 "VFCOnOff_On";
VAL_ 800 VFCVectorSUMVFCid16 0 "VFCOnOff_Off" 1 "VFCOnOff_On";
VAL_ 800 VFCVectorSUMVFCid17 0 "VFCOnOff_Off" 1 "VFCOnOff_On";
VAL_ 800 VFCVectorSUMVFCid18 0 "VFCOnOff_Off" 1 "VFCOnOff_On";
VAL_ 800 VFCVectorSUMVFCid19 0 "VFCOnOff_Off" 1 "VFCOnOff_On";
VAL_ 800 VFCVectorSUMVFCid2 0 "VFCOnOff_Off" 1 "VFCOnOff_On";
VAL_ 800 VFCVectorSUMVFCid20 0 "VFCOnOff_Off" 1 "VFCOnOff_On";
VAL_ 800 VFCVectorSUMVFCid21 0 "VFCOnOff_Off" 1 "VFCOnOff_On";
VAL_ 800 VFCVectorSUMVFCid22 0 "VFCOnOff_Off" 1 "VFCOnOff_On";
VAL_ 800 VFCVectorSUMVFCid23 0 "VFCOnOff_Off" 1 "VFCOnOff_On";
VAL_ 800 VFCVectorSUMVFCid24 0 "VFCOnOff_Off" 1 "VFCOnOff_On";
VAL_ 800 VFCVectorSUMVFCid25 0 "VFCOnOff_Off" 1 "VFCOnOff_On";
VAL_ 800 VFCVectorSUMVFCid26 0 "VFCOnOff_Off" 1 "VFCOnOff_On";
VAL_ 800 VFCVectorSUMVFCid27 0 "VFCOnOff_Off" 1 "VFCOnOff_On";
VAL_ 800 VFCVectorSUMVFCid28 0 "VFCOnOff_Off" 1 "VFCOnOff_On";
VAL_ 800 VFCVectorSUMVFCid29 0 "VFCOnOff_Off" 1 "VFCOnOff_On";
VAL_ 800 VFCVectorSUMVFCid3 0 "VFCOnOff_Off" 1 "VFCOnOff_On";
VAL_ 800 VFCVectorSUMVFCid30 0 "VFCOnOff_Off" 1 "VFCOnOff_On";
VAL_ 800 VFCVectorSUMVFCid31 0 "VFCOnOff_Off" 1 "VFCOnOff_On";
VAL_ 800 VFCVectorSUMVFCid32 0 "VFCOnOff_Off" 1 "VFCOnOff_On";
VAL_ 800 VFCVectorSUMVFCid33 0 "VFCOnOff_Off" 1 "VFCOnOff_On";
VAL_ 800 VFCVectorSUMVFCid34 0 "VFCOnOff_Off" 1 "VFCOnOff_On";
VAL_ 800 VFCVectorSUMVFCid35 0 "VFCOnOff_Off" 1 "VFCOnOff_On";
VAL_ 800 VFCVectorSUMVFCid36 0 "VFCOnOff_Off" 1 "VFCOnOff_On";
VAL_ 800 VFCVectorSUMVFCid37 0 "VFCOnOff_Off" 1 "VFCOnOff_On";
VAL_ 800 VFCVectorSUMVFCid38 0 "VFCOnOff_Off" 1 "VFCOnOff_On";
VAL_ 800 VFCVectorSUMVFCid39 0 "VFCOnOff_Off" 1 "VFCOnOff_On";
VAL_ 800 VFCVectorSUMVFCid4 0 "VFCOnOff_Off" 1 "VFCOnOff_On";
VAL_ 800 VFCVectorSUMVFCid40 0 "VFCOnOff_Off" 1 "VFCOnOff_On";
VAL_ 800 VFCVectorSUMVFCid41 0 "VFCOnOff_Off" 1 "VFCOnOff_On";
VAL_ 800 VFCVectorSUMVFCid42 0 "VFCOnOff_Off" 1 "VFCOnOff_On";
VAL_ 800 VFCVectorSUMVFCid43 0 "VFCOnOff_Off" 1 "VFCOnOff_On";
VAL_ 800 VFCVectorSUMVFCid44 0 "VFCOnOff_Off" 1 "VFCOnOff_On";
VAL_ 800 VFCVectorSUMVFCid45 0 "VFCOnOff_Off" 1 "VFCOnOff_On";
VAL_ 800 VFCVectorSUMVFCid46 0 "VFCOnOff_Off" 1 "VFCOnOff_On";
VAL_ 800 VFCVectorSUMVFCid47 0 "VFCOnOff_Off" 1 "VFCOnOff_On";
VAL_ 800 VFCVectorSUMVFCid48 0 "VFCOnOff_Off" 1 "VFCOnOff_On";
VAL_ 800 VFCVectorSUMVFCid49 0 "VFCOnOff_Off" 1 "VFCOnOff_On";
VAL_ 800 VFCVectorSUMVFCid5 0 "VFCOnOff_Off" 1 "VFCOnOff_On";
VAL_ 800 VFCVectorSUMVFCid50 0 "VFCOnOff_Off" 1 "VFCOnOff_On";
VAL_ 800 VFCVectorSUMVFCid51 0 "VFCOnOff_Off" 1 "VFCOnOff_On";
VAL_ 800 VFCVectorSUMVFCid52 0 "VFCOnOff_Off" 1 "VFCOnOff_On";
VAL_ 800 VFCVectorSUMVFCid53 0 "VFCOnOff_Off" 1 "VFCOnOff_On";
VAL_ 800 VFCVectorSUMVFCid54 0 "VFCOnOff_Off" 1 "VFCOnOff_On";
VAL_ 800 VFCVectorSUMVFCid55 0 "VFCOnOff_Off" 1 "VFCOnOff_On";
VAL_ 800 VFCVectorSUMVFCid56 0 "VFCOnOff_Off" 1 "VFCOnOff_On";
VAL_ 800 VFCVectorSUMVFCid57 0 "VFCOnOff_Off" 1 "VFCOnOff_On";
VAL_ 800 VFCVectorSUMVFCid58 0 "VFCOnOff_Off" 1 "VFCOnOff_On";
VAL_ 800 VFCVectorSUMVFCid59 0 "VFCOnOff_Off" 1 "VFCOnOff_On";
VAL_ 800 VFCVectorSUMVFCid6 0 "VFCOnOff_Off" 1 "VFCOnOff_On";
VAL_ 800 VFCVectorSUMVFCid60 0 "VFCOnOff_Off" 1 "VFCOnOff_On";
VAL_ 800 VFCVectorSUMVFCid61 0 "VFCOnOff_Off" 1 "VFCOnOff_On";
VAL_ 800 VFCVectorSUMVFCid7 0 "VFCOnOff_Off" 1 "VFCOnOff_On";
VAL_ 800 VFCVectorSUMVFCid8 0 "VFCOnOff_Off" 1 "VFCOnOff_On";
VAL_ 800 VFCVectorSUMVFCid9 0 "VFCOnOff_Off" 1 "VFCOnOff_On";
VAL_ 264 AdjSpdLimnActvnOk 0 "OnOff1_Off" 1 "OnOff1_On";
VAL_ 264 AdjSpdLimnMsg 0 "AdjSpdLimnMsg1_NoMsg0" 1 "AdjSpdLimnMsg1_AdjSpdLimnCncl" 2 "AdjSpdLimnMsg1_AdjSpdLimnInhb" 3 "AdjSpdLimnMsg1_AVSLDegradated";
VAL_ 264 AdjSpdLimnStbOk 0 "OnOff1_Off" 1 "OnOff1_On";
VAL_ 264 AdjSpdLimnSts 1 "AdjSpdLimnSts2_Off" 2 "AdjSpdLimnSts2_Stb" 3 "AdjSpdLimnSts2_Actv" 4 "AdjSpdLimnSts2_Ovrd";
VAL_ 264 ChdPrtnLeftSwReq 0 "Boolean_FALSE" 1 "Boolean_TRUE";
VAL_ 264 ChdPrtnRightSwReq 0 "Boolean_FALSE" 1 "Boolean_TRUE";
VAL_ 264 DoorLeOpenWarnReq 0 "Boolean_FALSE" 1 "Boolean_TRUE";
VAL_ 264 DoorRiOpenWarnReq 0 "Boolean_FALSE" 1 "Boolean_TRUE";
VAL_ 264 DrvrSeatSnsrSts 0 "OkNokDi_Ok" 1 "OkNokDi_NotOk" 2 "OkNokDi_Disabled" 3 "OkNokDi_Reserved";
VAL_ 264 DrvrSeatSwtCushExtSts 0 "SwtHozlSts1_Idle" 1 "SwtHozlSts1_Fwd" 2 "SwtHozlSts1_Backw";
VAL_ 264 ElecMot2ActvDampgModReq 0 "WhlMotSysActvDampgModCodSts_NoDampg" 1 "WhlMotSysActvDampgModCodSts_LoDampg" 2 "WhlMotSysActvDampgModCodSts_MedDampg" 3 "WhlMotSysActvDampgModCodSts_HiDampg";
VAL_ 264 ElecMot2ModSts 0 "IsgModTyp2_Inin" 1 "IsgModTyp2_Stb" 2 "IsgModTyp2_TqCtrl" 3 "IsgModTyp2_SpdCtrl" 4 "IsgModTyp2_UDcCtrl" 5 "IsgModTyp2_PreChrg" 6 "IsgModTyp2_PwrDwn" 7 "IsgModTyp2_Flt" 8 "IsgModTyp2_TcsCtrl" 9 "IsgModTyp2_CluOpe";
VAL_ 264 FrntSeatCmftCtrlReSeatLe 0 "CmftSet_NoReq" 1 "CmftSet_ComfortReq" 2 "CmftSet_ReturnReq";
VAL_ 264 FrntSeatCmftCtrlReSeatRi 0 "CmftSet_NoReq" 1 "CmftSet_ComfortReq" 2 "CmftSet_ReturnReq";
VAL_ 264 GearMovmtFlg 0 "FuncSts_NoReq" 1 "FuncSts_Set" 2 "FuncSts_Resume" 3 "FuncSts_Cancle";
VAL_ 264 LimSts 0 "LimSts_Unknown" 1 "LimSts_ManuallySet" 2 "LimSts_AutomaticallySet" 3 "LimSts_Reserved";
VAL_ 264 LowrTailgAntiPnch 0 "Boolean_FALSE" 1 "Boolean_TRUE";
VAL_ 264 LowrTailgObstclDetn 0 "Boolean_FALSE" 1 "Boolean_TRUE";
VAL_ 264 LowrTailgOpenerSts 0 "TrOpenerSts1_Ukwn" 1 "TrOpenerSts1_FullClsd" 2 "TrOpenerSts1_MovgUp" 3 "TrOpenerSts1_MovgUpBrkg" 4 "TrOpenerSts1_StopDurgOpen" 5 "TrOpenerSts1_FullOpend" 6 "TrOpenerSts1_MovgDwn" 7 "TrOpenerSts1_MovgDwnBrkg" 8 "TrOpenerSts1_StopDurgCls" 9 "TrOpenerSts1_HalfClsd" 10 "TrOpenerSts1_StopMinPntForCls";
VAL_ 264 MirrAdjVceAtPassCmd 0 "MirrAdjCmdTyp_Idle" 1 "MirrAdjCmdTyp_Up" 2 "MirrAdjCmdTyp_Dwn" 3 "MirrAdjCmdTyp_Le" 4 "MirrAdjCmdTyp_Ri";
VAL_ 264 MirrAtDrvrForVce 0 "MirrStsForVce_Idle" 1 "MirrStsForVce_LimReach" 2 "MirrStsForVce_MoveIntrpt";
VAL_ 264 MotDynCtrlStsReLeDmcSts 0 "DmcSts_Init" 1 "DmcSts_OnDec" 2 "DmcSts_Off" 3 "DmcSts_Fault" 4 "DmcSts_OnInc" 5 "DmcSts_YrLim" 6 "DmcSts_Reserve";
VAL_ 264 MotDynCtrlStsReRiDmcSts 0 "DmcSts_Init" 1 "DmcSts_OnDec" 2 "DmcSts_Off" 3 "DmcSts_Fault" 4 "DmcSts_OnInc" 5 "DmcSts_YrLim" 6 "DmcSts_Reserve";
VAL_ 264 RoadSgnInfoSts 0 "TrfcSgnInfoSts_TSIUnknown" 1 "TrfcSgnInfoSts_TSIOff" 2 "TrfcSgnInfoSts_TSIOn_fusion" 3 "TrfcSgnInfoSts_TSIOn_visiononlymode" 4 "TrfcSgnInfoSts_TSIOn_navigationonlymode" 5 "TrfcSgnInfoSts_TSIUnavailable" 6 "TrfcSgnInfoSts_TSIServicerequired" 7 "TrfcSgnInfoSts_Reserved";
VAL_ 264 RowSecLeFldRsdSts 0 "FoldRaiseMovmt_Uknwn" 1 "FoldRaiseMovmt_Fld" 2 "FoldRaiseMovmt_Rsd" 3 "FoldRaiseMovmt_MovmtToFld" 4 "FoldRaiseMovmt_MovmtToRsd" 5 "FoldRaiseMovmt_BtwnFldAndRsd";
VAL_ 264 RowSecLeFldRsdWarn 0 "Boolean_FALSE" 1 "Boolean_TRUE";
VAL_ 264 RowSecLeMassgRunng 0 "OnOff1_Off" 1 "OnOff1_On";
VAL_ 264 RowSecLeSeatActvSpplFct 0 "SeatActvSpplFct1_NotAvl" 1 "SeatActvSpplFct1_LumExtnAndLumHei" 2 "SeatActvSpplFct1_BackBlster" 3 "SeatActvSpplFct1_CushExtn" 4 "SeatActvSpplFct1_HdrestHeiAndHdrestTilt" 5 "SeatActvSpplFct1_MassgFct" 6 "SeatActvSpplFct1_ShoulderFct" 7 "SeatActvSpplFct1_LegrestFct";
VAL_ 264 RowSecLeSeatRotRmn 0 "Boolean_FALSE" 1 "Boolean_TRUE";
VAL_ 264 RowSecRiFldRsdWarn 0 "Boolean_FALSE" 1 "Boolean_TRUE";
VAL_ 264 RowSecRiMassgRunng 0 "OnOff1_Off" 1 "OnOff1_On";
VAL_ 264 RowSecRiSeatActvSpplFct 0 "SeatActvSpplFct1_NotAvl" 1 "SeatActvSpplFct1_LumExtnAndLumHei" 2 "SeatActvSpplFct1_BackBlster" 3 "SeatActvSpplFct1_CushExtn" 4 "SeatActvSpplFct1_HdrestHeiAndHdrestTilt" 5 "SeatActvSpplFct1_MassgFct" 6 "SeatActvSpplFct1_ShoulderFct" 7 "SeatActvSpplFct1_LegrestFct";
VAL_ 264 RowSecRiSeatRotRmn 0 "Boolean_FALSE" 1 "Boolean_TRUE";
VAL_ 264 SbWSyncStsH1HWASyncSts 0 "OkNotOk_NotOk" 1 "OkNotOk_Ok";
VAL_ 264 SeatMassgFctRowSecLeMassgInten 0 "MassgIntenLvl_IntenLo" 1 "MassgIntenLvl_IntenNorm" 2 "MassgIntenLvl_IntenHi" 3 "MassgIntenLvl_Off";
VAL_ 264 SeatMassgFctRowSecLeMassgProg 0 "MassgProgTyp_Prog1" 1 "MassgProgTyp_Prog2" 2 "MassgProgTyp_Prog3" 3 "MassgProgTyp_Prog4" 4 "MassgProgTyp_Prog5" 5 "MassgProgTyp_Prog6" 6 "MassgProgTyp_Prog7" 7 "MassgProgTyp_Prog8";
VAL_ 264 SeatMassgFctRowSecLeOnOff 0 "OnOff1_Off" 1 "OnOff1_On";
VAL_ 264 SeatMassgFctRowSecRiMassgInten 0 "MassgIntenLvl_IntenLo" 1 "MassgIntenLvl_IntenNorm" 2 "MassgIntenLvl_IntenHi" 3 "MassgIntenLvl_Off";
VAL_ 264 SeatMassgFctRowSecRiMassgProg 0 "MassgProgTyp_Prog1" 1 "MassgProgTyp_Prog2" 2 "MassgProgTyp_Prog3" 3 "MassgProgTyp_Prog4" 4 "MassgProgTyp_Prog5" 5 "MassgProgTyp_Prog6" 6 "MassgProgTyp_Prog7" 7 "MassgProgTyp_Prog8";
VAL_ 264 SeatMassgFctRowSecRiOnOff 0 "OnOff1_Off" 1 "OnOff1_On";
VAL_ 264 TCSCmprStrtFlt 0 "OnOff1_Off" 1 "OnOff1_On";
VAL_ 264 TCSModSwtSts 0 "Req_NoReq" 1 "Req_off" 2 "Req_Coolg" 3 "Req_Heatlg";
VAL_ 264 TrlrPrmntPwrActv 0 "YesNo1_Yes" 1 "YesNo1_No";
VAL_ 264 TrOpenerByFootOperSts 0 "OnOff1_Off" 1 "OnOff1_On";
VAL_ 264 TrsmReqForPfmncRedn3 0 "Boolean_FALSE" 1 "Boolean_TRUE";
VAL_ 67 BookTrvlFltSts 0 "Boolean_FALSE" 1 "Boolean_TRUE";
VAL_ 67 BookTrvlSetResponse 0 "BookChargeSetResponse_Default" 1 "BookChargeSetResponse_Success" 2 "BookChargeSetResponse_Cancelled" 3 "BookChargeSetResponse_Fail";
VAL_ 67 BookTrvlTiSetReqBookTrvlTiSetReq 0 "ReqSts1_NotReqd" 1 "ReqSts1_Reqd";
VAL_ 67 CrashSts2 0 "CrashSts4_Resd1" 1 "CrashSts4_NoCrash" 2 "CrashSts4_Crash" 3 "CrashSts4_SlightCrash";
VAL_ 67 DchaStopByTarDrvrIndcn 0 "ReqSts1_NotReqd" 1 "ReqSts1_Reqd";
VAL_ 1161 DmcStsFrntToEscDmcSts 0 "DMC_Init" 1 "DMC_On" 2 "DMC_Off" 3 "DMC_Fault";
VAL_ 1161 DrvrSteerActvDrvrSteerActv 0 "OnOff1_Off" 1 "OnOff1_On";
VAL_ 1161 EpbAvlSecCommunicationAvailable 0 "MsgSts_Inactive" 1 "MsgSts_Active";
VAL_ 1161 EpbAvlSecHostAvailabilityFull 0 "MsgSts_Inactive" 1 "MsgSts_Active";
VAL_ 1161 EpbAvlSecHostAvailabilityRelOnly 0 "MsgSts_Inactive" 1 "MsgSts_Active";
VAL_ 1161 EpbAvlSecReserved1 0 "MsgSts_Inactive" 1 "MsgSts_Active";
VAL_ 1161 EpbAvlSecReserved2 0 "MsgSts_Inactive" 1 "MsgSts_Active";
VAL_ 1161 EpbAvlSecReserved3 0 "MsgSts_Inactive" 1 "MsgSts_Active";
VAL_ 1161 EpbAvlSecReserved4 0 "MsgSts_Inactive" 1 "MsgSts_Active";
VAL_ 1161 EpbAvlSecReserved5 0 "MsgSts_Inactive" 1 "MsgSts_Active";
VAL_ 1161 EpbAvlSecReserved6 0 "MsgSts_Inactive" 1 "MsgSts_Active";
VAL_ 1161 EpbAvlSecReserved7 0 "MsgSts_Inactive" 1 "MsgSts_Active";
VAL_ 1161 IsgErrIndcnReq 0 "OnOff1_Off" 1 "OnOff1_On";
VAL_ 1161 IsgSpdActSgnSafeQF 0 "GenQf1_UndefindDataAccur" 1 "GenQf1_TmpUndefdData" 2 "GenQf1_DataAccurNotWithinSpcn" 3 "GenQf1_AccurData";
VAL_ 1161 Mot1ReqSafemod 0 "IsgModTyp1_Inin" 1 "IsgModTyp1_Stb" 2 "IsgModTyp1_TqCtrl" 3 "IsgModTyp1_SpdCtrl" 4 "IsgModTyp1_UDcCtrl" 5 "IsgModTyp1_PreChrg" 6 "IsgModTyp1_PwrDwn" 7 "IsgModTyp1_Flt" 8 "IsgModTyp1_TcsCtrl" 9 "IsgModTyp1_Reserved1" 10 "IsgModTyp1_Reserved2" 11 "IsgModTyp1_Reserved3" 12 "IsgModTyp1_Reserved4" 13 "IsgModTyp1_Reserved5" 14 "IsgModTyp1_Reserved6" 15 "IsgModTyp1_Reserved7";
VAL_ 1161 Mot3ReqSafemod 0 "IsgModTyp1_Inin" 1 "IsgModTyp1_Stb" 2 "IsgModTyp1_TqCtrl" 3 "IsgModTyp1_SpdCtrl" 4 "IsgModTyp1_UDcCtrl" 5 "IsgModTyp1_PreChrg" 6 "IsgModTyp1_PwrDwn" 7 "IsgModTyp1_Flt" 8 "IsgModTyp1_TcsCtrl" 9 "IsgModTyp1_Reserved1" 10 "IsgModTyp1_Reserved2" 11 "IsgModTyp1_Reserved3" 12 "IsgModTyp1_Reserved4" 13 "IsgModTyp1_Reserved5" 14 "IsgModTyp1_Reserved6" 15 "IsgModTyp1_Reserved7";
VAL_ 1161 PtCluTqQly 0 "Qly3_De0" 1 "Qly3_De1" 2 "Qly3_De2" 3 "Qly3_De3" 4 "Qly3_De4" 5 "Qly3_De5" 6 "Qly3_De6" 7 "Qly3_De7";
VAL_ 1161 PtGearTarReq 0 "GearIndcnTyp3_Neut" 1 "GearIndcnTyp3_Gear1" 2 "GearIndcnTyp3_Gear2" 3 "GearIndcnTyp3_Gear3" 4 "GearIndcnTyp3_N1" 5 "GearIndcnTyp3_N12" 6 "GearIndcnTyp3_N23" 7 "GearIndcnTyp3_N3";
VAL_ 1161 PtParkReqToWhlsRe 0 "ReqSts1_NotReqd" 1 "ReqSts1_Reqd";
VAL_ 1161 SteerExtFctStsDrvrSteerOvrd 0 "Boolean_FALSE" 1 "Boolean_TRUE";
VAL_ 1161 SteerExtFctStsExtFctLowerLimActive 0 "Boolean_FALSE" 1 "Boolean_TRUE";
VAL_ 1161 SteerExtFctStsExtFctRateLimActive 0 "Boolean_FALSE" 1 "Boolean_TRUE";
VAL_ 1161 SteerExtFctStsExtFctUpperLimActive 0 "Boolean_FALSE" 1 "Boolean_TRUE";
VAL_ 1161 SteerExtFctStsExtSafeLimActive 0 "Boolean_FALSE" 1 "Boolean_TRUE";
VAL_ 1161 SteerExtFctStsLatAgReqNotInRange 0 "Boolean_FALSE" 1 "Boolean_TRUE";
VAL_ 1161 SteerExtFctStsLatCtrlReqNotInRange 0 "Boolean_FALSE" 1 "Boolean_TRUE";
VAL_ 1161 SteerLockStsBolt 0 "BoltSteerLockSts_BoltSteerLockStsResd" 1 "BoltSteerLockSts_BoltSteerLockStsUnlckd" 2 "BoltSteerLockSts_BoltSteerLockStsLockd" 3 "BoltSteerLockSts_BoltSteerLockStsInVld";
VAL_ 1161 SteerLockStsFault 0 "FltSteerLockSts_FltSteerLockStsNoErr" 1 "FltSteerLockSts_FltSteerLockStsWrgResp" 2 "FltSteerLockSts_FltSteerLockStsNotProgd" 3 "FltSteerLockSts_FltSteerLockStsIntNewReq";
VAL_ 1161 SteerLockStsSafety 0 "SftySteerLockSts_SftySteerLockStsResd1" 1 "SftySteerLockSts_SftySteerLockNoStandStillDetd" 2 "SftySteerLockSts_SftySteerLockStandStillDetd" 3 "SftySteerLockSts_SftySteerLockStsResd2";
VAL_ 1161 SteerLockStsUnit 0 "SteerLockStsUnit_SteerLockColStsUnitUndefd" 1 "SteerLockStsUnit_SteerLockColStsUnitInProgs" 2 "SteerLockStsUnit_FltSteerLockColStsUnit" 3 "SteerLockStsUnit_SteerLockColStsUnitOk";
VAL_ 1161 SuspFailrStsSuspFailrSts 0 "SuspFailrStsTyp2_NoErr" 1 "SuspFailrStsTyp2_TrSwtConUsg" 2 "SuspFailrStsTyp2_CmprOvrheatd" 3 "SuspFailrStsTyp2_SrvRqrdErr" 4 "SuspFailrStsTyp2_StopCritErr" 5 "SuspFailrStsTyp2_LoAirM" 6 "SuspFailrStsTyp2_HiAirM" 7 "SuspFailrStsTyp2_VehLvlHiOrLoErr";
VAL_ 1161 SuspFailrStsTypQf 0 "GenQf1_UndefindDataAccur" 1 "GenQf1_TmpUndefdData" 2 "GenQf1_DataAccurNotWithinSpcn" 3 "GenQf1_AccurData";
VAL_ 1161 TrlrModVMMFltSts 0 "Boolean_FALSE" 1 "Boolean_TRUE";
VAL_ 1161 TrsmActrPosnSafeAuxTrsmActrPosn 0 "TrsmActrPosn1_Park" 1 "TrsmActrPosn1_ParkRvs" 2 "TrsmActrPosn1_Rvs" 3 "TrsmActrPosn1_RvsNeut" 4 "TrsmActrPosn1_Neut" 5 "TrsmActrPosn1_NeutDrv" 6 "TrsmActrPosn1_Drv" 7 "TrsmActrPosn1_Undefd";
VAL_ 1161 TrsmNeutFailr 0 "TrsmNeutFailr1_NeutPsbl" 1 "TrsmNeutFailr1_NeutNotPsbl";
VAL_ 1161 WrmUpCyc 0 "OnOff1_Off" 1 "OnOff1_On";
VAL_ 1173 BswRstReason 0 "BswRstReason_NotKnown" 1 "BswRstReason_PowerOnReset" 2 "BswRstReason_ExternalReset" 3 "BswRstReason_SWReset" 4 "BswRstReason_Reserved1" 5 "BswRstReason_Reserved2" 6 "BswRstReason_Reserved3" 7 "BswRstReason_Reserved4";
VAL_ 1173 CarLoctrToExtrLiVisReq 0 "ExtrLiVisReq_ExtrLiVisReqAlrmOff" 1 "ExtrLiVisReq_ExtrLiVisReqAlrm1" 2 "ExtrLiVisReq_ExtrLiVisReqAlrm2";
VAL_ 1173 DiagcSigSWM 0 "Nofault" 1 "Commonfailure" 2 "KL30overvoltage" 3 "HSSovercurInSWSorhartoSWS";
VAL_ 1173 EnaOfflineMonitor 0 "Boolean_FALSE" 1 "Boolean_TRUE";
VAL_ 1173 EngRunngReqByVehModMgrChassie 0 "Boolean_FALSE" 1 "Boolean_TRUE";
VAL_ 1173 EngRunngReqByVehModMgrClimate 0 "Boolean_FALSE" 1 "Boolean_TRUE";
VAL_ 1173 EngRunngReqByVehModMgrElectricalSystem 0 "Boolean_FALSE" 1 "Boolean_TRUE";
VAL_ 1173 EngRunngReqByVehModMgrTrailerPrsnt 0 "Boolean_FALSE" 1 "Boolean_TRUE";
VAL_ 1173 EngSt1WdSts1 0 "EngSt1_Ini" 1 "EngSt1_Awake" 2 "EngSt1_Rdy" 3 "EngSt1_PreStrtg" 4 "EngSt1_StrtgInProgs" 5 "EngSt1_RunngRunng" 6 "EngSt1_RunngStb" 7 "EngSt1_RunngStrtgInProgs" 8 "EngSt1_RunngRemStrtd" 9 "EngSt1_AftRun";
VAL_ 1173 FltOfBeamHiDrv 0 "DevErrSts2_NoFlt" 1 "DevErrSts2_Flt";
VAL_ 1173 FltOfBeamLoDrv 0 "DevErrSts2_NoFlt" 1 "DevErrSts2_Flt";
VAL_ 1173 FltOfCenHiMntdStopLamp 0 "DevErrSts2_NoFlt" 1 "DevErrSts2_Flt";
VAL_ 1173 FltOfCenHiMntdStopLamp1 0 "OnOff1_Off" 1 "OnOff1_On";
VAL_ 1173 FltOfDaytiRunngLampDrv 0 "DevErrSts2_NoFlt" 1 "DevErrSts2_Flt";
VAL_ 1173 FltOfFrntFogLampDrv 0 "DevErrSts2_NoFlt" 1 "DevErrSts2_Flt";
VAL_ 1173 FltOfFrntPosnLampDrv 0 "DevErrSts2_NoFlt" 1 "DevErrSts2_Flt";
VAL_ 1173 FltOfRePosnLampDrv 0 "DevErrSts2_NoFlt" 1 "DevErrSts2_Flt";
VAL_ 1173 FltOfStopLampDrv 0 "DevErrSts2_NoFlt" 1 "DevErrSts2_Flt";
VAL_ 1173 FltOfStopLampPass 0 "DevErrSts2_NoFlt" 1 "DevErrSts2_Flt";
VAL_ 1173 HornSwitchSts 0 "OnOff1_Off" 1 "OnOff1_On";
VAL_ 1173 HvActvForVehModReq 0 "OnOff1_Off" 1 "OnOff1_On";
VAL_ 1173 HvActvSts 0 "HvActvSts_Default" 1 "HvActvSts_CPSRIsActivated" 2 "HvActvSts_CPSRPlusContactorsIsActivated" 3 "HvActvSts_Error";
VAL_ 1173 HwRowFrstDrvrFrntHeiMotCtrl 0 "SwtVertSts1_Idle" 1 "SwtVertSts1_Up" 2 "SwtVertSts1_Dwn";
VAL_ 1173 HwRowFrstDrvrHeiMotCtrl 0 "SwtVertSts1_Idle" 1 "SwtVertSts1_Up" 2 "SwtVertSts1_Dwn";
VAL_ 1173 HwRowFrstDrvrInclMotCtrl 0 "SwtHozlSts1_Idle" 1 "SwtHozlSts1_Fwd" 2 "SwtHozlSts1_Backw";
VAL_ 1173 HwRowFrstDrvrSldMotCtrl 0 "SwtHozlSts1_Idle" 1 "SwtHozlSts1_Fwd" 2 "SwtHozlSts1_Backw";
VAL_ 1173 IntrLiRoofAUTOIndication 0 "Boolean_FALSE" 1 "Boolean_TRUE";
VAL_ 1173 IntrMirrCmdDrvrSide 0 "RiLeTyp_Right" 1 "RiLeTyp_Left";
VAL_ 1173 IntrMirrCmdIntrMirrAsyFanCmpMag 0 "OnOff1_Off" 1 "OnOff1_On";
VAL_ 1173 IntrMirrCmdIntrMirrDiagcRst 0 "Flg1_Rst" 1 "Flg1_Set";
VAL_ 1173 IntrMirrCmdIntrMirrDimSnvty 0 "IntrMirrDimSnvtyTyp_Normal" 1 "IntrMirrDimSnvtyTyp_Dark" 2 "IntrMirrDimSnvtyTyp_Light" 3 "IntrMirrDimSnvtyTyp_Inhibit";
VAL_ 1173 IntrMirrCmdIntrMirrEna 0 "OnOff1_Off" 1 "OnOff1_On";
VAL_ 1173 IntrMirrCmdIntrMirrInhbDim 0 "OnOff1_Off" 1 "OnOff1_On";
VAL_ 1173 IntrMirrCmdIntrMirrWindHeatrCmpMag 0 "OnOff1_Off" 1 "OnOff1_On";
VAL_ 1173 LatCtrlModCfmdLatCtrlMod 0 "LatCtrlMod5_NoReq" 1 "LatCtrlMod5_HighWayAssist" 2 "LatCtrlMod5_EmgyLaneKeepAidForObjRe" 3 "LatCtrlMod5_EmgyLaneKeepAidForStat" 4 "LatCtrlMod5_SftyLaneKeepAid" 5 "LatCtrlMod5_SteerAssc" 6 "LatCtrlMod5_DsrOversteer" 7 "LatCtrlMod5_DsrMueSplit" 8 "LatCtrlMod5_DsrTrlrStaby" 9 "LatCtrlMod5_EmgyManvAssi" 10 "LatCtrlMod5_Reserved1" 11 "LatCtrlMod5_E2E" 12 "LatCtrlMod5_SHWA" 13 "LatCtrlMod5_APA" 14 "LatCtrlMod5_RPA" 15 "LatCtrlMod5_HPA";
VAL_ 1173 MirrDefrstAtDrvrCmd 0 "OnOff1_Off" 1 "OnOff1_On";
VAL_ 1173 MirrSeldIndcn 0 "MirrSeldIndcnTyp_LedOff" 1 "MirrSeldIndcnTyp_LedOnLe" 2 "MirrSeldIndcnTyp_LedOnRi" 3 "MirrSeldIndcnTyp_LedOnLeAndRi";
VAL_ 1173 PanicAlrmAcoustReq 0 "AlrmAcoustReq_AlrmAcoustReqOff" 1 "AlrmAcoustReq_AlrmAcoustReq1";
VAL_ 1173 PanicAlrmToExtrLiVisReq 0 "ExtrLiVisReq_ExtrLiVisReqAlrmOff" 1 "ExtrLiVisReq_ExtrLiVisReqAlrm1" 2 "ExtrLiVisReq_ExtrLiVisReqAlrm2";
VAL_ 1173 PropsEnabfromAlcoLock 0 "OnOff1_Off" 1 "OnOff1_On";
VAL_ 1173 PtActvnReq1WdPtActvnReq 0 "PtActvnReq1_NoPtActvnReq" 1 "PtActvnReq1_PtActvnReq" 2 "PtActvnReq1_PtActvnReqRem" 3 "PtActvnReq1_PtActvnNotDriving";
VAL_ 1173 RainSensActvn 0 "OnOff1_Off" 1 "OnOff1_On";
VAL_ 1173 ReAdaptReq 0 "OnOff1_Off" 1 "OnOff1_On";
VAL_ 1173 RelHumSnsrErr 0 "Err1_NoErr" 1 "Err1_Err";
VAL_ 1173 RemStrtMsgToDrvrRemStrtBlkd1 0 "RemStrtMsgBlkd1_NoFailr" 1 "RemStrtMsgBlkd1_LoClntLvl" 2 "RemStrtMsgBlkd1_GearLvrNotInP" 3 "RemStrtMsgBlkd1_LoFuLvl" 4 "RemStrtMsgBlkd1_KeyInVeh" 5 "RemStrtMsgBlkd1_NrOfClimaLim" 6 "RemStrtMsgBlkd1_WrkshpMod" 7 "RemStrtMsgBlkd1_EngFlt" 8 "RemStrtMsgBlkd1_HoodOpend" 9 "RemStrtMsgBlkd1_Unlockd" 10 "RemStrtMsgBlkd1_LoVolSysFlt" 11 "RemStrtMsgBlkd1_ChrgCblCnnctd" 12 "RemStrtMsgBlkd1_Other";
VAL_ 1173 RemStrtMsgToDrvrRemStrtDev1 0 "RemStrtDev1_NotRqstd" 1 "RemStrtDev1_RqstdByKey" 2 "RemStrtDev1_RqstdByTelm" 3 "RemStrtDev1_Resd";
VAL_ 1173 RlyActvnForRoofCurtClsAut 0 "Boolean_FALSE" 1 "Boolean_TRUE";
VAL_ 1173 SteerLockEnagOfPrpsn 0 "SteerLockEnagOfPrpsn_SteerLockEnagResd1" 1 "SteerLockEnagOfPrpsn_PrpsnInhbFromSteerLock" 2 "SteerLockEnagOfPrpsn_PrpsnAllwdFromSteerLock" 3 "SteerLockEnagOfPrpsn_SteerLockEnagResd2";
VAL_ 1173 StsOfLedHiBeamLe 0 "DevSts4_Off" 1 "DevSts4_On" 2 "DevSts4_Err" 3 "DevSts4_Resd";
VAL_ 1173 StsOfLedHiBeamRi 0 "DevSts4_Off" 1 "DevSts4_On" 2 "DevSts4_Err" 3 "DevSts4_Resd";
VAL_ 1173 StsOfLedLoBeamLe 0 "DevSts4_Off" 1 "DevSts4_On" 2 "DevSts4_Err" 3 "DevSts4_Resd";
VAL_ 1173 StsOfLedLoBeamRi 0 "DevSts4_Off" 1 "DevSts4_On" 2 "DevSts4_Err" 3 "DevSts4_Resd";
VAL_ 1173 StsOfSwvlgLe 0 "DevSts4_Off" 1 "DevSts4_On" 2 "DevSts4_Err" 3 "DevSts4_Resd";
VAL_ 1173 StsOfSwvlgRi 0 "DevSts4_Off" 1 "DevSts4_On" 2 "DevSts4_Err" 3 "DevSts4_Resd";
VAL_ 1173 SunCurtEna 0 "SunRoofAndCurtEnaTyp_Di" 1 "SunRoofAndCurtEnaTyp_LimdEna" 2 "SunRoofAndCurtEnaTyp_FullEna" 3 "SunRoofAndCurtEnaTyp_Resd";
VAL_ 1173 SunRoofAndCurtExtCmd 0 "SunRoofAndCurtExtCmdTyp_Idle" 1 "SunRoofAndCurtExtCmdTyp_PanAndCurtStop" 2 "SunRoofAndCurtExtCmdTyp_CurtClsFull" 3 "SunRoofAndCurtExtCmdTyp_CurtOpenFull" 4 "SunRoofAndCurtExtCmdTyp_PanClsFull" 5 "SunRoofAndCurtExtCmdTyp_PanOpenFull" 6 "SunRoofAndCurtExtCmdTyp_PanTilt" 7 "SunRoofAndCurtExtCmdTyp_AutClsFast" 8 "SunRoofAndCurtExtCmdTyp_AutOpenFast" 9 "SunRoofAndCurtExtCmdTyp_CurtClsShort" 10 "SunRoofAndCurtExtCmdTyp_CurtOpnShort" 11 "SunRoofAndCurtExtCmdTyp_PanClsShort" 12 "SunRoofAndCurtExtCmdTyp_PanOpnShort" 13 "SunRoofAndCurtExtCmdTyp_CurtHalfOpn" 14 "SunRoofAndCurtExtCmdTyp_PanHalfOpn" 15 "SunRoofAndCurtExtCmdTyp_CurtAndPanInin";
VAL_ 1173 SwtBeamHi 0 "BeamHiFctReq1_Neut" 1 "BeamHiFctReq1_Flash" 2 "BeamHiFctReq1_HiBeam" 3 "BeamHiFctReq1_LoBeam";
VAL_ 1173 SwtLiHzrdWarn 0 "PsdNotPsd_NotPsd" 1 "PsdNotPsd_Psd";
VAL_ 1173 TankFlapReqFromSwtIntrFild 0 "PsdNotPsd1_NotPsd" 1 "PsdNotPsd1_Psd";
VAL_ 1173 TrOpenerReqTrigSrc 0 "TrOpenerTrigSrc1_TrNoTrigSrc" 1 "TrOpenerTrigSrc1_TrKeyRem" 2 "TrOpenerTrigSrc1_TrSwtIntr" 3 "TrOpenerTrigSrc1_TrByFootOper" 4 "TrOpenerTrigSrc1_TrHndlOutd" 5 "TrOpenerTrigSrc1_TrShutFace" 6 "TrOpenerTrigSrc1_TrHMI" 7 "TrOpenerTrigSrc1_TrByAppch";
VAL_ 1173 TrOpenerReqTrOpenerReq 0 "TrOpenerReq1_TrOpenerIdle" 1 "TrOpenerReq1_TrOpenerOpen" 2 "TrOpenerReq1_TrOpenerCls" 3 "TrOpenerReq1_TrOpenerStop" 4 "TrOpenerReq1_TrOpenerClsDly";
VAL_ 1173 TrsmParkLockSt 0 "LockSt4_Engaged" 1 "LockSt4_Disengaged" 2 "LockSt4_In_Progs" 3 "LockSt4_Undefined";
VAL_ 1173 WiprActv 0 "OnOff1_Off" 1 "OnOff1_On";
VAL_ 1173 WiprInWipgAr 0 "OnOff1_Off" 1 "OnOff1_On";
VAL_ 1173 WiprMotFrntLvrCmdSafeLvrInHiSpdPosnSafe 0 "OnOffCrit1_NotVld1" 1 "OnOffCrit1_Off" 2 "OnOffCrit1_On" 3 "OnOffCrit1_NotVld2";
VAL_ 1173 WiprMotFrntLvrCmdSafeLvrInIntlPosn 0 "OnOff1_Off" 1 "OnOff1_On";
VAL_ 1173 WiprMotFrntLvrCmdSafeLvrInLoSpdPosnSafe 0 "OnOffCrit1_NotVld1" 1 "OnOffCrit1_Off" 2 "OnOffCrit1_On" 3 "OnOffCrit1_NotVld2";
VAL_ 1173 WiprMotFrntLvrCmdSafeLvrInSnglStrokePos 0 "OnOff1_Off" 1 "OnOff1_On";
VAL_ 81 ClsdDueToRain 0 "ClsdDueToRain_IDLE" 1 "ClsdDueToRain_TRUE" 2 "ClsdDueToRain_FALSE";
VAL_ 659 AlrmTrsnMode 0 "Boolean_FALSE" 1 "Boolean_TRUE";
VAL_ 659 HvBattThermInfoCorrInFutureThermModAtTime 0 "Idle" 1 "ThermalBalancing" 2 "PassiveHeating" 3 "ActiveHeating" 4 "PassiveCooling" 5 "ActiveCooling" 6 "CombinedCooling" 7 "Reserved";
VAL_ 659 LiBattInPWLock 0 "OnOff1_Off" 1 "OnOff1_On";
VAL_ 659 PtCoolgPostRunActv 0 "Boolean_FALSE" 1 "Boolean_TRUE";
VAL_ 659 PtTotBrkTqReqPtTotBrkTqEna 0 "OnOff1_Off" 1 "OnOff1_On";
VAL_ 659 RainSnsrActvnErrToHmi 0 "OnOff1_Off" 1 "OnOff1_On";
VAL_ 659 StandStillReqForCmftToBrkgForEPedl 0 "Boolean_FALSE" 1 "Boolean_TRUE";
VAL_ 659 SteerLockMgrWarnIndcn 0 "SteerLockMgrWarnIndcn_SteerLockMgrNoMsg" 1 "SteerLockMgrWarnIndcn_SteerLockTiOutMsgMgr" 2 "SteerLockMgrWarnIndcn_SteerLockMsgNotProgdMgr" 3 "SteerLockMgrWarnIndcn_FltSteerLockMsgMgr" 4 "SteerLockMgrWarnIndcn_SteerLockTqMsgMgr" 5 "SteerLockMgrWarnIndcn_CryptoSteerLockMsgMgr" 6 "SteerLockMgrWarnIndcn_SftySteerLockMsgMgr" 7 "SteerLockMgrWarnIndcn_SteerLockMsgInVldMgr";
VAL_ 659 StrtRemSts1WdStrtRemSts 0 "StrtRemSts1_Idle" 1 "StrtRemSts1_Strtg" 2 "StrtRemSts1_Actv";
VAL_ 659 VehPropSts 0 "Boolean_FALSE" 1 "Boolean_TRUE";
VAL_ 659 WiprSysFailrDetdSafe 0 "OnOffCrit1_NotVld1" 1 "OnOffCrit1_Off" 2 "OnOffCrit1_On" 3 "OnOffCrit1_NotVld2";
VAL_ 659 WshrFldTankStsToHMI 0 "OnOff1_Off" 1 "OnOff1_On";
VAL_ 569 ConvPwrRelsForbRelsFrbn1 0 "Boolean_FALSE" 1 "Boolean_TRUE";
VAL_ 569 ConvPwrRelsForbRelsMtnFrbn 0 "Boolean_FALSE" 1 "Boolean_TRUE";
VAL_ 569 HeatrPmpStatCooltPmpDryErr 0 "CooltPmpDryErr_RunDryNotDetd" 1 "CooltPmpDryErr_RunDryDetd" 2 "CooltPmpDryErr_Resd1" 3 "CooltPmpDryErr_Resd2";
VAL_ 569 HeatrPmpStatCooltPmpEmgyModSts 0 "CooltPmpEmgyModSts_EmgyRunNotActv" 1 "CooltPmpEmgyModSts_EmgyRunActv" 2 "CooltPmpEmgyModSts_Resd1" 3 "CooltPmpEmgyModSts_Resd2";
VAL_ 569 HeatrPmpStatCooltPmpErrSts 0 "CooltPmpErrSts_StNoErr" 1 "CooltPmpErrSts_StErr" 2 "CooltPmpErrSts_StNewErr" 3 "CooltPmpErrSts_Resd";
VAL_ 569 HeatrPmpStatCooltPmpIErr 0 "CooltPmpIErr_INoErr" 1 "CooltPmpIErr_IErr" 2 "CooltPmpIErr_Resd1" 3 "CooltPmpIErr_Resd2";
VAL_ 569 HeatrPmpStatCooltPmpMonrSpd 0 "CooltPmpMonrSpd_MonrSpdActv" 1 "CooltPmpMonrSpd_MonrSpdNoActv" 2 "CooltPmpMonrSpd_Resd1" 3 "CooltPmpMonrSpd_Resd2";
VAL_ 569 HeatrPmpStatCooltPmpPostRunSts 0 "CooltPmpPostRunSts_CooltPmpPostRunFinshd" 1 "CooltPmpPostRunSts_CooltPmpPostRunCncld" 2 "CooltPmpPostRunSts_Resd1" 3 "CooltPmpPostRunSts_Resd2";
VAL_ 569 HeatrPmpStatCooltPmpSetPostRunReq 0 "CooltPmpSetPostRunReq_CooltPmpSetNoPostRun" 1 "CooltPmpSetPostRunReq_CooltPmpSetPostRun1" 2 "CooltPmpSetPostRunReq_CooltPmpSetPostRun2" 3 "CooltPmpSetPostRunReq_CooltPmpSetPostRun3" 4 "CooltPmpSetPostRunReq_CooltPmpSetPostRun4" 5 "CooltPmpSetPostRunReq_CooltPmpSetPostRun5" 6 "CooltPmpSetPostRunReq_Resd1" 7 "CooltPmpSetPostRunReq_Resd2";
VAL_ 569 HeatrPmpStatCooltPmpTErr 0 "CooltPmpTErr_CooltPmpNoTErr" 1 "CooltPmpTErr_CooltPmpTErr" 2 "CooltPmpTErr_Resd1" 3 "CooltPmpTErr_Resd2";
VAL_ 569 HeatrPmpStatCooltPmpUErr 0 "CooltPmpUErr_CooltPmpNoUErr" 1 "CooltPmpUErr_CooltPmpUErr" 2 "CooltPmpUErr_Resd1" 3 "CooltPmpUErr_Resd2";
VAL_ 569 HeatrPmpStatCooltPmpUnstallSts 0 "CooltPmpUnstallSts_CooltPmpUnstallNotActv" 1 "CooltPmpUnstallSts_CooltPmpUnstallActv" 2 "CooltPmpUnstallSts_Resd1" 3 "CooltPmpUnstallSts_Resd2";
VAL_ 569 SldngdoorLeReAntiPnchFaultFltMovngEvnt 0 "Boolean_FALSE" 1 "Boolean_TRUE";
VAL_ 569 SldngdoorLeReAntiPnchFaultPinchEvnt 0 "Boolean_FALSE" 1 "Boolean_TRUE";
VAL_ 569 SldngdoorRiReAntiPnchFaultFltMovngEvnt 0 "Boolean_FALSE" 1 "Boolean_TRUE";
VAL_ 569 SldngdoorRiReAntiPnchFaultPinchEvnt 0 "Boolean_FALSE" 1 "Boolean_TRUE";
VAL_ 569 SldngLeReWarnIndDisSldngDoorWarn 0 "Boolean_FALSE" 1 "Boolean_TRUE";
VAL_ 569 SldngLeReWarnIndDriveOpnDoorWarn 0 "Boolean_FALSE" 1 "Boolean_TRUE";
VAL_ 569 SldngLeReWarnIndDurngDoorMovWarn 0 "Boolean_FALSE" 1 "Boolean_TRUE";
VAL_ 569 SldngLeReWarnIndEndNotSuccssWarn 0 "Boolean_FALSE" 1 "Boolean_TRUE";
VAL_ 569 SldngLeReWarnIndFltAndPitchWarn 0 "Boolean_FALSE" 1 "Boolean_TRUE";
VAL_ 569 SldngLeReWarnIndFltngDoorWarn 0 "Boolean_FALSE" 1 "Boolean_TRUE";
VAL_ 569 SldngLeReWarnIndPreConNotFulfil 0 "Boolean_FALSE" 1 "Boolean_TRUE";
VAL_ 569 SldngLeReWarnIndStpDurngMovWarn 0 "Boolean_FALSE" 1 "Boolean_TRUE";
VAL_ 569 SldngLeReWarnIndStrMovngWarn 0 "Boolean_FALSE" 1 "Boolean_TRUE";
VAL_ 569 SldngRiReWarnIndDisSldngDoorWarn 0 "Boolean_FALSE" 1 "Boolean_TRUE";
VAL_ 569 SldngRiReWarnIndDriveOpnDoorWarn 0 "Boolean_FALSE" 1 "Boolean_TRUE";
VAL_ 569 SldngRiReWarnIndDurngDoorMovWarn 0 "Boolean_FALSE" 1 "Boolean_TRUE";
VAL_ 569 SldngRiReWarnIndEndNotSuccssWarn 0 "Boolean_FALSE" 1 "Boolean_TRUE";
VAL_ 569 SldngRiReWarnIndFltAndPitchWarn 0 "Boolean_FALSE" 1 "Boolean_TRUE";
VAL_ 569 SldngRiReWarnIndFltngDoorWarn 0 "Boolean_FALSE" 1 "Boolean_TRUE";
VAL_ 569 SldngRiReWarnIndPreConNotFulfil 0 "Boolean_FALSE" 1 "Boolean_TRUE";
VAL_ 569 SldngRiReWarnIndStpDurngMovWarn 0 "Boolean_FALSE" 1 "Boolean_TRUE";
VAL_ 569 SldngRiReWarnIndStrMovngWarn 0 "Boolean_FALSE" 1 "Boolean_TRUE";
VAL_ 82 NFCKeySearchReqKeyLocn 0 "KeyLocn1_KeyLocnIdle" 1 "KeyLocn1_KeyLocnAll" 2 "KeyLocn1_KeyLocnAllExt" 3 "KeyLocn1_KeyLocnDrvrExt" 4 "KeyLocn1_KeyLocnPassExt" 5 "KeyLocn1_KeyLocnTrExt" 6 "KeyLocn1_KeyLocnAllInt" 7 "KeyLocn1_KeyLocnDrvrInt" 8 "KeyLocn1_KeyLocnPassInt" 9 "KeyLocn1_KeyLocnResvInt" 10 "KeyLocn1_KeyLocnResvIntSimple";
VAL_ 82 NFCKeySearchReqTirgger 0 "Tirgger_Idle" 1 "Tirgger_VMM" 2 "Tirgger_Locking" 3 "Tirgger_KeyRmn" 4 "Tirgger_KeyWrn" 5 "Tirgger_ProfiMgr";
SIG_GROUP_ 67 BookTrvlTiSetReq 1 : BookTrvlTiSetReqBookTrvlChrgnTi BookTrvlTiSetReqBookTrvlTiSetReq;
SIG_GROUP_ 569 ConvPwrRelsForb 1 : ConvPwrRelsForbRelsFrbn1 ConvPwrRelsForbRelsMtnFrbn;
SIG_GROUP_ 659 DiagFrameForECM 1 : DiagFrameForECMByte0 DiagFrameForECMByte1 DiagFrameForECMByte2 DiagFrameForECMByte3 DiagFrameForECMByte4 DiagFrameForECMByte5 DiagFrameForECMByte6 DiagFrameForECMByte7;
SIG_GROUP_ 81 DKDataFromCEM 1 : DKDataFromCEMAcknowledgment DKDataFromCEMDKDataByte1 DKDataFromCEMDKDataByte2 DKDataFromCEMDKDataByte3 DKDataFromCEMDKDataByte4 DKDataFromCEMDKDataByte5 DKDataFromCEMDKDataByte6 DKDataFromCEMHeader;
SIG_GROUP_ 1161 DmcStsFrntToEsc 1 : DmcStsFrntToEscChks DmcStsFrntToEscCntr DmcStsFrntToEscDmcActAppTarTq DmcStsFrntToEscDmcSts DmcStsFrntToEscDmcSWInfo;
SIG_GROUP_ 1161 DrvrSteerActv 1 : DrvrSteerActvChks DrvrSteerActvCntr DrvrSteerActvDrvrSteerActv;
SIG_GROUP_ 1173 EngNSafe 1 : EngNSafeEngN EngNSafeEngNChks EngNSafeEngNCntr EngNSafeEngNGrdt;
SIG_GROUP_ 1173 EngRunngReqByVehModMgr 1 : EngRunngReqByVehModMgrChassie EngRunngReqByVehModMgrClimate EngRunngReqByVehModMgrElectricalSystem EngRunngReqByVehModMgrTrailerPrsnt;
SIG_GROUP_ 1161 EpbAvlSec 1 : EpbAvlSecChks EpbAvlSecCntr EpbAvlSecCommunicationAvailable EpbAvlSecHostAvailabilityFull EpbAvlSecHostAvailabilityRelOnly EpbAvlSecReserved1 EpbAvlSecReserved2 EpbAvlSecReserved3 EpbAvlSecReserved4 EpbAvlSecReserved5 EpbAvlSecReserved6 EpbAvlSecReserved7;
SIG_GROUP_ 569 HeatrPmpStat 1 : HeatrPmpStatCooltPmpDryErr HeatrPmpStatCooltPmpEmgyModSts HeatrPmpStatCooltPmpErrSts HeatrPmpStatCooltPmpI HeatrPmpStatCooltPmpIErr HeatrPmpStatCooltPmpMonrSpd HeatrPmpStatCooltPmpPostRunSts HeatrPmpStatCooltPmpSetPostRunReq HeatrPmpStatCooltPmpSetSpdReq HeatrPmpStatCooltPmpSpd HeatrPmpStatCooltPmpT HeatrPmpStatCooltPmpTErr HeatrPmpStatCooltPmpU HeatrPmpStatCooltPmpUErr HeatrPmpStatCooltPmpUnstallSts;
SIG_GROUP_ 659 HvBattThermInfoCorrInFuture 1 : HvBattThermInfoCorrInFuturePwrAtTime HvBattThermInfoCorrInFutureSequenceNo HvBattThermInfoCorrInFutureTempAtTime HvBattThermInfoCorrInFutureThermModAtTime HvBattThermInfoCorrInFutureTime HvBattThermInfoCorrInFutureVersionNo;
SIG_GROUP_ 800 HvCooltHeatrEnadWhE2E 1 : HvCooltHeatrEnadWhE2EChks HvCooltHeatrEnadWhE2ECntr HvCooltHeatrEnadWhE2EHvchEnad;
SIG_GROUP_ 1173 IntrMirrCmd 1 : IntrMirrCmdDrvrSide IntrMirrCmdIntrMirrAsyFanCmpMag IntrMirrCmdIntrMirrDiagcRst IntrMirrCmdIntrMirrDimSnvty IntrMirrCmdIntrMirrEna IntrMirrCmdIntrMirrInhbDim IntrMirrCmdIntrMirrWindHeatrCmpMag;
SIG_GROUP_ 1161 IsgSpdActSgnSafe 1 : IsgSpdActSgnSafeChks IsgSpdActSgnSafeCntr IsgSpdActSgnSafeIsgSpdActSgn800 IsgSpdActSgnSafeQF;
SIG_GROUP_ 1161 IsgTqAvl 1 : IsgTqAvlMax IsgTqAvlMin;
SIG_GROUP_ 1173 LatCtrlModCfmd 1 : LatCtrlModCfmdChks LatCtrlModCfmdCntr LatCtrlModCfmdLatCtrlMod;
SIG_GROUP_ 659 MirrPosnAdjFromSetTarPosnDrvr 1 : MirrPosnAdjFromSetTarPosnDrvrMirrAdjLeRi MirrPosnAdjFromSetTarPosnDrvrMirrAdjUpDown;
SIG_GROUP_ 1161 Mot1ReqSafe 1 : Mot1ReqSafeChks Mot1ReqSafeCntr Mot1ReqSafemod Mot1ReqSafeRsv Mot1ReqSafespd Mot1ReqSafetq;
SIG_GROUP_ 1161 Mot3ReqSafe 1 : Mot3ReqSafeChks Mot3ReqSafeCntr Mot3ReqSafemod Mot3ReqSafeRsv Mot3ReqSafespd Mot3ReqSafetq;
SIG_GROUP_ 264 MotDynCtrlStsReLe 1 : MotDynCtrlStsReLeChks MotDynCtrlStsReLeCntr MotDynCtrlStsReLeDmcActAppTarTq MotDynCtrlStsReLeDmcSts MotDynCtrlStsReLeDmcSWInfo;
SIG_GROUP_ 264 MotDynCtrlStsReRi 1 : MotDynCtrlStsReRiChks MotDynCtrlStsReRiCntr MotDynCtrlStsReRiDmcActAppTarTq MotDynCtrlStsReRiDmcSts MotDynCtrlStsReRiDmcSWInfo;
SIG_GROUP_ 82 NFCAndBLEKeyDiReq 1 : NFCAndBLEKeyDiReqData1 NFCAndBLEKeyDiReqData10 NFCAndBLEKeyDiReqData11 NFCAndBLEKeyDiReqData12 NFCAndBLEKeyDiReqData13 NFCAndBLEKeyDiReqData14 NFCAndBLEKeyDiReqData15 NFCAndBLEKeyDiReqData16 NFCAndBLEKeyDiReqData2 NFCAndBLEKeyDiReqData3 NFCAndBLEKeyDiReqData4 NFCAndBLEKeyDiReqData5 NFCAndBLEKeyDiReqData6 NFCAndBLEKeyDiReqData7 NFCAndBLEKeyDiReqData8 NFCAndBLEKeyDiReqData9;
SIG_GROUP_ 82 NFCKeySearchReq 1 : NFCKeySearchReqKeyLocn NFCKeySearchReqTirgger;
SIG_GROUP_ 67 PrpsnDataEvtA 1 : PrpsnDataEvtACnt PrpsnDataEvtAData1 PrpsnDataEvtAData2 PrpsnDataEvtAData3 PrpsnDataEvtAData4 PrpsnDataEvtAData5 PrpsnDataEvtAData6 PrpsnDataEvtAID;
SIG_GROUP_ 67 PrpsnDataEvtB 1 : PrpsnDataEvtBCnt PrpsnDataEvtBData1 PrpsnDataEvtBData2 PrpsnDataEvtBData3 PrpsnDataEvtBData4 PrpsnDataEvtBData5 PrpsnDataEvtBData6 PrpsnDataEvtBID;
SIG_GROUP_ 659 PrpsnDataPrdA 1 : PrpsnDataPrdACnt PrpsnDataPrdAData1 PrpsnDataPrdAData2 PrpsnDataPrdAData3 PrpsnDataPrdAData4 PrpsnDataPrdAData5 PrpsnDataPrdAData6 PrpsnDataPrdAData7;
SIG_GROUP_ 659 PrpsnDataPrdB 1 : PrpsnDataPrdBCnt PrpsnDataPrdBData1 PrpsnDataPrdBData2 PrpsnDataPrdBData3 PrpsnDataPrdBData4 PrpsnDataPrdBData5 PrpsnDataPrdBData6 PrpsnDataPrdBData7;
SIG_GROUP_ 1161 PtCluTq 1 : PtCluTqDyn PtCluTqPtCluTq PtCluTqQly;
SIG_GROUP_ 659 PtTotBrkTqReq 1 : PtTotBrkTqReqPtTotBrkTqEna PtTotBrkTqReqPtTotBrkTqReq;
SIG_GROUP_ 264 PtVehSpdMax 1 : PtVehSpdMaxChks PtVehSpdMaxCntr PtVehSpdMaxReq;
SIG_GROUP_ 1173 RemStrtMsgToDrvr 1 : RemStrtMsgToDrvrRemStrtBlkd1 RemStrtMsgToDrvrRemStrtDev1;
SIG_GROUP_ 264 SbWSyncStsH1 1 : SbWSyncStsH1Chks SbWSyncStsH1Cntr SbWSyncStsH1HWASyncSts;
SIG_GROUP_ 264 SeatMassgFctRowSecLe 1 : SeatMassgFctRowSecLeMassgInten SeatMassgFctRowSecLeMassgProg SeatMassgFctRowSecLeOnOff;
SIG_GROUP_ 264 SeatMassgFctRowSecRi 1 : SeatMassgFctRowSecRiMassgInten SeatMassgFctRowSecRiMassgProg SeatMassgFctRowSecRiOnOff;
SIG_GROUP_ 569 SldngdoorLeReAntiPnchFault 1 : SldngdoorLeReAntiPnchFaultFltMovngEvnt SldngdoorLeReAntiPnchFaultPinchEvnt;
SIG_GROUP_ 569 SldngdoorRiReAntiPnchFault 1 : SldngdoorRiReAntiPnchFaultFltMovngEvnt SldngdoorRiReAntiPnchFaultPinchEvnt;
SIG_GROUP_ 569 SldngLeReWarnInd 1 : SldngLeReWarnIndDisSldngDoorWarn SldngLeReWarnIndDriveOpnDoorWarn SldngLeReWarnIndDurngDoorMovWarn SldngLeReWarnIndEndNotSuccssWarn SldngLeReWarnIndFltAndPitchWarn SldngLeReWarnIndFltngDoorWarn SldngLeReWarnIndPreConNotFulfil SldngLeReWarnIndStpDurngMovWarn SldngLeReWarnIndStrMovngWarn;
SIG_GROUP_ 569 SldngRiReWarnInd 1 : SldngRiReWarnIndDisSldngDoorWarn SldngRiReWarnIndDriveOpnDoorWarn SldngRiReWarnIndDurngDoorMovWarn SldngRiReWarnIndEndNotSuccssWarn SldngRiReWarnIndFltAndPitchWarn SldngRiReWarnIndFltngDoorWarn SldngRiReWarnIndPreConNotFulfil SldngRiReWarnIndStpDurngMovWarn SldngRiReWarnIndStrMovngWarn;
SIG_GROUP_ 1161 SteerExtFctSts 1 : SteerExtFctStsChks SteerExtFctStsCntr SteerExtFctStsDrvrSteerOvrd SteerExtFctStsExtFctLowerLimActive SteerExtFctStsExtFctRateLimActive SteerExtFctStsExtFctUpperLimActive SteerExtFctStsExtSafeLimActive SteerExtFctStsLatAgReqNotInRange SteerExtFctStsLatCtrlReqNotInRange;
SIG_GROUP_ 1161 SteerLockSts 1 : SteerLockStsBolt SteerLockStsFault SteerLockStsSafety SteerLockStsUnit;
SIG_GROUP_ 1161 SuspFailrSts 1 : SuspFailrStsChks SuspFailrStsCntr SuspFailrStsSuspFailrSts SuspFailrStsTypQf;
SIG_GROUP_ 1173 TrOpenerReq 1 : TrOpenerReqTrigSrc TrOpenerReqTrOpenerReq;
SIG_GROUP_ 1161 TrsmActrPosnSafeAux 1 : TrsmActrPosnSafeAuxTrsmActrPosn TrsmActrPosnSafeAuxTrsmActrPosnChks TrsmActrPosnSafeAuxTrsmActrPosnCntr;
SIG_GROUP_ 1161 TrsmTqLoss 1 : TrsmTqLossChks TrsmTqLossCntr TrsmTqLossTrsmTqEff TrsmTqLossTrsmTqLoss;
SIG_GROUP_ 800 VFCVectorPOT 1 : VFCVectorPOTBlockID VFCVectorPOTVFCid0 VFCVectorPOTVFCid1 VFCVectorPOTVFCid10 VFCVectorPOTVFCid11 VFCVectorPOTVFCid12 VFCVectorPOTVFCid13 VFCVectorPOTVFCid14 VFCVectorPOTVFCid15 VFCVectorPOTVFCid16 VFCVectorPOTVFCid17 VFCVectorPOTVFCid18 VFCVectorPOTVFCid19 VFCVectorPOTVFCid2 VFCVectorPOTVFCid20 VFCVectorPOTVFCid21 VFCVectorPOTVFCid22 VFCVectorPOTVFCid23 VFCVectorPOTVFCid24 VFCVectorPOTVFCid25 VFCVectorPOTVFCid26 VFCVectorPOTVFCid27 VFCVectorPOTVFCid28 VFCVectorPOTVFCid29 VFCVectorPOTVFCid3 VFCVectorPOTVFCid30 VFCVectorPOTVFCid31 VFCVectorPOTVFCid32 VFCVectorPOTVFCid33 VFCVectorPOTVFCid34 VFCVectorPOTVFCid35 VFCVectorPOTVFCid36 VFCVectorPOTVFCid37 VFCVectorPOTVFCid38 VFCVectorPOTVFCid39 VFCVectorPOTVFCid4 VFCVectorPOTVFCid40 VFCVectorPOTVFCid41 VFCVectorPOTVFCid42 VFCVectorPOTVFCid43 VFCVectorPOTVFCid44 VFCVectorPOTVFCid45 VFCVectorPOTVFCid46 VFCVectorPOTVFCid47 VFCVectorPOTVFCid48 VFCVectorPOTVFCid49 VFCVectorPOTVFCid5 VFCVectorPOTVFCid50 VFCVectorPOTVFCid51 VFCVectorPOTVFCid52 VFCVectorPOTVFCid53 VFCVectorPOTVFCid54 VFCVectorPOTVFCid55 VFCVectorPOTVFCid56 VFCVectorPOTVFCid57 VFCVectorPOTVFCid58 VFCVectorPOTVFCid59 VFCVectorPOTVFCid6 VFCVectorPOTVFCid60 VFCVectorPOTVFCid61 VFCVectorPOTVFCid7 VFCVectorPOTVFCid8 VFCVectorPOTVFCid9;
SIG_GROUP_ 800 VFCVectorRBCM 1 : VFCVectorRBCMBlockID VFCVectorRBCMVFCid0 VFCVectorRBCMVFCid1 VFCVectorRBCMVFCid10 VFCVectorRBCMVFCid11 VFCVectorRBCMVFCid12 VFCVectorRBCMVFCid13 VFCVectorRBCMVFCid14 VFCVectorRBCMVFCid15 VFCVectorRBCMVFCid16 VFCVectorRBCMVFCid17 VFCVectorRBCMVFCid18 VFCVectorRBCMVFCid19 VFCVectorRBCMVFCid2 VFCVectorRBCMVFCid20 VFCVectorRBCMVFCid21 VFCVectorRBCMVFCid22 VFCVectorRBCMVFCid23 VFCVectorRBCMVFCid24 VFCVectorRBCMVFCid25 VFCVectorRBCMVFCid26 VFCVectorRBCMVFCid27 VFCVectorRBCMVFCid28 VFCVectorRBCMVFCid29 VFCVectorRBCMVFCid3 VFCVectorRBCMVFCid30 VFCVectorRBCMVFCid31 VFCVectorRBCMVFCid32 VFCVectorRBCMVFCid33 VFCVectorRBCMVFCid34 VFCVectorRBCMVFCid35 VFCVectorRBCMVFCid36 VFCVectorRBCMVFCid37 VFCVectorRBCMVFCid38 VFCVectorRBCMVFCid39 VFCVectorRBCMVFCid4 VFCVectorRBCMVFCid40 VFCVectorRBCMVFCid41 VFCVectorRBCMVFCid42 VFCVectorRBCMVFCid43 VFCVectorRBCMVFCid44 VFCVectorRBCMVFCid45 VFCVectorRBCMVFCid46 VFCVectorRBCMVFCid47 VFCVectorRBCMVFCid48 VFCVectorRBCMVFCid49 VFCVectorRBCMVFCid5 VFCVectorRBCMVFCid50 VFCVectorRBCMVFCid51 VFCVectorRBCMVFCid52 VFCVectorRBCMVFCid53 VFCVectorRBCMVFCid54 VFCVectorRBCMVFCid55 VFCVectorRBCMVFCid56 VFCVectorRBCMVFCid57 VFCVectorRBCMVFCid58 VFCVectorRBCMVFCid59 VFCVectorRBCMVFCid6 VFCVectorRBCMVFCid60 VFCVectorRBCMVFCid61 VFCVectorRBCMVFCid7 VFCVectorRBCMVFCid8 VFCVectorRBCMVFCid9;
SIG_GROUP_ 800 VFCVectorSRS 1 : VFCVectorSRSBlockID VFCVectorSRSVFCid0 VFCVectorSRSVFCid1 VFCVectorSRSVFCid10 VFCVectorSRSVFCid11 VFCVectorSRSVFCid12 VFCVectorSRSVFCid13 VFCVectorSRSVFCid14 VFCVectorSRSVFCid15 VFCVectorSRSVFCid16 VFCVectorSRSVFCid17 VFCVectorSRSVFCid18 VFCVectorSRSVFCid19 VFCVectorSRSVFCid2 VFCVectorSRSVFCid20 VFCVectorSRSVFCid21 VFCVectorSRSVFCid22 VFCVectorSRSVFCid23 VFCVectorSRSVFCid24 VFCVectorSRSVFCid25 VFCVectorSRSVFCid26 VFCVectorSRSVFCid27 VFCVectorSRSVFCid28 VFCVectorSRSVFCid29 VFCVectorSRSVFCid3 VFCVectorSRSVFCid30 VFCVectorSRSVFCid31 VFCVectorSRSVFCid32 VFCVectorSRSVFCid33 VFCVectorSRSVFCid34 VFCVectorSRSVFCid35 VFCVectorSRSVFCid36 VFCVectorSRSVFCid37 VFCVectorSRSVFCid38 VFCVectorSRSVFCid39 VFCVectorSRSVFCid4 VFCVectorSRSVFCid40 VFCVectorSRSVFCid41 VFCVectorSRSVFCid42 VFCVectorSRSVFCid43 VFCVectorSRSVFCid44 VFCVectorSRSVFCid45 VFCVectorSRSVFCid46 VFCVectorSRSVFCid47 VFCVectorSRSVFCid48 VFCVectorSRSVFCid49 VFCVectorSRSVFCid5 VFCVectorSRSVFCid50 VFCVectorSRSVFCid51 VFCVectorSRSVFCid52 VFCVectorSRSVFCid53 VFCVectorSRSVFCid54 VFCVectorSRSVFCid55 VFCVectorSRSVFCid56 VFCVectorSRSVFCid57 VFCVectorSRSVFCid58 VFCVectorSRSVFCid59 VFCVectorSRSVFCid6 VFCVectorSRSVFCid60 VFCVectorSRSVFCid61 VFCVectorSRSVFCid7 VFCVectorSRSVFCid8 VFCVectorSRSVFCid9;
SIG_GROUP_ 800 VFCVectorSUM 1 : VFCVectorSUMBlockID VFCVectorSUMVFCid0 VFCVectorSUMVFCid1 VFCVectorSUMVFCid10 VFCVectorSUMVFCid11 VFCVectorSUMVFCid12 VFCVectorSUMVFCid13 VFCVectorSUMVFCid14 VFCVectorSUMVFCid15 VFCVectorSUMVFCid16 VFCVectorSUMVFCid17 VFCVectorSUMVFCid18 VFCVectorSUMVFCid19 VFCVectorSUMVFCid2 VFCVectorSUMVFCid20 VFCVectorSUMVFCid21 VFCVectorSUMVFCid22 VFCVectorSUMVFCid23 VFCVectorSUMVFCid24 VFCVectorSUMVFCid25 VFCVectorSUMVFCid26 VFCVectorSUMVFCid27 VFCVectorSUMVFCid28 VFCVectorSUMVFCid29 VFCVectorSUMVFCid3 VFCVectorSUMVFCid30 VFCVectorSUMVFCid31 VFCVectorSUMVFCid32 VFCVectorSUMVFCid33 VFCVectorSUMVFCid34 VFCVectorSUMVFCid35 VFCVectorSUMVFCid36 VFCVectorSUMVFCid37 VFCVectorSUMVFCid38 VFCVectorSUMVFCid39 VFCVectorSUMVFCid4 VFCVectorSUMVFCid40 VFCVectorSUMVFCid41 VFCVectorSUMVFCid42 VFCVectorSUMVFCid43 VFCVectorSUMVFCid44 VFCVectorSUMVFCid45 VFCVectorSUMVFCid46 VFCVectorSUMVFCid47 VFCVectorSUMVFCid48 VFCVectorSUMVFCid49 VFCVectorSUMVFCid5 VFCVectorSUMVFCid50 VFCVectorSUMVFCid51 VFCVectorSUMVFCid52 VFCVectorSUMVFCid53 VFCVectorSUMVFCid54 VFCVectorSUMVFCid55 VFCVectorSUMVFCid56 VFCVectorSUMVFCid57 VFCVectorSUMVFCid58 VFCVectorSUMVFCid59 VFCVectorSUMVFCid6 VFCVectorSUMVFCid60 VFCVectorSUMVFCid61 VFCVectorSUMVFCid7 VFCVectorSUMVFCid8 VFCVectorSUMVFCid9;
SIG_GROUP_ 1173 WiprMotFrntLvrCmdSafe 1 : WiprMotFrntLvrCmdSafeLvrInHiSpdPosnSafe WiprMotFrntLvrCmdSafeLvrInIntlPosn WiprMotFrntLvrCmdSafeLvrInLoSpdPosnSafe WiprMotFrntLvrCmdSafeLvrInSnglStrokePos;
