// *************************************************************************** *
// *                                                                           *
// * Description:         CANDB File                                           *
// * Generated at:        2025-01-24 14:38                                     *
// * System:              SDB22436                                             *
// * Variant:             L946_ADCU9_ZCUD                                      *
// * Network:             ZCU_CANFD2                                           *
// *                                                                           *
// *************************************************************************** *
VERSION "ZCU_CANFD2"

NS_ :

BS_ :

BU_ :  ETC IHU ZCUD ZCUP

BO_ 328 ZCUDZCUCANFD2Fr51 : 64 ZCUD
 SG_ AjarChrgLidFrntSwitch : 74|2@0+ (1,0) [0|3] "" IHU
 SG_ AjarChrgLidFrntSwitch_UB : 72|1@0+ (1,0) [0|1] "" IHU
 SG_ CrabMovAvmReq : 7|1@0+ (1,0) [0|1] "" IHU
 SG_ CrabMovAvmReq_UB : 6|1@0+ (1,0) [0|1] "" IHU
 SG_ CrabMovIndcnMsg : 4|5@0+ (1.0,0.0) [0.0|31.0] "Unitless" IHU
 SG_ CrabMovIndcnMsg_UB : 5|1@0+ (1,0) [0|1] "" IHU
 SG_ CrabMovMonrReq : 16|1@0+ (1,0) [0|1] "" IHU
 SG_ CrabMovMonrReq_UB : 40|1@0+ (1,0) [0|1] "" IHU
 SG_ CrabMovNotAvailable : 31|1@0+ (1,0) [0|1] "" IHU
 SG_ CrabMovNotAvailable_UB : 30|1@0+ (1,0) [0|1] "" IHU
 SG_ CrabMovStLiReq_UB : 17|1@0+ (1,0) [0|1] "" IHU
 SG_ CrabMovStLiReqChks : 15|8@0+ (1.0,0.0) [0.0|255.0] "Unitless" IHU
 SG_ CrabMovStLiReqCntr : 23|4@0+ (1.0,0.0) [0.0|15.0] "Unitless" IHU
 SG_ CrabMovStLiReqStLiReq : 19|2@0+ (1,0) [0|3] "" IHU
 SG_ LowSpdStrIndcnMsg : 28|5@0+ (1.0,0.0) [0.0|31.0] "Unitless" IHU
 SG_ LowSpdStrIndcnMsg_UB : 29|1@0+ (1,0) [0|1] "" IHU
 SG_ LowSpdStrNotAvailable : 77|1@0+ (1,0) [0|1] "" IHU
 SG_ LowSpdStrNotAvailable_UB : 76|1@0+ (1,0) [0|1] "" IHU
 SG_ LowSpdStrNotAvailableForSecMod : 178|1@0+ (1,0) [0|1] "" IHU
 SG_ LowSpdStrNotAvailableForSecMod_UB : 177|1@0+ (1,0) [0|1] "" IHU
 SG_ LowSpdStrStLiReq_UB : 41|1@0+ (1,0) [0|1] "" IHU
 SG_ LowSpdStrStLiReqChks : 39|8@0+ (1.0,0.0) [0.0|255.0] "Unitless" IHU
 SG_ LowSpdStrStLiReqCntr : 47|4@0+ (1.0,0.0) [0.0|15.0] "Unitless" IHU
 SG_ LowSpdStrStLiReqForSecMod : 186|3@0+ (1,0) [0|7] "" IHU
 SG_ LowSpdStrStLiReqForSecMod_UB : 160|1@0+ (1,0) [0|1] "" IHU
 SG_ LowSpdStrStLiReqStLiReq : 43|2@0+ (1,0) [0|3] "" IHU
 SG_ LvlgFctAvl : 191|1@0+ (1,0) [0|1] "" IHU
 SG_ LvlgFctAvl_UB : 190|1@0+ (1,0) [0|1] "" IHU
 SG_ LvlgFctSts : 189|2@0+ (1,0) [0|3] "" IHU
 SG_ LvlgFctSts_UB : 187|1@0+ (1,0) [0|1] "" IHU
 SG_ MeCnsAvgIndcdMeCnsIndcdVal1 : 159|13@0+ (0.1,0.0) [0.0|819.1] "LPer100kilometer_1" IHU
 SG_ MeCnsAvgIndcdMeCnsIndcdVal1_UB : 162|1@0+ (1,0) [0|1] "" IHU
 SG_ MeCnsAvgIndcdMeCnsIndcdVal2 : 175|13@0+ (0.1,0.0) [0.0|819.1] "LPer100kilometer_1" IHU
 SG_ MeCnsAvgIndcdMeCnsIndcdVal2_UB : 161|1@0+ (1,0) [0|1] "" IHU
 SG_ NFCKeyReadStsToHMI2_UB : 75|1@0+ (1,0) [0|1] "" IHU
 SG_ NFCKeyReadStsToHMI2Key0 : 87|2@0+ (1,0) [0|3] "" IHU
 SG_ NFCKeyReadStsToHMI2Key1 : 85|2@0+ (1,0) [0|3] "" IHU
 SG_ NFCKeyReadStsToHMI2Key10 : 99|2@0+ (1,0) [0|3] "" IHU
 SG_ NFCKeyReadStsToHMI2Key11 : 97|2@0+ (1,0) [0|3] "" IHU
 SG_ NFCKeyReadStsToHMI2Key12 : 111|2@0+ (1,0) [0|3] "" IHU
 SG_ NFCKeyReadStsToHMI2Key13 : 109|2@0+ (1,0) [0|3] "" IHU
 SG_ NFCKeyReadStsToHMI2Key14 : 107|2@0+ (1,0) [0|3] "" IHU
 SG_ NFCKeyReadStsToHMI2Key15 : 105|2@0+ (1,0) [0|3] "" IHU
 SG_ NFCKeyReadStsToHMI2Key16 : 119|2@0+ (1,0) [0|3] "" IHU
 SG_ NFCKeyReadStsToHMI2Key17 : 117|2@0+ (1,0) [0|3] "" IHU
 SG_ NFCKeyReadStsToHMI2Key18 : 115|2@0+ (1,0) [0|3] "" IHU
 SG_ NFCKeyReadStsToHMI2Key19 : 113|2@0+ (1,0) [0|3] "" IHU
 SG_ NFCKeyReadStsToHMI2Key2 : 83|2@0+ (1,0) [0|3] "" IHU
 SG_ NFCKeyReadStsToHMI2Key20 : 127|2@0+ (1,0) [0|3] "" IHU
 SG_ NFCKeyReadStsToHMI2Key21 : 125|2@0+ (1,0) [0|3] "" IHU
 SG_ NFCKeyReadStsToHMI2Key22 : 123|2@0+ (1,0) [0|3] "" IHU
 SG_ NFCKeyReadStsToHMI2Key23 : 121|2@0+ (1,0) [0|3] "" IHU
 SG_ NFCKeyReadStsToHMI2Key24 : 135|2@0+ (1,0) [0|3] "" IHU
 SG_ NFCKeyReadStsToHMI2Key25 : 133|2@0+ (1,0) [0|3] "" IHU
 SG_ NFCKeyReadStsToHMI2Key26 : 131|2@0+ (1,0) [0|3] "" IHU
 SG_ NFCKeyReadStsToHMI2Key27 : 129|2@0+ (1,0) [0|3] "" IHU
 SG_ NFCKeyReadStsToHMI2Key28 : 143|2@0+ (1,0) [0|3] "" IHU
 SG_ NFCKeyReadStsToHMI2Key29 : 141|2@0+ (1,0) [0|3] "" IHU
 SG_ NFCKeyReadStsToHMI2Key3 : 81|2@0+ (1,0) [0|3] "" IHU
 SG_ NFCKeyReadStsToHMI2Key30 : 139|2@0+ (1,0) [0|3] "" IHU
 SG_ NFCKeyReadStsToHMI2Key31 : 137|2@0+ (1,0) [0|3] "" IHU
 SG_ NFCKeyReadStsToHMI2Key32 : 151|2@0+ (1,0) [0|3] "" IHU
 SG_ NFCKeyReadStsToHMI2Key33 : 149|2@0+ (1,0) [0|3] "" IHU
 SG_ NFCKeyReadStsToHMI2Key34 : 147|2@0+ (1,0) [0|3] "" IHU
 SG_ NFCKeyReadStsToHMI2Key35 : 145|2@0+ (1,0) [0|3] "" IHU
 SG_ NFCKeyReadStsToHMI2Key4 : 95|2@0+ (1,0) [0|3] "" IHU
 SG_ NFCKeyReadStsToHMI2Key5 : 93|2@0+ (1,0) [0|3] "" IHU
 SG_ NFCKeyReadStsToHMI2Key6 : 91|2@0+ (1,0) [0|3] "" IHU
 SG_ NFCKeyReadStsToHMI2Key7 : 89|2@0+ (1,0) [0|3] "" IHU
 SG_ NFCKeyReadStsToHMI2Key8 : 103|2@0+ (1,0) [0|3] "" IHU
 SG_ NFCKeyReadStsToHMI2Key9 : 101|2@0+ (1,0) [0|3] "" IHU
 SG_ SeatMassgRunngPass2 : 79|1@0+ (1,0) [0|1] "" ZCUP
 SG_ SeatMassgRunngPass2_UB : 78|1@0+ (1,0) [0|1] "" ZCUP
 SG_ SteerActReForTvc : 55|15@0- (0.001,0.0) [-16.384|16.383] "Deg" IHU
 SG_ SteerActReForTvc_UB : 56|1@0+ (1,0) [0|1] "" IHU
 SG_ TankTurnActIndcnMsg : 71|5@0+ (1.0,0.0) [0.0|31.0] "Unitless" IHU
 SG_ TankTurnActIndcnMsg_UB : 66|1@0+ (1,0) [0|1] "" IHU
 SG_ TankTurnActYawRateForHMI : 199|8@0- (1.0,0.0) [-128.0|127.0] "%" IHU
 SG_ TankTurnActYawRateForHMI_UB : 176|1@0+ (1,0) [0|1] "" IHU
 SG_ TankTurnNotAvailable : 65|1@0+ (1,0) [0|1] "" IHU
 SG_ TankTurnNotAvailable_UB : 64|1@0+ (1,0) [0|1] "" IHU

BO_ 671 ZCUDZCUCANFD2Fr52 : 64 ZCUD
 SG_ ActvnOfDrvSideDoorIllmn : 7|8@0+ (1.0,0.0) [0.0|100.0] "%" IHU
 SG_ ActvnOfDrvSideDoorIllmn_UB : 39|1@0+ (1,0) [0|1] "" IHU
 SG_ ActvnOfDrvSideStepIllmn : 15|8@0+ (1.0,0.0) [0.0|100.0] "%" IHU
 SG_ ActvnOfDrvSideStepIllmn_UB : 38|1@0+ (1,0) [0|1] "" IHU
 SG_ ActvnOfReDrvDoorIllmn : 23|8@0+ (1.0,0.0) [0.0|100.0] "%" IHU
 SG_ ActvnOfReDrvDoorIllmn_UB : 37|1@0+ (1,0) [0|1] "" IHU
 SG_ ActvnOfReDrvSideStepIllmn : 31|8@0+ (1.0,0.0) [0.0|100.0] "%" IHU
 SG_ ActvnOfReDrvSideStepIllmn_UB : 36|1@0+ (1,0) [0|1] "" IHU
 SG_ AmbTForVisy : 127|8@0+ (1.0,0.0) [0.0|255.0] "Unitless" IHU
 SG_ AmbTForVisy_UB : 113|1@0+ (1,0) [0|1] "" IHU
 SG_ BltCrashNotif_UB : 112|1@0+ (1,0) [0|1] "" IHU
 SG_ BltCrashNotifDrvr : 135|2@0+ (1,0) [0|3] "" IHU
 SG_ BltCrashNotifPass : 133|2@0+ (1,0) [0|3] "" IHU
 SG_ DampgRealFrntLe : 47|16@0- (1.0,0.0) [-20000.0|20000.0] "N" IHU
 SG_ DampgRealFrntLe_UB : 32|1@0+ (1,0) [0|1] "" IHU
 SG_ DampgRealFrntRi : 63|16@0- (1.0,0.0) [-20000.0|20000.0] "N" IHU
 SG_ DampgRealFrntRi_UB : 33|1@0+ (1,0) [0|1] "" IHU
 SG_ DampgRealReLe : 79|16@0- (1.0,0.0) [-20000.0|20000.0] "N" IHU
 SG_ DampgRealReLe_UB : 34|1@0+ (1,0) [0|1] "" IHU
 SG_ DampgRealReRi : 95|16@0- (1.0,0.0) [-20000.0|20000.0] "N" IHU
 SG_ DampgRealReRi_UB : 35|1@0+ (1,0) [0|1] "" IHU
 SG_ FrntSteerFEstimd1 : 143|16@0- (1.0,0.0) [-32768.0|32767.0] "N" IHU
 SG_ FrntSteerFEstimd1_UB : 131|1@0+ (1,0) [0|1] "" IHU
 SG_ SuspStabyCritFailrDetd_UB : 114|1@0+ (1,0) [0|1] "" IHU
 SG_ SuspStabyCritFailrDetdChks : 111|8@0+ (1.0,0.0) [0.0|255.0] "Unitless" IHU
 SG_ SuspStabyCritFailrDetdCntr : 119|4@0+ (1.0,0.0) [0.0|15.0] "Unitless" IHU
 SG_ SuspStabyCritFailrDetdSts : 115|1@0+ (1,0) [0|1] "" IHU

BO_ 54 ZCUDZCUCANFD2Fr53 : 64 ZCUD
 SG_ DrvrSeatPhytheraSts : 7|2@0+ (1,0) [0|3] "" IHU
 SG_ DrvrSeatPhytheraSts_UB : 5|1@0+ (1,0) [0|1] "" IHU
 SG_ IntrlMirrDispSysSts : 12|3@0+ (1,0) [0|7] "" IHU
 SG_ IntrlMirrDispSysSts_UB : 9|1@0+ (1,0) [0|1] "" IHU
 SG_ LeReWinBtnDwn : 4|1@0+ (1,0) [0|1] "" ZCUP
 SG_ LeReWinBtnDwn_UB : 3|1@0+ (1,0) [0|1] "" ZCUP
 SG_ LeReWinBtnRise : 1|1@0+ (1,0) [0|1] "" ZCUP
 SG_ LeReWinBtnRise_UB : 2|1@0+ (1,0) [0|1] "" ZCUP
 SG_ LeThirdElecticDuctVent : 8|1@0+ (1,0) [0|1] "" IHU
 SG_ LeThirdElecticDuctVent_UB : 23|1@0+ (1,0) [0|1] "" IHU
 SG_ LeThirdElecticDuctVentMode : 22|1@0+ (1,0) [0|1] "" IHU
 SG_ LeThirdElecticDuctVentMode_UB : 21|1@0+ (1,0) [0|1] "" IHU
 SG_ PassSeatFoldSwt : 20|1@0+ (1,0) [0|1] "" ZCUP
 SG_ PassSeatFoldSwt_UB : 19|1@0+ (1,0) [0|1] "" ZCUP
 SG_ PassSeatUnfoldSwt : 18|1@0+ (1,0) [0|1] "" ZCUP
 SG_ PassSeatUnfoldSwt_UB : 17|1@0+ (1,0) [0|1] "" ZCUP
 SG_ RiReWinBtnDwn : 0|1@0+ (1,0) [0|1] "" ZCUP
 SG_ RiReWinBtnDwn_UB : 15|1@0+ (1,0) [0|1] "" ZCUP
 SG_ RiReWinBtnRise : 14|1@0+ (1,0) [0|1] "" ZCUP
 SG_ RiReWinBtnRise_UB : 13|1@0+ (1,0) [0|1] "" ZCUP
 SG_ RiThirdElecticDuctVent : 16|1@0+ (1,0) [0|1] "" IHU
 SG_ RiThirdElecticDuctVent_UB : 31|1@0+ (1,0) [0|1] "" IHU
 SG_ RiThirdElecticDuctVentMode : 30|1@0+ (1,0) [0|1] "" IHU
 SG_ RiThirdElecticDuctVentMode_UB : 29|1@0+ (1,0) [0|1] "" IHU
 SG_ StreamingMirrBri : 28|4@0+ (1.0,0.0) [0.0|15.0] "Unitless" IHU
 SG_ StreamingMirrBri_UB : 41|1@0+ (1,0) [0|1] "" IHU
 SG_ StreamingMirrEnable : 62|1@0+ (1,0) [0|1] "" IHU
 SG_ StreamingMirrEnable_UB : 61|1@0+ (1,0) [0|1] "" IHU
 SG_ StreamingMirrImg : 55|4@0+ (1.0,0.0) [0.0|15.0] "Unitless" IHU
 SG_ StreamingMirrImg_UB : 40|1@0+ (1,0) [0|1] "" IHU
 SG_ StreamingMirrPosn : 51|4@0+ (1.0,0.0) [0.0|15.0] "Unitless" IHU
 SG_ StreamingMirrPosn_UB : 63|1@0+ (1,0) [0|1] "" IHU

BO_ 1348 ZCUDZCUCANFD2VFCVectorFr : 8 ZCUD
 SG_ VFCVectorZCUDMBlockID : 1|2@0+ (1.0,0.0) [0.0|3.0] "Unitless" IHU
 SG_ VFCVectorZCUDMVFCid0 : 2|1@0+ (1,0) [0|1] "" IHU
 SG_ VFCVectorZCUDMVFCid1 : 3|1@0+ (1,0) [0|1] "" IHU
 SG_ VFCVectorZCUDMVFCid10 : 12|1@0+ (1,0) [0|1] "" IHU
 SG_ VFCVectorZCUDMVFCid11 : 13|1@0+ (1,0) [0|1] "" IHU
 SG_ VFCVectorZCUDMVFCid12 : 14|1@0+ (1,0) [0|1] "" IHU
 SG_ VFCVectorZCUDMVFCid13 : 15|1@0+ (1,0) [0|1] "" IHU
 SG_ VFCVectorZCUDMVFCid14 : 16|1@0+ (1,0) [0|1] "" IHU
 SG_ VFCVectorZCUDMVFCid15 : 17|1@0+ (1,0) [0|1] "" IHU
 SG_ VFCVectorZCUDMVFCid16 : 18|1@0+ (1,0) [0|1] "" IHU
 SG_ VFCVectorZCUDMVFCid17 : 19|1@0+ (1,0) [0|1] "" IHU
 SG_ VFCVectorZCUDMVFCid18 : 20|1@0+ (1,0) [0|1] "" IHU
 SG_ VFCVectorZCUDMVFCid19 : 21|1@0+ (1,0) [0|1] "" IHU
 SG_ VFCVectorZCUDMVFCid2 : 4|1@0+ (1,0) [0|1] "" IHU
 SG_ VFCVectorZCUDMVFCid20 : 22|1@0+ (1,0) [0|1] "" IHU
 SG_ VFCVectorZCUDMVFCid21 : 23|1@0+ (1,0) [0|1] "" IHU
 SG_ VFCVectorZCUDMVFCid22 : 24|1@0+ (1,0) [0|1] "" IHU
 SG_ VFCVectorZCUDMVFCid23 : 25|1@0+ (1,0) [0|1] "" IHU
 SG_ VFCVectorZCUDMVFCid24 : 26|1@0+ (1,0) [0|1] "" IHU
 SG_ VFCVectorZCUDMVFCid25 : 27|1@0+ (1,0) [0|1] "" IHU
 SG_ VFCVectorZCUDMVFCid26 : 28|1@0+ (1,0) [0|1] "" IHU
 SG_ VFCVectorZCUDMVFCid27 : 29|1@0+ (1,0) [0|1] "" IHU
 SG_ VFCVectorZCUDMVFCid28 : 30|1@0+ (1,0) [0|1] "" IHU
 SG_ VFCVectorZCUDMVFCid29 : 31|1@0+ (1,0) [0|1] "" IHU
 SG_ VFCVectorZCUDMVFCid3 : 5|1@0+ (1,0) [0|1] "" IHU
 SG_ VFCVectorZCUDMVFCid30 : 32|1@0+ (1,0) [0|1] "" IHU
 SG_ VFCVectorZCUDMVFCid31 : 33|1@0+ (1,0) [0|1] "" IHU
 SG_ VFCVectorZCUDMVFCid32 : 34|1@0+ (1,0) [0|1] "" IHU
 SG_ VFCVectorZCUDMVFCid33 : 35|1@0+ (1,0) [0|1] "" IHU
 SG_ VFCVectorZCUDMVFCid34 : 36|1@0+ (1,0) [0|1] "" IHU
 SG_ VFCVectorZCUDMVFCid35 : 37|1@0+ (1,0) [0|1] "" IHU
 SG_ VFCVectorZCUDMVFCid36 : 38|1@0+ (1,0) [0|1] "" IHU
 SG_ VFCVectorZCUDMVFCid37 : 39|1@0+ (1,0) [0|1] "" IHU
 SG_ VFCVectorZCUDMVFCid38 : 40|1@0+ (1,0) [0|1] "" IHU
 SG_ VFCVectorZCUDMVFCid39 : 41|1@0+ (1,0) [0|1] "" IHU
 SG_ VFCVectorZCUDMVFCid4 : 6|1@0+ (1,0) [0|1] "" IHU
 SG_ VFCVectorZCUDMVFCid40 : 42|1@0+ (1,0) [0|1] "" IHU
 SG_ VFCVectorZCUDMVFCid41 : 43|1@0+ (1,0) [0|1] "" IHU
 SG_ VFCVectorZCUDMVFCid42 : 44|1@0+ (1,0) [0|1] "" IHU
 SG_ VFCVectorZCUDMVFCid43 : 45|1@0+ (1,0) [0|1] "" IHU
 SG_ VFCVectorZCUDMVFCid44 : 46|1@0+ (1,0) [0|1] "" IHU
 SG_ VFCVectorZCUDMVFCid45 : 47|1@0+ (1,0) [0|1] "" IHU
 SG_ VFCVectorZCUDMVFCid46 : 48|1@0+ (1,0) [0|1] "" IHU
 SG_ VFCVectorZCUDMVFCid47 : 49|1@0+ (1,0) [0|1] "" IHU
 SG_ VFCVectorZCUDMVFCid48 : 50|1@0+ (1,0) [0|1] "" IHU
 SG_ VFCVectorZCUDMVFCid49 : 51|1@0+ (1,0) [0|1] "" IHU
 SG_ VFCVectorZCUDMVFCid5 : 7|1@0+ (1,0) [0|1] "" IHU
 SG_ VFCVectorZCUDMVFCid50 : 52|1@0+ (1,0) [0|1] "" IHU
 SG_ VFCVectorZCUDMVFCid51 : 53|1@0+ (1,0) [0|1] "" IHU
 SG_ VFCVectorZCUDMVFCid52 : 54|1@0+ (1,0) [0|1] "" IHU
 SG_ VFCVectorZCUDMVFCid53 : 55|1@0+ (1,0) [0|1] "" IHU
 SG_ VFCVectorZCUDMVFCid54 : 56|1@0+ (1,0) [0|1] "" IHU
 SG_ VFCVectorZCUDMVFCid55 : 57|1@0+ (1,0) [0|1] "" IHU
 SG_ VFCVectorZCUDMVFCid56 : 58|1@0+ (1,0) [0|1] "" IHU
 SG_ VFCVectorZCUDMVFCid57 : 59|1@0+ (1,0) [0|1] "" IHU
 SG_ VFCVectorZCUDMVFCid58 : 60|1@0+ (1,0) [0|1] "" IHU
 SG_ VFCVectorZCUDMVFCid59 : 61|1@0+ (1,0) [0|1] "" IHU
 SG_ VFCVectorZCUDMVFCid6 : 8|1@0+ (1,0) [0|1] "" IHU
 SG_ VFCVectorZCUDMVFCid60 : 62|1@0+ (1,0) [0|1] "" IHU
 SG_ VFCVectorZCUDMVFCid61 : 63|1@0+ (1,0) [0|1] "" IHU
 SG_ VFCVectorZCUDMVFCid7 : 9|1@0+ (1,0) [0|1] "" IHU
 SG_ VFCVectorZCUDMVFCid8 : 10|1@0+ (1,0) [0|1] "" IHU
 SG_ VFCVectorZCUDMVFCid9 : 11|1@0+ (1,0) [0|1] "" IHU

BO_ 1569 ZcudZcudsToDhuZCUCANFD2DiagResFr : 64 ZCUD

BO_ 1538 ZcupToDhuZCUCANFD2DiagResFr : 64 ZCUP

BO_ 1379 ZCUPZCUCANFD2DEVFr01 : 64 ZCUP
 SG_ ZCUPdevelpsignalgroupResp_UB : 504|1@0+ (1,0) [0|1] "" ETC
 SG_ ZCUPdevelpsignalgroupRespFunctiondevpsignalgroup1 : 7|8@0+ (1.0,0.0) [0.0|255.0] "Unitless" ETC
 SG_ ZCUPdevelpsignalgroupRespFunctiondevpsignalgroup2 : 15|8@0+ (1.0,0.0) [0.0|255.0] "Unitless" ETC
 SG_ ZCUPdevelpsignalgroupRespFunctiondevpsignalgroup3 : 23|8@0+ (1.0,0.0) [0.0|255.0] "Unitless" ETC
 SG_ ZCUPdevelpsignalgroupRespFunctiondevpsignalgroup4 : 31|8@0+ (1.0,0.0) [0.0|255.0] "Unitless" ETC
 SG_ ZCUPdevelpsignalgroupRespFunctiondevpsignalgroup5 : 39|8@0+ (1.0,0.0) [0.0|255.0] "Unitless" ETC
 SG_ ZCUPdevelpsignalgroupRespFunctiondevpsignalgroup6 : 47|8@0+ (1.0,0.0) [0.0|255.0] "Unitless" ETC
 SG_ ZCUPdevelpsignalgroupRespFunctiondevpsignalgroup7 : 55|8@0+ (1.0,0.0) [0.0|255.0] "Unitless" ETC
 SG_ ZCUPdevelpsignalgroupRespFunctiondevpsignalgroup8 : 63|8@0+ (1.0,0.0) [0.0|255.0] "Unitless" ETC

BO_ 441 ZcupZCUCANFD2Fr01 : 64 ZCUP
 SG_ AjarChrgLidRearSwitch : 103|2@0+ (1,0) [0|3] "" IHU,ZCUD
 SG_ AjarChrgLidRearSwitch_UB : 144|1@0+ (1,0) [0|1] "" IHU,ZCUD
 SG_ AjarFuelFlapSwitch : 101|2@0+ (1,0) [0|3] "" IHU,ZCUD
 SG_ AjarFuelFlapSwitch_UB : 147|1@0+ (1,0) [0|1] "" IHU,ZCUD
 SG_ CarTiIntForClima : 175|32@0+ (0.1,0.0) [0.0|429496729.5] "s" IHU,ZCUD
 SG_ CarTiIntForClima_UB : 166|1@0+ (1,0) [0|1] "" IHU,ZCUD
 SG_ ClimaCmptSts : 111|3@0+ (1,0) [0|7] "" IHU,ZCUD
 SG_ ClimaCmptSts_UB : 167|1@0+ (1,0) [0|1] "" IHU,ZCUD
 SG_ ClimaCtrlActv : 233|1@0+ (1,0) [0|1] "" IHU,ZCUD
 SG_ ClimaCtrlActv_UB : 232|1@0+ (1,0) [0|1] "" IHU,ZCUD
 SG_ ClimaDefrstSts : 108|1@0+ (1,0) [0|1] "" IHU,ZCUD
 SG_ ClimaDefrstSts_UB : 107|1@0+ (1,0) [0|1] "" IHU,ZCUD
 SG_ ClimaEstimdTForHeat : 231|13@0- (0.1,0.0) [-256.0|255.9] "degC" IHU
 SG_ ClimaEstimdTForHeat_UB : 234|1@0+ (1,0) [0|1] "" IHU
 SG_ ClimaEstimdTForReHeat : 247|13@0- (0.1,0.0) [-256.0|255.9] "degC" IHU
 SG_ ClimaEstimdTForReHeat_UB : 250|1@0+ (1,0) [0|1] "" IHU
 SG_ CmptmtAirTEstimdAtRowFirstLoResl : 207|11@0+ (0.1,-60.0) [-60.0|125.0] "degC" IHU,ZCUD
 SG_ CmptmtAirTEstimdAtRowFirstLoResl_UB : 106|1@0+ (1,0) [0|1] "" IHU,ZCUD
 SG_ CoupldCtrlErrAtRowFirstLe : 263|13@0- (0.1,0.0) [-256.0|255.9] "degC" IHU
 SG_ CoupldCtrlErrAtRowFirstLe_UB : 266|1@0+ (1,0) [0|1] "" IHU
 SG_ CoupldCtrlErrAtRowFirstRi : 279|13@0- (0.1,0.0) [-256.0|255.9] "degC" IHU
 SG_ CoupldCtrlErrAtRowFirstRi_UB : 282|1@0+ (1,0) [0|1] "" IHU
 SG_ CoupldCtrlErrAtRowSecLe : 295|13@0- (0.1,0.0) [-256.0|255.9] "degC" IHU
 SG_ CoupldCtrlErrAtRowSecLe_UB : 298|1@0+ (1,0) [0|1] "" IHU
 SG_ CoupldCtrlErrAtRowSecRi : 311|13@0- (0.1,0.0) [-256.0|255.9] "degC" IHU
 SG_ CoupldCtrlErrAtRowSecRi_UB : 314|1@0+ (1,0) [0|1] "" IHU
 SG_ DoorPass2Swt1DplyHndl : 249|1@0+ (1,0) [0|1] "" IHU
 SG_ DoorPass2Swt1DplyHndl_UB : 248|1@0+ (1,0) [0|1] "" IHU
 SG_ DoorPass2Swt2DplyHndl : 265|1@0+ (1,0) [0|1] "" IHU
 SG_ DoorPass2Swt2DplyHndl_UB : 264|1@0+ (1,0) [0|1] "" IHU
 SG_ DoorPassLatPosn : 223|2@0+ (1,0) [0|3] "" IHU,ZCUD
 SG_ DoorPassLatPosn_UB : 208|1@0+ (1,0) [0|1] "" IHU,ZCUD
 SG_ DoorPassRe2Sw1DplyHndl : 219|1@0+ (1,0) [0|1] "" IHU
 SG_ DoorPassRe2Sw1DplyHndl_UB : 218|1@0+ (1,0) [0|1] "" IHU
 SG_ DoorPassRe2Sw2DplyHndl : 217|1@0+ (1,0) [0|1] "" IHU
 SG_ DoorPassRe2Sw2DplyHndl_UB : 216|1@0+ (1,0) [0|1] "" IHU
 SG_ DrvrSeatHeatgPwrAllwd : 23|8@0+ (1.0,0.0) [0.0|255.0] "Unitless" IHU,ZCUD
 SG_ DrvrSeatHeatgPwrAllwd_UB : 145|1@0+ (1,0) [0|1] "" IHU,ZCUD
 SG_ DrvrSeatVentnPwrAllwd : 31|8@0+ (1.0,0.0) [0.0|255.0] "Unitless" IHU,ZCUD
 SG_ DrvrSeatVentnPwrAllwd_UB : 146|1@0+ (1,0) [0|1] "" IHU,ZCUD
 SG_ EngSpdIncIdleForClima : 99|1@0+ (1,0) [0|1] "" IHU,ZCUD
 SG_ EngSpdIncIdleForClima_UB : 152|1@0+ (1,0) [0|1] "" IHU,ZCUD
 SG_ FltOfReRegPlateLamp : 98|1@0+ (1,0) [0|1] "" IHU,ZCUD
 SG_ FltOfReRegPlateLamp_UB : 153|1@0+ (1,0) [0|1] "" IHU,ZCUD
 SG_ FragCh1Id : 39|8@0+ (1.0,0.0) [0.0|255.0] "Unitless" IHU
 SG_ FragCh1Id_UB : 154|1@0+ (1,0) [0|1] "" IHU
 SG_ FragCh2Id : 47|8@0+ (1.0,0.0) [0.0|255.0] "Unitless" IHU
 SG_ FragCh2Id_UB : 155|1@0+ (1,0) [0|1] "" IHU
 SG_ FragCh3Id : 55|8@0+ (1.0,0.0) [0.0|255.0] "Unitless" IHU
 SG_ FragCh3Id_UB : 156|1@0+ (1,0) [0|1] "" IHU
 SG_ FragCh4Id : 63|8@0+ (1.0,0.0) [0.0|255.0] "Unitless" IHU
 SG_ FragCh4Id_UB : 157|1@0+ (1,0) [0|1] "" IHU
 SG_ FragCh5Id : 71|8@0+ (1.0,0.0) [0.0|255.0] "Unitless" IHU
 SG_ FragCh5Id_UB : 158|1@0+ (1,0) [0|1] "" IHU
 SG_ HvEgyDesForClima : 79|8@0+ (50.0,0.0) [0.0|12750.0] "Wh" IHU,ZCUD
 SG_ HvEgyDesForClima_UB : 159|1@0+ (1,0) [0|1] "" IHU,ZCUD
 SG_ IceBreakDoorPassActv : 281|1@0+ (1,0) [0|1] "" IHU
 SG_ IceBreakDoorPassActv_UB : 280|1@0+ (1,0) [0|1] "" IHU
 SG_ MirrAtPassForVce : 343|3@0+ (1,0) [0|7] "" IHU
 SG_ MirrAtPassForVce_UB : 340|1@0+ (1,0) [0|1] "" IHU
 SG_ MirrAtPassInMovmt : 97|1@0+ (1,0) [0|1] "" IHU
 SG_ MirrAtPassInMovmt_UB : 160|1@0+ (1,0) [0|1] "" IHU
 SG_ PassSeatAdjmtLimForFldWarn : 297|1@0+ (1,0) [0|1] "" IHU
 SG_ PassSeatAdjmtLimForFldWarn_UB : 296|1@0+ (1,0) [0|1] "" IHU
 SG_ PassSeatAdjmtLimnWarn : 221|1@0+ (1,0) [0|1] "" IHU
 SG_ PassSeatAdjmtLimnWarn_UB : 220|1@0+ (1,0) [0|1] "" IHU
 SG_ PassSeatCushDownPosPerc_UB : 312|1@0+ (1,0) [0|1] "" IHU
 SG_ PassSeatCushDownPosPercSeatPosPerc : 327|10@0+ (0.1,0.0) [0.0|100.0] "%" IHU
 SG_ PassSeatCushDownPosPercSeatPosQf : 333|2@0+ (1,0) [0|3] "" IHU
 SG_ PassSeatFoldFailFb : 331|3@0+ (1.0,0.0) [0.0|7.0] "Unitless" IHU
 SG_ PassSeatFoldFailFb_UB : 328|1@0+ (1,0) [0|1] "" IHU
 SG_ PassSeatPhytheraSts : 339|2@0+ (1,0) [0|3] "" IHU
 SG_ PassSeatPhytheraSts_UB : 337|1@0+ (1,0) [0|1] "" IHU
 SG_ PassSeatPosPerc_UB : 162|1@0+ (1,0) [0|1] "" IHU,ZCUD
 SG_ PassSeatPosPercSeatPosFrntHeiPerc : 119|10@0+ (0.1,0.0) [0.0|100.0] "%" IHU,ZCUD
 SG_ PassSeatPosPercSeatPosFrntHeiQF : 125|2@0+ (1,0) [0|3] "" IHU,ZCUD
 SG_ PassSeatPosPercSeatPosHeiPerc : 121|10@0+ (0.1,0.0) [0.0|100.0] "%" IHU,ZCUD
 SG_ PassSeatPosPercSeatPosHeiQF : 123|2@0+ (1,0) [0|3] "" IHU,ZCUD
 SG_ PassSeatPosPercSeatPosSldPerc : 143|10@0+ (0.1,0.0) [0.0|100.0] "%" IHU,ZCUD
 SG_ PassSeatPosPercSeatPosSldQF : 149|2@0+ (1,0) [0|3] "" IHU,ZCUD
 SG_ SeatBackAngleRowFirstPass : 87|8@0+ (1.0,0.0) [0.0|180.0] "Deg" IHU,ZCUD
 SG_ SeatBackAngleRowFirstPass_UB : 163|1@0+ (1,0) [0|1] "" IHU,ZCUD
 SG_ SeatOccptAtRowSecPasSide2 : 212|2@0+ (1,0) [0|3] "" IHU,ZCUD
 SG_ SeatOccptAtRowSecPasSide2_UB : 105|1@0+ (1,0) [0|1] "" IHU,ZCUD
 SG_ SeatOccptAtRowSecPasSideSnsSts2 : 210|2@0+ (1,0) [0|3] "" IHU,ZCUD
 SG_ SeatOccptAtRowSecPasSideSnsSts2_UB : 104|1@0+ (1,0) [0|1] "" IHU,ZCUD
 SG_ SteerWhlHeatgDurgClima : 96|1@0+ (1,0) [0|1] "" IHU,ZCUD
 SG_ SteerWhlHeatgDurgClima_UB : 164|1@0+ (1,0) [0|1] "" IHU,ZCUD
 SG_ SteerWhlHeatgPwrAllwd : 95|8@0+ (1.0,0.0) [0.0|255.0] "Unitless" IHU,ZCUD
 SG_ SteerWhlHeatgPwrAllwd_UB : 165|1@0+ (1,0) [0|1] "" IHU,ZCUD

BO_ 801 ZcupZCUCANFD2Fr02 : 64 ZCUP
 SG_ AmbTEstimd_UB : 8|1@0+ (1,0) [0|1] "" IHU,ZCUD
 SG_ AmbTEstimdAmbTEstimd : 7|11@0+ (0.1,-70.0) [-70.0|134.70000000000002] "degC" IHU,ZCUD
 SG_ AmbTEstimdQf : 12|1@0+ (1,0) [0|1] "" IHU,ZCUD
 SG_ ClimaOvrHeatPrtSts : 11|1@0+ (1,0) [0|1] "" IHU,ZCUD
 SG_ ClimaOvrHeatPrtSts_UB : 9|1@0+ (1,0) [0|1] "" IHU,ZCUD
 SG_ CmptmtAirTEstimdExtd_UB : 10|1@0+ (1,0) [0|1] "" IHU,ZCUD
 SG_ CmptmtAirTEstimdExtdComptmtT : 23|11@0+ (0.1,-60.0) [-60.0|125.0] "degC" IHU,ZCUD
 SG_ CmptmtAirTEstimdExtdQlyFlg : 28|2@0+ (1,0) [0|3] "" IHU,ZCUD

BO_ 520 ZcupZCUCANFD2Fr03 : 64 ZCUP
 SG_ AmbTFildForClima : 42|11@0+ (0.1,-70.0) [-70.0|134.70000000000002] "degC" IHU
 SG_ AmbTFildForClima_UB : 43|1@0+ (1,0) [0|1] "" IHU
 SG_ AmbTRawAtPassSide_UB : 10|1@0+ (1,0) [0|1] "" IHU,ZCUD
 SG_ AmbTRawAtPassSideAmbTVal : 7|11@0+ (0.1,-70.0) [-70.0|134.70000000000002] "degC" IHU,ZCUD
 SG_ AmbTRawAtPassSideQly : 12|2@0+ (1,0) [0|3] "" IHU,ZCUD
 SG_ AmbTURawAtPassSide : 23|12@0+ (0.1,-70.0) [-70.0|339.5] "degC" IHU,ZCUD
 SG_ AmbTURawAtPassSide_UB : 9|1@0+ (1,0) [0|1] "" IHU,ZCUD
 SG_ ClimaAtRowSecActv : 63|1@0+ (1,0) [0|1] "" IHU
 SG_ ClimaAtRowSecActv_UB : 24|1@0+ (1,0) [0|1] "" IHU
 SG_ HvacEvaprTSpFrnt : 39|8@0+ (0.1,-5.0) [-5.0|20.0] "Unitless" IHU,ZCUD
 SG_ HvacEvaprTSpFrnt_UB : 8|1@0+ (1,0) [0|1] "" IHU,ZCUD
 SG_ PassSeatActvSwtFctMod : 62|2@0+ (1,0) [0|3] "" IHU
 SG_ PassSeatActvSwtFctMod_UB : 60|1@0+ (1,0) [0|1] "" IHU
 SG_ PassSeatIntgrSwtSts_UB : 56|1@0+ (1,0) [0|1] "" IHU
 SG_ PassSeatIntgrSwtStsIntgrSwtHozlSts : 71|2@0+ (1,0) [0|3] "" IHU
 SG_ PassSeatIntgrSwtStsIntgrSwtRotSts : 69|2@0+ (1,0) [0|3] "" IHU
 SG_ PassSeatIntgrSwtStsIntgrSwtSelnSts : 67|2@0+ (1,0) [0|3] "" IHU
 SG_ PassSeatIntgrSwtStsIntgrSwtVertSts : 65|2@0+ (1,0) [0|3] "" IHU
 SG_ RlyCmftForClimaReq : 47|1@0+ (1,0) [0|1] "" IHU,ZCUD
 SG_ RlyCmftForClimaReq_UB : 46|1@0+ (1,0) [0|1] "" IHU,ZCUD
 SG_ RlyCrashForClimaReq : 45|1@0+ (1,0) [0|1] "" IHU,ZCUD
 SG_ RlyCrashForClimaReq_UB : 44|1@0+ (1,0) [0|1] "" IHU,ZCUD

BO_ 58 ZcupZCUCANFD2Fr04 : 64 ZCUP
 SG_ DoorPassOpenLowReqOutdSwt1 : 7|2@0+ (1,0) [0|3] "" IHU,ZCUD
 SG_ DoorPassOpenLowReqOutdSwt1_UB : 15|1@0+ (1,0) [0|1] "" IHU,ZCUD
 SG_ DoorPassOpenReqInsdSwt1 : 5|2@0+ (1,0) [0|3] "" IHU,ZCUD
 SG_ DoorPassOpenReqInsdSwt1_UB : 14|1@0+ (1,0) [0|1] "" IHU,ZCUD
 SG_ DoorPassReCinhIntFailInf_UB : 13|1@0+ (1,0) [0|1] "" IHU,ZCUD
 SG_ DoorPassReCinhIntFailInfCinchFlt1 : 3|1@0+ (1,0) [0|1] "" IHU,ZCUD
 SG_ DoorPassReCinhIntFailInfCinchRestFlt : 2|1@0+ (1,0) [0|1] "" IHU,ZCUD
 SG_ DoorPassReLatPosn : 1|2@0+ (1,0) [0|3] "" IHU,ZCUD
 SG_ DoorPassReLatPosn_UB : 12|1@0+ (1,0) [0|1] "" IHU,ZCUD
 SG_ DoorPassReOpenLowReqOutdSwt1 : 23|2@0+ (1,0) [0|3] "" IHU,ZCUD
 SG_ DoorPassReOpenLowReqOutdSwt1_UB : 11|1@0+ (1,0) [0|1] "" IHU,ZCUD
 SG_ DoorPassReOpenReqInsdSwt1 : 21|2@0+ (1,0) [0|3] "" IHU,ZCUD
 SG_ DoorPassReOpenReqInsdSwt1_UB : 10|1@0+ (1,0) [0|1] "" IHU,ZCUD
 SG_ DoorPassReRelsFail_UB : 28|1@0+ (1,0) [0|1] "" IHU,ZCUD
 SG_ DoorPassReRelsFailCinchOverTimed : 31|1@0+ (1,0) [0|1] "" IHU,ZCUD
 SG_ DoorPassReRelsFailFailure1 : 30|1@0+ (1,0) [0|1] "" IHU,ZCUD
 SG_ DoorPassReRelsFailMechRels : 29|1@0+ (1,0) [0|1] "" IHU,ZCUD
 SG_ DoorRiReLatPosn : 19|2@0+ (1,0) [0|3] "" IHU,ZCUD
 SG_ DoorRiReLatPosn_UB : 9|1@0+ (1,0) [0|1] "" IHU,ZCUD
 SG_ DoorRiReOpenLowReqOutdSwt1 : 17|2@0+ (1,0) [0|3] "" IHU,ZCUD
 SG_ DoorRiReOpenLowReqOutdSwt1_UB : 8|1@0+ (1,0) [0|1] "" IHU,ZCUD
 SG_ DoorRiReOpenReqInsdSwt1 : 27|2@0+ (1,0) [0|3] "" IHU,ZCUD
 SG_ DoorRiReOpenReqInsdSwt1_UB : 25|1@0+ (1,0) [0|1] "" IHU,ZCUD
 SG_ IceBreakDoorPassReActv : 39|1@0+ (1,0) [0|1] "" IHU,ZCUD
 SG_ IceBreakDoorPassReActv_UB : 24|1@0+ (1,0) [0|1] "" IHU,ZCUD
 SG_ MirrAdjVceStsAtPass : 38|1@0+ (1,0) [0|1] "" ZCUD
 SG_ MirrAdjVceStsAtPass_UB : 37|1@0+ (1,0) [0|1] "" ZCUD

BO_ 310 ZcupZCUCANFD2Fr05 : 64 ZCUP
 SG_ AutDemstOperSts : 35|1@0+ (1,0) [0|1] "" IHU
 SG_ AutDemstOperSts_UB : 56|1@0+ (1,0) [0|1] "" IHU
 SG_ ChdLockPassReSts : 39|2@0+ (1,0) [0|3] "" IHU,ZCUD
 SG_ ChdLockPassReSts_UB : 57|1@0+ (1,0) [0|1] "" IHU,ZCUD
 SG_ ChdLockRightSts : 37|2@0+ (1,0) [0|3] "" IHU,ZCUD
 SG_ ChdLockRightSts_UB : 58|1@0+ (1,0) [0|1] "" IHU,ZCUD
 SG_ CinhPassReSts : 211|1@0+ (1,0) [0|1] "" IHU,ZCUD
 SG_ CinhPassReSts_UB : 210|1@0+ (1,0) [0|1] "" IHU,ZCUD
 SG_ CinhPassReSwt : 209|1@0+ (1,0) [0|1] "" IHU,ZCUD
 SG_ CinhPassReSwt_UB : 208|1@0+ (1,0) [0|1] "" IHU,ZCUD
 SG_ CinhPassSts : 111|1@0+ (1,0) [0|1] "" IHU,ZCUD
 SG_ CinhPassSts_UB : 110|1@0+ (1,0) [0|1] "" IHU,ZCUD
 SG_ CinhPassSwt : 234|1@0+ (1,0) [0|1] "" IHU,ZCUD
 SG_ CinhPassSwt_UB : 233|1@0+ (1,0) [0|1] "" IHU,ZCUD
 SG_ ClimaTiOfEnd : 7|32@0+ (0.1,0.0) [0.0|429496729.5] "s" IHU,ZCUD
 SG_ ClimaTiOfEnd_UB : 60|1@0+ (1,0) [0|1] "" IHU,ZCUD
 SG_ CmptmtTFrnt_UB : 72|1@0+ (1,0) [0|1] "" IHU,ZCUD
 SG_ CmptmtTFrntCmptmtTFrnt : 71|11@0+ (0.1,-60.0) [-60.0|125.0] "degC" IHU,ZCUD
 SG_ CmptmtTFrntFanForCmptmtTRunng : 76|1@0+ (1,0) [0|1] "" IHU,ZCUD
 SG_ CmptmtTFrntQf : 75|2@0+ (1,0) [0|3] "" IHU,ZCUD
 SG_ DoorPassReHndlSts : 47|3@0+ (1,0) [0|7] "" IHU,ZCUD
 SG_ DoorPassReHndlSts_UB : 73|1@0+ (1,0) [0|1] "" IHU,ZCUD
 SG_ EvaprTFrnt_UB : 225|1@0+ (1,0) [0|1] "" IHU,ZCUD
 SG_ EvaprTFrntEvaprTFrnt : 223|13@0- (0.1,0.0) [-256.0|255.9] "degC" IHU,ZCUD
 SG_ EvaprTFrntEvaprTQf : 226|1@0+ (1,0) [0|1] "" IHU,ZCUD
 SG_ FltOfBeamHiPass : 33|1@0+ (1,0) [0|1] "" IHU,ZCUD
 SG_ FltOfBeamHiPass_UB : 88|1@0+ (1,0) [0|1] "" IHU,ZCUD
 SG_ FltOfBeamLoPass : 32|1@0+ (1,0) [0|1] "" IHU,ZCUD
 SG_ FltOfBeamLoPass_UB : 89|1@0+ (1,0) [0|1] "" IHU,ZCUD
 SG_ FltOfDaytiRunngLampPass : 44|1@0+ (1,0) [0|1] "" IHU,ZCUD
 SG_ FltOfDaytiRunngLampPass_UB : 96|1@0+ (1,0) [0|1] "" IHU,ZCUD
 SG_ FltOfFrntFogLampPass : 43|1@0+ (1,0) [0|1] "" IHU,ZCUD
 SG_ FltOfFrntFogLampPass_UB : 97|1@0+ (1,0) [0|1] "" IHU,ZCUD
 SG_ FltOfFrntPosnLampPass : 42|1@0+ (1,0) [0|1] "" IHU,ZCUD
 SG_ FltOfFrntPosnLampPass_UB : 98|1@0+ (1,0) [0|1] "" IHU,ZCUD
 SG_ FltOfReFogLampDrv : 41|1@0+ (1,0) [0|1] "" IHU,ZCUD
 SG_ FltOfReFogLampDrv_UB : 99|1@0+ (1,0) [0|1] "" IHU,ZCUD
 SG_ FltOfRePosnLampPass : 40|1@0+ (1,0) [0|1] "" IHU,ZCUD
 SG_ FltOfRePosnLampPass_UB : 100|1@0+ (1,0) [0|1] "" IHU,ZCUD
 SG_ FltOfRvsgLampPass : 50|1@0+ (1,0) [0|1] "" IHU,ZCUD
 SG_ FltOfRvsgLampPass_UB : 101|1@0+ (1,0) [0|1] "" IHU,ZCUD
 SG_ HvacCoolgEnaRe : 49|1@0+ (1,0) [0|1] "" IHU,ZCUD
 SG_ HvacCoolgEnaRe_UB : 102|1@0+ (1,0) [0|1] "" IHU,ZCUD
 SG_ HvahAirTEstmd_UB : 103|1@0+ (1,0) [0|1] "" IHU,ZCUD
 SG_ HvahAirTEstmdEvaprTFrnt : 87|13@0- (0.1,0.0) [-256.0|255.9] "degC" IHU,ZCUD
 SG_ HvahAirTEstmdEvaprTQf : 90|1@0+ (1,0) [0|1] "" IHU,ZCUD
 SG_ IceBreakDoorRiReActv : 224|1@0+ (1,0) [0|1] "" IHU,ZCUD
 SG_ IceBreakDoorRiReActv_UB : 239|1@0+ (1,0) [0|1] "" IHU,ZCUD
 SG_ IntPm25StsFrmClima : 52|2@0+ (1,0) [0|3] "" IHU
 SG_ IntPm25StsFrmClima_UB : 104|1@0+ (1,0) [0|1] "" IHU
 SG_ MirrDwnStsAtPass : 55|3@0+ (1,0) [0|7] "" IHU,ZCUD
 SG_ MirrDwnStsAtPass_UB : 105|1@0+ (1,0) [0|1] "" IHU,ZCUD
 SG_ MirrPosnToSetTarPosnAtPass_UB : 264|1@0+ (1,0) [0|1] "" IHU
 SG_ MirrPosnToSetTarPosnAtPassMirrAdjLeRi : 277|14@0+ (1.0,0.0) [0.0|10000.0] "Unitless" IHU
 SG_ MirrPosnToSetTarPosnAtPassMirrAdjUpDown : 295|14@0+ (1.0,0.0) [0.0|10000.0] "Unitless" IHU
 SG_ OpenPassReSwt : 242|1@0+ (1,0) [0|1] "" IHU,ZCUD
 SG_ OpenPassReSwt_UB : 241|1@0+ (1,0) [0|1] "" IHU,ZCUD
 SG_ OpenPassSwt : 240|1@0+ (1,0) [0|1] "" IHU,ZCUD
 SG_ OpenPassSwt_UB : 255|1@0+ (1,0) [0|1] "" IHU,ZCUD
 SG_ PassSeatBtnPsd : 48|1@0+ (1,0) [0|1] "" IHU
 SG_ PassSeatBtnPsd_UB : 106|1@0+ (1,0) [0|1] "" IHU
 SG_ PassSeatFoldSts : 270|3@0+ (1,0) [0|7] "" IHU,ZCUD
 SG_ PassSeatFoldSts_UB : 267|1@0+ (1,0) [0|1] "" IHU,ZCUD
 SG_ PassSeatFootRstAutMovmtSts : 307|2@0+ (1,0) [0|3] "" IHU
 SG_ PassSeatFootRstAutMovmtSts_UB : 297|1@0+ (1,0) [0|1] "" IHU
 SG_ PassSeatFootRstPosPerc : 319|7@0+ (1.0,0.0) [0.0|127.0] "%" IHU
 SG_ PassSeatFootRstPosPerc_UB : 312|1@0+ (1,0) [0|1] "" IHU
 SG_ PassSeatFootRstSwtSts : 305|2@0+ (1,0) [0|3] "" IHU
 SG_ PassSeatFootRstSwtSts_UB : 296|1@0+ (1,0) [0|1] "" IHU
 SG_ PassSeatInAutMovmt : 61|1@0+ (1,0) [0|1] "" IHU,ZCUD
 SG_ PassSeatInAutMovmt_UB : 107|1@0+ (1,0) [0|1] "" IHU,ZCUD
 SG_ PassSeatPosFrntExtPerc_UB : 252|1@0+ (1,0) [0|1] "" IHU
 SG_ PassSeatPosFrntExtPercSeatPosPerc : 249|10@0+ (0.1,0.0) [0.0|100.0] "%" IHU
 SG_ PassSeatPosFrntExtPercSeatPosQf : 251|2@0+ (1,0) [0|3] "" IHU
 SG_ PawlPassReSwt : 238|1@0+ (1,0) [0|1] "" IHU,ZCUD
 SG_ PawlPassReSwt_UB : 237|1@0+ (1,0) [0|1] "" IHU,ZCUD
 SG_ PawlPassSwt : 236|1@0+ (1,0) [0|1] "" IHU,ZCUD
 SG_ PawlPassSwt_UB : 235|1@0+ (1,0) [0|1] "" IHU,ZCUD
 SG_ PrkgClimaHVReq : 266|1@0+ (1,0) [0|1] "" ZCUD
 SG_ PrkgClimaHVReq_UB : 265|1@0+ (1,0) [0|1] "" ZCUD
 SG_ RemActvSts_UB : 108|1@0+ (1,0) [0|1] "" IHU
 SG_ RemActvStsRemClimaActvSts : 63|1@0+ (1,0) [0|1] "" IHU
 SG_ RemActvStsRemDefrstSts : 62|1@0+ (1,0) [0|1] "" IHU
 SG_ RemClimaElecDefrstReq_UB : 308|1@0+ (1,0) [0|1] "" ZCUD
 SG_ RemClimaElecDefrstReqMirrDefrstReq : 311|1@0+ (1,0) [0|1] "" ZCUD
 SG_ RemClimaElecDefrstReqWinDefrstFrntReq : 310|1@0+ (1,0) [0|1] "" ZCUD
 SG_ RemClimaElecDefrstReqWinDefrstReReq : 309|1@0+ (1,0) [0|1] "" ZCUD
 SG_ SeatMassgBackBlstrCtrlPass : 327|2@0+ (1,0) [0|3] "" ZCUD
 SG_ SeatMassgBackBlstrCtrlPass_UB : 325|1@0+ (1,0) [0|1] "" ZCUD
 SG_ SeatMassgBackBlstrEnaPass : 324|1@0+ (1,0) [0|1] "" ZCUD
 SG_ SeatMassgBackBlstrEnaPass_UB : 323|1@0+ (1,0) [0|1] "" ZCUD
 SG_ SeatMassgCushBlstrCtrlPass : 321|2@0+ (1,0) [0|3] "" ZCUD
 SG_ SeatMassgCushBlstrCtrlPass_UB : 322|1@0+ (1,0) [0|1] "" ZCUD
 SG_ SeatMassgCushBlstrEnaPass : 335|1@0+ (1,0) [0|1] "" ZCUD
 SG_ SeatMassgCushBlstrEnaPass_UB : 334|1@0+ (1,0) [0|1] "" ZCUD
 SG_ SeatMassgCushLiftCtrlPass : 333|1@0+ (1,0) [0|1] "" ZCUD
 SG_ SeatMassgCushLiftCtrlPass_UB : 332|1@0+ (1,0) [0|1] "" ZCUD
 SG_ SeatMassgCushLiftEnaPass : 331|1@0+ (1,0) [0|1] "" ZCUD
 SG_ SeatMassgCushLiftEnaPass_UB : 330|1@0+ (1,0) [0|1] "" ZCUD
 SG_ SeatMassgFctPass_UB : 345|1@0+ (1,0) [0|1] "" ZCUD
 SG_ SeatMassgFctPassMassgInten : 347|2@0+ (1,0) [0|3] "" ZCUD
 SG_ SeatMassgFctPassMassgProg : 351|3@0+ (1,0) [0|7] "" ZCUD
 SG_ SeatMassgFctPassOnOff : 348|1@0+ (1,0) [0|1] "" ZCUD
 SG_ SeatMassgLumExtnCtrlPass : 343|2@0+ (1,0) [0|3] "" ZCUD
 SG_ SeatMassgLumExtnCtrlPass_UB : 341|1@0+ (1,0) [0|1] "" ZCUD
 SG_ SeatMassgLumHeiCtrlPass : 339|2@0+ (1,0) [0|3] "" ZCUD
 SG_ SeatMassgLumHeiCtrlPass_UB : 340|1@0+ (1,0) [0|1] "" ZCUD
 SG_ SeatMassgLumMotrEnaPass : 337|1@0+ (1,0) [0|1] "" ZCUD
 SG_ SeatMassgLumMotrEnaPass_UB : 336|1@0+ (1,0) [0|1] "" ZCUD
 SG_ SecRowLeSeatHeatgPwrAllwd : 135|8@0+ (1.0,0.0) [0.0|255.0] "Unitless" ZCUD
 SG_ SecRowLeSeatHeatgPwrAllwd_UB : 199|1@0+ (1,0) [0|1] "" ZCUD
 SG_ SecRowLeSeatVentnPwrAllwd : 143|8@0+ (1.0,0.0) [0.0|255.0] "Unitless" ZCUD
 SG_ SecRowLeSeatVentnPwrAllwd_UB : 198|1@0+ (1,0) [0|1] "" ZCUD
 SG_ SecRowRiSeatHeatgPwrAllwd : 151|8@0+ (1.0,0.0) [0.0|255.0] "Unitless" ZCUD
 SG_ SecRowRiSeatHeatgPwrAllwd_UB : 197|1@0+ (1,0) [0|1] "" ZCUD
 SG_ SecRowRiSeatVentnPwrAllwd : 159|8@0+ (1.0,0.0) [0.0|255.0] "Unitless" ZCUD
 SG_ SecRowRiSeatVentnPwrAllwd_UB : 196|1@0+ (1,0) [0|1] "" ZCUD
 SG_ ShortDropWinPassReSts : 254|2@0+ (1,0) [0|3] "" IHU,ZCUD
 SG_ ShortDropWinPassReSts_UB : 271|1@0+ (1,0) [0|1] "" IHU,ZCUD
 SG_ ShortDropWinPassSts : 247|2@0+ (1,0) [0|3] "" IHU,ZCUD
 SG_ ShortDropWinPassSts_UB : 232|1@0+ (1,0) [0|1] "" IHU,ZCUD
 SG_ ShortDropWinReRiSts : 245|2@0+ (1,0) [0|3] "" IHU,ZCUD
 SG_ ShortDropWinReRiSts_UB : 243|1@0+ (1,0) [0|1] "" IHU,ZCUD
 SG_ ThrdRowLeSeatHeatgPwrAllwd : 167|8@0+ (1.0,0.0) [0.0|255.0] "Unitless" ZCUD
 SG_ ThrdRowLeSeatHeatgPwrAllwd_UB : 195|1@0+ (1,0) [0|1] "" ZCUD
 SG_ ThrdRowLeSeatVentnPwrAllwd : 175|8@0+ (1.0,0.0) [0.0|255.0] "Unitless" ZCUD
 SG_ ThrdRowLeSeatVentnPwrAllwd_UB : 194|1@0+ (1,0) [0|1] "" ZCUD
 SG_ ThrdRowRiSeatHeatgPwrAllwd : 183|8@0+ (1.0,0.0) [0.0|255.0] "Unitless" ZCUD
 SG_ ThrdRowRiSeatHeatgPwrAllwd_UB : 193|1@0+ (1,0) [0|1] "" ZCUD
 SG_ ThrdRowRiSeatVentnPwrAllwd : 191|8@0+ (1.0,0.0) [0.0|255.0] "Unitless" ZCUD
 SG_ ThrdRowRiSeatVentnPwrAllwd_UB : 192|1@0+ (1,0) [0|1] "" ZCUD
 SG_ WinDsblPassReSts : 201|1@0+ (1,0) [0|1] "" IHU,ZCUD
 SG_ WinDsblPassReSts_UB : 200|1@0+ (1,0) [0|1] "" IHU,ZCUD
 SG_ WinDsblRightSts : 215|1@0+ (1,0) [0|1] "" IHU,ZCUD
 SG_ WinDsblRightSts_UB : 214|1@0+ (1,0) [0|1] "" IHU,ZCUD
 SG_ WinFailrStsAtPassRe : 213|1@0+ (1,0) [0|1] "" IHU,ZCUD
 SG_ WinFailrStsAtPassRe_UB : 212|1@0+ (1,0) [0|1] "" IHU,ZCUD
 SG_ WinPosnStsAtPassRe : 207|5@0+ (1,0) [0|31] "" IHU,ZCUD
 SG_ WinPosnStsAtPassRe_UB : 202|1@0+ (1,0) [0|1] "" IHU,ZCUD

BO_ 1184 ZcupZCUCANFD2Fr06 : 64 ZCUP
 SG_ CmptmtIntrMtrlTEstimd_UB : 252|1@0+ (1,0) [0|1] "" IHU
 SG_ CmptmtIntrMtrlTEstimdMtrlSnsrT : 127|13@0- (0.1,0.0) [-256.0|255.9] "degC" IHU
 SG_ CmptmtIntrMtrlTEstimdMtrlSnsrTQly2 : 130|2@0+ (1,0) [0|3] "" IHU
 SG_ EgyDesForClima : 103|7@0+ (1.0,0.0) [0.0|127.0] "Wh" IHU,ZCUD
 SG_ EgyDesForClima_UB : 96|1@0+ (1,0) [0|1] "" IHU,ZCUD
 SG_ ElecVentnMotPwrCnsAct : 199|10@0+ (0.1,0.0) [0.0|102.30000000000001] "W" IHU
 SG_ ElecVentnMotPwrCnsAct_UB : 253|1@0+ (1,0) [0|1] "" IHU
 SG_ ElecVentnMotPwrCnsDes : 247|10@0+ (0.1,0.0) [0.0|102.30000000000001] "W" IHU
 SG_ ElecVentnMotPwrCnsDes_UB : 274|1@0+ (1,0) [0|1] "" IHU
 SG_ HvacDefrstFlapActlPosn : 249|10@0+ (0.1,0.0) [0.0|100.0] "%" IHU
 SG_ HvacDefrstFlapActlPosn_UB : 275|1@0+ (1,0) [0|1] "" IHU
 SG_ HvacFanSet2HvacFanSpd2 : 39|8@0+ (1.0,0.0) [0.0|255.0] "Unitless" IHU
 SG_ HvacFanSet2HvacFanSpd2_UB : 276|1@0+ (1,0) [0|1] "" IHU
 SG_ HvacHeatElmAirMFlowEstimd : 271|10@0+ (1.0,0.0) [0.0|1000.0] "Kg / h" IHU,ZCUD
 SG_ HvacHeatElmAirMFlowEstimd_UB : 277|1@0+ (1,0) [0|1] "" IHU,ZCUD
 SG_ HvacModFlapActlPosnFrstRowLe : 153|10@0+ (0.1,0.0) [0.0|100.0] "%" IHU
 SG_ HvacModFlapActlPosnFrstRowLe_UB : 299|1@0+ (1,0) [0|1] "" IHU
 SG_ HvacModFlapActlPosnFrstRowRi : 273|10@0+ (0.1,0.0) [0.0|100.0] "%" IHU
 SG_ HvacModFlapActlPosnFrstRowRi_UB : 300|1@0+ (1,0) [0|1] "" IHU
 SG_ HvacModFlapActlPosnSecRowLe : 295|10@0+ (0.1,0.0) [0.0|100.0] "%" IHU
 SG_ HvacModFlapActlPosnSecRowLe_UB : 301|1@0+ (1,0) [0|1] "" IHU
 SG_ HvacModFlapActlPosnSecRowRi : 297|10@0+ (0.1,0.0) [0.0|100.0] "%" IHU
 SG_ HvacModFlapActlPosnSecRowRi_UB : 322|1@0+ (1,0) [0|1] "" IHU
 SG_ HvacOsaFlapActlPosn : 319|10@0+ (0.1,0.0) [0.0|100.0] "%" IHU
 SG_ HvacOsaFlapActlPosn_UB : 325|1@0+ (1,0) [0|1] "" IHU
 SG_ HvacRecFlapActlPosn : 321|10@0+ (0.1,0.0) [0.0|100.0] "%" IHU
 SG_ HvacRecFlapActlPosn_UB : 323|1@0+ (1,0) [0|1] "" IHU
 SG_ OutdAirQly_UB : 324|1@0+ (1,0) [0|1] "" IHU
 SG_ OutdAirQlyOutdAirQly : 95|2@0+ (1,0) [0|3] "" IHU
 SG_ OutdAirQlyQf : 93|1@0+ (1,0) [0|1] "" IHU
 SG_ OutdPm25StsFrmClima : 89|2@0+ (1,0) [0|3] "" IHU
 SG_ OutdPm25StsFrmClima_UB : 336|1@0+ (1,0) [0|1] "" IHU
 SG_ PassSeatHeatgActlPwrCns : 47|8@0+ (1.0,0.0) [0.0|255.0] "Unitless" IHU
 SG_ PassSeatHeatgActlPwrCns_UB : 338|1@0+ (1,0) [0|1] "" IHU
 SG_ PassSeatHeatgDesPwrCns : 55|8@0+ (1.0,0.0) [0.0|255.0] "Unitless" IHU
 SG_ PassSeatHeatgDesPwrCns_UB : 339|1@0+ (1,0) [0|1] "" IHU
 SG_ PassSeatHeatgPwrAllwd : 63|8@0+ (1.0,0.0) [0.0|255.0] "Unitless" IHU
 SG_ PassSeatHeatgPwrAllwd_UB : 340|1@0+ (1,0) [0|1] "" IHU
 SG_ PassSeatVentnActlPwrCns : 71|8@0+ (1.0,0.0) [0.0|255.0] "Unitless" IHU
 SG_ PassSeatVentnActlPwrCns_UB : 341|1@0+ (1,0) [0|1] "" IHU
 SG_ PassSeatVentnDesPwrCns : 79|8@0+ (1.0,0.0) [0.0|255.0] "Unitless" IHU
 SG_ PassSeatVentnDesPwrCns_UB : 342|1@0+ (1,0) [0|1] "" IHU
 SG_ PassSeatVentnPwrAllwd : 87|8@0+ (1.0,0.0) [0.0|255.0] "Unitless" IHU
 SG_ PassSeatVentnPwrAllwd_UB : 343|1@0+ (1,0) [0|1] "" IHU
 SG_ PwrAllwdForElecAirVentn : 223|10@0+ (0.1,0.0) [0.0|102.30000000000001] "W" IHU
 SG_ PwrAllwdForElecAirVentn_UB : 344|1@0+ (1,0) [0|1] "" IHU
 SG_ SunDataAzi : 128|9@0+ (1.0,0.0) [0.0|511.0] "Unitless" IHU
 SG_ SunDataAzi_UB : 345|1@0+ (1,0) [0|1] "" IHU
 SG_ SunDataElevn : 178|11@0+ (0.1,-90.0) [-90.0|90.0] "Deg" IHU
 SG_ SunDataElevn_UB : 346|1@0+ (1,0) [0|1] "" IHU
 SG_ TgtHvacAirTForRowFirstLe : 111|13@0- (0.1,0.0) [-256.0|255.9] "degC" IHU
 SG_ TgtHvacAirTForRowFirstLe_UB : 347|1@0+ (1,0) [0|1] "" IHU
 SG_ TgtHvacAirTForRowFirstRi : 175|13@0- (0.1,0.0) [-256.0|255.9] "degC" IHU
 SG_ TgtHvacAirTForRowFirstRi_UB : 348|1@0+ (1,0) [0|1] "" IHU
 SG_ TgtHvacAirTForRowSecLe : 204|13@0- (0.1,0.0) [-256.0|255.9] "degC" IHU
 SG_ TgtHvacAirTForRowSecLe_UB : 205|1@0+ (1,0) [0|1] "" IHU
 SG_ TgtHvacAirTForRowSecRi : 228|13@0- (0.1,0.0) [-256.0|255.9] "degC" IHU
 SG_ TgtHvacAirTForRowSecRi_UB : 229|1@0+ (1,0) [0|1] "" IHU

BO_ 600 ZcupZCUCANFD2Fr07 : 64 ZCUP
 SG_ AFUGenErr : 136|1@0+ (1,0) [0|1] "" IHU
 SG_ AFUGenErr_UB : 172|1@0+ (1,0) [0|1] "" IHU
 SG_ AirFragFanErr : 175|1@0+ (1,0) [0|1] "" IHU
 SG_ AirFragFanErr_UB : 174|1@0+ (1,0) [0|1] "" IHU
 SG_ AirFragMot1Err : 190|1@0+ (1,0) [0|1] "" IHU
 SG_ AirFragMot1Err_UB : 189|1@0+ (1,0) [0|1] "" IHU
 SG_ AirFragOvrVoltErr : 188|1@0+ (1,0) [0|1] "" IHU
 SG_ AirFragOvrVoltErr_UB : 187|1@0+ (1,0) [0|1] "" IHU
 SG_ AirFragTempErr : 186|2@0+ (1,0) [0|3] "" IHU
 SG_ AirFragTempErr_UB : 225|1@0+ (1,0) [0|1] "" IHU
 SG_ AirFragUndVoltErr : 224|1@0+ (1,0) [0|1] "" IHU
 SG_ AirFragUndVoltErr_UB : 241|1@0+ (1,0) [0|1] "" IHU
 SG_ ALM1Diag1_UB : 408|1@0+ (1,0) [0|1] "" IHU
 SG_ ALM1Diag10_UB : 409|1@0+ (1,0) [0|1] "" IHU
 SG_ ALM1Diag10BluSts : 261|1@0+ (1,0) [0|1] "" IHU
 SG_ ALM1Diag10GreenSts : 260|1@0+ (1,0) [0|1] "" IHU
 SG_ ALM1Diag10RedSts : 259|1@0+ (1,0) [0|1] "" IHU
 SG_ ALM1Diag10TmpSts : 258|1@0+ (1,0) [0|1] "" IHU
 SG_ ALM1Diag10VltSts : 257|1@0+ (1,0) [0|1] "" IHU
 SG_ ALM1Diag11_UB : 410|1@0+ (1,0) [0|1] "" IHU
 SG_ ALM1Diag11BluSts : 250|1@0+ (1,0) [0|1] "" IHU
 SG_ ALM1Diag11GreenSts : 249|1@0+ (1,0) [0|1] "" IHU
 SG_ ALM1Diag11RedSts : 248|1@0+ (1,0) [0|1] "" IHU
 SG_ ALM1Diag11TmpSts : 263|1@0+ (1,0) [0|1] "" IHU
 SG_ ALM1Diag11VltSts : 262|1@0+ (1,0) [0|1] "" IHU
 SG_ ALM1Diag12_UB : 411|1@0+ (1,0) [0|1] "" IHU
 SG_ ALM1Diag12BluSts : 256|1@0+ (1,0) [0|1] "" IHU
 SG_ ALM1Diag12GreenSts : 271|1@0+ (1,0) [0|1] "" IHU
 SG_ ALM1Diag12RedSts : 270|1@0+ (1,0) [0|1] "" IHU
 SG_ ALM1Diag12TmpSts : 269|1@0+ (1,0) [0|1] "" IHU
 SG_ ALM1Diag12VltSts : 268|1@0+ (1,0) [0|1] "" IHU
 SG_ ALM1Diag13_UB : 412|1@0+ (1,0) [0|1] "" IHU
 SG_ ALM1Diag13BluSts : 267|1@0+ (1,0) [0|1] "" IHU
 SG_ ALM1Diag13GreenSts : 266|1@0+ (1,0) [0|1] "" IHU
 SG_ ALM1Diag13RedSts : 265|1@0+ (1,0) [0|1] "" IHU
 SG_ ALM1Diag13TmpSts : 264|1@0+ (1,0) [0|1] "" IHU
 SG_ ALM1Diag13VltSts : 279|1@0+ (1,0) [0|1] "" IHU
 SG_ ALM1Diag14_UB : 413|1@0+ (1,0) [0|1] "" IHU
 SG_ ALM1Diag14BluSts : 278|1@0+ (1,0) [0|1] "" IHU
 SG_ ALM1Diag14GreenSts : 277|1@0+ (1,0) [0|1] "" IHU
 SG_ ALM1Diag14RedSts : 276|1@0+ (1,0) [0|1] "" IHU
 SG_ ALM1Diag14TmpSts : 275|1@0+ (1,0) [0|1] "" IHU
 SG_ ALM1Diag14VltSts : 274|1@0+ (1,0) [0|1] "" IHU
 SG_ ALM1Diag15_UB : 414|1@0+ (1,0) [0|1] "" IHU
 SG_ ALM1Diag15BluSts : 273|1@0+ (1,0) [0|1] "" IHU
 SG_ ALM1Diag15GreenSts : 272|1@0+ (1,0) [0|1] "" IHU
 SG_ ALM1Diag15RedSts : 287|1@0+ (1,0) [0|1] "" IHU
 SG_ ALM1Diag15TmpSts : 286|1@0+ (1,0) [0|1] "" IHU
 SG_ ALM1Diag15VltSts : 285|1@0+ (1,0) [0|1] "" IHU
 SG_ ALM1Diag16_UB : 415|1@0+ (1,0) [0|1] "" IHU
 SG_ ALM1Diag16BluSts : 284|1@0+ (1,0) [0|1] "" IHU
 SG_ ALM1Diag16GreenSts : 283|1@0+ (1,0) [0|1] "" IHU
 SG_ ALM1Diag16RedSts : 282|1@0+ (1,0) [0|1] "" IHU
 SG_ ALM1Diag16TmpSts : 281|1@0+ (1,0) [0|1] "" IHU
 SG_ ALM1Diag16VltSts : 280|1@0+ (1,0) [0|1] "" IHU
 SG_ ALM1Diag1BluSts : 255|1@0+ (1,0) [0|1] "" IHU
 SG_ ALM1Diag1GreenSts : 254|1@0+ (1,0) [0|1] "" IHU
 SG_ ALM1Diag1RedSts : 253|1@0+ (1,0) [0|1] "" IHU
 SG_ ALM1Diag1TmpSts : 252|1@0+ (1,0) [0|1] "" IHU
 SG_ ALM1Diag1VltSts : 251|1@0+ (1,0) [0|1] "" IHU
 SG_ ALM1Diag2_UB : 416|1@0+ (1,0) [0|1] "" IHU
 SG_ ALM1Diag2BluSts : 295|1@0+ (1,0) [0|1] "" IHU
 SG_ ALM1Diag2GreenSts : 294|1@0+ (1,0) [0|1] "" IHU
 SG_ ALM1Diag2RedSts : 293|1@0+ (1,0) [0|1] "" IHU
 SG_ ALM1Diag2TmpSts : 292|1@0+ (1,0) [0|1] "" IHU
 SG_ ALM1Diag2VltSts : 291|1@0+ (1,0) [0|1] "" IHU
 SG_ ALM1Diag3_UB : 417|1@0+ (1,0) [0|1] "" IHU
 SG_ ALM1Diag3BluSts : 290|1@0+ (1,0) [0|1] "" IHU
 SG_ ALM1Diag3GreenSts : 289|1@0+ (1,0) [0|1] "" IHU
 SG_ ALM1Diag3RedSts : 288|1@0+ (1,0) [0|1] "" IHU
 SG_ ALM1Diag3TmpSts : 303|1@0+ (1,0) [0|1] "" IHU
 SG_ ALM1Diag3VltSts : 302|1@0+ (1,0) [0|1] "" IHU
 SG_ ALM1Diag4_UB : 418|1@0+ (1,0) [0|1] "" IHU
 SG_ ALM1Diag4BluSts : 301|1@0+ (1,0) [0|1] "" IHU
 SG_ ALM1Diag4GreenSts : 300|1@0+ (1,0) [0|1] "" IHU
 SG_ ALM1Diag4RedSts : 299|1@0+ (1,0) [0|1] "" IHU
 SG_ ALM1Diag4TmpSts : 298|1@0+ (1,0) [0|1] "" IHU
 SG_ ALM1Diag4VltSts : 297|1@0+ (1,0) [0|1] "" IHU
 SG_ ALM1Diag5_UB : 419|1@0+ (1,0) [0|1] "" IHU
 SG_ ALM1Diag5BluSts : 296|1@0+ (1,0) [0|1] "" IHU
 SG_ ALM1Diag5GreenSts : 311|1@0+ (1,0) [0|1] "" IHU
 SG_ ALM1Diag5RedSts : 310|1@0+ (1,0) [0|1] "" IHU
 SG_ ALM1Diag5TmpSts : 309|1@0+ (1,0) [0|1] "" IHU
 SG_ ALM1Diag5VltSts : 308|1@0+ (1,0) [0|1] "" IHU
 SG_ ALM1Diag6_UB : 420|1@0+ (1,0) [0|1] "" IHU
 SG_ ALM1Diag6BluSts : 307|1@0+ (1,0) [0|1] "" IHU
 SG_ ALM1Diag6GreenSts : 306|1@0+ (1,0) [0|1] "" IHU
 SG_ ALM1Diag6RedSts : 305|1@0+ (1,0) [0|1] "" IHU
 SG_ ALM1Diag6TmpSts : 304|1@0+ (1,0) [0|1] "" IHU
 SG_ ALM1Diag6VltSts : 319|1@0+ (1,0) [0|1] "" IHU
 SG_ ALM1Diag7_UB : 421|1@0+ (1,0) [0|1] "" IHU
 SG_ ALM1Diag7BluSts : 318|1@0+ (1,0) [0|1] "" IHU
 SG_ ALM1Diag7GreenSts : 317|1@0+ (1,0) [0|1] "" IHU
 SG_ ALM1Diag7RedSts : 316|1@0+ (1,0) [0|1] "" IHU
 SG_ ALM1Diag7TmpSts : 315|1@0+ (1,0) [0|1] "" IHU
 SG_ ALM1Diag7VltSts : 314|1@0+ (1,0) [0|1] "" IHU
 SG_ ALM1Diag8_UB : 422|1@0+ (1,0) [0|1] "" IHU
 SG_ ALM1Diag8BluSts : 313|1@0+ (1,0) [0|1] "" IHU
 SG_ ALM1Diag8GreenSts : 312|1@0+ (1,0) [0|1] "" IHU
 SG_ ALM1Diag8RedSts : 327|1@0+ (1,0) [0|1] "" IHU
 SG_ ALM1Diag8TmpSts : 326|1@0+ (1,0) [0|1] "" IHU
 SG_ ALM1Diag8VltSts : 325|1@0+ (1,0) [0|1] "" IHU
 SG_ ALM1Diag9_UB : 423|1@0+ (1,0) [0|1] "" IHU
 SG_ ALM1Diag9BluSts : 324|1@0+ (1,0) [0|1] "" IHU
 SG_ ALM1Diag9GreenSts : 323|1@0+ (1,0) [0|1] "" IHU
 SG_ ALM1Diag9RedSts : 322|1@0+ (1,0) [0|1] "" IHU
 SG_ ALM1Diag9TmpSts : 321|1@0+ (1,0) [0|1] "" IHU
 SG_ ALM1Diag9VltSts : 320|1@0+ (1,0) [0|1] "" IHU
 SG_ ALM2Diag1_UB : 424|1@0+ (1,0) [0|1] "" IHU
 SG_ ALM2Diag10_UB : 425|1@0+ (1,0) [0|1] "" IHU
 SG_ ALM2Diag10BluSts : 330|1@0+ (1,0) [0|1] "" IHU
 SG_ ALM2Diag10GreenSts : 329|1@0+ (1,0) [0|1] "" IHU
 SG_ ALM2Diag10RedSts : 328|1@0+ (1,0) [0|1] "" IHU
 SG_ ALM2Diag10TmpSts : 343|1@0+ (1,0) [0|1] "" IHU
 SG_ ALM2Diag10VltSts : 342|1@0+ (1,0) [0|1] "" IHU
 SG_ ALM2Diag11_UB : 426|1@0+ (1,0) [0|1] "" IHU
 SG_ ALM2Diag11BluSts : 341|1@0+ (1,0) [0|1] "" IHU
 SG_ ALM2Diag11GreenSts : 340|1@0+ (1,0) [0|1] "" IHU
 SG_ ALM2Diag11RedSts : 339|1@0+ (1,0) [0|1] "" IHU
 SG_ ALM2Diag11TmpSts : 338|1@0+ (1,0) [0|1] "" IHU
 SG_ ALM2Diag11VltSts : 337|1@0+ (1,0) [0|1] "" IHU
 SG_ ALM2Diag12_UB : 427|1@0+ (1,0) [0|1] "" IHU
 SG_ ALM2Diag12BluSts : 336|1@0+ (1,0) [0|1] "" IHU
 SG_ ALM2Diag12GreenSts : 351|1@0+ (1,0) [0|1] "" IHU
 SG_ ALM2Diag12RedSts : 350|1@0+ (1,0) [0|1] "" IHU
 SG_ ALM2Diag12TmpSts : 349|1@0+ (1,0) [0|1] "" IHU
 SG_ ALM2Diag12VltSts : 348|1@0+ (1,0) [0|1] "" IHU
 SG_ ALM2Diag13_UB : 428|1@0+ (1,0) [0|1] "" IHU
 SG_ ALM2Diag13BluSts : 347|1@0+ (1,0) [0|1] "" IHU
 SG_ ALM2Diag13GreenSts : 346|1@0+ (1,0) [0|1] "" IHU
 SG_ ALM2Diag13RedSts : 345|1@0+ (1,0) [0|1] "" IHU
 SG_ ALM2Diag13TmpSts : 344|1@0+ (1,0) [0|1] "" IHU
 SG_ ALM2Diag13VltSts : 359|1@0+ (1,0) [0|1] "" IHU
 SG_ ALM2Diag14_UB : 429|1@0+ (1,0) [0|1] "" IHU
 SG_ ALM2Diag14BluSts : 358|1@0+ (1,0) [0|1] "" IHU
 SG_ ALM2Diag14GreenSts : 357|1@0+ (1,0) [0|1] "" IHU
 SG_ ALM2Diag14RedSts : 356|1@0+ (1,0) [0|1] "" IHU
 SG_ ALM2Diag14TmpSts : 355|1@0+ (1,0) [0|1] "" IHU
 SG_ ALM2Diag14VltSts : 354|1@0+ (1,0) [0|1] "" IHU
 SG_ ALM2Diag15_UB : 430|1@0+ (1,0) [0|1] "" IHU
 SG_ ALM2Diag15BluSts : 353|1@0+ (1,0) [0|1] "" IHU
 SG_ ALM2Diag15GreenSts : 352|1@0+ (1,0) [0|1] "" IHU
 SG_ ALM2Diag15RedSts : 367|1@0+ (1,0) [0|1] "" IHU
 SG_ ALM2Diag15TmpSts : 366|1@0+ (1,0) [0|1] "" IHU
 SG_ ALM2Diag15VltSts : 365|1@0+ (1,0) [0|1] "" IHU
 SG_ ALM2Diag16_UB : 431|1@0+ (1,0) [0|1] "" IHU
 SG_ ALM2Diag16BluSts : 364|1@0+ (1,0) [0|1] "" IHU
 SG_ ALM2Diag16GreenSts : 363|1@0+ (1,0) [0|1] "" IHU
 SG_ ALM2Diag16RedSts : 362|1@0+ (1,0) [0|1] "" IHU
 SG_ ALM2Diag16TmpSts : 361|1@0+ (1,0) [0|1] "" IHU
 SG_ ALM2Diag16VltSts : 360|1@0+ (1,0) [0|1] "" IHU
 SG_ ALM2Diag1BluSts : 335|1@0+ (1,0) [0|1] "" IHU
 SG_ ALM2Diag1GreenSts : 334|1@0+ (1,0) [0|1] "" IHU
 SG_ ALM2Diag1RedSts : 333|1@0+ (1,0) [0|1] "" IHU
 SG_ ALM2Diag1TmpSts : 332|1@0+ (1,0) [0|1] "" IHU
 SG_ ALM2Diag1VltSts : 331|1@0+ (1,0) [0|1] "" IHU
 SG_ ALM2Diag2_UB : 432|1@0+ (1,0) [0|1] "" IHU
 SG_ ALM2Diag2BluSts : 375|1@0+ (1,0) [0|1] "" IHU
 SG_ ALM2Diag2GreenSts : 374|1@0+ (1,0) [0|1] "" IHU
 SG_ ALM2Diag2RedSts : 373|1@0+ (1,0) [0|1] "" IHU
 SG_ ALM2Diag2TmpSts : 372|1@0+ (1,0) [0|1] "" IHU
 SG_ ALM2Diag2VltSts : 371|1@0+ (1,0) [0|1] "" IHU
 SG_ ALM2Diag3_UB : 433|1@0+ (1,0) [0|1] "" IHU
 SG_ ALM2Diag3BluSts : 370|1@0+ (1,0) [0|1] "" IHU
 SG_ ALM2Diag3GreenSts : 369|1@0+ (1,0) [0|1] "" IHU
 SG_ ALM2Diag3RedSts : 368|1@0+ (1,0) [0|1] "" IHU
 SG_ ALM2Diag3TmpSts : 383|1@0+ (1,0) [0|1] "" IHU
 SG_ ALM2Diag3VltSts : 382|1@0+ (1,0) [0|1] "" IHU
 SG_ ALM2Diag4_UB : 434|1@0+ (1,0) [0|1] "" IHU
 SG_ ALM2Diag4BluSts : 381|1@0+ (1,0) [0|1] "" IHU
 SG_ ALM2Diag4GreenSts : 380|1@0+ (1,0) [0|1] "" IHU
 SG_ ALM2Diag4RedSts : 379|1@0+ (1,0) [0|1] "" IHU
 SG_ ALM2Diag4TmpSts : 378|1@0+ (1,0) [0|1] "" IHU
 SG_ ALM2Diag4VltSts : 377|1@0+ (1,0) [0|1] "" IHU
 SG_ ALM2Diag5_UB : 435|1@0+ (1,0) [0|1] "" IHU
 SG_ ALM2Diag5BluSts : 376|1@0+ (1,0) [0|1] "" IHU
 SG_ ALM2Diag5GreenSts : 391|1@0+ (1,0) [0|1] "" IHU
 SG_ ALM2Diag5RedSts : 390|1@0+ (1,0) [0|1] "" IHU
 SG_ ALM2Diag5TmpSts : 389|1@0+ (1,0) [0|1] "" IHU
 SG_ ALM2Diag5VltSts : 388|1@0+ (1,0) [0|1] "" IHU
 SG_ ALM2Diag6_UB : 436|1@0+ (1,0) [0|1] "" IHU
 SG_ ALM2Diag6BluSts : 387|1@0+ (1,0) [0|1] "" IHU
 SG_ ALM2Diag6GreenSts : 386|1@0+ (1,0) [0|1] "" IHU
 SG_ ALM2Diag6RedSts : 385|1@0+ (1,0) [0|1] "" IHU
 SG_ ALM2Diag6TmpSts : 384|1@0+ (1,0) [0|1] "" IHU
 SG_ ALM2Diag6VltSts : 399|1@0+ (1,0) [0|1] "" IHU
 SG_ ALM2Diag7_UB : 437|1@0+ (1,0) [0|1] "" IHU
 SG_ ALM2Diag7BluSts : 398|1@0+ (1,0) [0|1] "" IHU
 SG_ ALM2Diag7GreenSts : 397|1@0+ (1,0) [0|1] "" IHU
 SG_ ALM2Diag7RedSts : 396|1@0+ (1,0) [0|1] "" IHU
 SG_ ALM2Diag7TmpSts : 395|1@0+ (1,0) [0|1] "" IHU
 SG_ ALM2Diag7VltSts : 394|1@0+ (1,0) [0|1] "" IHU
 SG_ ALM2Diag8_UB : 438|1@0+ (1,0) [0|1] "" IHU
 SG_ ALM2Diag8BluSts : 393|1@0+ (1,0) [0|1] "" IHU
 SG_ ALM2Diag8GreenSts : 392|1@0+ (1,0) [0|1] "" IHU
 SG_ ALM2Diag8RedSts : 407|1@0+ (1,0) [0|1] "" IHU
 SG_ ALM2Diag8TmpSts : 406|1@0+ (1,0) [0|1] "" IHU
 SG_ ALM2Diag8VltSts : 405|1@0+ (1,0) [0|1] "" IHU
 SG_ ALM2Diag9_UB : 439|1@0+ (1,0) [0|1] "" IHU
 SG_ ALM2Diag9BluSts : 404|1@0+ (1,0) [0|1] "" IHU
 SG_ ALM2Diag9GreenSts : 403|1@0+ (1,0) [0|1] "" IHU
 SG_ ALM2Diag9RedSts : 402|1@0+ (1,0) [0|1] "" IHU
 SG_ ALM2Diag9TmpSts : 401|1@0+ (1,0) [0|1] "" IHU
 SG_ ALM2Diag9VltSts : 400|1@0+ (1,0) [0|1] "" IHU
 SG_ CcmElecAirDirCrtlReqDrvrLePosX : 23|8@0+ (1.0,0.0) [0.0|255.0] "Unitless" IHU
 SG_ CcmElecAirDirCrtlReqDrvrLePosX_UB : 144|1@0+ (1,0) [0|1] "" IHU
 SG_ CcmElecAirDirCrtlReqDrvrLePosY : 31|8@0+ (1.0,0.0) [0.0|255.0] "Unitless" IHU
 SG_ CcmElecAirDirCrtlReqDrvrLePosY_UB : 145|1@0+ (1,0) [0|1] "" IHU
 SG_ CcmElecAirDirCrtlReqDrvrRiPosX : 39|8@0+ (1.0,0.0) [0.0|255.0] "Unitless" IHU
 SG_ CcmElecAirDirCrtlReqDrvrRiPosX_UB : 146|1@0+ (1,0) [0|1] "" IHU
 SG_ CcmElecAirDirCrtlReqDrvrRiPosY : 47|8@0+ (1.0,0.0) [0.0|255.0] "Unitless" IHU
 SG_ CcmElecAirDirCrtlReqDrvrRiPosY_UB : 147|1@0+ (1,0) [0|1] "" IHU
 SG_ CcmElecAirDirCrtlReqPassLePosX : 55|8@0+ (1.0,0.0) [0.0|255.0] "Unitless" IHU
 SG_ CcmElecAirDirCrtlReqPassLePosX_UB : 148|1@0+ (1,0) [0|1] "" IHU
 SG_ CcmElecAirDirCrtlReqPassLePosY : 63|8@0+ (1.0,0.0) [0.0|255.0] "Unitless" IHU
 SG_ CcmElecAirDirCrtlReqPassLePosY_UB : 152|1@0+ (1,0) [0|1] "" IHU
 SG_ CcmElecAirDirCrtlReqPassRiPosX : 71|8@0+ (1.0,0.0) [0.0|255.0] "Unitless" IHU
 SG_ CcmElecAirDirCrtlReqPassRiPosX_UB : 153|1@0+ (1,0) [0|1] "" IHU
 SG_ CcmElecAirDirCrtlReqPassRiPosY : 79|8@0+ (1.0,0.0) [0.0|255.0] "Unitless" IHU
 SG_ CcmElecAirDirCrtlReqPassRiPosY_UB : 154|1@0+ (1,0) [0|1] "" IHU
 SG_ ClimaActv : 89|1@0+ (1,0) [0|1] "" IHU,ZCUD
 SG_ ClimaActv_UB : 155|1@0+ (1,0) [0|1] "" IHU,ZCUD
 SG_ ElecAirVentnAvlSts : 95|3@0+ (1,0) [0|7] "" IHU
 SG_ ElecAirVentnAvlSts_UB : 157|1@0+ (1,0) [0|1] "" IHU
 SG_ ElecDefrstReq_UB : 158|1@0+ (1,0) [0|1] "" IHU,ZCUD
 SG_ ElecDefrstReqMirrDefrstReq : 92|1@0+ (1,0) [0|1] "" IHU,ZCUD
 SG_ ElecDefrstReqWinDefrstFrntReq : 91|1@0+ (1,0) [0|1] "" IHU,ZCUD
 SG_ ElecDefrstReqWinDefrstReReq : 90|1@0+ (1,0) [0|1] "" IHU,ZCUD
 SG_ EvaprTRe_UB : 159|1@0+ (1,0) [0|1] "" IHU,ZCUD
 SG_ EvaprTReEvaprTFrnt : 103|13@0- (0.1,0.0) [-256.0|255.9] "degC" IHU,ZCUD
 SG_ EvaprTReEvaprTQf : 106|1@0+ (1,0) [0|1] "" IHU,ZCUD
 SG_ FogFlashPrevnActv : 139|1@0+ (1,0) [0|1] "" IHU
 SG_ FogFlashPrevnActv_UB : 138|1@0+ (1,0) [0|1] "" IHU
 SG_ FragCh1UseUpWrn : 105|1@0+ (1,0) [0|1] "" IHU
 SG_ FragCh1UseUpWrn_UB : 160|1@0+ (1,0) [0|1] "" IHU
 SG_ FragCh2UseUpWrn : 104|1@0+ (1,0) [0|1] "" IHU
 SG_ FragCh2UseUpWrn_UB : 161|1@0+ (1,0) [0|1] "" IHU
 SG_ FragCh3UseUpWrn : 120|1@0+ (1,0) [0|1] "" IHU
 SG_ FragCh3UseUpWrn_UB : 162|1@0+ (1,0) [0|1] "" IHU
 SG_ FragCh4UseUpWrn : 129|1@0+ (1,0) [0|1] "" IHU
 SG_ FragCh4UseUpWrn_UB : 163|1@0+ (1,0) [0|1] "" IHU
 SG_ FragCh5UseUpWrn : 128|1@0+ (1,0) [0|1] "" IHU
 SG_ FragCh5UseUpWrn_UB : 164|1@0+ (1,0) [0|1] "" IHU
 SG_ FragLvlFrmClima : 135|2@0+ (1,0) [0|3] "" IHU
 SG_ FragLvlFrmClima_UB : 165|1@0+ (1,0) [0|1] "" IHU
 SG_ FragStsFrmClima : 133|2@0+ (1,0) [0|3] "" IHU
 SG_ FragStsFrmClima_UB : 166|1@0+ (1,0) [0|1] "" IHU
 SG_ HeatrAirTReqFirstLe : 183|9@0+ (0.5,-60.0) [-60.0|195.5] "Unitless" ZCUD
 SG_ HeatrAirTReqFirstLe_UB : 88|1@0+ (1,0) [0|1] "" ZCUD
 SG_ HeatrAirTReqFirstRi : 184|9@0+ (0.5,-60.0) [-60.0|195.5] "Unitless" ZCUD
 SG_ HeatrAirTReqFirstRi_UB : 126|1@0+ (1,0) [0|1] "" ZCUD
 SG_ HeatrAirTReqSecLe : 119|9@0+ (0.5,-60.0) [-60.0|195.5] "Unitless" ZCUD
 SG_ HeatrAirTReqSecLe_UB : 125|1@0+ (1,0) [0|1] "" ZCUD
 SG_ HvacEvaprTSpRe : 87|8@0+ (0.1,-5.0) [-5.0|20.0] "Unitless" IHU,ZCUD
 SG_ HvacEvaprTSpRe_UB : 167|1@0+ (1,0) [0|1] "" IHU,ZCUD
 SG_ HvacHexAirTFirstLe_UB : 209|1@0+ (1,0) [0|1] "" IHU,ZCUD
 SG_ HvacHexAirTFirstLeHvacAirTForHeatrFrnt : 207|13@0- (0.1,0.0) [-256.0|255.9] "degC" IHU,ZCUD
 SG_ HvacHexAirTFirstLeHvacAirTForHeatrFrntQf : 210|1@0+ (1,0) [0|1] "" IHU,ZCUD
 SG_ HvacHexAirTFirstRi_UB : 208|1@0+ (1,0) [0|1] "" IHU,ZCUD
 SG_ HvacHexAirTFirstRiHvacAirTForHeatrFrnt : 223|13@0- (0.1,0.0) [-256.0|255.9] "degC" IHU,ZCUD
 SG_ HvacHexAirTFirstRiHvacAirTForHeatrFrntQf : 226|1@0+ (1,0) [0|1] "" IHU,ZCUD
 SG_ HvacHexAirTSecLe_UB : 156|1@0+ (1,0) [0|1] "" IHU,ZCUD
 SG_ HvacHexAirTSecLeHvacAirTForHeatrFrnt : 239|13@0- (0.1,0.0) [-256.0|255.9] "degC" IHU,ZCUD
 SG_ HvacHexAirTSecLeHvacAirTForHeatrFrntQf : 242|1@0+ (1,0) [0|1] "" IHU,ZCUD
 SG_ IntPm25HiPopUp : 131|2@0+ (1,0) [0|3] "" IHU
 SG_ IntPm25HiPopUp_UB : 168|1@0+ (1,0) [0|1] "" IHU
 SG_ PassSeatVentAvlSts : 151|3@0+ (1,0) [0|7] "" IHU
 SG_ PassSeatVentAvlSts_UB : 171|1@0+ (1,0) [0|1] "" IHU
 SG_ PrkgClimaWarn : 124|4@0+ (1,0) [0|15] "" IHU
 SG_ PrkgClimaWarn_UB : 173|1@0+ (1,0) [0|1] "" IHU
 SG_ SeatClimaDurgClima_UB : 137|1@0+ (1,0) [0|1] "" IHU,ZCUD
 SG_ SeatClimaDurgClimaHmiSeatHeatgForRowFirstLe : 7|2@0+ (1,0) [0|3] "" IHU,ZCUD
 SG_ SeatClimaDurgClimaHmiSeatHeatgForRowFirstRi : 5|2@0+ (1,0) [0|3] "" IHU,ZCUD
 SG_ SeatClimaDurgClimaHmiSeatHeatgForRowSecLe : 3|2@0+ (1,0) [0|3] "" IHU,ZCUD
 SG_ SeatClimaDurgClimaHmiSeatHeatgForRowSecRi : 1|2@0+ (1,0) [0|3] "" IHU,ZCUD
 SG_ SeatClimaDurgClimaHmiSeatVentnForRowFirstLe : 15|2@0+ (1,0) [0|3] "" IHU,ZCUD
 SG_ SeatClimaDurgClimaHmiSeatVentnForRowFirstRi : 13|2@0+ (1,0) [0|3] "" IHU,ZCUD
 SG_ SeatClimaDurgClimaHmiSeatVentnForRowSecLe : 11|2@0+ (1,0) [0|3] "" IHU,ZCUD
 SG_ SeatClimaDurgClimaHmiSeatVentnForRowSecRi : 9|2@0+ (1,0) [0|3] "" IHU,ZCUD

BO_ 803 ZcupZCUCANFD2Fr08 : 64 ZCUP
 SG_ CcmRollgCntrSts : 39|8@0+ (1.0,0.0) [0.0|255.0] "Unitless" IHU,ZCUD
 SG_ CcmRollgCntrSts_UB : 138|1@0+ (1,0) [0|1] "" IHU,ZCUD
 SG_ ClimaCoolgReqLvl : 196|2@0+ (1,0) [0|3] "" IHU,ZCUD
 SG_ ClimaCoolgReqLvl_UB : 190|1@0+ (1,0) [0|1] "" IHU,ZCUD
 SG_ ClimaHeatgReqLvl : 194|2@0+ (1,0) [0|3] "" IHU,ZCUD
 SG_ ClimaHeatgReqLvl_UB : 192|1@0+ (1,0) [0|1] "" IHU,ZCUD
 SG_ CmptModForHp : 205|3@0+ (1,0) [0|7] "" IHU,ZCUD
 SG_ CmptModForHp_UB : 202|1@0+ (1,0) [0|1] "" IHU,ZCUD
 SG_ CmptmtTRe_UB : 140|1@0+ (1,0) [0|1] "" IHU,ZCUD
 SG_ CmptmtTReCmptmtTFrnt : 71|11@0+ (0.1,-60.0) [-60.0|125.0] "degC" IHU,ZCUD
 SG_ CmptmtTReCmptmtTFrntQf : 76|2@0+ (1,0) [0|3] "" IHU,ZCUD
 SG_ CmptmtTReFanForCmptmtTRunng : 74|1@0+ (1,0) [0|1] "" IHU,ZCUD
 SG_ DvlpFrameForCCM_UB : 200|1@0+ (1,0) [0|1] "" IHU,ZCUD
 SG_ DvlpFrameForCCMByte0 : 215|8@0+ (1.0,0.0) [0.0|255.0] "Unitless" IHU,ZCUD
 SG_ DvlpFrameForCCMByte1 : 223|8@0+ (1.0,0.0) [0.0|255.0] "Unitless" IHU,ZCUD
 SG_ DvlpFrameForCCMByte2 : 231|8@0+ (1.0,0.0) [0.0|255.0] "Unitless" IHU,ZCUD
 SG_ DvlpFrameForCCMByte3 : 239|8@0+ (1.0,0.0) [0.0|255.0] "Unitless" IHU,ZCUD
 SG_ DvlpFrameForCCMByte4 : 247|8@0+ (1.0,0.0) [0.0|255.0] "Unitless" IHU,ZCUD
 SG_ DvlpFrameForCCMByte5 : 255|8@0+ (1.0,0.0) [0.0|255.0] "Unitless" IHU,ZCUD
 SG_ DvlpFrameForCCMByte6 : 263|8@0+ (1.0,0.0) [0.0|255.0] "Unitless" IHU,ZCUD
 SG_ DvlpFrameForCCMByte7 : 271|8@0+ (1.0,0.0) [0.0|255.0] "Unitless" IHU,ZCUD
 SG_ FrntHvacBlowerSts : 279|2@0+ (1,0) [0|3] "" IHU,ZCUD
 SG_ FrntHvacBlowerSts_UB : 201|1@0+ (1,0) [0|1] "" IHU,ZCUD
 SG_ HeatrAirTReq : 88|9@0+ (0.5,-60.0) [-60.0|195.5] "Unitless" IHU,ZCUD
 SG_ HeatrAirTReq_UB : 141|1@0+ (1,0) [0|1] "" IHU,ZCUD
 SG_ HpReqCritSts : 277|1@0+ (1,0) [0|1] "" IHU,ZCUD
 SG_ HpReqCritSts_UB : 276|1@0+ (1,0) [0|1] "" IHU,ZCUD
 SG_ HvacAirMFlowEstimd : 273|10@0+ (1.0,0.0) [0.0|1000.0] "Kg / h" IHU,ZCUD
 SG_ HvacAirMFlowEstimd_UB : 274|1@0+ (1,0) [0|1] "" IHU,ZCUD
 SG_ HvacAirMFlowReEstimd : 113|10@0+ (1.0,0.0) [0.0|1000.0] "Kg / h" IHU,ZCUD
 SG_ HvacAirMFlowReEstimd_UB : 162|1@0+ (1,0) [0|1] "" IHU,ZCUD
 SG_ HvacAirTForRowFirstAtFlrLe_UB : 275|1@0+ (1,0) [0|1] "" IHU,ZCUD
 SG_ HvacAirTForRowFirstAtFlrLeEvaprTFrnt : 292|13@0- (0.1,0.0) [-256.0|255.9] "degC" IHU,ZCUD
 SG_ HvacAirTForRowFirstAtFlrLeEvaprTQf : 293|1@0+ (1,0) [0|1] "" IHU,ZCUD
 SG_ HvacAirTForRowFirstAtFlrRi_UB : 310|1@0+ (1,0) [0|1] "" IHU,ZCUD
 SG_ HvacAirTForRowFirstAtFlrRiEvaprTFrnt : 308|13@0- (0.1,0.0) [-256.0|255.9] "degC" IHU,ZCUD
 SG_ HvacAirTForRowFirstAtFlrRiEvaprTQf : 309|1@0+ (1,0) [0|1] "" IHU,ZCUD
 SG_ HvacAirTForRowFirstAtVentLe_UB : 326|1@0+ (1,0) [0|1] "" IHU,ZCUD
 SG_ HvacAirTForRowFirstAtVentLeEvaprTFrnt : 324|13@0- (0.1,0.0) [-256.0|255.9] "degC" IHU,ZCUD
 SG_ HvacAirTForRowFirstAtVentLeEvaprTQf : 325|1@0+ (1,0) [0|1] "" IHU,ZCUD
 SG_ HvacAirTForRowFirstAtVentRi_UB : 311|1@0+ (1,0) [0|1] "" IHU,ZCUD
 SG_ HvacAirTForRowFirstAtVentRiEvaprTFrnt : 340|13@0- (0.1,0.0) [-256.0|255.9] "degC" IHU,ZCUD
 SG_ HvacAirTForRowFirstAtVentRiEvaprTQf : 341|1@0+ (1,0) [0|1] "" IHU,ZCUD
 SG_ HvacAirTForRowSecAtFlrLe_UB : 327|1@0+ (1,0) [0|1] "" IHU,ZCUD
 SG_ HvacAirTForRowSecAtFlrLeEvaprTFrnt : 356|13@0- (0.1,0.0) [-256.0|255.9] "degC" IHU,ZCUD
 SG_ HvacAirTForRowSecAtFlrLeEvaprTQf : 357|1@0+ (1,0) [0|1] "" IHU,ZCUD
 SG_ HvacAirTForRowSecAtFlrRi_UB : 294|1@0+ (1,0) [0|1] "" IHU,ZCUD
 SG_ HvacAirTForRowSecAtFlrRiEvaprTFrnt : 372|13@0- (0.1,0.0) [-256.0|255.9] "degC" IHU,ZCUD
 SG_ HvacAirTForRowSecAtFlrRiEvaprTQf : 373|1@0+ (1,0) [0|1] "" IHU,ZCUD
 SG_ HvacAirTForRowSecAtVentLe_UB : 295|1@0+ (1,0) [0|1] "" IHU,ZCUD
 SG_ HvacAirTForRowSecAtVentLeEvaprTFrnt : 388|13@0- (0.1,0.0) [-256.0|255.9] "degC" IHU,ZCUD
 SG_ HvacAirTForRowSecAtVentLeEvaprTQf : 389|1@0+ (1,0) [0|1] "" IHU,ZCUD
 SG_ HvacAirTForRowSecAtVentRi_UB : 342|1@0+ (1,0) [0|1] "" IHU,ZCUD
 SG_ HvacAirTForRowSecAtVentRiEvaprTFrnt : 404|13@0- (0.1,0.0) [-256.0|255.9] "degC" IHU,ZCUD
 SG_ HvacAirTForRowSecAtVentRiEvaprTQf : 405|1@0+ (1,0) [0|1] "" IHU,ZCUD
 SG_ HvacAirTForRowThrdAtFlrRi_UB : 465|1@0+ (1,0) [0|1] "" ZCUD
 SG_ HvacAirTForRowThrdAtFlrRiEvaprTFrnt : 479|13@0- (0.1,0.0) [-256.0|255.9] "degC" ZCUD
 SG_ HvacAirTForRowThrdAtFlrRiEvaprTQf : 464|1@0+ (1,0) [0|1] "" ZCUD
 SG_ HvacAirTForRowThrdAtVentRi_UB : 481|1@0+ (1,0) [0|1] "" ZCUD
 SG_ HvacAirTForRowThrdAtVentRiEvaprTFrnt : 495|13@0- (0.1,0.0) [-256.0|255.9] "degC" ZCUD
 SG_ HvacAirTForRowThrdAtVentRiEvaprTQf : 480|1@0+ (1,0) [0|1] "" ZCUD
 SG_ HvacCondsorT_UB : 343|1@0+ (1,0) [0|1] "" IHU,ZCUD
 SG_ HvacCondsorTEvaprTFrnt : 420|13@0- (0.1,0.0) [-256.0|255.9] "degC" IHU,ZCUD
 SG_ HvacCondsorTEvaprTQf : 421|1@0+ (1,0) [0|1] "" IHU,ZCUD
 SG_ HvacCondsorTsp_UB : 358|1@0+ (1,0) [0|1] "" IHU,ZCUD
 SG_ HvacCondsorTspEvaprTFrnt : 436|13@0- (0.1,0.0) [-256.0|255.9] "degC" IHU,ZCUD
 SG_ HvacCondsorTspEvaprTQf : 437|1@0+ (1,0) [0|1] "" IHU,ZCUD
 SG_ HvacHeatrInletTempReq_UB : 163|1@0+ (1,0) [0|1] "" IHU,ZCUD
 SG_ HvacHeatrInletTempReqEvaprTFrnt : 111|13@0- (0.1,0.0) [-256.0|255.9] "degC" IHU,ZCUD
 SG_ HvacHeatrInletTempReqEvaprTQf : 114|1@0+ (1,0) [0|1] "" IHU,ZCUD
 SG_ HvacOsaAndRecActrQfForHp : 375|1@0+ (1,0) [0|1] "" IHU,ZCUD
 SG_ HvacOsaAndRecActrQfForHp_UB : 374|1@0+ (1,0) [0|1] "" IHU,ZCUD
 SG_ HvacTempFlapActlPosnFrstRowLe : 135|10@0+ (0.1,0.0) [0.0|100.0] "%" IHU,ZCUD
 SG_ HvacTempFlapActlPosnFrstRowLe_UB : 164|1@0+ (1,0) [0|1] "" IHU,ZCUD
 SG_ HvacTempFlapActlPosnFrstRowRi : 137|10@0+ (0.1,0.0) [0.0|100.0] "%" IHU,ZCUD
 SG_ HvacTempFlapActlPosnFrstRowRi_UB : 165|1@0+ (1,0) [0|1] "" IHU,ZCUD
 SG_ HvacTempFlapActlPosnSecRowLe : 159|10@0+ (0.1,0.0) [0.0|100.0] "%" IHU,ZCUD
 SG_ HvacTempFlapActlPosnSecRowLe_UB : 176|1@0+ (1,0) [0|1] "" IHU,ZCUD
 SG_ HvacTempFlapActlPosnSecRowRi : 161|10@0+ (0.1,0.0) [0.0|100.0] "%" IHU,ZCUD
 SG_ HvacTempFlapActlPosnSecRowRi_UB : 177|1@0+ (1,0) [0|1] "" IHU,ZCUD
 SG_ HvahHeatgReq : 73|1@0+ (1,0) [0|1] "" IHU,ZCUD
 SG_ HvahHeatgReq_UB : 178|1@0+ (1,0) [0|1] "" IHU,ZCUD
 SG_ HvahPwrReq : 455|8@0+ (20.0,0.0) [0.0|5100.0] "W" IHU,ZCUD
 SG_ HvahPwrReq_UB : 359|1@0+ (1,0) [0|1] "" IHU,ZCUD
 SG_ MirrDefrstAtPassSts : 72|1@0+ (1,0) [0|1] "" IHU,ZCUD
 SG_ MirrDefrstAtPassSts_UB : 179|1@0+ (1,0) [0|1] "" IHU,ZCUD
 SG_ ReEvapVlvSts : 199|3@0+ (1,0) [0|7] "" ZCUD
 SG_ ReEvapVlvSts_UB : 191|1@0+ (1,0) [0|1] "" ZCUD
 SG_ ReHvacBlowerSts : 92|2@0+ (1,0) [0|3] "" IHU,ZCUD
 SG_ ReHvacBlowerSts_UB : 180|1@0+ (1,0) [0|1] "" IHU,ZCUD
 SG_ ReHvacHexAirT_UB : 139|1@0+ (1,0) [0|1] "" ZCUD
 SG_ ReHvacHexAirTHvacAirTForHeatrFrnt : 463|13@0- (0.1,0.0) [-256.0|255.9] "degC" ZCUD
 SG_ ReHvacHexAirTHvacAirTForHeatrFrntQf : 466|1@0+ (1,0) [0|1] "" ZCUD
 SG_ RemClimaActv : 90|1@0+ (1,0) [0|1] "" IHU
 SG_ RemClimaActv_UB : 181|1@0+ (1,0) [0|1] "" IHU
 SG_ ResrvdSigForECM1 : 47|8@0+ (1.0,0.0) [0.0|255.0] "Unitless" IHU,ZCUD
 SG_ ResrvdSigForECM1_UB : 182|1@0+ (1,0) [0|1] "" IHU,ZCUD
 SG_ ResrvdSigForECM2 : 55|8@0+ (1.0,0.0) [0.0|255.0] "Unitless" IHU,ZCUD
 SG_ ResrvdSigForECM2_UB : 183|1@0+ (1,0) [0|1] "" IHU,ZCUD
 SG_ ResrvdSigForECM3 : 7|16@0+ (1.0,0.0) [0.0|65535.0] "Unitless" IHU,ZCUD
 SG_ ResrvdSigForECM3_UB : 184|1@0+ (1,0) [0|1] "" IHU,ZCUD
 SG_ ResrvdSigForECM4 : 23|16@0+ (1.0,0.0) [0.0|65535.0] "Unitless" IHU,ZCUD
 SG_ ResrvdSigForECM4_UB : 185|1@0+ (1,0) [0|1] "" IHU,ZCUD
 SG_ TiOfDeactvnForClimaCtrl : 63|6@0+ (1.0,0.0) [0.0|59.0] "s" IHU
 SG_ TiOfDeactvnForClimaCtrl_UB : 188|1@0+ (1,0) [0|1] "" IHU
 SG_ UBoostReqByClima : 89|1@0+ (1,0) [0|1] "" IHU,ZCUD
 SG_ UBoostReqByClima_UB : 189|1@0+ (1,0) [0|1] "" IHU,ZCUD

CM_ SG_ 328 AjarChrgLidFrntSwitch "AjarChrgLidFrntSwitch - Front Charge Lid Switch status
Ukwn - Unknown status
Opend - Opened
Clsd - Closed";
CM_ SG_ 328 CrabMovAvmReq "AVM request when CrabMoving function exit in GearR.";
CM_ SG_ 328 CrabMovIndcnMsg "CrabMoving reminder or warning message.";
CM_ SG_ 328 CrabMovMonrReq "CrabMoving request video streaming splicing.";
CM_ SG_ 328 CrabMovNotAvailable "CrabMoving funtion available flag.";
CM_ SG_ 328 CrabMovStLiReqChks "checksum";
CM_ SG_ 328 CrabMovStLiReqCntr "counter";
CM_ SG_ 328 CrabMovStLiReqStLiReq "CrabMoving around light request.";
CM_ SG_ 328 LowSpdStrIndcnMsg "AgileSteering reminder or warning message.";
CM_ SG_ 328 LowSpdStrNotAvailable "AgileSteering funtion available flag.";
CM_ SG_ 328 LowSpdStrNotAvailableForSecMod "AgileSteering funtion available flag for second mode.";
CM_ SG_ 328 LowSpdStrStLiReqChks "checksum";
CM_ SG_ 328 LowSpdStrStLiReqCntr "counter";
CM_ SG_ 328 LowSpdStrStLiReqForSecMod "AgileSteering around light request for second mode.";
CM_ SG_ 328 LowSpdStrStLiReqStLiReq "AgileSteering around light request.";
CM_ SG_ 328 LvlgFctAvl "One KeyLeveling function availability";
CM_ SG_ 328 LvlgFctSts "One KeyLeveling function state";
CM_ SG_ 328 MeCnsAvgIndcdMeCnsIndcdVal1 "Average methanol Consumption Trip1";
CM_ SG_ 328 MeCnsAvgIndcdMeCnsIndcdVal2 "Average methanol Consumption Trip2";
CM_ SG_ 328 NFCKeyReadStsToHMI2Key0 "key read status";
CM_ SG_ 328 NFCKeyReadStsToHMI2Key1 "key read status";
CM_ SG_ 328 NFCKeyReadStsToHMI2Key10 "key read status";
CM_ SG_ 328 NFCKeyReadStsToHMI2Key11 "key read status";
CM_ SG_ 328 NFCKeyReadStsToHMI2Key12 "key read status";
CM_ SG_ 328 NFCKeyReadStsToHMI2Key13 "key read status";
CM_ SG_ 328 NFCKeyReadStsToHMI2Key14 "key read status";
CM_ SG_ 328 NFCKeyReadStsToHMI2Key15 "key read status";
CM_ SG_ 328 NFCKeyReadStsToHMI2Key16 "key read status";
CM_ SG_ 328 NFCKeyReadStsToHMI2Key17 "key read status";
CM_ SG_ 328 NFCKeyReadStsToHMI2Key18 "key read status";
CM_ SG_ 328 NFCKeyReadStsToHMI2Key19 "key read status";
CM_ SG_ 328 NFCKeyReadStsToHMI2Key2 "key read status";
CM_ SG_ 328 NFCKeyReadStsToHMI2Key20 "key read status";
CM_ SG_ 328 NFCKeyReadStsToHMI2Key21 "key read status";
CM_ SG_ 328 NFCKeyReadStsToHMI2Key22 "key read status";
CM_ SG_ 328 NFCKeyReadStsToHMI2Key23 "key read status";
CM_ SG_ 328 NFCKeyReadStsToHMI2Key24 "key read status";
CM_ SG_ 328 NFCKeyReadStsToHMI2Key25 "key read status";
CM_ SG_ 328 NFCKeyReadStsToHMI2Key26 "key read status";
CM_ SG_ 328 NFCKeyReadStsToHMI2Key27 "key read status";
CM_ SG_ 328 NFCKeyReadStsToHMI2Key28 "key read status";
CM_ SG_ 328 NFCKeyReadStsToHMI2Key29 "key read status";
CM_ SG_ 328 NFCKeyReadStsToHMI2Key3 "key read status";
CM_ SG_ 328 NFCKeyReadStsToHMI2Key30 "key read status";
CM_ SG_ 328 NFCKeyReadStsToHMI2Key31 "key read status";
CM_ SG_ 328 NFCKeyReadStsToHMI2Key32 "key read status";
CM_ SG_ 328 NFCKeyReadStsToHMI2Key33 "key read status";
CM_ SG_ 328 NFCKeyReadStsToHMI2Key34 "key read status";
CM_ SG_ 328 NFCKeyReadStsToHMI2Key35 "key read status";
CM_ SG_ 328 NFCKeyReadStsToHMI2Key4 "key read status";
CM_ SG_ 328 NFCKeyReadStsToHMI2Key5 "key read status";
CM_ SG_ 328 NFCKeyReadStsToHMI2Key6 "key read status";
CM_ SG_ 328 NFCKeyReadStsToHMI2Key7 "key read status";
CM_ SG_ 328 NFCKeyReadStsToHMI2Key8 "key read status";
CM_ SG_ 328 NFCKeyReadStsToHMI2Key9 "key read status";
CM_ SG_ 328 SeatMassgRunngPass2 "Massage Module feedback signal if massage funcitonality is currently running";
CM_ SG_ 328 SteerActReForTvc "Actual steering wheel angle from the actual centre position of the steering wheel used for disaplay on HMI.";
CM_ SG_ 328 TankTurnActIndcnMsg "Tank U-turns often show a request in classical Chinese";
CM_ SG_ 328 TankTurnActYawRateForHMI "Actual yaw rate for Tankturn fucntion.";
CM_ SG_ 328 TankTurnNotAvailable "TankTurn funtion available flag.";
CM_ SG_ 671 ActvnOfDrvSideDoorIllmn "PWM signal to control Driver side Inner door/door pocket light illumination.";
CM_ SG_ 671 ActvnOfDrvSideStepIllmn "PWM signal to control Driver side step light illumination.";
CM_ SG_ 671 ActvnOfReDrvDoorIllmn "PWM signal to control Driver side Rear Inner door/door pocket light illumination.";
CM_ SG_ 671 ActvnOfReDrvSideStepIllmn "PWM signal to control Driver Rear side step light illumination.";
CM_ SG_ 671 AmbTForVisy "The temperature shall be calculated from the signal with the following operation";
CM_ SG_ 671 BltCrashNotifDrvr "Status signal for driver belt pyrotechnic activation.";
CM_ SG_ 671 BltCrashNotifPass "Status signal for passenger belt pyrotechnic activation.";
CM_ SG_ 671 DampgRealFrntLe "Current damping force output of the shock absorber";
CM_ SG_ 671 DampgRealFrntRi "Current damping force output of the shock absorber";
CM_ SG_ 671 DampgRealReLe "Current damping force output of the shock absorber";
CM_ SG_ 671 DampgRealReRi "Current damping force output of the shock absorber";
CM_ SG_ 671 FrntSteerFEstimd1 "FrntSteerFEstimd1 (Front Steer Force Estimated) provides estimates of the front steering rack force.";
CM_ SG_ 671 SuspStabyCritFailrDetdChks "This DATA-Element is used to inform that a stability problem has occur in the suspension. Checksum.";
CM_ SG_ 671 SuspStabyCritFailrDetdCntr "This DATA-Element is used to inform that a stability problem has occur in the suspension. Counter.";
CM_ SG_ 671 SuspStabyCritFailrDetdSts "This DATA-Element is used to inform that a stability problem has occur in the wheel suspension.";
CM_ SG_ 54 DrvrSeatPhytheraSts "Driver seat physiotherapy functionality activation status feedback.";
CM_ SG_ 54 IntrlMirrDispSysSts "The work status of IRMD.";
CM_ SG_ 54 LeReWinBtnDwn "down";
CM_ SG_ 54 LeReWinBtnRise "rise";
CM_ SG_ 54 LeThirdElecticDuctVent "Left Third row Electric Duct Vent Open and Close Button";
CM_ SG_ 54 LeThirdElecticDuctVentMode "Left Third row Electric Duct Vent Mode Open and Close Button";
CM_ SG_ 54 PassSeatFoldSwt "Passenger seat folding switch";
CM_ SG_ 54 PassSeatUnfoldSwt "Passenger seat expansion switch";
CM_ SG_ 54 RiReWinBtnDwn "down";
CM_ SG_ 54 RiReWinBtnRise "rise
";
CM_ SG_ 54 RiThirdElecticDuctVent "Right Third row Electric Duct Vent Open and Close Button";
CM_ SG_ 54 RiThirdElecticDuctVentMode "Right Third row Electric Duct Vent Mode Open and Close Button";
CM_ SG_ 54 StreamingMirrBri "Feedback of manually adjust the brightness of the streaming media rearview mirror";
CM_ SG_ 54 StreamingMirrEnable "Feedback on or off the streaming media rearview mirror.";
CM_ SG_ 54 StreamingMirrImg "Feedback of rearview mirror streaming image zoom.";
CM_ SG_ 54 StreamingMirrPosn "Feedback of streaming media rearview mirror position adjustment";
CM_ SG_ 1348 VFCVectorZCUDMBlockID "BlockID";
CM_ SG_ 1348 VFCVectorZCUDMVFCid0 "SettingsComfort";
CM_ SG_ 1348 VFCVectorZCUDMVFCid1 "ParkingDrivingClimatization";
CM_ SG_ 1348 VFCVectorZCUDMVFCid10 "ExteriorLighting";
CM_ SG_ 1348 VFCVectorZCUDMVFCid11 "VFC11";
CM_ SG_ 1348 VFCVectorZCUDMVFCid12 "Alarm";
CM_ SG_ 1348 VFCVectorZCUDMVFCid13 "VFC13";
CM_ SG_ 1348 VFCVectorZCUDMVFCid14 "InteriorLighting";
CM_ SG_ 1348 VFCVectorZCUDMVFCid15 "VFC15";
CM_ SG_ 1348 VFCVectorZCUDMVFCid16 "Locking";
CM_ SG_ 1348 VFCVectorZCUDMVFCid17 "RemoteKeyFunctionality";
CM_ SG_ 1348 VFCVectorZCUDMVFCid18 "PropulsionStart";
CM_ SG_ 1348 VFCVectorZCUDMVFCid19 "VFC19";
CM_ SG_ 1348 VFCVectorZCUDMVFCid2 "PostClimatisation";
CM_ SG_ 1348 VFCVectorZCUDMVFCid20 "VFC20";
CM_ SG_ 1348 VFCVectorZCUDMVFCid21 "PowerClosures";
CM_ SG_ 1348 VFCVectorZCUDMVFCid22 "VehicleDriving";
CM_ SG_ 1348 VFCVectorZCUDMVFCid23 "VFC23";
CM_ SG_ 1348 VFCVectorZCUDMVFCid24 "SettingsProfile";
CM_ SG_ 1348 VFCVectorZCUDMVFCid25 "SeatComfortFunctions";
CM_ SG_ 1348 VFCVectorZCUDMVFCid26 "Brake";
CM_ SG_ 1348 VFCVectorZCUDMVFCid27 "InfotainmentPoll";
CM_ SG_ 1348 VFCVectorZCUDMVFCid28 "HVEnergyStorage";
CM_ SG_ 1348 VFCVectorZCUDMVFCid29 "VFC29";
CM_ SG_ 1348 VFCVectorZCUDMVFCid3 "PowertrainParkingClimatization";
CM_ SG_ 1348 VFCVectorZCUDMVFCid30 "TelematicsConnectivity";
CM_ SG_ 1348 VFCVectorZCUDMVFCid31 "VFC31";
CM_ SG_ 1348 VFCVectorZCUDMVFCid32 "VFC32";
CM_ SG_ 1348 VFCVectorZCUDMVFCid33 "Diagnostics";
CM_ SG_ 1348 VFCVectorZCUDMVFCid34 "VehicleModeManagement";
CM_ SG_ 1348 VFCVectorZCUDMVFCid35 "TrailerCaravanFunctions";
CM_ SG_ 1348 VFCVectorZCUDMVFCid36 "Immobilizer";
CM_ SG_ 1348 VFCVectorZCUDMVFCid37 "Windows";
CM_ SG_ 1348 VFCVectorZCUDMVFCid38 "Visibility";
CM_ SG_ 1348 VFCVectorZCUDMVFCid39 "VFC39";
CM_ SG_ 1348 VFCVectorZCUDMVFCid4 "VFC4";
CM_ SG_ 1348 VFCVectorZCUDMVFCid40 "VFC40";
CM_ SG_ 1348 VFCVectorZCUDMVFCid41 "InfotainmentPush";
CM_ SG_ 1348 VFCVectorZCUDMVFCid42 "ChargingHV";
CM_ SG_ 1348 VFCVectorZCUDMVFCid43 "BodyPreClimatisation";
CM_ SG_ 1348 VFCVectorZCUDMVFCid44 "Crash";
CM_ SG_ 1348 VFCVectorZCUDMVFCid45 "GlobalShortDuration";
CM_ SG_ 1348 VFCVectorZCUDMVFCid46 "ExteriorLightsHazard";
CM_ SG_ 1348 VFCVectorZCUDMVFCid47 "VFC47";
CM_ SG_ 1348 VFCVectorZCUDMVFCid48 "DoorOpenWarning";
CM_ SG_ 1348 VFCVectorZCUDMVFCid49 "ChargingLVInit";
CM_ SG_ 1348 VFCVectorZCUDMVFCid5 "VFC5";
CM_ SG_ 1348 VFCVectorZCUDMVFCid50 "VFC50";
CM_ SG_ 1348 VFCVectorZCUDMVFCid51 "VFC51";
CM_ SG_ 1348 VFCVectorZCUDMVFCid52 "HVBatteryThermalEventWarning";
CM_ SG_ 1348 VFCVectorZCUDMVFCid53 "VisualAssist";
CM_ SG_ 1348 VFCVectorZCUDMVFCid54 "PassiveSafety";
CM_ SG_ 1348 VFCVectorZCUDMVFCid55 "LifeDetection";
CM_ SG_ 1348 VFCVectorZCUDMVFCid56 "BackboneFlexray";
CM_ SG_ 1348 VFCVectorZCUDMVFCid57 "Functionmarket";
CM_ SG_ 1348 VFCVectorZCUDMVFCid58 "VFCid58";
CM_ SG_ 1348 VFCVectorZCUDMVFCid59 "VFCid59";
CM_ SG_ 1348 VFCVectorZCUDMVFCid6 "SettingsVehicle";
CM_ SG_ 1348 VFCVectorZCUDMVFCid60 "VFCid60";
CM_ SG_ 1348 VFCVectorZCUDMVFCid61 "VFCid61";
CM_ SG_ 1348 VFCVectorZCUDMVFCid7 "VFC7";
CM_ SG_ 1348 VFCVectorZCUDMVFCid8 "VFC8";
CM_ SG_ 1348 VFCVectorZCUDMVFCid9 "IPWakeup";
CM_ SG_ 1379 ZCUPdevelpsignalgroupRespFunctiondevpsignalgroup1 "develop signal group";
CM_ SG_ 1379 ZCUPdevelpsignalgroupRespFunctiondevpsignalgroup2 "develop signal group";
CM_ SG_ 1379 ZCUPdevelpsignalgroupRespFunctiondevpsignalgroup3 "develop signal group";
CM_ SG_ 1379 ZCUPdevelpsignalgroupRespFunctiondevpsignalgroup4 "develop signal group";
CM_ SG_ 1379 ZCUPdevelpsignalgroupRespFunctiondevpsignalgroup5 "develop signal group";
CM_ SG_ 1379 ZCUPdevelpsignalgroupRespFunctiondevpsignalgroup6 "develop signal group";
CM_ SG_ 1379 ZCUPdevelpsignalgroupRespFunctiondevpsignalgroup7 "develop signal group";
CM_ SG_ 1379 ZCUPdevelpsignalgroupRespFunctiondevpsignalgroup8 "develop signal group";
CM_ SG_ 441 AjarChrgLidRearSwitch "AjarChrgLidRearSwitch - Rear Charge Lid Switch status
Ukwn - Unknown status
Opend - Opened
Clsd - Closed";
CM_ SG_ 441 AjarFuelFlapSwitch "AjarFuelFlapSwitch - Fuel Flap Switch status

Ukwn - Unknown status
Opend - Opened
Clsd - Closed";
CM_ SG_ 441 CarTiIntForClima "CCM internal mirror of CarTiGlb. Keeps counting when the bus signal is not available.";
CM_ SG_ 441 ClimaCmptSts "Compartment climate status.";
CM_ SG_ 441 ClimaCtrlActv "ClimaCtrlActv";
CM_ SG_ 441 ClimaDefrstSts "Defrost status.";
CM_ SG_ 441 ClimaEstimdTForHeat "Clima Estimd T For Heat";
CM_ SG_ 441 ClimaEstimdTForReHeat "Clima Estimd TFor Re Heat";
CM_ SG_ 441 CmptmtAirTEstimdAtRowFirstLoResl "Estimated compartment temperature at head level, first row";
CM_ SG_ 441 CoupldCtrlErrAtRowFirstLe "Front left coupling control error";
CM_ SG_ 441 CoupldCtrlErrAtRowFirstRi "Front Right coupling control error";
CM_ SG_ 441 CoupldCtrlErrAtRowSecLe "Second row left coupling control error";
CM_ SG_ 441 CoupldCtrlErrAtRowSecRi "Second row Right coupling control error";
CM_ SG_ 441 DoorPass2Swt1DplyHndl "Door Pass 2 Switch solution deployable handle [Switch 1]
Psd - Pressed = 0
NotPsd - Not Pressed = 1";
CM_ SG_ 441 DoorPass2Swt2DplyHndl "Door Pass 2 Switch solution deployable handle [Switch 2]
Psd - Pressed = 0
NotPsd - Not Pressed = 1";
CM_ SG_ 441 DoorPassLatPosn "Passenger door Cinch position. x01 equal fully open, x02 equal secondary position, x03 equal fully closed.";
CM_ SG_ 441 DoorPassRe2Sw1DplyHndl "Door Passenger Rear 2 Switch solution deployable handle [Switch 1]";
CM_ SG_ 441 DoorPassRe2Sw2DplyHndl "Door Passenger Rear 2 Switch solution deployable handle [Switch 2]";
CM_ SG_ 441 DrvrSeatHeatgPwrAllwd "Power limitation for driver seat climatization.";
CM_ SG_ 441 DrvrSeatVentnPwrAllwd "Allowed driver seat ventilation power.";
CM_ SG_ 441 EngSpdIncIdleForClima "Request to increase idle speed. Used when current engine speed is insufficient for climate comfort";
CM_ SG_ 441 FltOfReRegPlateLamp "Fault of Rear Registration Plate Lamp";
CM_ SG_ 441 FragCh1Id "Fragrance channel 1 ID from climate to Hmi.";
CM_ SG_ 441 FragCh2Id "Fragrance channel 1 ID from climate to Hmi.";
CM_ SG_ 441 FragCh3Id "Fragrance channel 1 ID from climate to Hmi.";
CM_ SG_ 441 FragCh4Id "Fragrance channel 1 ID from climate to Hmi.";
CM_ SG_ 441 FragCh5Id "Fragrance channel 1 ID from climate to Hmi.";
CM_ SG_ 441 HvEgyDesForClima "Desired energy from high voltage system to use for climatisation";
CM_ SG_ 441 IceBreakDoorPassActv "Boolean signal to indicate if Passenger door ice break function is activated";
CM_ SG_ 441 MirrAtPassForVce "Feedback to the voice system about the position of the mirrors";
CM_ SG_ 441 MirrAtPassInMovmt "Informs the Setting Management subsystem that the outer rear view mirrors are in movement. Passanger side.";
CM_ SG_ 441 PassSeatAdjmtLimForFldWarn "Passenger Seat Adjustment limited warning signal for fold status";
CM_ SG_ 441 PassSeatAdjmtLimnWarn "Warning Signal of Passenger Seat Adjustment Limitation depending on Roof Display status";
CM_ SG_ 441 PassSeatCushDownPosPercSeatPosPerc "Cushion Down Position Percentage";
CM_ SG_ 441 PassSeatCushDownPosPercSeatPosQf "Cushion Down Position Quality Factor";
CM_ SG_ 441 PassSeatFoldFailFb "Passenger Seat Fold fail reason feedback";
CM_ SG_ 441 PassSeatPhytheraSts "Passenger seat physiotherapy functionality activation status feedback.";
CM_ SG_ 441 PassSeatPosPercSeatPosFrntHeiPerc "Front Height Position Percentage";
CM_ SG_ 441 PassSeatPosPercSeatPosFrntHeiQF "Front Height Position Quality Factor";
CM_ SG_ 441 PassSeatPosPercSeatPosHeiPerc "Height Position Percentage";
CM_ SG_ 441 PassSeatPosPercSeatPosHeiQF "Height Position Quality Factor";
CM_ SG_ 441 PassSeatPosPercSeatPosSldPerc "Length Position Percentage";
CM_ SG_ 441 PassSeatPosPercSeatPosSldQF "Length Position Quality Factor";
CM_ SG_ 441 SeatBackAngleRowFirstPass "Backrest angle of the First Row Passenger Seat";
CM_ SG_ 441 SeatOccptAtRowSecPasSide2 "Describes if an occupant is detected in the  seat.";
CM_ SG_ 441 SeatOccptAtRowSecPasSideSnsSts2 "Informs if there is a fault on the driver seat sensor is detected through electrical measurements, or plausibility judgement. NotOk means sensor is judged as faulty. Di means that the sensor is not configured.";
CM_ SG_ 441 SteerWhlHeatgDurgClima "Requests for remote steering wheel heating.";
CM_ SG_ 441 SteerWhlHeatgPwrAllwd "Steering wheel heating power allowed percent.";
CM_ SG_ 801 AmbTEstimdAmbTEstimd "Estimated/filtered/modelled amibient temperature based on information from ambient temp sensor and all other available temperature sensors and vehicle information.  Estimated ambient temperature";
CM_ SG_ 801 AmbTEstimdQf "Estimated/filtered/modelled amibient temperature based on information from ambient temp sensor and all other available temperature sensors and vehicle information.  Quality factor for estimated signal";
CM_ SG_ 801 ClimaOvrHeatPrtSts "Request for climate system to change usage mode from abandon to inactive.";
CM_ SG_ 801 CmptmtAirTEstimdExtdComptmtT "Estimated compartment temperature with quality flag Estimated compartment Temperature";
CM_ SG_ 801 CmptmtAirTEstimdExtdQlyFlg "Estimated compartment temperature with quality flag Quality flag ";
CM_ SG_ 520 AmbTFildForClima "External temperature after special filtering, only Climate control subsystem use.";
CM_ SG_ 520 AmbTRawAtPassSideAmbTVal "Unfiltered ambient temp raw data in deg C";
CM_ SG_ 520 AmbTRawAtPassSideQly "quality";
CM_ SG_ 520 AmbTURawAtPassSide "Ambient temp raw data in deg C at passenger side";
CM_ SG_ 520 ClimaAtRowSecActv "The two-row air conditioner control is activated";
CM_ SG_ 520 HvacEvaprTSpFrnt "Set value for air temperature after evaporator in front HVAC";
CM_ SG_ 520 PassSeatActvSwtFctMod "Passenger Seat Active Integrated Switch Mode";
CM_ SG_ 520 PassSeatIntgrSwtStsIntgrSwtHozlSts "Seat Integrated Horizontal Switch Status";
CM_ SG_ 520 PassSeatIntgrSwtStsIntgrSwtRotSts "Seat Integrated Rotary Switch Status";
CM_ SG_ 520 PassSeatIntgrSwtStsIntgrSwtSelnSts "Seat Integrated Selector Switch Status";
CM_ SG_ 520 PassSeatIntgrSwtStsIntgrSwtVertSts "Seat Integrated Vertical Switch Status";
CM_ SG_ 520 RlyCmftForClimaReq "Request to close comfort relay, used by ClimateControl to ensure all wanted sensors and actuators are power supplied.";
CM_ SG_ 520 RlyCrashForClimaReq "Request to activate crash relay in order to have power supply for front blower.";
CM_ SG_ 58 DoorPassOpenLowReqOutdSwt1 "DooPassOpenLowReqOutdSwt1 - Passenger Door Open Request from Outside Switch 1 - Traditional door (No Power operated). Button status of the outside dpassenger door handle switch connection 1.
Psd - Pressed
NotPsd - Not Pressed
NoInfo1/2 - Invalid";
CM_ SG_ 58 DoorPassOpenReqInsdSwt1 "DoorDrvrOpenReqInsdSwt1 - Passenger Door Open Request from Inside Switch 1
Button status of the inside passenger door handle switch connection 1
Psd - Pressed
NotPsd - Not Pressed
NoInfo1/2 - Invalid";
CM_ SG_ 58 DoorPassReCinhIntFailInfCinchFlt1 "Cinch fault";
CM_ SG_ 58 DoorPassReCinhIntFailInfCinchRestFlt "Cinch reset fault";
CM_ SG_ 58 DoorPassReLatPosn "Passenger rear door Cinch position. x01 equal fully open, x02 equal secondary position, x03 equal fully closed.";
CM_ SG_ 58 DoorPassReOpenLowReqOutdSwt1 "Passenger Rear Door Open Request from Outside Switch 1 - Traditional door";
CM_ SG_ 58 DoorPassReOpenReqInsdSwt1 "Passenger Rear Door Open Request from Inside Switch 1";
CM_ SG_ 58 DoorPassReRelsFailCinchOverTimed "Cinch processwas not successfull. It is overtimed.";
CM_ SG_ 58 DoorPassReRelsFailFailure1 "Issue described by requiremnt according to specific project";
CM_ SG_ 58 DoorPassReRelsFailMechRels "Door Mechanical release (No Power operated)";
CM_ SG_ 58 DoorRiReLatPosn "Right rear door Cinch position. x01 equal fully open, x02 equal secondary position, x03 equal fully closed.";
CM_ SG_ 58 DoorRiReOpenLowReqOutdSwt1 "DoorRiReOpenLowReqOutdSwt1 - Right Rear Door Open Request from Outside Switch 1 - Traditional door (No Power operated). Button status of the outside Right Rear door handle switch connection 1.
Psd - Pressed
NotPsd - Not Pressed
NoInfo1/2 - Invalid";
CM_ SG_ 58 DoorRiReOpenReqInsdSwt1 "DoorDrvrOpenReqInsdSwt1 - Right rear Open Request from Inside Switch 1
Button status of the inside Right rear door handle switch connection 1
Psd - Pressed
NotPsd - Not Pressed
NoInfo1/2 - Invalid";
CM_ SG_ 58 IceBreakDoorPassReActv "Boolean signal to indicate if Passenger Rear door ice break function is activated";
CM_ SG_ 58 MirrAdjVceStsAtPass "Feedback on mirror voice movement status-(Pass)";
CM_ SG_ 310 AutDemstOperSts "Automatic demist operation state";
CM_ SG_ 310 ChdLockPassReSts "Child protection Passenger rear door, child lock status.";
CM_ SG_ 310 ChdLockRightSts "CdhLockgProtnStsAtRiRe - Child Lock Protection Status at Right Rear Door
Indicates child lock status for right rear door
On - Child lock is active
Off - Child lock is not active";
CM_ SG_ 310 CinhPassReSts "Passenger rear Door cinch Status";
CM_ SG_ 310 CinhPassReSwt "Passenger rear door Cinch switch status";
CM_ SG_ 310 CinhPassSts "passenger door Cinch switch status";
CM_ SG_ 310 CinhPassSwt "passenger door Cinch switch status";
CM_ SG_ 310 ClimaTiOfEnd "Informs of when the last pre-conditioning was ended.";
CM_ SG_ 310 CmptmtTFrntCmptmtTFrnt "Measured temperature in compartment. ";
CM_ SG_ 310 CmptmtTFrntFanForCmptmtTRunng "Fan for component temperature requirement.";
CM_ SG_ 310 CmptmtTFrntQf "Component temperature sensor signal quality.";
CM_ SG_ 310 DoorPassReHndlSts "To inform about Passenger rear door handle status";
CM_ SG_ 310 EvaprTFrntEvaprTFrnt "Air temperature measured in HVAC after evaporator";
CM_ SG_ 310 EvaprTFrntEvaprTQf "Air temperature measured in HVAC after evaporator signal quality.";
CM_ SG_ 310 FltOfBeamHiPass "Fault status of high beam of passenger side";
CM_ SG_ 310 FltOfBeamLoPass "Fault status of low beam of passenger side";
CM_ SG_ 310 FltOfDaytiRunngLampPass "Fault status of DRL Lamp of passenger side";
CM_ SG_ 310 FltOfFrntFogLampPass "Fault status of front fog Lamp of passenger side";
CM_ SG_ 310 FltOfFrntPosnLampPass "Fault status of front position Lamp of passenger side";
CM_ SG_ 310 FltOfReFogLampDrv "Fault status of rear fog Lamp of driver side";
CM_ SG_ 310 FltOfRePosnLampPass "Fault status of rear position Lamp of passenger side";
CM_ SG_ 310 FltOfRvsgLampPass "Fault status of reverse Lamp of passenger side";
CM_ SG_ 310 HvacCoolgEnaRe "Request cooling for rear HVAC";
CM_ SG_ 310 HvahAirTEstmdEvaprTFrnt "Actual air temperature after rear evaporator.";
CM_ SG_ 310 HvahAirTEstmdEvaprTQf "Actual air temperature quality flag after rear evaporator.";
CM_ SG_ 310 IceBreakDoorRiReActv "Boolean signal to indicate if Right Rear door ice break function is activated";
CM_ SG_ 310 IntPm25StsFrmClima "Interior Pm 2.5 sensor status feedback.";
CM_ SG_ 310 MirrDwnStsAtPass "Reports the status of the mirror dipping mode. Passanger side.";
CM_ SG_ 310 MirrPosnToSetTarPosnAtPassMirrAdjLeRi "Horizontal position adjustment of mirror";
CM_ SG_ 310 MirrPosnToSetTarPosnAtPassMirrAdjUpDown "vertical position adjustment of mirror";
CM_ SG_ 310 OpenPassReSwt "Passenger rear door open switch status";
CM_ SG_ 310 OpenPassSwt "passenger door open switch status";
CM_ SG_ 310 PassSeatBtnPsd "The signal PassSeatBtnPsd shall be sent when any button connected to the PSM is activated. ";
CM_ SG_ 310 PassSeatFoldSts "Status signal for the Passenger Seat Fold or Raise";
CM_ SG_ 310 PassSeatFootRstAutMovmtSts "Passenger Seat Foot Rest  automatic movement status feedback";
CM_ SG_ 310 PassSeatFootRstPosPerc "Passenger Seat Foot Rest position percentage";
CM_ SG_ 310 PassSeatFootRstSwtSts "Passenger Seat Foot Rest switch status";
CM_ SG_ 310 PassSeatInAutMovmt "Passenger Seat in Automatic Movement";
CM_ SG_ 310 PassSeatPosFrntExtPercSeatPosPerc "Front Extension Position Percentage";
CM_ SG_ 310 PassSeatPosFrntExtPercSeatPosQf "Front Extension Position Quality Factor";
CM_ SG_ 310 PawlPassReSwt "Passenger rear door pawl switch status";
CM_ SG_ 310 PawlPassSwt "passenger door pawl switch status";
CM_ SG_ 310 PrkgClimaHVReq "parking climate HV request";
CM_ SG_ 310 RemActvStsRemClimaActvSts "Remote control of climate status";
CM_ SG_ 310 RemActvStsRemDefrstSts "Remote control of deforest status";
CM_ SG_ 310 RemClimaElecDefrstReqMirrDefrstReq "Mirror heating request during remote climatization.";
CM_ SG_ 310 RemClimaElecDefrstReqWinDefrstFrntReq "Front electrical defrost request during remote climatization.";
CM_ SG_ 310 RemClimaElecDefrstReqWinDefrstReReq "Rear electrical defrost request during remote climatization.";
CM_ SG_ 310 SeatMassgBackBlstrCtrlPass "Seat Massage Backrest Bolster Control Row First Passager";
CM_ SG_ 310 SeatMassgBackBlstrEnaPass "Seat Massage Backrest Bolster Enable Row First Passager";
CM_ SG_ 310 SeatMassgCushBlstrCtrlPass "Seat Massage Cushion Bolster Control Row First Passager";
CM_ SG_ 310 SeatMassgCushBlstrEnaPass "Seat Massage Cushion Bolster Enable Row First Passager";
CM_ SG_ 310 SeatMassgCushLiftCtrlPass "Used by air cell adjustment, trigger to deflate or inflate the cushion air cells automatically.";
CM_ SG_ 310 SeatMassgCushLiftEnaPass "Configuration signal to tell the massage module if it should expect cushion lift components.";
CM_ SG_ 310 SeatMassgFctPassMassgInten "Seat Massage Intensity Selection Row First Passager";
CM_ SG_ 310 SeatMassgFctPassMassgProg "Seat Massage Program Selection Row First Passager";
CM_ SG_ 310 SeatMassgFctPassOnOff "Seat Massage On or Off Row First Passager";
CM_ SG_ 310 SeatMassgLumExtnCtrlPass "Seat Massage Lumbar Extension Control Row First Passager";
CM_ SG_ 310 SeatMassgLumHeiCtrlPass "Seat Massage Lumbar Height Control Row First Passager";
CM_ SG_ 310 SeatMassgLumMotrEnaPass "Seat Massage Lumbar Motor Enable Row First Passager";
CM_ SG_ 310 SecRowLeSeatHeatgPwrAllwd "Power limitation for second row left seat climatization.";
CM_ SG_ 310 SecRowLeSeatVentnPwrAllwd "Allowed second row left seat ventilation power.";
CM_ SG_ 310 SecRowRiSeatHeatgPwrAllwd "Power limitation for second row right seat climatization.";
CM_ SG_ 310 SecRowRiSeatVentnPwrAllwd "Allowed second row right seat ventilation power.";
CM_ SG_ 310 ShortDropWinPassReSts "Short drop a status sent back to locking to secure window is down and door is ready to be released. ";
CM_ SG_ 310 ShortDropWinPassSts "Short drop a status sent back to locking to secure window is down and door is ready to be released. ";
CM_ SG_ 310 ShortDropWinReRiSts "Short drop a status sent back to locking to secure window is down and door is ready to be released. ";
CM_ SG_ 310 ThrdRowLeSeatHeatgPwrAllwd "Power limitation for second row left seat climatization.";
CM_ SG_ 310 ThrdRowLeSeatVentnPwrAllwd "Allowed third row left seat ventilation power.";
CM_ SG_ 310 ThrdRowRiSeatHeatgPwrAllwd "Power limitation for third row right seat climatization.";
CM_ SG_ 310 ThrdRowRiSeatVentnPwrAllwd "Allowed third row right seat ventilation power.";
CM_ SG_ 310 WinDsblPassReSts "Signal sent from the rear passenger door module to the Driver door module that informs of the local status of the power window disable functionality.";
CM_ SG_ 310 WinDsblRightSts "Signal sent from the rear passenger door module to the Driver door module that informs of the local status of the power window disable functionality.
";
CM_ SG_ 310 WinFailrStsAtPassRe "Report failure if Window motor is not possible to Run";
CM_ SG_ 310 WinPosnStsAtPassRe "Signal sent to inform the rest of the car of the window position status for the rear passenger side door. The value of the signal is either an approximated percentage of openness, of the window is moving or if the position is unkown.";
CM_ SG_ 1184 CmptmtIntrMtrlTEstimdMtrlSnsrT "Material temperature";
CM_ SG_ 1184 CmptmtIntrMtrlTEstimdMtrlSnsrTQly2 "Materical quality flag";
CM_ SG_ 1184 EgyDesForClima "Desired energy to use for climatisation";
CM_ SG_ 1184 ElecVentnMotPwrCnsAct "Electrical ventilation motor actual power consumption.";
CM_ SG_ 1184 ElecVentnMotPwrCnsDes "Electrical ventilation motor estimated power consumption.";
CM_ SG_ 1184 HvacDefrstFlapActlPosn "Defrost actual flap position.";
CM_ SG_ 1184 HvacFanSet2HvacFanSpd2 "Fan speed.";
CM_ SG_ 1184 HvacHeatElmAirMFlowEstimd "Estimated total mass air flow in front HVAC heater element. ";
CM_ SG_ 1184 HvacModFlapActlPosnFrstRowLe "Vent actual flap position for first row.";
CM_ SG_ 1184 HvacModFlapActlPosnFrstRowRi "Floor actual flap position for first row.";
CM_ SG_ 1184 HvacModFlapActlPosnSecRowLe "Vent actual flap position for second row.";
CM_ SG_ 1184 HvacModFlapActlPosnSecRowRi "Floor actual flap position for second row.";
CM_ SG_ 1184 HvacOsaFlapActlPosn "OSA actual flap position.";
CM_ SG_ 1184 HvacRecFlapActlPosn "Recirculation actual flap position.";
CM_ SG_ 1184 OutdAirQlyOutdAirQly "OutSide Air Quality";
CM_ SG_ 1184 OutdAirQlyQf "Quality Factor OutSide Air Quality";
CM_ SG_ 1184 OutdPm25StsFrmClima "Outside Pm 2.5 sensor status feedback.";
CM_ SG_ 1184 PassSeatHeatgActlPwrCns "Actual power consumption for passenger seat climate, including ventilation and heating.";
CM_ SG_ 1184 PassSeatHeatgDesPwrCns "Desired power consumption for passenger seat climate, including ventilation and heating.";
CM_ SG_ 1184 PassSeatHeatgPwrAllwd "Power limitation for passenger seat climatization.";
CM_ SG_ 1184 PassSeatVentnActlPwrCns "Passenger seat ventilation actual power consumption.";
CM_ SG_ 1184 PassSeatVentnDesPwrCns "Passenger seat ventilation desired power consumption.";
CM_ SG_ 1184 PassSeatVentnPwrAllwd "Allowed passenger seat ventilation power.";
CM_ SG_ 1184 PwrAllwdForElecAirVentn "Power allowed for electrical ventilation motor.";
CM_ SG_ 1184 SunDataAzi "Sun azimuth angle.";
CM_ SG_ 1184 SunDataElevn "Sun elevation angle";
CM_ SG_ 1184 TgtHvacAirTForRowFirstLe "First row left target outlet air temperature.";
CM_ SG_ 1184 TgtHvacAirTForRowFirstRi "First row right target outlet air temperature.";
CM_ SG_ 1184 TgtHvacAirTForRowSecLe "Second row left target outlet air temperature.";
CM_ SG_ 1184 TgtHvacAirTForRowSecRi "Second row right target outlet air temperature.";
CM_ SG_ 600 AFUGenErr "Internal Control Module Memory Checksum Error.";
CM_ SG_ 600 AirFragFanErr "Air fragrance fan error.";
CM_ SG_ 600 AirFragMot1Err "Air fragrance motor error.";
CM_ SG_ 600 AirFragOvrVoltErr "Air fragrance over voltage error.";
CM_ SG_ 600 AirFragTempErr "Air fragrance temperature error.";
CM_ SG_ 600 AirFragUndVoltErr "Air fragrance under voltage error.";
CM_ SG_ 600 ALM1Diag10BluSts "Diagnostic signals from ALM to CEM, ";
CM_ SG_ 600 ALM1Diag10GreenSts "Diagnostic signals from ALM to CEM, ";
CM_ SG_ 600 ALM1Diag10RedSts "Diagnostic signals from ALM to CEM, ";
CM_ SG_ 600 ALM1Diag10TmpSts "Diagnostic signals from ALM to CEM, ";
CM_ SG_ 600 ALM1Diag10VltSts "Diagnostic signals from ALM to CEM, ";
CM_ SG_ 600 ALM1Diag11BluSts "Diagnostic signals from ALM to CEM, ";
CM_ SG_ 600 ALM1Diag11GreenSts "Diagnostic signals from ALM to CEM, ";
CM_ SG_ 600 ALM1Diag11RedSts "Diagnostic signals from ALM to CEM, ";
CM_ SG_ 600 ALM1Diag11TmpSts "Diagnostic signals from ALM to CEM, ";
CM_ SG_ 600 ALM1Diag11VltSts "Diagnostic signals from ALM to CEM, ";
CM_ SG_ 600 ALM1Diag12BluSts "Diagnostic signals from ALM to CEM, ";
CM_ SG_ 600 ALM1Diag12GreenSts "Diagnostic signals from ALM to CEM, ";
CM_ SG_ 600 ALM1Diag12RedSts "Diagnostic signals from ALM to CEM, ";
CM_ SG_ 600 ALM1Diag12TmpSts "Diagnostic signals from ALM to CEM, ";
CM_ SG_ 600 ALM1Diag12VltSts "Diagnostic signals from ALM to CEM, ";
CM_ SG_ 600 ALM1Diag13BluSts "Diagnostic signals from ALM to CEM, ";
CM_ SG_ 600 ALM1Diag13GreenSts "Diagnostic signals from ALM to CEM, ";
CM_ SG_ 600 ALM1Diag13RedSts "Diagnostic signals from ALM to CEM, ";
CM_ SG_ 600 ALM1Diag13TmpSts "Diagnostic signals from ALM to CEM, ";
CM_ SG_ 600 ALM1Diag13VltSts "Diagnostic signals from ALM to CEM, ";
CM_ SG_ 600 ALM1Diag14BluSts "Diagnostic signals from ALM to CEM, ";
CM_ SG_ 600 ALM1Diag14GreenSts "Diagnostic signals from ALM to CEM, ";
CM_ SG_ 600 ALM1Diag14RedSts "Diagnostic signals from ALM to CEM, ";
CM_ SG_ 600 ALM1Diag14TmpSts "Diagnostic signals from ALM to CEM, ";
CM_ SG_ 600 ALM1Diag14VltSts "Diagnostic signals from ALM to CEM, ";
CM_ SG_ 600 ALM1Diag15BluSts "Diagnostic signals from ALM to CEM, ";
CM_ SG_ 600 ALM1Diag15GreenSts "Diagnostic signals from ALM to CEM, ";
CM_ SG_ 600 ALM1Diag15RedSts "Diagnostic signals from ALM to CEM, ";
CM_ SG_ 600 ALM1Diag15TmpSts "Diagnostic signals from ALM to CEM, ";
CM_ SG_ 600 ALM1Diag15VltSts "Diagnostic signals from ALM to CEM, ";
CM_ SG_ 600 ALM1Diag16BluSts "Diagnostic signals from ALM to CEM, ";
CM_ SG_ 600 ALM1Diag16GreenSts "Diagnostic signals from ALM to CEM, ";
CM_ SG_ 600 ALM1Diag16RedSts "Diagnostic signals from ALM to CEM, ";
CM_ SG_ 600 ALM1Diag16TmpSts "Diagnostic signals from ALM to CEM, ";
CM_ SG_ 600 ALM1Diag16VltSts "Diagnostic signals from ALM to CEM, ";
CM_ SG_ 600 ALM1Diag1BluSts "Diagnostic signals from ALM to CEM, ";
CM_ SG_ 600 ALM1Diag1GreenSts "Diagnostic signals from ALM to CEM, ";
CM_ SG_ 600 ALM1Diag1RedSts "Diagnostic signals from ALM to CEM, ";
CM_ SG_ 600 ALM1Diag1TmpSts "Diagnostic signals from ALM to CEM, ";
CM_ SG_ 600 ALM1Diag1VltSts "Diagnostic signals from ALM to CEM, ";
CM_ SG_ 600 ALM1Diag2BluSts "Diagnostic signals from ALM to CEM, ";
CM_ SG_ 600 ALM1Diag2GreenSts "Diagnostic signals from ALM to CEM, ";
CM_ SG_ 600 ALM1Diag2RedSts "Diagnostic signals from ALM to CEM, ";
CM_ SG_ 600 ALM1Diag2TmpSts "Diagnostic signals from ALM to CEM, ";
CM_ SG_ 600 ALM1Diag2VltSts "Diagnostic signals from ALM to CEM, ";
CM_ SG_ 600 ALM1Diag3BluSts "Diagnostic signals from ALM to CEM, ";
CM_ SG_ 600 ALM1Diag3GreenSts "Diagnostic signals from ALM to CEM, ";
CM_ SG_ 600 ALM1Diag3RedSts "Diagnostic signals from ALM to CEM, ";
CM_ SG_ 600 ALM1Diag3TmpSts "Diagnostic signals from ALM to CEM, ";
CM_ SG_ 600 ALM1Diag3VltSts "Diagnostic signals from ALM to CEM, ";
CM_ SG_ 600 ALM1Diag4BluSts "Diagnostic signals from ALM to CEM, ";
CM_ SG_ 600 ALM1Diag4GreenSts "Diagnostic signals from ALM to CEM, ";
CM_ SG_ 600 ALM1Diag4RedSts "Diagnostic signals from ALM to CEM, ";
CM_ SG_ 600 ALM1Diag4TmpSts "Diagnostic signals from ALM to CEM, ";
CM_ SG_ 600 ALM1Diag4VltSts "Diagnostic signals from ALM to CEM, ";
CM_ SG_ 600 ALM1Diag5BluSts "Diagnostic signals from ALM to CEM, ";
CM_ SG_ 600 ALM1Diag5GreenSts "Diagnostic signals from ALM to CEM, ";
CM_ SG_ 600 ALM1Diag5RedSts "Diagnostic signals from ALM to CEM, ";
CM_ SG_ 600 ALM1Diag5TmpSts "Diagnostic signals from ALM to CEM, ";
CM_ SG_ 600 ALM1Diag5VltSts "Diagnostic signals from ALM to CEM, ";
CM_ SG_ 600 ALM1Diag6BluSts "Diagnostic signals from ALM to CEM, ";
CM_ SG_ 600 ALM1Diag6GreenSts "Diagnostic signals from ALM to CEM, ";
CM_ SG_ 600 ALM1Diag6RedSts "Diagnostic signals from ALM to CEM, ";
CM_ SG_ 600 ALM1Diag6TmpSts "Diagnostic signals from ALM to CEM, ";
CM_ SG_ 600 ALM1Diag6VltSts "Diagnostic signals from ALM to CEM, ";
CM_ SG_ 600 ALM1Diag7BluSts "Diagnostic signals from ALM to CEM, ";
CM_ SG_ 600 ALM1Diag7GreenSts "Diagnostic signals from ALM to CEM, ";
CM_ SG_ 600 ALM1Diag7RedSts "Diagnostic signals from ALM to CEM, ";
CM_ SG_ 600 ALM1Diag7TmpSts "Diagnostic signals from ALM to CEM, ";
CM_ SG_ 600 ALM1Diag7VltSts "Diagnostic signals from ALM to CEM, ";
CM_ SG_ 600 ALM1Diag8BluSts "Diagnostic signals from ALM to CEM, ";
CM_ SG_ 600 ALM1Diag8GreenSts "Diagnostic signals from ALM to CEM, ";
CM_ SG_ 600 ALM1Diag8RedSts "Diagnostic signals from ALM to CEM, ";
CM_ SG_ 600 ALM1Diag8TmpSts "Diagnostic signals from ALM to CEM, ";
CM_ SG_ 600 ALM1Diag8VltSts "Diagnostic signals from ALM to CEM, ";
CM_ SG_ 600 ALM1Diag9BluSts "Diagnostic signals from ALM to CEM, ";
CM_ SG_ 600 ALM1Diag9GreenSts "Diagnostic signals from ALM to CEM, ";
CM_ SG_ 600 ALM1Diag9RedSts "Diagnostic signals from ALM to CEM, ";
CM_ SG_ 600 ALM1Diag9TmpSts "Diagnostic signals from ALM to CEM, ";
CM_ SG_ 600 ALM1Diag9VltSts "Diagnostic signals from ALM to CEM, ";
CM_ SG_ 600 ALM2Diag10BluSts "Diagnostic signals from ALM to CEM, ";
CM_ SG_ 600 ALM2Diag10GreenSts "Diagnostic signals from ALM to CEM, ";
CM_ SG_ 600 ALM2Diag10RedSts "Diagnostic signals from ALM to CEM, ";
CM_ SG_ 600 ALM2Diag10TmpSts "Diagnostic signals from ALM to CEM, ";
CM_ SG_ 600 ALM2Diag10VltSts "Diagnostic signals from ALM to CEM, ";
CM_ SG_ 600 ALM2Diag11BluSts "Diagnostic signals from ALM to CEM, ";
CM_ SG_ 600 ALM2Diag11GreenSts "Diagnostic signals from ALM to CEM, ";
CM_ SG_ 600 ALM2Diag11RedSts "Diagnostic signals from ALM to CEM, ";
CM_ SG_ 600 ALM2Diag11TmpSts "Diagnostic signals from ALM to CEM, ";
CM_ SG_ 600 ALM2Diag11VltSts "Diagnostic signals from ALM to CEM, ";
CM_ SG_ 600 ALM2Diag12BluSts "Diagnostic signals from ALM to CEM, ";
CM_ SG_ 600 ALM2Diag12GreenSts "Diagnostic signals from ALM to CEM, ";
CM_ SG_ 600 ALM2Diag12RedSts "Diagnostic signals from ALM to CEM, ";
CM_ SG_ 600 ALM2Diag12TmpSts "Diagnostic signals from ALM to CEM, ";
CM_ SG_ 600 ALM2Diag12VltSts "Diagnostic signals from ALM to CEM, ";
CM_ SG_ 600 ALM2Diag13BluSts "Diagnostic signals from ALM to CEM, ";
CM_ SG_ 600 ALM2Diag13GreenSts "Diagnostic signals from ALM to CEM, ";
CM_ SG_ 600 ALM2Diag13RedSts "Diagnostic signals from ALM to CEM, ";
CM_ SG_ 600 ALM2Diag13TmpSts "Diagnostic signals from ALM to CEM, ";
CM_ SG_ 600 ALM2Diag13VltSts "Diagnostic signals from ALM to CEM, ";
CM_ SG_ 600 ALM2Diag14BluSts "Diagnostic signals from ALM to CEM, ";
CM_ SG_ 600 ALM2Diag14GreenSts "Diagnostic signals from ALM to CEM, ";
CM_ SG_ 600 ALM2Diag14RedSts "Diagnostic signals from ALM to CEM, ";
CM_ SG_ 600 ALM2Diag14TmpSts "Diagnostic signals from ALM to CEM, ";
CM_ SG_ 600 ALM2Diag14VltSts "Diagnostic signals from ALM to CEM, ";
CM_ SG_ 600 ALM2Diag15BluSts "Diagnostic signals from ALM to CEM, ";
CM_ SG_ 600 ALM2Diag15GreenSts "Diagnostic signals from ALM to CEM, ";
CM_ SG_ 600 ALM2Diag15RedSts "Diagnostic signals from ALM to CEM, ";
CM_ SG_ 600 ALM2Diag15TmpSts "Diagnostic signals from ALM to CEM, ";
CM_ SG_ 600 ALM2Diag15VltSts "Diagnostic signals from ALM to CEM, ";
CM_ SG_ 600 ALM2Diag16BluSts "Diagnostic signals from ALM to CEM, ";
CM_ SG_ 600 ALM2Diag16GreenSts "Diagnostic signals from ALM to CEM, ";
CM_ SG_ 600 ALM2Diag16RedSts "Diagnostic signals from ALM to CEM, ";
CM_ SG_ 600 ALM2Diag16TmpSts "Diagnostic signals from ALM to CEM, ";
CM_ SG_ 600 ALM2Diag16VltSts "Diagnostic signals from ALM to CEM, ";
CM_ SG_ 600 ALM2Diag1BluSts "Diagnostic signals from ALM to CEM, ";
CM_ SG_ 600 ALM2Diag1GreenSts "Diagnostic signals from ALM to CEM, ";
CM_ SG_ 600 ALM2Diag1RedSts "Diagnostic signals from ALM to CEM, ";
CM_ SG_ 600 ALM2Diag1TmpSts "Diagnostic signals from ALM to CEM, ";
CM_ SG_ 600 ALM2Diag1VltSts "Diagnostic signals from ALM to CEM, ";
CM_ SG_ 600 ALM2Diag2BluSts "Diagnostic signals from ALM to CEM, ";
CM_ SG_ 600 ALM2Diag2GreenSts "Diagnostic signals from ALM to CEM, ";
CM_ SG_ 600 ALM2Diag2RedSts "Diagnostic signals from ALM to CEM, ";
CM_ SG_ 600 ALM2Diag2TmpSts "Diagnostic signals from ALM to CEM, ";
CM_ SG_ 600 ALM2Diag2VltSts "Diagnostic signals from ALM to CEM, ";
CM_ SG_ 600 ALM2Diag3BluSts "Diagnostic signals from ALM to CEM, ";
CM_ SG_ 600 ALM2Diag3GreenSts "Diagnostic signals from ALM to CEM, ";
CM_ SG_ 600 ALM2Diag3RedSts "Diagnostic signals from ALM to CEM, ";
CM_ SG_ 600 ALM2Diag3TmpSts "Diagnostic signals from ALM to CEM, ";
CM_ SG_ 600 ALM2Diag3VltSts "Diagnostic signals from ALM to CEM, ";
CM_ SG_ 600 ALM2Diag4BluSts "Diagnostic signals from ALM to CEM, ";
CM_ SG_ 600 ALM2Diag4GreenSts "Diagnostic signals from ALM to CEM, ";
CM_ SG_ 600 ALM2Diag4RedSts "Diagnostic signals from ALM to CEM, ";
CM_ SG_ 600 ALM2Diag4TmpSts "Diagnostic signals from ALM to CEM, ";
CM_ SG_ 600 ALM2Diag4VltSts "Diagnostic signals from ALM to CEM, ";
CM_ SG_ 600 ALM2Diag5BluSts "Diagnostic signals from ALM to CEM, ";
CM_ SG_ 600 ALM2Diag5GreenSts "Diagnostic signals from ALM to CEM, ";
CM_ SG_ 600 ALM2Diag5RedSts "Diagnostic signals from ALM to CEM, ";
CM_ SG_ 600 ALM2Diag5TmpSts "Diagnostic signals from ALM to CEM, ";
CM_ SG_ 600 ALM2Diag5VltSts "Diagnostic signals from ALM to CEM, ";
CM_ SG_ 600 ALM2Diag6BluSts "Diagnostic signals from ALM to CEM, ";
CM_ SG_ 600 ALM2Diag6GreenSts "Diagnostic signals from ALM to CEM, ";
CM_ SG_ 600 ALM2Diag6RedSts "Diagnostic signals from ALM to CEM, ";
CM_ SG_ 600 ALM2Diag6TmpSts "Diagnostic signals from ALM to CEM, ";
CM_ SG_ 600 ALM2Diag6VltSts "Diagnostic signals from ALM to CEM, ";
CM_ SG_ 600 ALM2Diag7BluSts "Diagnostic signals from ALM to CEM, ";
CM_ SG_ 600 ALM2Diag7GreenSts "Diagnostic signals from ALM to CEM, ";
CM_ SG_ 600 ALM2Diag7RedSts "Diagnostic signals from ALM to CEM, ";
CM_ SG_ 600 ALM2Diag7TmpSts "Diagnostic signals from ALM to CEM, ";
CM_ SG_ 600 ALM2Diag7VltSts "Diagnostic signals from ALM to CEM, ";
CM_ SG_ 600 ALM2Diag8BluSts "Diagnostic signals from ALM to CEM, ";
CM_ SG_ 600 ALM2Diag8GreenSts "Diagnostic signals from ALM to CEM, ";
CM_ SG_ 600 ALM2Diag8RedSts "Diagnostic signals from ALM to CEM, ";
CM_ SG_ 600 ALM2Diag8TmpSts "Diagnostic signals from ALM to CEM, ";
CM_ SG_ 600 ALM2Diag8VltSts "Diagnostic signals from ALM to CEM, ";
CM_ SG_ 600 ALM2Diag9BluSts "Diagnostic signals from ALM to CEM, ";
CM_ SG_ 600 ALM2Diag9GreenSts "Diagnostic signals from ALM to CEM, ";
CM_ SG_ 600 ALM2Diag9RedSts "Diagnostic signals from ALM to CEM, ";
CM_ SG_ 600 ALM2Diag9TmpSts "Diagnostic signals from ALM to CEM, ";
CM_ SG_ 600 ALM2Diag9VltSts "Diagnostic signals from ALM to CEM, ";
CM_ SG_ 600 CcmElecAirDirCrtlReqDrvrLePosX "VGA position for HMI";
CM_ SG_ 600 CcmElecAirDirCrtlReqDrvrLePosY "VGA position for HMI";
CM_ SG_ 600 CcmElecAirDirCrtlReqDrvrRiPosX "VGA position for HMI";
CM_ SG_ 600 CcmElecAirDirCrtlReqDrvrRiPosY "VGA position for HMI";
CM_ SG_ 600 CcmElecAirDirCrtlReqPassLePosX "VGA position for HMI";
CM_ SG_ 600 CcmElecAirDirCrtlReqPassLePosY "VGA position for HMI";
CM_ SG_ 600 CcmElecAirDirCrtlReqPassRiPosX "VGA position for HMI";
CM_ SG_ 600 CcmElecAirDirCrtlReqPassRiPosY "VGA position for HMI";
CM_ SG_ 600 ClimaActv "Informs if a parking climatisation is active (either pre- or post conditioning).";
CM_ SG_ 600 ElecAirVentnAvlSts "Electrical air ventilation motor on, off, error status.";
CM_ SG_ 600 ElecDefrstReqMirrDefrstReq "Request to activate electric defrosters.  Mirror defroster request";
CM_ SG_ 600 ElecDefrstReqWinDefrstFrntReq "Request to activate electric defrosters.  Windscreen defroster request";
CM_ SG_ 600 ElecDefrstReqWinDefrstReReq "Request to activate electric defrosters.  Rear window defroster request";
CM_ SG_ 600 EvaprTReEvaprTFrnt "Actual air temperature after rear evaporator.";
CM_ SG_ 600 EvaprTReEvaprTQf "Actual air temperature quality flag after rear evaporator.";
CM_ SG_ 600 FogFlashPrevnActv "Fog Flash Prevn Actv";
CM_ SG_ 600 FragCh1UseUpWrn "To remind customer the fragrance channel 1 use up.";
CM_ SG_ 600 FragCh2UseUpWrn "To remind customer the fragrance channel 2 use up.";
CM_ SG_ 600 FragCh3UseUpWrn "To remind customer the fragrance channel 3 use up.";
CM_ SG_ 600 FragCh4UseUpWrn "To remind customer the fragrance channel 4 use up.";
CM_ SG_ 600 FragCh5UseUpWrn "To remind customer the fragrance channel 5 use up.";
CM_ SG_ 600 FragLvlFrmClima "Fragrance level status from climate.";
CM_ SG_ 600 FragStsFrmClima "Fragrance use up and error warn from climate to Hmi.";
CM_ SG_ 600 HeatrAirTReqFirstLe "Heater air temperature request for first row left";
CM_ SG_ 600 HeatrAirTReqFirstRi "Heater air temperature request for first row right";
CM_ SG_ 600 HeatrAirTReqSecLe "Heater air temperature request for second row left";
CM_ SG_ 600 HvacEvaprTSpRe "Set value for air temperature after evaporator in rear HVAC";
CM_ SG_ 600 HvacHexAirTFirstLeHvacAirTForHeatrFrnt "Hex temerature value for first row left";
CM_ SG_ 600 HvacHexAirTFirstLeHvacAirTForHeatrFrntQf "Hex temerature QF for first row left";
CM_ SG_ 600 HvacHexAirTFirstRiHvacAirTForHeatrFrnt "Hex temerature value for first row right";
CM_ SG_ 600 HvacHexAirTFirstRiHvacAirTForHeatrFrntQf "Hex temerature QF for first row right";
CM_ SG_ 600 HvacHexAirTSecLeHvacAirTForHeatrFrnt "Hex temerature value for second row left";
CM_ SG_ 600 HvacHexAirTSecLeHvacAirTForHeatrFrntQf "Hex temerature QF for second row left";
CM_ SG_ 600 IntPm25HiPopUp "Inside PM2.5 value high warning for IHU to Pop up.";
CM_ SG_ 600 PassSeatVentAvlSts "Seat ventilation on, off, error and limitation status for passenger seat.";
CM_ SG_ 600 PrkgClimaWarn "Informs if anything has gone wrong with the parking climatisation.";
CM_ SG_ 600 SeatClimaDurgClimaHmiSeatHeatgForRowFirstLe "Seat heating status for first row left seat";
CM_ SG_ 600 SeatClimaDurgClimaHmiSeatHeatgForRowFirstRi "Seat heating status for first row right seat.";
CM_ SG_ 600 SeatClimaDurgClimaHmiSeatHeatgForRowSecLe "Seat heating status for second row left status.";
CM_ SG_ 600 SeatClimaDurgClimaHmiSeatHeatgForRowSecRi "Seat heating status for second row right seat.";
CM_ SG_ 600 SeatClimaDurgClimaHmiSeatVentnForRowFirstLe "Seat ventialtion status for first row left seat";
CM_ SG_ 600 SeatClimaDurgClimaHmiSeatVentnForRowFirstRi "Seat ventilation status for first row right";
CM_ SG_ 600 SeatClimaDurgClimaHmiSeatVentnForRowSecLe "Seat ventilation status for second row left";
CM_ SG_ 600 SeatClimaDurgClimaHmiSeatVentnForRowSecRi "Seat ventilation status for second row right";
CM_ SG_ 803 CcmRollgCntrSts "Ccm round counter signal to indicate CCM busoff status.";
CM_ SG_ 803 ClimaCoolgReqLvl "Climatization cooling level request.";
CM_ SG_ 803 ClimaHeatgReqLvl "Climatization heating level request.";
CM_ SG_ 803 CmptModForHp "Compartment status for heat pump system. Value is 0x0 vent, 0x1 cool, 0x2 heat, 0x3 cool defog, 0x4 heat defog, 0x5 to 0x255 reserved.";
CM_ SG_ 803 CmptmtTReCmptmtTFrnt "Rear incar temperature.";
CM_ SG_ 803 CmptmtTReCmptmtTFrntQf "Rear incar temperature quality flag";
CM_ SG_ 803 CmptmtTReFanForCmptmtTRunng "Fan for component temperature requirement.";
CM_ SG_ 803 DvlpFrameForCCMByte0 "Reserved developing frame byte0 for CCM.";
CM_ SG_ 803 DvlpFrameForCCMByte1 "Reserved developing frame byte1 for CCM.";
CM_ SG_ 803 DvlpFrameForCCMByte2 "Reserved developing frame byte2 for CCM.";
CM_ SG_ 803 DvlpFrameForCCMByte3 "Reserved developing frame byte3 for CCM.";
CM_ SG_ 803 DvlpFrameForCCMByte4 "Reserved developing frame byte4 for CCM.";
CM_ SG_ 803 DvlpFrameForCCMByte5 "Reserved developing frame byte5 for CCM.";
CM_ SG_ 803 DvlpFrameForCCMByte6 "Reserved developing frame byte6 for CCM.";
CM_ SG_ 803 DvlpFrameForCCMByte7 "Reserved developing frame byte7 for CCM.";
CM_ SG_ 803 FrntHvacBlowerSts "Front blower status.";
CM_ SG_ 803 HeatrAirTReq "Heater air temperature request.";
CM_ SG_ 803 HpReqCritSts "Heat pump critical request status.";
CM_ SG_ 803 HvacAirMFlowEstimd "Estimated total mass air flow in front HVAC. ";
CM_ SG_ 803 HvacAirMFlowReEstimd "Estimated total mass air flow in rear HVAC.";
CM_ SG_ 803 HvacAirTForRowFirstAtFlrLeEvaprTFrnt "First row left floor air temperature.";
CM_ SG_ 803 HvacAirTForRowFirstAtFlrLeEvaprTQf "First row left floor air temperature quality flag.";
CM_ SG_ 803 HvacAirTForRowFirstAtFlrRiEvaprTFrnt "First row right floor air temperature.";
CM_ SG_ 803 HvacAirTForRowFirstAtFlrRiEvaprTQf "First row right floor air temperature quality flag";
CM_ SG_ 803 HvacAirTForRowFirstAtVentLeEvaprTFrnt "First row left ventilation air temperature.";
CM_ SG_ 803 HvacAirTForRowFirstAtVentLeEvaprTQf "First row left ventilation air temperature quality flag.";
CM_ SG_ 803 HvacAirTForRowFirstAtVentRiEvaprTFrnt "First row right ventilation air temperature.";
CM_ SG_ 803 HvacAirTForRowFirstAtVentRiEvaprTQf "First row right ventilation air temperature quality flag";
CM_ SG_ 803 HvacAirTForRowSecAtFlrLeEvaprTFrnt "Second row left floor air temperature.";
CM_ SG_ 803 HvacAirTForRowSecAtFlrLeEvaprTQf "Second row left floor air temperature quality flag.";
CM_ SG_ 803 HvacAirTForRowSecAtFlrRiEvaprTFrnt "Second row right floor air temperature.";
CM_ SG_ 803 HvacAirTForRowSecAtFlrRiEvaprTQf "Second row right floor air temperature quality flag.";
CM_ SG_ 803 HvacAirTForRowSecAtVentLeEvaprTFrnt "Second row left ventilation air temperature.";
CM_ SG_ 803 HvacAirTForRowSecAtVentLeEvaprTQf "Second row left ventilation air temperature quality flag.";
CM_ SG_ 803 HvacAirTForRowSecAtVentRiEvaprTFrnt "Second row right ventilation air temperature.";
CM_ SG_ 803 HvacAirTForRowSecAtVentRiEvaprTQf "Second row right ventilation air temperature quality flag.";
CM_ SG_ 803 HvacAirTForRowThrdAtFlrRiEvaprTFrnt "Third row right floor air temperature.";
CM_ SG_ 803 HvacAirTForRowThrdAtFlrRiEvaprTQf "Third row right floor air temperature quality flag";
CM_ SG_ 803 HvacAirTForRowThrdAtVentRiEvaprTFrnt "Third row right ventilation air temperature.";
CM_ SG_ 803 HvacAirTForRowThrdAtVentRiEvaprTQf "Third row right ventilation air temperature quality flag";
CM_ SG_ 803 HvacCondsorTEvaprTFrnt "heat pump inner condensor actual temperature.";
CM_ SG_ 803 HvacCondsorTEvaprTQf "heat pump inner condensor actual temperature quality flag.";
CM_ SG_ 803 HvacCondsorTspEvaprTFrnt "heat pump inner condensor target temperture.";
CM_ SG_ 803 HvacCondsorTspEvaprTQf "heat pump inner condensor target temperture signal quality.";
CM_ SG_ 803 HvacHeatrInletTempReqEvaprTFrnt "Front evaporator temperature.";
CM_ SG_ 803 HvacHeatrInletTempReqEvaprTQf "Front evaporator signal quality.";
CM_ SG_ 803 HvacOsaAndRecActrQfForHp "Recirculation ratio for HVAC from CCM to Heatpump.";
CM_ SG_ 803 HvacTempFlapActlPosnFrstRowLe "Left temperature actual flap position for first row.";
CM_ SG_ 803 HvacTempFlapActlPosnFrstRowRi "Right temperature actual flap position for first row.";
CM_ SG_ 803 HvacTempFlapActlPosnSecRowLe "Left temperature actual flap position for second row.";
CM_ SG_ 803 HvacTempFlapActlPosnSecRowRi "Right temperature actual flap position for second row.";
CM_ SG_ 803 HvahHeatgReq "HVAH heater heating enable.";
CM_ SG_ 803 HvahPwrReq "HVAH power consumption request.";
CM_ SG_ 803 MirrDefrstAtPassSts "Status signal exterior rear view mirror electrical defroster passenger side.";
CM_ SG_ 803 ReEvapVlvSts "Status of rear evaporator valve.";
CM_ SG_ 803 ReHvacBlowerSts "Rear HVAC blower status.";
CM_ SG_ 803 ReHvacHexAirTHvacAirTForHeatrFrnt "Rear HVAC heater exchange temerature value.";
CM_ SG_ 803 ReHvacHexAirTHvacAirTForHeatrFrntQf "Rear HVAC heater exchange temerature value quality flag";
CM_ SG_ 803 RemClimaActv "Remote climate start status.";
CM_ SG_ 803 ResrvdSigForECM1 "Reserved signal 1 for ECM.";
CM_ SG_ 803 ResrvdSigForECM2 "Reserved signal 2 for ECM.";
CM_ SG_ 803 ResrvdSigForECM3 "Reserved signal 3 for ECM.";
CM_ SG_ 803 ResrvdSigForECM4 "Reserved signal 4 for ECM.";
CM_ SG_ 803 TiOfDeactvnForClimaCtrl "Time since last deactivation of climate control. Freezes at activation of climate control.";
CM_ SG_ 803 UBoostReqByClima "Request of extra voltage to boost HVAC fan speed level";
BA_DEF_ BO_ "CANFD_BRS" ENUM "0","1";
BA_DEF_ BO_ "GenMsgCycleTime" INT 0 65536; // [ms]
BA_DEF_ BO_ "GenMsgDelayTime" INT 0 65536; // [ms]
BA_DEF_ BO_ "GenMsgSendType" ENUM "cyclic", "spontaneous", "not-used", "not-used", "not-used", "cyclicAndSpontaneous", "not-used", "cyclicIfActive", "NoMsgSendType"; // [us]
BA_DEF_ BO_ "GenMsgStartDelayTime" INT 0 65536; // [ms]
BA_DEF_ BO_ "VFrameFormat" ENUM "StandardCAN","ExtendedCAN","reserved","J1939PG","reserved","reserved","reserved","reserved","reserved","reserved","reserved","reserved","reserved","reserved","StandardCAN_FD","ExtendedCAN_FD";
BA_DEF_ SG_ "GenSigSendType" ENUM "Cyclic","OnWrite","OnWriteWithRepetition","OnChange","OnChangeWithRepetition","IfActive","IfActiveWithRepetition","NoSigSendType";
BA_DEF_ SG_ "GenSigStartValue" HEX 0 80000000;
BA_DEF_ BO_ "GenMsgILSupport" ENUM "No","Yes";
BA_DEF_ BO_ "NmAsrMessage" ENUM "No","Yes";
BA_DEF_ SG_ "GenSigFuncType" ENUM "NoFunction","n/a","n/a","n/a","n/a","n/a","n/a","n/a","n/a","n/a","n/a","n/a","n/a","n/a","n/a","CHK","CNTR","n/a","n/a","n/a","CNTR_AR_01","CRC_AR_01_BOTH","CRC_AR_01_ALT","CRC_AR_01_LOW","CRC_AR_01_NIBBLE","CNTR_AR_04","CRC_AR_04A","CNTR_AR_05","CRC_AR_05";
BA_DEF_ SG_ "GenSigDataID" STRING;
BA_DEF_DEF_ "CANFD_BRS" "1";
BA_DEF_DEF_ "GenSigStartValue" 0;
BA_DEF_DEF_ "VFrameFormat" "J1939PG";
BA_DEF_DEF_ "GenSigSendType" "NoSigSendType";
BA_DEF_DEF_ "GenMsgCycleTime" 0;
BA_DEF_DEF_ "GenMsgDelayTime" 0;
BA_DEF_DEF_ "GenMsgStartDelayTime" 0;
BA_DEF_DEF_ "GenMsgSendType" "NoMsgSendType";
BA_DEF_DEF_ "GenMsgILSupport" "Yes";
BA_DEF_DEF_ "NmAsrMessage" "No";
BA_DEF_DEF_ "GenSigFuncType" "NoFunction";
BA_DEF_DEF_ "GenSigDataID" "";
// Frame: ZCUDZCUCANFD2Fr51
BA_ "GenMsgCycleTime" BO_ 328 50.000;
BA_ "GenMsgSendType" BO_ 328 0;
BA_ "VFrameFormat" BO_ 328 14;
// Frame: ZCUDZCUCANFD2Fr52
BA_ "GenMsgCycleTime" BO_ 671 400.000;
BA_ "GenMsgSendType" BO_ 671 0;
BA_ "VFrameFormat" BO_ 671 14;
// Frame: ZCUDZCUCANFD2Fr53
BA_ "GenMsgCycleTime" BO_ 54 10.000;
BA_ "GenMsgSendType" BO_ 54 0;
BA_ "VFrameFormat" BO_ 54 14;
// Frame: ZCUDZCUCANFD2VFCVectorFr
BA_ "GenMsgCycleTime" BO_ 1348 500.000;
BA_ "GenMsgSendType" BO_ 1348 0;
BA_ "VFrameFormat" BO_ 1348 0;
// Frame: ZCUPZCUCANFD2DEVFr01
BA_ "GenMsgDelayTime" BO_ 1379 100.000;
BA_ "GenMsgSendType" BO_ 1379 1;
BA_ "VFrameFormat" BO_ 1379 14;
// Frame: ZcudZcudsToDhuZCUCANFD2DiagResFr
BA_ "GenMsgDelayTime" BO_ 1569 5.000;
BA_ "GenMsgSendType" BO_ 1569 1;
BA_ "VFrameFormat" BO_ 1569 14;
// Frame: ZcupToDhuZCUCANFD2DiagResFr
BA_ "GenMsgDelayTime" BO_ 1538 5.000;
BA_ "GenMsgSendType" BO_ 1538 1;
BA_ "VFrameFormat" BO_ 1538 14;
// Frame: ZcupZCUCANFD2Fr01
BA_ "GenMsgCycleTime" BO_ 441 100.000;
BA_ "GenMsgSendType" BO_ 441 0;
BA_ "VFrameFormat" BO_ 441 14;
// Frame: ZcupZCUCANFD2Fr02
BA_ "GenMsgCycleTime" BO_ 801 450.000;
BA_ "GenMsgSendType" BO_ 801 0;
BA_ "VFrameFormat" BO_ 801 14;
// Frame: ZcupZCUCANFD2Fr03
BA_ "GenMsgCycleTime" BO_ 520 200.000;
BA_ "GenMsgSendType" BO_ 520 0;
BA_ "VFrameFormat" BO_ 520 14;
// Frame: ZcupZCUCANFD2Fr04
BA_ "GenMsgCycleTime" BO_ 58 10.000;
BA_ "GenMsgSendType" BO_ 58 0;
BA_ "VFrameFormat" BO_ 58 14;
// Frame: ZcupZCUCANFD2Fr05
BA_ "GenMsgCycleTime" BO_ 310 50.000;
BA_ "GenMsgSendType" BO_ 310 0;
BA_ "VFrameFormat" BO_ 310 14;
// Frame: ZcupZCUCANFD2Fr06
BA_ "GenMsgCycleTime" BO_ 1184 1000.000;
BA_ "GenMsgSendType" BO_ 1184 0;
BA_ "VFrameFormat" BO_ 1184 14;
// Frame: ZcupZCUCANFD2Fr07
BA_ "GenMsgCycleTime" BO_ 600 250.000;
BA_ "GenMsgSendType" BO_ 600 0;
BA_ "VFrameFormat" BO_ 600 14;
// Frame: ZcupZCUCANFD2Fr08
BA_ "GenMsgCycleTime" BO_ 803 500.000;
BA_ "GenMsgSendType" BO_ 803 0;
BA_ "VFrameFormat" BO_ 803 14;
BA_ "GenSigSendType" SG_ 600 AFUGenErr 0;
BA_ "GenSigSendType" SG_ 671 ActvnOfDrvSideDoorIllmn 0;
BA_ "GenSigSendType" SG_ 671 ActvnOfDrvSideStepIllmn 0;
BA_ "GenSigSendType" SG_ 671 ActvnOfReDrvDoorIllmn 0;
BA_ "GenSigSendType" SG_ 671 ActvnOfReDrvSideStepIllmn 0;
BA_ "GenSigSendType" SG_ 600 AirFragFanErr 0;
BA_ "GenSigSendType" SG_ 600 AirFragMot1Err 0;
BA_ "GenSigSendType" SG_ 600 AirFragOvrVoltErr 0;
BA_ "GenSigSendType" SG_ 600 AirFragTempErr 0;
BA_ "GenSigSendType" SG_ 600 AirFragUndVoltErr 0;
BA_ "GenSigSendType" SG_ 328 AjarChrgLidFrntSwitch 0;
BA_ "GenSigSendType" SG_ 441 AjarChrgLidRearSwitch 0;
BA_ "GenSigSendType" SG_ 441 AjarFuelFlapSwitch 0;
BA_ "GenSigSendType" SG_ 801 AmbTEstimdAmbTEstimd 0;
BA_ "GenSigStartValue" SG_ 801 AmbTEstimdAmbTEstimd 700;
BA_ "GenSigSendType" SG_ 801 AmbTEstimdQf 0;
BA_ "GenSigSendType" SG_ 520 AmbTFildForClima 0;
BA_ "GenSigStartValue" SG_ 520 AmbTFildForClima 900;
BA_ "GenSigSendType" SG_ 671 AmbTForVisy 0;
BA_ "GenSigSendType" SG_ 520 AmbTRawAtPassSideAmbTVal 0;
BA_ "GenSigStartValue" SG_ 520 AmbTRawAtPassSideAmbTVal 700;
BA_ "GenSigSendType" SG_ 520 AmbTRawAtPassSideQly 0;
BA_ "GenSigSendType" SG_ 520 AmbTURawAtPassSide 0;
BA_ "GenSigStartValue" SG_ 520 AmbTURawAtPassSide 700;
BA_ "GenSigSendType" SG_ 310 AutDemstOperSts 0;
BA_ "GenSigSendType" SG_ 671 BltCrashNotifDrvr 0;
BA_ "GenSigSendType" SG_ 671 BltCrashNotifPass 0;
BA_ "GenSigSendType" SG_ 441 CarTiIntForClima 0;
BA_ "GenSigSendType" SG_ 600 CcmElecAirDirCrtlReqDrvrLePosX 0;
BA_ "GenSigSendType" SG_ 600 CcmElecAirDirCrtlReqDrvrLePosY 0;
BA_ "GenSigSendType" SG_ 600 CcmElecAirDirCrtlReqDrvrRiPosX 0;
BA_ "GenSigSendType" SG_ 600 CcmElecAirDirCrtlReqDrvrRiPosY 0;
BA_ "GenSigSendType" SG_ 600 CcmElecAirDirCrtlReqPassLePosX 0;
BA_ "GenSigSendType" SG_ 600 CcmElecAirDirCrtlReqPassLePosY 0;
BA_ "GenSigSendType" SG_ 600 CcmElecAirDirCrtlReqPassRiPosX 0;
BA_ "GenSigSendType" SG_ 600 CcmElecAirDirCrtlReqPassRiPosY 0;
BA_ "GenSigSendType" SG_ 803 CcmRollgCntrSts 0;
BA_ "GenSigSendType" SG_ 310 ChdLockPassReSts 0;
BA_ "GenSigSendType" SG_ 310 ChdLockRightSts 0;
BA_ "GenSigSendType" SG_ 310 CinhPassReSts 0;
BA_ "GenSigSendType" SG_ 310 CinhPassReSwt 0;
BA_ "GenSigSendType" SG_ 310 CinhPassSts 0;
BA_ "GenSigSendType" SG_ 310 CinhPassSwt 0;
BA_ "GenSigSendType" SG_ 600 ClimaActv 0;
BA_ "GenSigSendType" SG_ 520 ClimaAtRowSecActv 0;
BA_ "GenSigSendType" SG_ 441 ClimaCmptSts 0;
BA_ "GenSigSendType" SG_ 803 ClimaCoolgReqLvl 0;
BA_ "GenSigSendType" SG_ 441 ClimaCtrlActv 0;
BA_ "GenSigSendType" SG_ 441 ClimaDefrstSts 0;
BA_ "GenSigSendType" SG_ 441 ClimaEstimdTForHeat 0;
BA_ "GenSigSendType" SG_ 441 ClimaEstimdTForReHeat 0;
BA_ "GenSigSendType" SG_ 803 ClimaHeatgReqLvl 0;
BA_ "GenSigSendType" SG_ 801 ClimaOvrHeatPrtSts 0;
BA_ "GenSigSendType" SG_ 310 ClimaTiOfEnd 0;
BA_ "GenSigSendType" SG_ 803 CmptModForHp 0;
BA_ "GenSigStartValue" SG_ 803 CmptModForHp 5;
BA_ "GenSigSendType" SG_ 441 CmptmtAirTEstimdAtRowFirstLoResl 0;
BA_ "GenSigStartValue" SG_ 441 CmptmtAirTEstimdAtRowFirstLoResl 600;
BA_ "GenSigSendType" SG_ 801 CmptmtAirTEstimdExtdComptmtT 0;
BA_ "GenSigStartValue" SG_ 801 CmptmtAirTEstimdExtdComptmtT 600;
BA_ "GenSigSendType" SG_ 801 CmptmtAirTEstimdExtdQlyFlg 0;
BA_ "GenSigSendType" SG_ 1184 CmptmtIntrMtrlTEstimdMtrlSnsrT 0;
BA_ "GenSigSendType" SG_ 1184 CmptmtIntrMtrlTEstimdMtrlSnsrTQly2 0;
BA_ "GenSigStartValue" SG_ 1184 CmptmtIntrMtrlTEstimdMtrlSnsrTQly2 1;
BA_ "GenSigSendType" SG_ 310 CmptmtTFrntCmptmtTFrnt 0;
BA_ "GenSigStartValue" SG_ 310 CmptmtTFrntCmptmtTFrnt 600;
BA_ "GenSigSendType" SG_ 310 CmptmtTFrntFanForCmptmtTRunng 0;
BA_ "GenSigSendType" SG_ 310 CmptmtTFrntQf 0;
BA_ "GenSigStartValue" SG_ 310 CmptmtTFrntQf 1;
BA_ "GenSigSendType" SG_ 803 CmptmtTReCmptmtTFrnt 0;
BA_ "GenSigStartValue" SG_ 803 CmptmtTReCmptmtTFrnt 600;
BA_ "GenSigSendType" SG_ 803 CmptmtTReCmptmtTFrntQf 0;
BA_ "GenSigStartValue" SG_ 803 CmptmtTReCmptmtTFrntQf 1;
BA_ "GenSigSendType" SG_ 803 CmptmtTReFanForCmptmtTRunng 0;
BA_ "GenSigSendType" SG_ 441 CoupldCtrlErrAtRowFirstLe 0;
BA_ "GenSigSendType" SG_ 441 CoupldCtrlErrAtRowFirstRi 0;
BA_ "GenSigSendType" SG_ 441 CoupldCtrlErrAtRowSecLe 0;
BA_ "GenSigSendType" SG_ 441 CoupldCtrlErrAtRowSecRi 0;
BA_ "GenSigSendType" SG_ 328 CrabMovAvmReq 0;
BA_ "GenSigSendType" SG_ 328 CrabMovIndcnMsg 0;
BA_ "GenSigSendType" SG_ 328 CrabMovMonrReq 0;
BA_ "GenSigSendType" SG_ 328 CrabMovNotAvailable 0;
BA_ "GenSigSendType" SG_ 328 CrabMovStLiReqChks 0;
BA_ "GenSigSendType" SG_ 328 CrabMovStLiReqCntr 0;
BA_ "GenSigSendType" SG_ 328 CrabMovStLiReqStLiReq 0;
BA_ "GenSigSendType" SG_ 671 DampgRealFrntLe 0;
BA_ "GenSigSendType" SG_ 671 DampgRealFrntRi 0;
BA_ "GenSigSendType" SG_ 671 DampgRealReLe 0;
BA_ "GenSigSendType" SG_ 671 DampgRealReRi 0;
BA_ "GenSigSendType" SG_ 441 DoorPass2Swt1DplyHndl 0;
BA_ "GenSigStartValue" SG_ 441 DoorPass2Swt1DplyHndl 1;
BA_ "GenSigSendType" SG_ 441 DoorPass2Swt2DplyHndl 0;
BA_ "GenSigSendType" SG_ 441 DoorPassLatPosn 0;
BA_ "GenSigSendType" SG_ 58 DoorPassOpenLowReqOutdSwt1 0;
BA_ "GenSigStartValue" SG_ 58 DoorPassOpenLowReqOutdSwt1 2;
BA_ "GenSigSendType" SG_ 58 DoorPassOpenReqInsdSwt1 0;
BA_ "GenSigStartValue" SG_ 58 DoorPassOpenReqInsdSwt1 2;
BA_ "GenSigSendType" SG_ 441 DoorPassRe2Sw1DplyHndl 0;
BA_ "GenSigStartValue" SG_ 441 DoorPassRe2Sw1DplyHndl 1;
BA_ "GenSigSendType" SG_ 441 DoorPassRe2Sw2DplyHndl 0;
BA_ "GenSigSendType" SG_ 58 DoorPassReCinhIntFailInfCinchFlt1 0;
BA_ "GenSigSendType" SG_ 58 DoorPassReCinhIntFailInfCinchRestFlt 0;
BA_ "GenSigSendType" SG_ 310 DoorPassReHndlSts 0;
BA_ "GenSigSendType" SG_ 58 DoorPassReLatPosn 0;
BA_ "GenSigSendType" SG_ 58 DoorPassReOpenLowReqOutdSwt1 0;
BA_ "GenSigStartValue" SG_ 58 DoorPassReOpenLowReqOutdSwt1 2;
BA_ "GenSigSendType" SG_ 58 DoorPassReOpenReqInsdSwt1 0;
BA_ "GenSigStartValue" SG_ 58 DoorPassReOpenReqInsdSwt1 2;
BA_ "GenSigSendType" SG_ 58 DoorPassReRelsFailCinchOverTimed 0;
BA_ "GenSigSendType" SG_ 58 DoorPassReRelsFailFailure1 0;
BA_ "GenSigSendType" SG_ 58 DoorPassReRelsFailMechRels 0;
BA_ "GenSigSendType" SG_ 58 DoorRiReLatPosn 0;
BA_ "GenSigSendType" SG_ 58 DoorRiReOpenLowReqOutdSwt1 0;
BA_ "GenSigStartValue" SG_ 58 DoorRiReOpenLowReqOutdSwt1 2;
BA_ "GenSigSendType" SG_ 58 DoorRiReOpenReqInsdSwt1 0;
BA_ "GenSigStartValue" SG_ 58 DoorRiReOpenReqInsdSwt1 2;
BA_ "GenSigSendType" SG_ 441 DrvrSeatHeatgPwrAllwd 0;
BA_ "GenSigSendType" SG_ 54 DrvrSeatPhytheraSts 0;
BA_ "GenSigSendType" SG_ 441 DrvrSeatVentnPwrAllwd 0;
BA_ "GenSigSendType" SG_ 803 DvlpFrameForCCMByte0 0;
BA_ "GenSigSendType" SG_ 803 DvlpFrameForCCMByte1 0;
BA_ "GenSigSendType" SG_ 803 DvlpFrameForCCMByte2 0;
BA_ "GenSigSendType" SG_ 803 DvlpFrameForCCMByte3 0;
BA_ "GenSigSendType" SG_ 803 DvlpFrameForCCMByte4 0;
BA_ "GenSigSendType" SG_ 803 DvlpFrameForCCMByte5 0;
BA_ "GenSigSendType" SG_ 803 DvlpFrameForCCMByte6 0;
BA_ "GenSigSendType" SG_ 803 DvlpFrameForCCMByte7 0;
BA_ "GenSigSendType" SG_ 1184 EgyDesForClima 0;
BA_ "GenSigSendType" SG_ 600 ElecAirVentnAvlSts 0;
BA_ "GenSigSendType" SG_ 600 ElecDefrstReqMirrDefrstReq 0;
BA_ "GenSigSendType" SG_ 600 ElecDefrstReqWinDefrstFrntReq 0;
BA_ "GenSigSendType" SG_ 600 ElecDefrstReqWinDefrstReReq 0;
BA_ "GenSigSendType" SG_ 1184 ElecVentnMotPwrCnsAct 0;
BA_ "GenSigSendType" SG_ 1184 ElecVentnMotPwrCnsDes 0;
BA_ "GenSigSendType" SG_ 441 EngSpdIncIdleForClima 0;
BA_ "GenSigSendType" SG_ 310 EvaprTFrntEvaprTFrnt 0;
BA_ "GenSigSendType" SG_ 310 EvaprTFrntEvaprTQf 0;
BA_ "GenSigStartValue" SG_ 310 EvaprTFrntEvaprTQf 1;
BA_ "GenSigSendType" SG_ 600 EvaprTReEvaprTFrnt 0;
BA_ "GenSigSendType" SG_ 600 EvaprTReEvaprTQf 0;
BA_ "GenSigStartValue" SG_ 600 EvaprTReEvaprTQf 1;
BA_ "GenSigSendType" SG_ 310 FltOfBeamHiPass 0;
BA_ "GenSigSendType" SG_ 310 FltOfBeamLoPass 0;
BA_ "GenSigSendType" SG_ 310 FltOfDaytiRunngLampPass 0;
BA_ "GenSigSendType" SG_ 310 FltOfFrntFogLampPass 0;
BA_ "GenSigSendType" SG_ 310 FltOfFrntPosnLampPass 0;
BA_ "GenSigSendType" SG_ 310 FltOfReFogLampDrv 0;
BA_ "GenSigSendType" SG_ 310 FltOfRePosnLampPass 0;
BA_ "GenSigSendType" SG_ 441 FltOfReRegPlateLamp 0;
BA_ "GenSigSendType" SG_ 310 FltOfRvsgLampPass 0;
BA_ "GenSigSendType" SG_ 600 FogFlashPrevnActv 0;
BA_ "GenSigSendType" SG_ 441 FragCh1Id 0;
BA_ "GenSigSendType" SG_ 600 FragCh1UseUpWrn 0;
BA_ "GenSigSendType" SG_ 441 FragCh2Id 0;
BA_ "GenSigSendType" SG_ 600 FragCh2UseUpWrn 0;
BA_ "GenSigSendType" SG_ 441 FragCh3Id 0;
BA_ "GenSigSendType" SG_ 600 FragCh3UseUpWrn 0;
BA_ "GenSigSendType" SG_ 441 FragCh4Id 0;
BA_ "GenSigSendType" SG_ 600 FragCh4UseUpWrn 0;
BA_ "GenSigSendType" SG_ 441 FragCh5Id 0;
BA_ "GenSigSendType" SG_ 600 FragCh5UseUpWrn 0;
BA_ "GenSigSendType" SG_ 600 FragLvlFrmClima 0;
BA_ "GenSigSendType" SG_ 600 FragStsFrmClima 0;
BA_ "GenSigStartValue" SG_ 600 FragStsFrmClima 1;
BA_ "GenSigSendType" SG_ 803 FrntHvacBlowerSts 0;
BA_ "GenSigSendType" SG_ 671 FrntSteerFEstimd1 0;
BA_ "GenSigSendType" SG_ 803 HeatrAirTReq 0;
BA_ "GenSigStartValue" SG_ 803 HeatrAirTReq 120;
BA_ "GenSigSendType" SG_ 600 HeatrAirTReqFirstLe 0;
BA_ "GenSigSendType" SG_ 600 HeatrAirTReqFirstRi 0;
BA_ "GenSigSendType" SG_ 600 HeatrAirTReqSecLe 0;
BA_ "GenSigSendType" SG_ 803 HpReqCritSts 0;
BA_ "GenSigSendType" SG_ 441 HvEgyDesForClima 0;
BA_ "GenSigSendType" SG_ 803 HvacAirMFlowEstimd 0;
BA_ "GenSigSendType" SG_ 803 HvacAirMFlowReEstimd 0;
BA_ "GenSigSendType" SG_ 803 HvacAirTForRowFirstAtFlrLeEvaprTFrnt 0;
BA_ "GenSigSendType" SG_ 803 HvacAirTForRowFirstAtFlrLeEvaprTQf 0;
BA_ "GenSigStartValue" SG_ 803 HvacAirTForRowFirstAtFlrLeEvaprTQf 1;
BA_ "GenSigSendType" SG_ 803 HvacAirTForRowFirstAtFlrRiEvaprTFrnt 0;
BA_ "GenSigSendType" SG_ 803 HvacAirTForRowFirstAtFlrRiEvaprTQf 0;
BA_ "GenSigStartValue" SG_ 803 HvacAirTForRowFirstAtFlrRiEvaprTQf 1;
BA_ "GenSigSendType" SG_ 803 HvacAirTForRowFirstAtVentLeEvaprTFrnt 0;
BA_ "GenSigSendType" SG_ 803 HvacAirTForRowFirstAtVentLeEvaprTQf 0;
BA_ "GenSigStartValue" SG_ 803 HvacAirTForRowFirstAtVentLeEvaprTQf 1;
BA_ "GenSigSendType" SG_ 803 HvacAirTForRowFirstAtVentRiEvaprTFrnt 0;
BA_ "GenSigSendType" SG_ 803 HvacAirTForRowFirstAtVentRiEvaprTQf 0;
BA_ "GenSigStartValue" SG_ 803 HvacAirTForRowFirstAtVentRiEvaprTQf 1;
BA_ "GenSigSendType" SG_ 803 HvacAirTForRowSecAtFlrLeEvaprTFrnt 0;
BA_ "GenSigSendType" SG_ 803 HvacAirTForRowSecAtFlrLeEvaprTQf 0;
BA_ "GenSigStartValue" SG_ 803 HvacAirTForRowSecAtFlrLeEvaprTQf 1;
BA_ "GenSigSendType" SG_ 803 HvacAirTForRowSecAtFlrRiEvaprTFrnt 0;
BA_ "GenSigSendType" SG_ 803 HvacAirTForRowSecAtFlrRiEvaprTQf 0;
BA_ "GenSigStartValue" SG_ 803 HvacAirTForRowSecAtFlrRiEvaprTQf 1;
BA_ "GenSigSendType" SG_ 803 HvacAirTForRowSecAtVentLeEvaprTFrnt 0;
BA_ "GenSigSendType" SG_ 803 HvacAirTForRowSecAtVentLeEvaprTQf 0;
BA_ "GenSigStartValue" SG_ 803 HvacAirTForRowSecAtVentLeEvaprTQf 1;
BA_ "GenSigSendType" SG_ 803 HvacAirTForRowSecAtVentRiEvaprTFrnt 0;
BA_ "GenSigSendType" SG_ 803 HvacAirTForRowSecAtVentRiEvaprTQf 0;
BA_ "GenSigStartValue" SG_ 803 HvacAirTForRowSecAtVentRiEvaprTQf 1;
BA_ "GenSigSendType" SG_ 803 HvacAirTForRowThrdAtFlrRiEvaprTFrnt 0;
BA_ "GenSigSendType" SG_ 803 HvacAirTForRowThrdAtFlrRiEvaprTQf 0;
BA_ "GenSigStartValue" SG_ 803 HvacAirTForRowThrdAtFlrRiEvaprTQf 1;
BA_ "GenSigSendType" SG_ 803 HvacAirTForRowThrdAtVentRiEvaprTFrnt 0;
BA_ "GenSigSendType" SG_ 803 HvacAirTForRowThrdAtVentRiEvaprTQf 0;
BA_ "GenSigStartValue" SG_ 803 HvacAirTForRowThrdAtVentRiEvaprTQf 1;
BA_ "GenSigSendType" SG_ 803 HvacCondsorTEvaprTFrnt 0;
BA_ "GenSigSendType" SG_ 803 HvacCondsorTEvaprTQf 0;
BA_ "GenSigStartValue" SG_ 803 HvacCondsorTEvaprTQf 1;
BA_ "GenSigSendType" SG_ 803 HvacCondsorTspEvaprTFrnt 0;
BA_ "GenSigSendType" SG_ 803 HvacCondsorTspEvaprTQf 0;
BA_ "GenSigStartValue" SG_ 803 HvacCondsorTspEvaprTQf 1;
BA_ "GenSigSendType" SG_ 310 HvacCoolgEnaRe 0;
BA_ "GenSigSendType" SG_ 1184 HvacDefrstFlapActlPosn 0;
BA_ "GenSigSendType" SG_ 520 HvacEvaprTSpFrnt 0;
BA_ "GenSigStartValue" SG_ 520 HvacEvaprTSpFrnt 50;
BA_ "GenSigSendType" SG_ 600 HvacEvaprTSpRe 0;
BA_ "GenSigStartValue" SG_ 600 HvacEvaprTSpRe 50;
BA_ "GenSigSendType" SG_ 1184 HvacFanSet2HvacFanSpd2 0;
BA_ "GenSigSendType" SG_ 1184 HvacHeatElmAirMFlowEstimd 0;
BA_ "GenSigSendType" SG_ 803 HvacHeatrInletTempReqEvaprTFrnt 0;
BA_ "GenSigSendType" SG_ 803 HvacHeatrInletTempReqEvaprTQf 0;
BA_ "GenSigSendType" SG_ 600 HvacHexAirTFirstLeHvacAirTForHeatrFrnt 0;
BA_ "GenSigSendType" SG_ 600 HvacHexAirTFirstLeHvacAirTForHeatrFrntQf 0;
BA_ "GenSigStartValue" SG_ 600 HvacHexAirTFirstLeHvacAirTForHeatrFrntQf 1;
BA_ "GenSigSendType" SG_ 600 HvacHexAirTFirstRiHvacAirTForHeatrFrnt 0;
BA_ "GenSigSendType" SG_ 600 HvacHexAirTFirstRiHvacAirTForHeatrFrntQf 0;
BA_ "GenSigStartValue" SG_ 600 HvacHexAirTFirstRiHvacAirTForHeatrFrntQf 1;
BA_ "GenSigSendType" SG_ 600 HvacHexAirTSecLeHvacAirTForHeatrFrnt 0;
BA_ "GenSigSendType" SG_ 600 HvacHexAirTSecLeHvacAirTForHeatrFrntQf 0;
BA_ "GenSigStartValue" SG_ 600 HvacHexAirTSecLeHvacAirTForHeatrFrntQf 1;
BA_ "GenSigSendType" SG_ 1184 HvacModFlapActlPosnFrstRowLe 0;
BA_ "GenSigSendType" SG_ 1184 HvacModFlapActlPosnFrstRowRi 0;
BA_ "GenSigSendType" SG_ 1184 HvacModFlapActlPosnSecRowLe 0;
BA_ "GenSigSendType" SG_ 1184 HvacModFlapActlPosnSecRowRi 0;
BA_ "GenSigSendType" SG_ 803 HvacOsaAndRecActrQfForHp 0;
BA_ "GenSigSendType" SG_ 1184 HvacOsaFlapActlPosn 0;
BA_ "GenSigSendType" SG_ 1184 HvacRecFlapActlPosn 0;
BA_ "GenSigSendType" SG_ 803 HvacTempFlapActlPosnFrstRowLe 0;
BA_ "GenSigSendType" SG_ 803 HvacTempFlapActlPosnFrstRowRi 0;
BA_ "GenSigSendType" SG_ 803 HvacTempFlapActlPosnSecRowLe 0;
BA_ "GenSigSendType" SG_ 803 HvacTempFlapActlPosnSecRowRi 0;
BA_ "GenSigSendType" SG_ 310 HvahAirTEstmdEvaprTFrnt 0;
BA_ "GenSigSendType" SG_ 310 HvahAirTEstmdEvaprTQf 0;
BA_ "GenSigStartValue" SG_ 310 HvahAirTEstmdEvaprTQf 1;
BA_ "GenSigSendType" SG_ 803 HvahHeatgReq 0;
BA_ "GenSigSendType" SG_ 803 HvahPwrReq 0;
BA_ "GenSigSendType" SG_ 441 IceBreakDoorPassActv 0;
BA_ "GenSigSendType" SG_ 58 IceBreakDoorPassReActv 0;
BA_ "GenSigSendType" SG_ 310 IceBreakDoorRiReActv 0;
BA_ "GenSigSendType" SG_ 600 IntPm25HiPopUp 0;
BA_ "GenSigSendType" SG_ 310 IntPm25StsFrmClima 0;
BA_ "GenSigSendType" SG_ 328 LowSpdStrIndcnMsg 0;
BA_ "GenSigSendType" SG_ 328 LowSpdStrNotAvailable 0;
BA_ "GenSigSendType" SG_ 328 LowSpdStrNotAvailableForSecMod 0;
BA_ "GenSigSendType" SG_ 328 LowSpdStrStLiReqChks 0;
BA_ "GenSigSendType" SG_ 328 LowSpdStrStLiReqCntr 0;
BA_ "GenSigSendType" SG_ 328 LowSpdStrStLiReqForSecMod 0;
BA_ "GenSigSendType" SG_ 328 LowSpdStrStLiReqStLiReq 0;
BA_ "GenSigSendType" SG_ 328 LvlgFctAvl 0;
BA_ "GenSigStartValue" SG_ 328 LvlgFctAvl 1;
BA_ "GenSigSendType" SG_ 328 LvlgFctSts 0;
BA_ "GenSigStartValue" SG_ 328 LvlgFctSts 3;
BA_ "GenSigSendType" SG_ 328 MeCnsAvgIndcdMeCnsIndcdVal1 0;
BA_ "GenSigSendType" SG_ 328 MeCnsAvgIndcdMeCnsIndcdVal2 0;
BA_ "GenSigSendType" SG_ 58 MirrAdjVceStsAtPass 0;
BA_ "GenSigSendType" SG_ 441 MirrAtPassForVce 0;
BA_ "GenSigSendType" SG_ 441 MirrAtPassInMovmt 0;
BA_ "GenSigSendType" SG_ 803 MirrDefrstAtPassSts 0;
BA_ "GenSigSendType" SG_ 310 MirrDwnStsAtPass 0;
BA_ "GenSigSendType" SG_ 310 MirrPosnToSetTarPosnAtPassMirrAdjLeRi 0;
BA_ "GenSigStartValue" SG_ 310 MirrPosnToSetTarPosnAtPassMirrAdjLeRi 5000;
BA_ "GenSigSendType" SG_ 310 MirrPosnToSetTarPosnAtPassMirrAdjUpDown 0;
BA_ "GenSigStartValue" SG_ 310 MirrPosnToSetTarPosnAtPassMirrAdjUpDown 5000;
BA_ "GenSigSendType" SG_ 328 NFCKeyReadStsToHMI2Key0 0;
BA_ "GenSigSendType" SG_ 328 NFCKeyReadStsToHMI2Key1 0;
BA_ "GenSigSendType" SG_ 328 NFCKeyReadStsToHMI2Key10 0;
BA_ "GenSigSendType" SG_ 328 NFCKeyReadStsToHMI2Key11 0;
BA_ "GenSigSendType" SG_ 328 NFCKeyReadStsToHMI2Key12 0;
BA_ "GenSigSendType" SG_ 328 NFCKeyReadStsToHMI2Key13 0;
BA_ "GenSigSendType" SG_ 328 NFCKeyReadStsToHMI2Key14 0;
BA_ "GenSigSendType" SG_ 328 NFCKeyReadStsToHMI2Key15 0;
BA_ "GenSigSendType" SG_ 328 NFCKeyReadStsToHMI2Key16 0;
BA_ "GenSigSendType" SG_ 328 NFCKeyReadStsToHMI2Key17 0;
BA_ "GenSigSendType" SG_ 328 NFCKeyReadStsToHMI2Key18 0;
BA_ "GenSigSendType" SG_ 328 NFCKeyReadStsToHMI2Key19 0;
BA_ "GenSigSendType" SG_ 328 NFCKeyReadStsToHMI2Key2 0;
BA_ "GenSigSendType" SG_ 328 NFCKeyReadStsToHMI2Key20 0;
BA_ "GenSigSendType" SG_ 328 NFCKeyReadStsToHMI2Key21 0;
BA_ "GenSigSendType" SG_ 328 NFCKeyReadStsToHMI2Key22 0;
BA_ "GenSigSendType" SG_ 328 NFCKeyReadStsToHMI2Key23 0;
BA_ "GenSigSendType" SG_ 328 NFCKeyReadStsToHMI2Key24 0;
BA_ "GenSigSendType" SG_ 328 NFCKeyReadStsToHMI2Key25 0;
BA_ "GenSigSendType" SG_ 328 NFCKeyReadStsToHMI2Key26 0;
BA_ "GenSigSendType" SG_ 328 NFCKeyReadStsToHMI2Key27 0;
BA_ "GenSigSendType" SG_ 328 NFCKeyReadStsToHMI2Key28 0;
BA_ "GenSigSendType" SG_ 328 NFCKeyReadStsToHMI2Key29 0;
BA_ "GenSigSendType" SG_ 328 NFCKeyReadStsToHMI2Key3 0;
BA_ "GenSigSendType" SG_ 328 NFCKeyReadStsToHMI2Key30 0;
BA_ "GenSigSendType" SG_ 328 NFCKeyReadStsToHMI2Key31 0;
BA_ "GenSigSendType" SG_ 328 NFCKeyReadStsToHMI2Key32 0;
BA_ "GenSigSendType" SG_ 328 NFCKeyReadStsToHMI2Key33 0;
BA_ "GenSigSendType" SG_ 328 NFCKeyReadStsToHMI2Key34 0;
BA_ "GenSigSendType" SG_ 328 NFCKeyReadStsToHMI2Key35 0;
BA_ "GenSigSendType" SG_ 328 NFCKeyReadStsToHMI2Key4 0;
BA_ "GenSigSendType" SG_ 328 NFCKeyReadStsToHMI2Key5 0;
BA_ "GenSigSendType" SG_ 328 NFCKeyReadStsToHMI2Key6 0;
BA_ "GenSigSendType" SG_ 328 NFCKeyReadStsToHMI2Key7 0;
BA_ "GenSigSendType" SG_ 328 NFCKeyReadStsToHMI2Key8 0;
BA_ "GenSigSendType" SG_ 328 NFCKeyReadStsToHMI2Key9 0;
BA_ "GenSigSendType" SG_ 310 OpenPassReSwt 0;
BA_ "GenSigSendType" SG_ 310 OpenPassSwt 0;
BA_ "GenSigSendType" SG_ 1184 OutdAirQlyOutdAirQly 0;
BA_ "GenSigSendType" SG_ 1184 OutdAirQlyQf 0;
BA_ "GenSigSendType" SG_ 1184 OutdPm25StsFrmClima 0;
BA_ "GenSigSendType" SG_ 520 PassSeatActvSwtFctMod 0;
BA_ "GenSigSendType" SG_ 441 PassSeatAdjmtLimForFldWarn 0;
BA_ "GenSigSendType" SG_ 441 PassSeatAdjmtLimnWarn 0;
BA_ "GenSigSendType" SG_ 310 PassSeatBtnPsd 0;
BA_ "GenSigSendType" SG_ 441 PassSeatCushDownPosPercSeatPosPerc 0;
BA_ "GenSigSendType" SG_ 441 PassSeatCushDownPosPercSeatPosQf 0;
BA_ "GenSigSendType" SG_ 441 PassSeatFoldFailFb 0;
BA_ "GenSigSendType" SG_ 310 PassSeatFoldSts 0;
BA_ "GenSigSendType" SG_ 54 PassSeatFoldSwt 0;
BA_ "GenSigStartValue" SG_ 310 PassSeatFootRstPosPerc 127;
BA_ "GenSigSendType" SG_ 1184 PassSeatHeatgActlPwrCns 0;
BA_ "GenSigSendType" SG_ 1184 PassSeatHeatgDesPwrCns 0;
BA_ "GenSigSendType" SG_ 1184 PassSeatHeatgPwrAllwd 0;
BA_ "GenSigStartValue" SG_ 1184 PassSeatHeatgPwrAllwd 100;
BA_ "GenSigSendType" SG_ 310 PassSeatInAutMovmt 0;
BA_ "GenSigSendType" SG_ 520 PassSeatIntgrSwtStsIntgrSwtHozlSts 0;
BA_ "GenSigSendType" SG_ 520 PassSeatIntgrSwtStsIntgrSwtRotSts 0;
BA_ "GenSigSendType" SG_ 520 PassSeatIntgrSwtStsIntgrSwtSelnSts 0;
BA_ "GenSigSendType" SG_ 520 PassSeatIntgrSwtStsIntgrSwtVertSts 0;
BA_ "GenSigSendType" SG_ 310 PassSeatPosFrntExtPercSeatPosPerc 0;
BA_ "GenSigStartValue" SG_ 310 PassSeatPosFrntExtPercSeatPosPerc 1000;
BA_ "GenSigSendType" SG_ 310 PassSeatPosFrntExtPercSeatPosQf 0;
BA_ "GenSigStartValue" SG_ 310 PassSeatPosFrntExtPercSeatPosQf 1;
BA_ "GenSigSendType" SG_ 441 PassSeatPosPercSeatPosFrntHeiPerc 0;
BA_ "GenSigStartValue" SG_ 441 PassSeatPosPercSeatPosFrntHeiPerc 1000;
BA_ "GenSigSendType" SG_ 441 PassSeatPosPercSeatPosFrntHeiQF 0;
BA_ "GenSigStartValue" SG_ 441 PassSeatPosPercSeatPosFrntHeiQF 1;
BA_ "GenSigSendType" SG_ 441 PassSeatPosPercSeatPosHeiPerc 0;
BA_ "GenSigStartValue" SG_ 441 PassSeatPosPercSeatPosHeiPerc 1000;
BA_ "GenSigSendType" SG_ 441 PassSeatPosPercSeatPosHeiQF 0;
BA_ "GenSigStartValue" SG_ 441 PassSeatPosPercSeatPosHeiQF 1;
BA_ "GenSigSendType" SG_ 441 PassSeatPosPercSeatPosSldPerc 0;
BA_ "GenSigStartValue" SG_ 441 PassSeatPosPercSeatPosSldPerc 1000;
BA_ "GenSigSendType" SG_ 441 PassSeatPosPercSeatPosSldQF 0;
BA_ "GenSigStartValue" SG_ 441 PassSeatPosPercSeatPosSldQF 1;
BA_ "GenSigSendType" SG_ 54 PassSeatUnfoldSwt 0;
BA_ "GenSigSendType" SG_ 600 PassSeatVentAvlSts 0;
BA_ "GenSigSendType" SG_ 1184 PassSeatVentnActlPwrCns 0;
BA_ "GenSigSendType" SG_ 1184 PassSeatVentnDesPwrCns 0;
BA_ "GenSigSendType" SG_ 1184 PassSeatVentnPwrAllwd 0;
BA_ "GenSigSendType" SG_ 310 PawlPassReSwt 0;
BA_ "GenSigSendType" SG_ 310 PawlPassSwt 0;
BA_ "GenSigSendType" SG_ 310 PrkgClimaHVReq 0;
BA_ "GenSigSendType" SG_ 600 PrkgClimaWarn 0;
BA_ "GenSigSendType" SG_ 1184 PwrAllwdForElecAirVentn 0;
BA_ "GenSigSendType" SG_ 803 ReEvapVlvSts 0;
BA_ "GenSigSendType" SG_ 803 ReHvacBlowerSts 0;
BA_ "GenSigSendType" SG_ 803 ReHvacHexAirTHvacAirTForHeatrFrnt 0;
BA_ "GenSigSendType" SG_ 803 ReHvacHexAirTHvacAirTForHeatrFrntQf 0;
BA_ "GenSigStartValue" SG_ 803 ReHvacHexAirTHvacAirTForHeatrFrntQf 1;
BA_ "GenSigSendType" SG_ 310 RemActvStsRemClimaActvSts 0;
BA_ "GenSigSendType" SG_ 310 RemActvStsRemDefrstSts 0;
BA_ "GenSigSendType" SG_ 803 RemClimaActv 0;
BA_ "GenSigSendType" SG_ 310 RemClimaElecDefrstReqMirrDefrstReq 0;
BA_ "GenSigSendType" SG_ 310 RemClimaElecDefrstReqWinDefrstFrntReq 0;
BA_ "GenSigSendType" SG_ 310 RemClimaElecDefrstReqWinDefrstReReq 0;
BA_ "GenSigSendType" SG_ 803 ResrvdSigForECM1 0;
BA_ "GenSigSendType" SG_ 803 ResrvdSigForECM2 0;
BA_ "GenSigSendType" SG_ 803 ResrvdSigForECM3 0;
BA_ "GenSigSendType" SG_ 803 ResrvdSigForECM4 0;
BA_ "GenSigSendType" SG_ 520 RlyCmftForClimaReq 0;
BA_ "GenSigSendType" SG_ 520 RlyCrashForClimaReq 0;
BA_ "GenSigSendType" SG_ 441 SeatBackAngleRowFirstPass 0;
BA_ "GenSigSendType" SG_ 600 SeatClimaDurgClimaHmiSeatHeatgForRowFirstLe 0;
BA_ "GenSigSendType" SG_ 600 SeatClimaDurgClimaHmiSeatHeatgForRowFirstRi 0;
BA_ "GenSigSendType" SG_ 600 SeatClimaDurgClimaHmiSeatHeatgForRowSecLe 0;
BA_ "GenSigSendType" SG_ 600 SeatClimaDurgClimaHmiSeatHeatgForRowSecRi 0;
BA_ "GenSigSendType" SG_ 600 SeatClimaDurgClimaHmiSeatVentnForRowFirstLe 0;
BA_ "GenSigSendType" SG_ 600 SeatClimaDurgClimaHmiSeatVentnForRowFirstRi 0;
BA_ "GenSigSendType" SG_ 600 SeatClimaDurgClimaHmiSeatVentnForRowSecLe 0;
BA_ "GenSigSendType" SG_ 600 SeatClimaDurgClimaHmiSeatVentnForRowSecRi 0;
BA_ "GenSigSendType" SG_ 310 SeatMassgBackBlstrCtrlPass 0;
BA_ "GenSigSendType" SG_ 310 SeatMassgBackBlstrEnaPass 0;
BA_ "GenSigSendType" SG_ 310 SeatMassgCushBlstrCtrlPass 0;
BA_ "GenSigSendType" SG_ 310 SeatMassgCushBlstrEnaPass 0;
BA_ "GenSigSendType" SG_ 310 SeatMassgCushLiftCtrlPass 0;
BA_ "GenSigSendType" SG_ 310 SeatMassgCushLiftEnaPass 0;
BA_ "GenSigSendType" SG_ 310 SeatMassgFctPassMassgInten 0;
BA_ "GenSigSendType" SG_ 310 SeatMassgFctPassMassgProg 0;
BA_ "GenSigSendType" SG_ 310 SeatMassgFctPassOnOff 0;
BA_ "GenSigSendType" SG_ 310 SeatMassgLumExtnCtrlPass 0;
BA_ "GenSigSendType" SG_ 310 SeatMassgLumHeiCtrlPass 0;
BA_ "GenSigSendType" SG_ 310 SeatMassgLumMotrEnaPass 0;
BA_ "GenSigSendType" SG_ 441 SeatOccptAtRowSecPasSide2 0;
BA_ "GenSigStartValue" SG_ 441 SeatOccptAtRowSecPasSide2 1;
BA_ "GenSigSendType" SG_ 441 SeatOccptAtRowSecPasSideSnsSts2 0;
BA_ "GenSigSendType" SG_ 310 SecRowLeSeatHeatgPwrAllwd 0;
BA_ "GenSigStartValue" SG_ 310 SecRowLeSeatHeatgPwrAllwd 100;
BA_ "GenSigSendType" SG_ 310 SecRowLeSeatVentnPwrAllwd 0;
BA_ "GenSigSendType" SG_ 310 SecRowRiSeatHeatgPwrAllwd 0;
BA_ "GenSigSendType" SG_ 310 SecRowRiSeatVentnPwrAllwd 0;
BA_ "GenSigSendType" SG_ 310 ShortDropWinPassReSts 0;
BA_ "GenSigSendType" SG_ 310 ShortDropWinPassSts 0;
BA_ "GenSigSendType" SG_ 310 ShortDropWinReRiSts 0;
BA_ "GenSigSendType" SG_ 328 SteerActReForTvc 0;
BA_ "GenSigSendType" SG_ 441 SteerWhlHeatgDurgClima 0;
BA_ "GenSigSendType" SG_ 441 SteerWhlHeatgPwrAllwd 0;
BA_ "GenSigStartValue" SG_ 54 StreamingMirrBri 10;
BA_ "GenSigStartValue" SG_ 54 StreamingMirrEnable 1;
BA_ "GenSigStartValue" SG_ 54 StreamingMirrPosn 3;
BA_ "GenSigSendType" SG_ 1184 SunDataAzi 0;
BA_ "GenSigSendType" SG_ 1184 SunDataElevn 0;
BA_ "GenSigStartValue" SG_ 1184 SunDataElevn 900;
BA_ "GenSigDataID" SG_ 671 SuspStabyCritFailrDetdChks "0x41E";
BA_ "GenSigFuncType" SG_ 671 SuspStabyCritFailrDetdChks 15;
BA_ "GenSigSendType" SG_ 671 SuspStabyCritFailrDetdChks 0;
BA_ "GenSigFuncType" SG_ 671 SuspStabyCritFailrDetdCntr 16;
BA_ "GenSigSendType" SG_ 671 SuspStabyCritFailrDetdCntr 0;
BA_ "GenSigSendType" SG_ 671 SuspStabyCritFailrDetdSts 0;
BA_ "GenSigSendType" SG_ 328 TankTurnActIndcnMsg 0;
BA_ "GenSigSendType" SG_ 328 TankTurnActYawRateForHMI 0;
BA_ "GenSigSendType" SG_ 328 TankTurnNotAvailable 0;
BA_ "GenSigSendType" SG_ 1184 TgtHvacAirTForRowFirstLe 0;
BA_ "GenSigStartValue" SG_ 1184 TgtHvacAirTForRowFirstLe 250;
BA_ "GenSigSendType" SG_ 1184 TgtHvacAirTForRowFirstRi 0;
BA_ "GenSigStartValue" SG_ 1184 TgtHvacAirTForRowFirstRi 250;
BA_ "GenSigSendType" SG_ 1184 TgtHvacAirTForRowSecLe 0;
BA_ "GenSigStartValue" SG_ 1184 TgtHvacAirTForRowSecLe 250;
BA_ "GenSigSendType" SG_ 1184 TgtHvacAirTForRowSecRi 0;
BA_ "GenSigStartValue" SG_ 1184 TgtHvacAirTForRowSecRi 250;
BA_ "GenSigSendType" SG_ 310 ThrdRowLeSeatHeatgPwrAllwd 0;
BA_ "GenSigSendType" SG_ 310 ThrdRowLeSeatVentnPwrAllwd 0;
BA_ "GenSigSendType" SG_ 310 ThrdRowRiSeatHeatgPwrAllwd 0;
BA_ "GenSigSendType" SG_ 310 ThrdRowRiSeatVentnPwrAllwd 0;
BA_ "GenSigSendType" SG_ 803 TiOfDeactvnForClimaCtrl 0;
BA_ "GenSigSendType" SG_ 803 UBoostReqByClima 0;
BA_ "GenSigSendType" SG_ 1348 VFCVectorZCUDMBlockID 0;
BA_ "GenSigSendType" SG_ 1348 VFCVectorZCUDMVFCid0 0;
BA_ "GenSigSendType" SG_ 1348 VFCVectorZCUDMVFCid1 0;
BA_ "GenSigSendType" SG_ 1348 VFCVectorZCUDMVFCid10 0;
BA_ "GenSigSendType" SG_ 1348 VFCVectorZCUDMVFCid11 0;
BA_ "GenSigSendType" SG_ 1348 VFCVectorZCUDMVFCid12 0;
BA_ "GenSigSendType" SG_ 1348 VFCVectorZCUDMVFCid13 0;
BA_ "GenSigSendType" SG_ 1348 VFCVectorZCUDMVFCid14 0;
BA_ "GenSigSendType" SG_ 1348 VFCVectorZCUDMVFCid15 0;
BA_ "GenSigSendType" SG_ 1348 VFCVectorZCUDMVFCid16 0;
BA_ "GenSigSendType" SG_ 1348 VFCVectorZCUDMVFCid17 0;
BA_ "GenSigSendType" SG_ 1348 VFCVectorZCUDMVFCid18 0;
BA_ "GenSigSendType" SG_ 1348 VFCVectorZCUDMVFCid19 0;
BA_ "GenSigSendType" SG_ 1348 VFCVectorZCUDMVFCid2 0;
BA_ "GenSigSendType" SG_ 1348 VFCVectorZCUDMVFCid20 0;
BA_ "GenSigSendType" SG_ 1348 VFCVectorZCUDMVFCid21 0;
BA_ "GenSigSendType" SG_ 1348 VFCVectorZCUDMVFCid22 0;
BA_ "GenSigSendType" SG_ 1348 VFCVectorZCUDMVFCid23 0;
BA_ "GenSigSendType" SG_ 1348 VFCVectorZCUDMVFCid24 0;
BA_ "GenSigSendType" SG_ 1348 VFCVectorZCUDMVFCid25 0;
BA_ "GenSigSendType" SG_ 1348 VFCVectorZCUDMVFCid26 0;
BA_ "GenSigSendType" SG_ 1348 VFCVectorZCUDMVFCid27 0;
BA_ "GenSigSendType" SG_ 1348 VFCVectorZCUDMVFCid28 0;
BA_ "GenSigSendType" SG_ 1348 VFCVectorZCUDMVFCid29 0;
BA_ "GenSigSendType" SG_ 1348 VFCVectorZCUDMVFCid3 0;
BA_ "GenSigSendType" SG_ 1348 VFCVectorZCUDMVFCid30 0;
BA_ "GenSigSendType" SG_ 1348 VFCVectorZCUDMVFCid31 0;
BA_ "GenSigSendType" SG_ 1348 VFCVectorZCUDMVFCid32 0;
BA_ "GenSigSendType" SG_ 1348 VFCVectorZCUDMVFCid33 0;
BA_ "GenSigSendType" SG_ 1348 VFCVectorZCUDMVFCid34 0;
BA_ "GenSigSendType" SG_ 1348 VFCVectorZCUDMVFCid35 0;
BA_ "GenSigSendType" SG_ 1348 VFCVectorZCUDMVFCid36 0;
BA_ "GenSigSendType" SG_ 1348 VFCVectorZCUDMVFCid37 0;
BA_ "GenSigSendType" SG_ 1348 VFCVectorZCUDMVFCid38 0;
BA_ "GenSigSendType" SG_ 1348 VFCVectorZCUDMVFCid39 0;
BA_ "GenSigSendType" SG_ 1348 VFCVectorZCUDMVFCid4 0;
BA_ "GenSigSendType" SG_ 1348 VFCVectorZCUDMVFCid40 0;
BA_ "GenSigSendType" SG_ 1348 VFCVectorZCUDMVFCid41 0;
BA_ "GenSigSendType" SG_ 1348 VFCVectorZCUDMVFCid42 0;
BA_ "GenSigSendType" SG_ 1348 VFCVectorZCUDMVFCid43 0;
BA_ "GenSigSendType" SG_ 1348 VFCVectorZCUDMVFCid44 0;
BA_ "GenSigSendType" SG_ 1348 VFCVectorZCUDMVFCid45 0;
BA_ "GenSigSendType" SG_ 1348 VFCVectorZCUDMVFCid46 0;
BA_ "GenSigSendType" SG_ 1348 VFCVectorZCUDMVFCid47 0;
BA_ "GenSigSendType" SG_ 1348 VFCVectorZCUDMVFCid48 0;
BA_ "GenSigSendType" SG_ 1348 VFCVectorZCUDMVFCid49 0;
BA_ "GenSigSendType" SG_ 1348 VFCVectorZCUDMVFCid5 0;
BA_ "GenSigSendType" SG_ 1348 VFCVectorZCUDMVFCid50 0;
BA_ "GenSigSendType" SG_ 1348 VFCVectorZCUDMVFCid51 0;
BA_ "GenSigSendType" SG_ 1348 VFCVectorZCUDMVFCid52 0;
BA_ "GenSigSendType" SG_ 1348 VFCVectorZCUDMVFCid53 0;
BA_ "GenSigSendType" SG_ 1348 VFCVectorZCUDMVFCid54 0;
BA_ "GenSigSendType" SG_ 1348 VFCVectorZCUDMVFCid55 0;
BA_ "GenSigSendType" SG_ 1348 VFCVectorZCUDMVFCid56 0;
BA_ "GenSigSendType" SG_ 1348 VFCVectorZCUDMVFCid57 0;
BA_ "GenSigSendType" SG_ 1348 VFCVectorZCUDMVFCid58 0;
BA_ "GenSigSendType" SG_ 1348 VFCVectorZCUDMVFCid59 0;
BA_ "GenSigSendType" SG_ 1348 VFCVectorZCUDMVFCid6 0;
BA_ "GenSigSendType" SG_ 1348 VFCVectorZCUDMVFCid60 0;
BA_ "GenSigSendType" SG_ 1348 VFCVectorZCUDMVFCid61 0;
BA_ "GenSigSendType" SG_ 1348 VFCVectorZCUDMVFCid7 0;
BA_ "GenSigSendType" SG_ 1348 VFCVectorZCUDMVFCid8 0;
BA_ "GenSigSendType" SG_ 1348 VFCVectorZCUDMVFCid9 0;
BA_ "GenSigSendType" SG_ 310 WinDsblPassReSts 0;
BA_ "GenSigSendType" SG_ 310 WinDsblRightSts 0;
BA_ "GenSigSendType" SG_ 310 WinFailrStsAtPassRe 0;
BA_ "GenSigSendType" SG_ 310 WinPosnStsAtPassRe 0;
BA_ "GenSigSendType" SG_ 1379 ZCUPdevelpsignalgroupRespFunctiondevpsignalgroup1 1;
BA_ "GenSigSendType" SG_ 1379 ZCUPdevelpsignalgroupRespFunctiondevpsignalgroup2 1;
BA_ "GenSigSendType" SG_ 1379 ZCUPdevelpsignalgroupRespFunctiondevpsignalgroup3 1;
BA_ "GenSigSendType" SG_ 1379 ZCUPdevelpsignalgroupRespFunctiondevpsignalgroup4 1;
BA_ "GenSigSendType" SG_ 1379 ZCUPdevelpsignalgroupRespFunctiondevpsignalgroup5 1;
BA_ "GenSigSendType" SG_ 1379 ZCUPdevelpsignalgroupRespFunctiondevpsignalgroup6 1;
BA_ "GenSigSendType" SG_ 1379 ZCUPdevelpsignalgroupRespFunctiondevpsignalgroup7 1;
BA_ "GenSigSendType" SG_ 1379 ZCUPdevelpsignalgroupRespFunctiondevpsignalgroup8 1;
VAL_ 328 AjarChrgLidFrntSwitch 0 "DoorSts2_Ukwn" 1 "DoorSts2_Opend" 2 "DoorSts2_Clsd";
VAL_ 328 CrabMovAvmReq 0 "ReqSts1_NotReqd" 1 "ReqSts1_Reqd";
VAL_ 328 CrabMovMonrReq 0 "ReqSts1_NotReqd" 1 "ReqSts1_Reqd";
VAL_ 328 CrabMovNotAvailable 0 "CrabMovNotAvailable_Available" 1 "CrabMovNotAvailable_NotAvailable";
VAL_ 328 CrabMovStLiReqStLiReq 0 "TankTurnStLiReq_Off" 1 "TankTurnStLiReq_White" 2 "TankTurnStLiReq_Green" 3 "TankTurnStLiReq_Reserved";
VAL_ 328 LowSpdStrNotAvailable 0 "CrabMovNotAvailable_Available" 1 "CrabMovNotAvailable_NotAvailable";
VAL_ 328 LowSpdStrNotAvailableForSecMod 0 "Availe2_Availiable" 1 "Availe2_NotAvailiable";
VAL_ 328 LowSpdStrStLiReqForSecMod 0 "TankTurnStLiReqForSecMod_Off" 1 "TankTurnStLiReqForSecMod_1stLvlWhite" 2 "TankTurnStLiReqForSecMod_1stLvlGreen" 3 "TankTurnStLiReqForSecMod_2ndLvlWhite" 4 "TankTurnStLiReqForSecMod_2ndLvlGreen";
VAL_ 328 LowSpdStrStLiReqStLiReq 0 "TankTurnStLiReq_Off" 1 "TankTurnStLiReq_White" 2 "TankTurnStLiReq_Green" 3 "TankTurnStLiReq_Reserved";
VAL_ 328 LvlgFctAvl 0 "Available1_NotAvailable" 1 "Available1_Available";
VAL_ 328 LvlgFctSts 0 "LvlgFctSts_Default" 1 "LvlgFctSts_FunctionOn" 2 "LvlgFctSts_FunctionStandby" 3 "LvlgFctSts_Functionoff";
VAL_ 328 NFCKeyReadStsToHMI2Key0 0 "KeyPrsntSts1_KeyPrsntStsIdle" 1 "KeyPrsntSts1_KeyPrsntStsInProgs" 2 "KeyPrsntSts1_KeyPrsntStsNotPrsnt" 3 "KeyPrsntSts1_KeyPrsntStsPrsnt";
VAL_ 328 NFCKeyReadStsToHMI2Key1 0 "KeyPrsntSts1_KeyPrsntStsIdle" 1 "KeyPrsntSts1_KeyPrsntStsInProgs" 2 "KeyPrsntSts1_KeyPrsntStsNotPrsnt" 3 "KeyPrsntSts1_KeyPrsntStsPrsnt";
VAL_ 328 NFCKeyReadStsToHMI2Key10 0 "KeyPrsntSts1_KeyPrsntStsIdle" 1 "KeyPrsntSts1_KeyPrsntStsInProgs" 2 "KeyPrsntSts1_KeyPrsntStsNotPrsnt" 3 "KeyPrsntSts1_KeyPrsntStsPrsnt";
VAL_ 328 NFCKeyReadStsToHMI2Key11 0 "KeyPrsntSts1_KeyPrsntStsIdle" 1 "KeyPrsntSts1_KeyPrsntStsInProgs" 2 "KeyPrsntSts1_KeyPrsntStsNotPrsnt" 3 "KeyPrsntSts1_KeyPrsntStsPrsnt";
VAL_ 328 NFCKeyReadStsToHMI2Key12 0 "KeyPrsntSts1_KeyPrsntStsIdle" 1 "KeyPrsntSts1_KeyPrsntStsInProgs" 2 "KeyPrsntSts1_KeyPrsntStsNotPrsnt" 3 "KeyPrsntSts1_KeyPrsntStsPrsnt";
VAL_ 328 NFCKeyReadStsToHMI2Key13 0 "KeyPrsntSts1_KeyPrsntStsIdle" 1 "KeyPrsntSts1_KeyPrsntStsInProgs" 2 "KeyPrsntSts1_KeyPrsntStsNotPrsnt" 3 "KeyPrsntSts1_KeyPrsntStsPrsnt";
VAL_ 328 NFCKeyReadStsToHMI2Key14 0 "KeyPrsntSts1_KeyPrsntStsIdle" 1 "KeyPrsntSts1_KeyPrsntStsInProgs" 2 "KeyPrsntSts1_KeyPrsntStsNotPrsnt" 3 "KeyPrsntSts1_KeyPrsntStsPrsnt";
VAL_ 328 NFCKeyReadStsToHMI2Key15 0 "KeyPrsntSts1_KeyPrsntStsIdle" 1 "KeyPrsntSts1_KeyPrsntStsInProgs" 2 "KeyPrsntSts1_KeyPrsntStsNotPrsnt" 3 "KeyPrsntSts1_KeyPrsntStsPrsnt";
VAL_ 328 NFCKeyReadStsToHMI2Key16 0 "KeyPrsntSts1_KeyPrsntStsIdle" 1 "KeyPrsntSts1_KeyPrsntStsInProgs" 2 "KeyPrsntSts1_KeyPrsntStsNotPrsnt" 3 "KeyPrsntSts1_KeyPrsntStsPrsnt";
VAL_ 328 NFCKeyReadStsToHMI2Key17 0 "KeyPrsntSts1_KeyPrsntStsIdle" 1 "KeyPrsntSts1_KeyPrsntStsInProgs" 2 "KeyPrsntSts1_KeyPrsntStsNotPrsnt" 3 "KeyPrsntSts1_KeyPrsntStsPrsnt";
VAL_ 328 NFCKeyReadStsToHMI2Key18 0 "KeyPrsntSts1_KeyPrsntStsIdle" 1 "KeyPrsntSts1_KeyPrsntStsInProgs" 2 "KeyPrsntSts1_KeyPrsntStsNotPrsnt" 3 "KeyPrsntSts1_KeyPrsntStsPrsnt";
VAL_ 328 NFCKeyReadStsToHMI2Key19 0 "KeyPrsntSts1_KeyPrsntStsIdle" 1 "KeyPrsntSts1_KeyPrsntStsInProgs" 2 "KeyPrsntSts1_KeyPrsntStsNotPrsnt" 3 "KeyPrsntSts1_KeyPrsntStsPrsnt";
VAL_ 328 NFCKeyReadStsToHMI2Key2 0 "KeyPrsntSts1_KeyPrsntStsIdle" 1 "KeyPrsntSts1_KeyPrsntStsInProgs" 2 "KeyPrsntSts1_KeyPrsntStsNotPrsnt" 3 "KeyPrsntSts1_KeyPrsntStsPrsnt";
VAL_ 328 NFCKeyReadStsToHMI2Key20 0 "KeyPrsntSts1_KeyPrsntStsIdle" 1 "KeyPrsntSts1_KeyPrsntStsInProgs" 2 "KeyPrsntSts1_KeyPrsntStsNotPrsnt" 3 "KeyPrsntSts1_KeyPrsntStsPrsnt";
VAL_ 328 NFCKeyReadStsToHMI2Key21 0 "KeyPrsntSts1_KeyPrsntStsIdle" 1 "KeyPrsntSts1_KeyPrsntStsInProgs" 2 "KeyPrsntSts1_KeyPrsntStsNotPrsnt" 3 "KeyPrsntSts1_KeyPrsntStsPrsnt";
VAL_ 328 NFCKeyReadStsToHMI2Key22 0 "KeyPrsntSts1_KeyPrsntStsIdle" 1 "KeyPrsntSts1_KeyPrsntStsInProgs" 2 "KeyPrsntSts1_KeyPrsntStsNotPrsnt" 3 "KeyPrsntSts1_KeyPrsntStsPrsnt";
VAL_ 328 NFCKeyReadStsToHMI2Key23 0 "KeyPrsntSts1_KeyPrsntStsIdle" 1 "KeyPrsntSts1_KeyPrsntStsInProgs" 2 "KeyPrsntSts1_KeyPrsntStsNotPrsnt" 3 "KeyPrsntSts1_KeyPrsntStsPrsnt";
VAL_ 328 NFCKeyReadStsToHMI2Key24 0 "KeyPrsntSts1_KeyPrsntStsIdle" 1 "KeyPrsntSts1_KeyPrsntStsInProgs" 2 "KeyPrsntSts1_KeyPrsntStsNotPrsnt" 3 "KeyPrsntSts1_KeyPrsntStsPrsnt";
VAL_ 328 NFCKeyReadStsToHMI2Key25 0 "KeyPrsntSts1_KeyPrsntStsIdle" 1 "KeyPrsntSts1_KeyPrsntStsInProgs" 2 "KeyPrsntSts1_KeyPrsntStsNotPrsnt" 3 "KeyPrsntSts1_KeyPrsntStsPrsnt";
VAL_ 328 NFCKeyReadStsToHMI2Key26 0 "KeyPrsntSts1_KeyPrsntStsIdle" 1 "KeyPrsntSts1_KeyPrsntStsInProgs" 2 "KeyPrsntSts1_KeyPrsntStsNotPrsnt" 3 "KeyPrsntSts1_KeyPrsntStsPrsnt";
VAL_ 328 NFCKeyReadStsToHMI2Key27 0 "KeyPrsntSts1_KeyPrsntStsIdle" 1 "KeyPrsntSts1_KeyPrsntStsInProgs" 2 "KeyPrsntSts1_KeyPrsntStsNotPrsnt" 3 "KeyPrsntSts1_KeyPrsntStsPrsnt";
VAL_ 328 NFCKeyReadStsToHMI2Key28 0 "KeyPrsntSts1_KeyPrsntStsIdle" 1 "KeyPrsntSts1_KeyPrsntStsInProgs" 2 "KeyPrsntSts1_KeyPrsntStsNotPrsnt" 3 "KeyPrsntSts1_KeyPrsntStsPrsnt";
VAL_ 328 NFCKeyReadStsToHMI2Key29 0 "KeyPrsntSts1_KeyPrsntStsIdle" 1 "KeyPrsntSts1_KeyPrsntStsInProgs" 2 "KeyPrsntSts1_KeyPrsntStsNotPrsnt" 3 "KeyPrsntSts1_KeyPrsntStsPrsnt";
VAL_ 328 NFCKeyReadStsToHMI2Key3 0 "KeyPrsntSts1_KeyPrsntStsIdle" 1 "KeyPrsntSts1_KeyPrsntStsInProgs" 2 "KeyPrsntSts1_KeyPrsntStsNotPrsnt" 3 "KeyPrsntSts1_KeyPrsntStsPrsnt";
VAL_ 328 NFCKeyReadStsToHMI2Key30 0 "KeyPrsntSts1_KeyPrsntStsIdle" 1 "KeyPrsntSts1_KeyPrsntStsInProgs" 2 "KeyPrsntSts1_KeyPrsntStsNotPrsnt" 3 "KeyPrsntSts1_KeyPrsntStsPrsnt";
VAL_ 328 NFCKeyReadStsToHMI2Key31 0 "KeyPrsntSts1_KeyPrsntStsIdle" 1 "KeyPrsntSts1_KeyPrsntStsInProgs" 2 "KeyPrsntSts1_KeyPrsntStsNotPrsnt" 3 "KeyPrsntSts1_KeyPrsntStsPrsnt";
VAL_ 328 NFCKeyReadStsToHMI2Key32 0 "KeyPrsntSts1_KeyPrsntStsIdle" 1 "KeyPrsntSts1_KeyPrsntStsInProgs" 2 "KeyPrsntSts1_KeyPrsntStsNotPrsnt" 3 "KeyPrsntSts1_KeyPrsntStsPrsnt";
VAL_ 328 NFCKeyReadStsToHMI2Key33 0 "KeyPrsntSts1_KeyPrsntStsIdle" 1 "KeyPrsntSts1_KeyPrsntStsInProgs" 2 "KeyPrsntSts1_KeyPrsntStsNotPrsnt" 3 "KeyPrsntSts1_KeyPrsntStsPrsnt";
VAL_ 328 NFCKeyReadStsToHMI2Key34 0 "KeyPrsntSts1_KeyPrsntStsIdle" 1 "KeyPrsntSts1_KeyPrsntStsInProgs" 2 "KeyPrsntSts1_KeyPrsntStsNotPrsnt" 3 "KeyPrsntSts1_KeyPrsntStsPrsnt";
VAL_ 328 NFCKeyReadStsToHMI2Key35 0 "KeyPrsntSts1_KeyPrsntStsIdle" 1 "KeyPrsntSts1_KeyPrsntStsInProgs" 2 "KeyPrsntSts1_KeyPrsntStsNotPrsnt" 3 "KeyPrsntSts1_KeyPrsntStsPrsnt";
VAL_ 328 NFCKeyReadStsToHMI2Key4 0 "KeyPrsntSts1_KeyPrsntStsIdle" 1 "KeyPrsntSts1_KeyPrsntStsInProgs" 2 "KeyPrsntSts1_KeyPrsntStsNotPrsnt" 3 "KeyPrsntSts1_KeyPrsntStsPrsnt";
VAL_ 328 NFCKeyReadStsToHMI2Key5 0 "KeyPrsntSts1_KeyPrsntStsIdle" 1 "KeyPrsntSts1_KeyPrsntStsInProgs" 2 "KeyPrsntSts1_KeyPrsntStsNotPrsnt" 3 "KeyPrsntSts1_KeyPrsntStsPrsnt";
VAL_ 328 NFCKeyReadStsToHMI2Key6 0 "KeyPrsntSts1_KeyPrsntStsIdle" 1 "KeyPrsntSts1_KeyPrsntStsInProgs" 2 "KeyPrsntSts1_KeyPrsntStsNotPrsnt" 3 "KeyPrsntSts1_KeyPrsntStsPrsnt";
VAL_ 328 NFCKeyReadStsToHMI2Key7 0 "KeyPrsntSts1_KeyPrsntStsIdle" 1 "KeyPrsntSts1_KeyPrsntStsInProgs" 2 "KeyPrsntSts1_KeyPrsntStsNotPrsnt" 3 "KeyPrsntSts1_KeyPrsntStsPrsnt";
VAL_ 328 NFCKeyReadStsToHMI2Key8 0 "KeyPrsntSts1_KeyPrsntStsIdle" 1 "KeyPrsntSts1_KeyPrsntStsInProgs" 2 "KeyPrsntSts1_KeyPrsntStsNotPrsnt" 3 "KeyPrsntSts1_KeyPrsntStsPrsnt";
VAL_ 328 NFCKeyReadStsToHMI2Key9 0 "KeyPrsntSts1_KeyPrsntStsIdle" 1 "KeyPrsntSts1_KeyPrsntStsInProgs" 2 "KeyPrsntSts1_KeyPrsntStsNotPrsnt" 3 "KeyPrsntSts1_KeyPrsntStsPrsnt";
VAL_ 328 SeatMassgRunngPass2 0 "Boolean_FALSE" 1 "Boolean_TRUE";
VAL_ 328 TankTurnNotAvailable 0 "CrabMovNotAvailable_Available" 1 "CrabMovNotAvailable_NotAvailable";
VAL_ 671 BltCrashNotifDrvr 0 "NoYesCrit1_NotVld1" 1 "NoYesCrit1_No" 2 "NoYesCrit1_Yes" 3 "NoYesCrit1_NotVld2";
VAL_ 671 BltCrashNotifPass 0 "NoYesCrit1_NotVld1" 1 "NoYesCrit1_No" 2 "NoYesCrit1_Yes" 3 "NoYesCrit1_NotVld2";
VAL_ 671 SuspStabyCritFailrDetdSts 0 "NoYes1_No" 1 "NoYes1_Yes";
VAL_ 54 DrvrSeatPhytheraSts 0 "OffOnErrInvalid_Off" 1 "OffOnErrInvalid_On" 2 "OffOnErrInvalid_Err" 3 "OffOnErrInvalid_Invalid";
VAL_ 54 IntrlMirrDispSysSts 0 "IntrlMirrDispSysSts_Off" 1 "IntrlMirrDispSysSts_Standby" 2 "IntrlMirrDispSysSts_Active" 3 "IntrlMirrDispSysSts_Failure" 4 "IntrlMirrDispSysSts_CheckSelf" 5 "IntrlMirrDispSysSts_Reserved";
VAL_ 54 LeReWinBtnDwn 0 "PsdNotPsd_NotPsd" 1 "PsdNotPsd_Psd";
VAL_ 54 LeReWinBtnRise 0 "PsdNotPsd_NotPsd" 1 "PsdNotPsd_Psd";
VAL_ 54 LeThirdElecticDuctVent 0 "PsdNotPsd_NotPsd" 1 "PsdNotPsd_Psd";
VAL_ 54 LeThirdElecticDuctVentMode 0 "PsdNotPsd_NotPsd" 1 "PsdNotPsd_Psd";
VAL_ 54 PassSeatFoldSwt 0 "PsdNotPsd_NotPsd" 1 "PsdNotPsd_Psd";
VAL_ 54 PassSeatUnfoldSwt 0 "PsdNotPsd_NotPsd" 1 "PsdNotPsd_Psd";
VAL_ 54 RiReWinBtnDwn 0 "PsdNotPsd_NotPsd" 1 "PsdNotPsd_Psd";
VAL_ 54 RiReWinBtnRise 0 "PsdNotPsd_NotPsd" 1 "PsdNotPsd_Psd";
VAL_ 54 RiThirdElecticDuctVent 0 "PsdNotPsd_NotPsd" 1 "PsdNotPsd_Psd";
VAL_ 54 RiThirdElecticDuctVentMode 0 "PsdNotPsd_NotPsd" 1 "PsdNotPsd_Psd";
VAL_ 54 StreamingMirrEnable 0 "OnOff1_Off" 1 "OnOff1_On";
VAL_ 1348 VFCVectorZCUDMVFCid0 0 "VFCOnOff_Off" 1 "VFCOnOff_On";
VAL_ 1348 VFCVectorZCUDMVFCid1 0 "VFCOnOff_Off" 1 "VFCOnOff_On";
VAL_ 1348 VFCVectorZCUDMVFCid10 0 "VFCOnOff_Off" 1 "VFCOnOff_On";
VAL_ 1348 VFCVectorZCUDMVFCid11 0 "VFCOnOff_Off" 1 "VFCOnOff_On";
VAL_ 1348 VFCVectorZCUDMVFCid12 0 "VFCOnOff_Off" 1 "VFCOnOff_On";
VAL_ 1348 VFCVectorZCUDMVFCid13 0 "VFCOnOff_Off" 1 "VFCOnOff_On";
VAL_ 1348 VFCVectorZCUDMVFCid14 0 "VFCOnOff_Off" 1 "VFCOnOff_On";
VAL_ 1348 VFCVectorZCUDMVFCid15 0 "VFCOnOff_Off" 1 "VFCOnOff_On";
VAL_ 1348 VFCVectorZCUDMVFCid16 0 "VFCOnOff_Off" 1 "VFCOnOff_On";
VAL_ 1348 VFCVectorZCUDMVFCid17 0 "VFCOnOff_Off" 1 "VFCOnOff_On";
VAL_ 1348 VFCVectorZCUDMVFCid18 0 "VFCOnOff_Off" 1 "VFCOnOff_On";
VAL_ 1348 VFCVectorZCUDMVFCid19 0 "VFCOnOff_Off" 1 "VFCOnOff_On";
VAL_ 1348 VFCVectorZCUDMVFCid2 0 "VFCOnOff_Off" 1 "VFCOnOff_On";
VAL_ 1348 VFCVectorZCUDMVFCid20 0 "VFCOnOff_Off" 1 "VFCOnOff_On";
VAL_ 1348 VFCVectorZCUDMVFCid21 0 "VFCOnOff_Off" 1 "VFCOnOff_On";
VAL_ 1348 VFCVectorZCUDMVFCid22 0 "VFCOnOff_Off" 1 "VFCOnOff_On";
VAL_ 1348 VFCVectorZCUDMVFCid23 0 "VFCOnOff_Off" 1 "VFCOnOff_On";
VAL_ 1348 VFCVectorZCUDMVFCid24 0 "VFCOnOff_Off" 1 "VFCOnOff_On";
VAL_ 1348 VFCVectorZCUDMVFCid25 0 "VFCOnOff_Off" 1 "VFCOnOff_On";
VAL_ 1348 VFCVectorZCUDMVFCid26 0 "VFCOnOff_Off" 1 "VFCOnOff_On";
VAL_ 1348 VFCVectorZCUDMVFCid27 0 "VFCOnOff_Off" 1 "VFCOnOff_On";
VAL_ 1348 VFCVectorZCUDMVFCid28 0 "VFCOnOff_Off" 1 "VFCOnOff_On";
VAL_ 1348 VFCVectorZCUDMVFCid29 0 "VFCOnOff_Off" 1 "VFCOnOff_On";
VAL_ 1348 VFCVectorZCUDMVFCid3 0 "VFCOnOff_Off" 1 "VFCOnOff_On";
VAL_ 1348 VFCVectorZCUDMVFCid30 0 "VFCOnOff_Off" 1 "VFCOnOff_On";
VAL_ 1348 VFCVectorZCUDMVFCid31 0 "VFCOnOff_Off" 1 "VFCOnOff_On";
VAL_ 1348 VFCVectorZCUDMVFCid32 0 "VFCOnOff_Off" 1 "VFCOnOff_On";
VAL_ 1348 VFCVectorZCUDMVFCid33 0 "VFCOnOff_Off" 1 "VFCOnOff_On";
VAL_ 1348 VFCVectorZCUDMVFCid34 0 "VFCOnOff_Off" 1 "VFCOnOff_On";
VAL_ 1348 VFCVectorZCUDMVFCid35 0 "VFCOnOff_Off" 1 "VFCOnOff_On";
VAL_ 1348 VFCVectorZCUDMVFCid36 0 "VFCOnOff_Off" 1 "VFCOnOff_On";
VAL_ 1348 VFCVectorZCUDMVFCid37 0 "VFCOnOff_Off" 1 "VFCOnOff_On";
VAL_ 1348 VFCVectorZCUDMVFCid38 0 "VFCOnOff_Off" 1 "VFCOnOff_On";
VAL_ 1348 VFCVectorZCUDMVFCid39 0 "VFCOnOff_Off" 1 "VFCOnOff_On";
VAL_ 1348 VFCVectorZCUDMVFCid4 0 "VFCOnOff_Off" 1 "VFCOnOff_On";
VAL_ 1348 VFCVectorZCUDMVFCid40 0 "VFCOnOff_Off" 1 "VFCOnOff_On";
VAL_ 1348 VFCVectorZCUDMVFCid41 0 "VFCOnOff_Off" 1 "VFCOnOff_On";
VAL_ 1348 VFCVectorZCUDMVFCid42 0 "VFCOnOff_Off" 1 "VFCOnOff_On";
VAL_ 1348 VFCVectorZCUDMVFCid43 0 "VFCOnOff_Off" 1 "VFCOnOff_On";
VAL_ 1348 VFCVectorZCUDMVFCid44 0 "VFCOnOff_Off" 1 "VFCOnOff_On";
VAL_ 1348 VFCVectorZCUDMVFCid45 0 "VFCOnOff_Off" 1 "VFCOnOff_On";
VAL_ 1348 VFCVectorZCUDMVFCid46 0 "VFCOnOff_Off" 1 "VFCOnOff_On";
VAL_ 1348 VFCVectorZCUDMVFCid47 0 "VFCOnOff_Off" 1 "VFCOnOff_On";
VAL_ 1348 VFCVectorZCUDMVFCid48 0 "VFCOnOff_Off" 1 "VFCOnOff_On";
VAL_ 1348 VFCVectorZCUDMVFCid49 0 "VFCOnOff_Off" 1 "VFCOnOff_On";
VAL_ 1348 VFCVectorZCUDMVFCid5 0 "VFCOnOff_Off" 1 "VFCOnOff_On";
VAL_ 1348 VFCVectorZCUDMVFCid50 0 "VFCOnOff_Off" 1 "VFCOnOff_On";
VAL_ 1348 VFCVectorZCUDMVFCid51 0 "VFCOnOff_Off" 1 "VFCOnOff_On";
VAL_ 1348 VFCVectorZCUDMVFCid52 0 "VFCOnOff_Off" 1 "VFCOnOff_On";
VAL_ 1348 VFCVectorZCUDMVFCid53 0 "VFCOnOff_Off" 1 "VFCOnOff_On";
VAL_ 1348 VFCVectorZCUDMVFCid54 0 "VFCOnOff_Off" 1 "VFCOnOff_On";
VAL_ 1348 VFCVectorZCUDMVFCid55 0 "VFCOnOff_Off" 1 "VFCOnOff_On";
VAL_ 1348 VFCVectorZCUDMVFCid56 0 "VFCOnOff_Off" 1 "VFCOnOff_On";
VAL_ 1348 VFCVectorZCUDMVFCid57 0 "VFCOnOff_Off" 1 "VFCOnOff_On";
VAL_ 1348 VFCVectorZCUDMVFCid58 0 "VFCOnOff_Off" 1 "VFCOnOff_On";
VAL_ 1348 VFCVectorZCUDMVFCid59 0 "VFCOnOff_Off" 1 "VFCOnOff_On";
VAL_ 1348 VFCVectorZCUDMVFCid6 0 "VFCOnOff_Off" 1 "VFCOnOff_On";
VAL_ 1348 VFCVectorZCUDMVFCid60 0 "VFCOnOff_Off" 1 "VFCOnOff_On";
VAL_ 1348 VFCVectorZCUDMVFCid61 0 "VFCOnOff_Off" 1 "VFCOnOff_On";
VAL_ 1348 VFCVectorZCUDMVFCid7 0 "VFCOnOff_Off" 1 "VFCOnOff_On";
VAL_ 1348 VFCVectorZCUDMVFCid8 0 "VFCOnOff_Off" 1 "VFCOnOff_On";
VAL_ 1348 VFCVectorZCUDMVFCid9 0 "VFCOnOff_Off" 1 "VFCOnOff_On";
VAL_ 441 AjarChrgLidRearSwitch 0 "DoorSts2_Ukwn" 1 "DoorSts2_Opend" 2 "DoorSts2_Clsd";
VAL_ 441 AjarFuelFlapSwitch 0 "DoorSts2_Ukwn" 1 "DoorSts2_Opend" 2 "DoorSts2_Clsd";
VAL_ 441 ClimaCmptSts 0 "CmptSts_NoRequest" 1 "CmptSts_CoolingRequest" 2 "CmptSts_HeatingRequest" 3 "CmptSts_CoolingAndHeatingRequest" 4 "CmptSts_PostHeating";
VAL_ 441 ClimaCtrlActv 0 "Boolean_FALSE" 1 "Boolean_TRUE";
VAL_ 441 ClimaDefrstSts 0 "OnOff1_Off" 1 "OnOff1_On";
VAL_ 441 DoorPass2Swt1DplyHndl 0 "PsdNotPsd1_NotPsd" 1 "PsdNotPsd1_Psd";
VAL_ 441 DoorPass2Swt2DplyHndl 0 "PsdNotPsd1_NotPsd" 1 "PsdNotPsd1_Psd";
VAL_ 441 DoorPassLatPosn 0 "DoorPos_Undefined" 1 "DoorPos_FullyClosed" 2 "DoorPos_SecondaryPosition" 3 "DoorPos_FullyOpen";
VAL_ 441 DoorPassRe2Sw1DplyHndl 0 "PsdNotPsd1_NotPsd" 1 "PsdNotPsd1_Psd";
VAL_ 441 DoorPassRe2Sw2DplyHndl 0 "PsdNotPsd1_NotPsd" 1 "PsdNotPsd1_Psd";
VAL_ 441 EngSpdIncIdleForClima 0 "Flg1_Rst" 1 "Flg1_Set";
VAL_ 441 FltOfReRegPlateLamp 0 "DevErrSts2_NoFlt" 1 "DevErrSts2_Flt";
VAL_ 441 IceBreakDoorPassActv 0 "Boolean_FALSE" 1 "Boolean_TRUE";
VAL_ 441 MirrAtPassForVce 0 "MirrStsForVce_Idle" 1 "MirrStsForVce_LimReach" 2 "MirrStsForVce_MoveIntrpt";
VAL_ 441 MirrAtPassInMovmt 0 "Boolean_FALSE" 1 "Boolean_TRUE";
VAL_ 441 PassSeatAdjmtLimForFldWarn 0 "Boolean_FALSE" 1 "Boolean_TRUE";
VAL_ 441 PassSeatAdjmtLimnWarn 0 "Boolean_FALSE" 1 "Boolean_TRUE";
VAL_ 441 PassSeatCushDownPosPercSeatPosQf 0 "Qf1_DevOfDataUndefd" 1 "Qf1_DataTmpUndefdAndEvlnInProgs" 2 "Qf1_DevOfDataNotWithinRngAllwd" 3 "Qf1_DataCalcdWithDevDefd";
VAL_ 441 PassSeatPhytheraSts 0 "OffOnErrInvalid_Off" 1 "OffOnErrInvalid_On" 2 "OffOnErrInvalid_Err" 3 "OffOnErrInvalid_Invalid";
VAL_ 441 PassSeatPosPercSeatPosFrntHeiQF 0 "Qf1_DevOfDataUndefd" 1 "Qf1_DataTmpUndefdAndEvlnInProgs" 2 "Qf1_DevOfDataNotWithinRngAllwd" 3 "Qf1_DataCalcdWithDevDefd";
VAL_ 441 PassSeatPosPercSeatPosHeiQF 0 "Qf1_DevOfDataUndefd" 1 "Qf1_DataTmpUndefdAndEvlnInProgs" 2 "Qf1_DevOfDataNotWithinRngAllwd" 3 "Qf1_DataCalcdWithDevDefd";
VAL_ 441 PassSeatPosPercSeatPosSldQF 0 "Qf1_DevOfDataUndefd" 1 "Qf1_DataTmpUndefdAndEvlnInProgs" 2 "Qf1_DevOfDataNotWithinRngAllwd" 3 "Qf1_DataCalcdWithDevDefd";
VAL_ 441 SeatOccptAtRowSecPasSide2 0 "OccptPresSt1_Undefd1" 1 "OccptPresSt1_OccptNotPrsnt" 2 "OccptPresSt1_OccptPrsnt" 3 "OccptPresSt1_Undefd2";
VAL_ 441 SeatOccptAtRowSecPasSideSnsSts2 0 "OkNokDi_Ok" 1 "OkNokDi_NotOk" 2 "OkNokDi_Disabled" 3 "OkNokDi_Reserved";
VAL_ 441 SteerWhlHeatgDurgClima 0 "Boolean_FALSE" 1 "Boolean_TRUE";
VAL_ 801 AmbTEstimdQf 0 "HvacTIfQf_SnsrDataNotOk" 1 "HvacTIfQf_SnsrDataOk";
VAL_ 801 ClimaOvrHeatPrtSts 0 "OnOff1_Off" 1 "OnOff1_On";
VAL_ 801 CmptmtAirTEstimdExtdQlyFlg 0 "GenQf1_UndefindDataAccur" 1 "GenQf1_TmpUndefdData" 2 "GenQf1_DataAccurNotWithinSpcn" 3 "GenQf1_AccurData";
VAL_ 520 AmbTRawAtPassSideQly 0 "GenQf1_UndefindDataAccur" 1 "GenQf1_TmpUndefdData" 2 "GenQf1_DataAccurNotWithinSpcn" 3 "GenQf1_AccurData";
VAL_ 520 ClimaAtRowSecActv 0 "Boolean_FALSE" 1 "Boolean_TRUE";
VAL_ 520 PassSeatActvSwtFctMod 0 "SwtFctMod_Mod1" 1 "SwtFctMod_Mod2" 2 "SwtFctMod_Mod3" 3 "SwtFctMod_Mod4";
VAL_ 520 PassSeatIntgrSwtStsIntgrSwtHozlSts 0 "SwtHozlSts1_Idle" 1 "SwtHozlSts1_Fwd" 2 "SwtHozlSts1_Backw";
VAL_ 520 PassSeatIntgrSwtStsIntgrSwtRotSts 0 "SwtHozlSts1_Idle" 1 "SwtHozlSts1_Fwd" 2 "SwtHozlSts1_Backw";
VAL_ 520 PassSeatIntgrSwtStsIntgrSwtSelnSts 0 "SwtVertSts1_Idle" 1 "SwtVertSts1_Up" 2 "SwtVertSts1_Dwn";
VAL_ 520 PassSeatIntgrSwtStsIntgrSwtVertSts 0 "SwtVertSts1_Idle" 1 "SwtVertSts1_Up" 2 "SwtVertSts1_Dwn";
VAL_ 520 RlyCmftForClimaReq 0 "OnOff1_Off" 1 "OnOff1_On";
VAL_ 520 RlyCrashForClimaReq 0 "OnOff1_Off" 1 "OnOff1_On";
VAL_ 58 DoorPassOpenLowReqOutdSwt1 0 "PsdNotPsd3_NoInfo1" 1 "PsdNotPsd3_Psd" 2 "PsdNotPsd3_NotPsd" 3 "PsdNotPsd3_NoInfo2";
VAL_ 58 DoorPassOpenReqInsdSwt1 0 "PsdNotPsd3_NoInfo1" 1 "PsdNotPsd3_Psd" 2 "PsdNotPsd3_NotPsd" 3 "PsdNotPsd3_NoInfo2";
VAL_ 58 DoorPassReCinhIntFailInfCinchFlt1 0 "Boolean_FALSE" 1 "Boolean_TRUE";
VAL_ 58 DoorPassReCinhIntFailInfCinchRestFlt 0 "Boolean_FALSE" 1 "Boolean_TRUE";
VAL_ 58 DoorPassReLatPosn 0 "DoorPos_Undefined" 1 "DoorPos_FullyClosed" 2 "DoorPos_SecondaryPosition" 3 "DoorPos_FullyOpen";
VAL_ 58 DoorPassReOpenLowReqOutdSwt1 0 "PsdNotPsd3_NoInfo1" 1 "PsdNotPsd3_Psd" 2 "PsdNotPsd3_NotPsd" 3 "PsdNotPsd3_NoInfo2";
VAL_ 58 DoorPassReOpenReqInsdSwt1 0 "PsdNotPsd3_NoInfo1" 1 "PsdNotPsd3_Psd" 2 "PsdNotPsd3_NotPsd" 3 "PsdNotPsd3_NoInfo2";
VAL_ 58 DoorPassReRelsFailCinchOverTimed 0 "Boolean_FALSE" 1 "Boolean_TRUE";
VAL_ 58 DoorPassReRelsFailFailure1 0 "Boolean_FALSE" 1 "Boolean_TRUE";
VAL_ 58 DoorPassReRelsFailMechRels 0 "Boolean_FALSE" 1 "Boolean_TRUE";
VAL_ 58 DoorRiReLatPosn 0 "DoorPos_Undefined" 1 "DoorPos_FullyClosed" 2 "DoorPos_SecondaryPosition" 3 "DoorPos_FullyOpen";
VAL_ 58 DoorRiReOpenLowReqOutdSwt1 0 "PsdNotPsd3_NoInfo1" 1 "PsdNotPsd3_Psd" 2 "PsdNotPsd3_NotPsd" 3 "PsdNotPsd3_NoInfo2";
VAL_ 58 DoorRiReOpenReqInsdSwt1 0 "PsdNotPsd3_NoInfo1" 1 "PsdNotPsd3_Psd" 2 "PsdNotPsd3_NotPsd" 3 "PsdNotPsd3_NoInfo2";
VAL_ 58 IceBreakDoorPassReActv 0 "Boolean_FALSE" 1 "Boolean_TRUE";
VAL_ 58 MirrAdjVceStsAtPass 0 "Boolean_FALSE" 1 "Boolean_TRUE";
VAL_ 310 AutDemstOperSts 0 "OnOff1_Off" 1 "OnOff1_On";
VAL_ 310 ChdLockPassReSts 0 "OnOffSafe1_OnOffSafeInvld1" 1 "OnOffSafe1_OnOffSafeOn" 2 "OnOffSafe1_OnOffSafeOff" 3 "OnOffSafe1_OnOffSafeInvld2";
VAL_ 310 ChdLockRightSts 0 "OnOffSafe1_OnOffSafeInvld1" 1 "OnOffSafe1_OnOffSafeOn" 2 "OnOffSafe1_OnOffSafeOff" 3 "OnOffSafe1_OnOffSafeInvld2";
VAL_ 310 CinhPassReSts 0 "PsdNotPsd1_NotPsd" 1 "PsdNotPsd1_Psd";
VAL_ 310 CinhPassReSwt 0 "PsdNotPsd1_NotPsd" 1 "PsdNotPsd1_Psd";
VAL_ 310 CinhPassSts 0 "Boolean_FALSE" 1 "Boolean_TRUE";
VAL_ 310 CinhPassSwt 0 "PsdNotPsd1_NotPsd" 1 "PsdNotPsd1_Psd";
VAL_ 310 CmptmtTFrntFanForCmptmtTRunng 0 "Flg1_Rst" 1 "Flg1_Set";
VAL_ 310 CmptmtTFrntQf 0 "CmptmtTFrntQf_SnsrDataUndefd" 1 "CmptmtTFrntQf_FanNotRunning" 2 "CmptmtTFrntQf_SnsrDataNotOk" 3 "CmptmtTFrntQf_SnsrDataOk";
VAL_ 310 DoorPassReHndlSts 0 "DoorHndlSts_Ukwn" 1 "DoorHndlSts_FullRtrctd" 2 "DoorHndlSts_MovgOut" 3 "DoorHndlSts_StopDurgDply" 4 "DoorHndlSts_FullDplyd" 5 "DoorHndlSts_MovgIn" 6 "DoorHndlSts_StopDurgRtrct" 7 "DoorHndlSts_Flt";
VAL_ 310 EvaprTFrntEvaprTQf 0 "HvacTIfQf_SnsrDataNotOk" 1 "HvacTIfQf_SnsrDataOk";
VAL_ 310 FltOfBeamHiPass 0 "DevErrSts2_NoFlt" 1 "DevErrSts2_Flt";
VAL_ 310 FltOfBeamLoPass 0 "DevErrSts2_NoFlt" 1 "DevErrSts2_Flt";
VAL_ 310 FltOfDaytiRunngLampPass 0 "DevErrSts2_NoFlt" 1 "DevErrSts2_Flt";
VAL_ 310 FltOfFrntFogLampPass 0 "DevErrSts2_NoFlt" 1 "DevErrSts2_Flt";
VAL_ 310 FltOfFrntPosnLampPass 0 "DevErrSts2_NoFlt" 1 "DevErrSts2_Flt";
VAL_ 310 FltOfReFogLampDrv 0 "DevErrSts2_NoFlt" 1 "DevErrSts2_Flt";
VAL_ 310 FltOfRePosnLampPass 0 "DevErrSts2_NoFlt" 1 "DevErrSts2_Flt";
VAL_ 310 FltOfRvsgLampPass 0 "DevErrSts2_NoFlt" 1 "DevErrSts2_Flt";
VAL_ 310 HvacCoolgEnaRe 0 "OnOff1_Off" 1 "OnOff1_On";
VAL_ 310 HvahAirTEstmdEvaprTQf 0 "HvacTIfQf_SnsrDataNotOk" 1 "HvacTIfQf_SnsrDataOk";
VAL_ 310 IceBreakDoorRiReActv 0 "Boolean_FALSE" 1 "Boolean_TRUE";
VAL_ 310 IntPm25StsFrmClima 0 "PmSnsrSts_Initial" 1 "PmSnsrSts_Collecting" 2 "PmSnsrSts_Complete" 3 "PmSnsrSts_Error";
VAL_ 310 MirrDwnStsAtPass 0 "MirrDwnStsTyp_MirrTiltUndefd" 1 "MirrDwnStsTyp_MirrUpPosn" 2 "MirrDwnStsTyp_MirrTiltPosn" 3 "MirrDwnStsTyp_MirrMovgToUpPosn" 4 "MirrDwnStsTyp_MirrMovgToTiltPosn";
VAL_ 310 OpenPassReSwt 0 "PsdNotPsd1_NotPsd" 1 "PsdNotPsd1_Psd";
VAL_ 310 OpenPassSwt 0 "PsdNotPsd1_NotPsd" 1 "PsdNotPsd1_Psd";
VAL_ 310 PassSeatBtnPsd 0 "Boolean_FALSE" 1 "Boolean_TRUE";
VAL_ 310 PassSeatFoldSts 0 "FoldRaiseMovmt_Uknwn" 1 "FoldRaiseMovmt_Fld" 2 "FoldRaiseMovmt_Rsd" 3 "FoldRaiseMovmt_MovmtToFld" 4 "FoldRaiseMovmt_MovmtToRsd" 5 "FoldRaiseMovmt_BtwnFldAndRsd";
VAL_ 310 PassSeatFootRstAutMovmtSts 0 "Sts_Resd" 1 "Sts_Err" 2 "Sts_CmplOk" 3 "Sts_InProgs";
VAL_ 310 PassSeatFootRstSwtSts 0 "SwtVertSts1_Idle" 1 "SwtVertSts1_Up" 2 "SwtVertSts1_Dwn";
VAL_ 310 PassSeatInAutMovmt 0 "Boolean_FALSE" 1 "Boolean_TRUE";
VAL_ 310 PassSeatPosFrntExtPercSeatPosQf 0 "Qf1_DevOfDataUndefd" 1 "Qf1_DataTmpUndefdAndEvlnInProgs" 2 "Qf1_DevOfDataNotWithinRngAllwd" 3 "Qf1_DataCalcdWithDevDefd";
VAL_ 310 PawlPassReSwt 0 "PsdNotPsd1_NotPsd" 1 "PsdNotPsd1_Psd";
VAL_ 310 PawlPassSwt 0 "PsdNotPsd1_NotPsd" 1 "PsdNotPsd1_Psd";
VAL_ 310 PrkgClimaHVReq 0 "OnOff1_Off" 1 "OnOff1_On";
VAL_ 310 RemActvStsRemClimaActvSts 0 "OnOff1_Off" 1 "OnOff1_On";
VAL_ 310 RemActvStsRemDefrstSts 0 "OnOff1_Off" 1 "OnOff1_On";
VAL_ 310 RemClimaElecDefrstReqMirrDefrstReq 0 "OnOff1_Off" 1 "OnOff1_On";
VAL_ 310 RemClimaElecDefrstReqWinDefrstFrntReq 0 "OnOff1_Off" 1 "OnOff1_On";
VAL_ 310 RemClimaElecDefrstReqWinDefrstReReq 0 "OnOff1_Off" 1 "OnOff1_On";
VAL_ 310 SeatMassgBackBlstrCtrlPass 0 "SwtHozlSts1_Idle" 1 "SwtHozlSts1_Fwd" 2 "SwtHozlSts1_Backw";
VAL_ 310 SeatMassgBackBlstrEnaPass 0 "Boolean_FALSE" 1 "Boolean_TRUE";
VAL_ 310 SeatMassgCushBlstrCtrlPass 0 "SwtVertSts1_Idle" 1 "SwtVertSts1_Up" 2 "SwtVertSts1_Dwn";
VAL_ 310 SeatMassgCushBlstrEnaPass 0 "Boolean_FALSE" 1 "Boolean_TRUE";
VAL_ 310 SeatMassgCushLiftCtrlPass 0 "Boolean_FALSE" 1 "Boolean_TRUE";
VAL_ 310 SeatMassgCushLiftEnaPass 0 "Boolean_FALSE" 1 "Boolean_TRUE";
VAL_ 310 SeatMassgFctPassMassgInten 0 "MassgIntenLvl_IntenLo" 1 "MassgIntenLvl_IntenNorm" 2 "MassgIntenLvl_IntenHi" 3 "MassgIntenLvl_Off";
VAL_ 310 SeatMassgFctPassMassgProg 0 "MassgProgTyp_Prog1" 1 "MassgProgTyp_Prog2" 2 "MassgProgTyp_Prog3" 3 "MassgProgTyp_Prog4" 4 "MassgProgTyp_Prog5" 5 "MassgProgTyp_Prog6" 6 "MassgProgTyp_Prog7" 7 "MassgProgTyp_Prog8";
VAL_ 310 SeatMassgFctPassOnOff 0 "OnOff1_Off" 1 "OnOff1_On";
VAL_ 310 SeatMassgLumExtnCtrlPass 0 "SwtHozlSts1_Idle" 1 "SwtHozlSts1_Fwd" 2 "SwtHozlSts1_Backw";
VAL_ 310 SeatMassgLumHeiCtrlPass 0 "SwtVertSts1_Idle" 1 "SwtVertSts1_Up" 2 "SwtVertSts1_Dwn";
VAL_ 310 SeatMassgLumMotrEnaPass 0 "Boolean_FALSE" 1 "Boolean_TRUE";
VAL_ 310 ShortDropWinPassReSts 0 "ShortDropSts_Idle" 1 "ShortDropSts_WindowDown" 2 "ShortDropSts_WindowClosed" 3 "ShortDropSts_NotUsed";
VAL_ 310 ShortDropWinPassSts 0 "ShortDropSts_Idle" 1 "ShortDropSts_WindowDown" 2 "ShortDropSts_WindowClosed" 3 "ShortDropSts_NotUsed";
VAL_ 310 ShortDropWinReRiSts 0 "ShortDropSts_Idle" 1 "ShortDropSts_WindowDown" 2 "ShortDropSts_WindowClosed" 3 "ShortDropSts_NotUsed";
VAL_ 310 WinDsblPassReSts 0 "OnOff1_Off" 1 "OnOff1_On";
VAL_ 310 WinDsblRightSts 0 "OnOff1_Off" 1 "OnOff1_On";
VAL_ 310 WinFailrStsAtPassRe 0 "Flt_NoFault" 1 "Flt_Fault";
VAL_ 310 WinPosnStsAtPassRe 0 "WinAndRoofAndCurtPosnTyp_PosnUkwn" 1 "WinAndRoofAndCurtPosnTyp_ClsFull" 2 "WinAndRoofAndCurtPosnTyp_PercOpen4" 3 "WinAndRoofAndCurtPosnTyp_PercOpen8" 4 "WinAndRoofAndCurtPosnTyp_PercOpen12" 5 "WinAndRoofAndCurtPosnTyp_PercOpen16" 6 "WinAndRoofAndCurtPosnTyp_PercOpen20" 7 "WinAndRoofAndCurtPosnTyp_PercOpen24" 8 "WinAndRoofAndCurtPosnTyp_PercOpen28" 9 "WinAndRoofAndCurtPosnTyp_PercOpen32" 10 "WinAndRoofAndCurtPosnTyp_PercOpen36" 11 "WinAndRoofAndCurtPosnTyp_PercOpen40" 12 "WinAndRoofAndCurtPosnTyp_PercOpen44" 13 "WinAndRoofAndCurtPosnTyp_PercOpen48" 14 "WinAndRoofAndCurtPosnTyp_PercOpen52" 15 "WinAndRoofAndCurtPosnTyp_PercOpen56" 16 "WinAndRoofAndCurtPosnTyp_PercOpen60" 17 "WinAndRoofAndCurtPosnTyp_PercOpen64" 18 "WinAndRoofAndCurtPosnTyp_PercOpen68" 19 "WinAndRoofAndCurtPosnTyp_PercOpen72" 20 "WinAndRoofAndCurtPosnTyp_PercOpen76" 21 "WinAndRoofAndCurtPosnTyp_PercOpen80" 22 "WinAndRoofAndCurtPosnTyp_PercOpen84" 23 "WinAndRoofAndCurtPosnTyp_PercOpen88" 24 "WinAndRoofAndCurtPosnTyp_PercOpen92" 25 "WinAndRoofAndCurtPosnTyp_PercOpen96" 26 "WinAndRoofAndCurtPosnTyp_OpenFull" 27 "WinAndRoofAndCurtPosnTyp_Resd1" 28 "WinAndRoofAndCurtPosnTyp_Resd2" 29 "WinAndRoofAndCurtPosnTyp_Resd3" 30 "WinAndRoofAndCurtPosnTyp_Resd4" 31 "WinAndRoofAndCurtPosnTyp_Movg";
VAL_ 1184 CmptmtIntrMtrlTEstimdMtrlSnsrTQly2 0 "Qly2_Flt" 1 "Qly2_NoInfo" 2 "Qly2_Vld";
VAL_ 1184 OutdAirQlyOutdAirQly 0 "AirQly_No" 1 "AirQly_LvlLo" 2 "AirQly_LvlMed" 3 "AirQly_LvlHi";
VAL_ 1184 OutdAirQlyQf 0 "OutdAirQlyQf_SnsrNotOk" 1 "OutdAirQlyQf_SnsrOk";
VAL_ 1184 OutdPm25StsFrmClima 0 "PmSnsrSts_Initial" 1 "PmSnsrSts_Collecting" 2 "PmSnsrSts_Complete" 3 "PmSnsrSts_Error";
VAL_ 600 AFUGenErr 0 "OnOff1_Off" 1 "OnOff1_On";
VAL_ 600 AirFragFanErr 0 "Err1_NoErr" 1 "Err1_Err";
VAL_ 600 AirFragMot1Err 0 "Err1_NoErr" 1 "Err1_Err";
VAL_ 600 AirFragOvrVoltErr 0 "Err1_NoErr" 1 "Err1_Err";
VAL_ 600 AirFragTempErr 0 "TempErr_Normal" 1 "TempErr_OverTemp" 2 "TempErr_UnderTemp" 3 "TempErr_Invalid";
VAL_ 600 AirFragUndVoltErr 0 "Err1_NoErr" 1 "Err1_Err";
VAL_ 600 ALM1Diag10BluSts 0 "Boolean_FALSE" 1 "Boolean_TRUE";
VAL_ 600 ALM1Diag10GreenSts 0 "Boolean_FALSE" 1 "Boolean_TRUE";
VAL_ 600 ALM1Diag10RedSts 0 "Boolean_FALSE" 1 "Boolean_TRUE";
VAL_ 600 ALM1Diag10TmpSts 0 "Boolean_FALSE" 1 "Boolean_TRUE";
VAL_ 600 ALM1Diag10VltSts 0 "Boolean_FALSE" 1 "Boolean_TRUE";
VAL_ 600 ALM1Diag11BluSts 0 "Boolean_FALSE" 1 "Boolean_TRUE";
VAL_ 600 ALM1Diag11GreenSts 0 "Boolean_FALSE" 1 "Boolean_TRUE";
VAL_ 600 ALM1Diag11RedSts 0 "Boolean_FALSE" 1 "Boolean_TRUE";
VAL_ 600 ALM1Diag11TmpSts 0 "Boolean_FALSE" 1 "Boolean_TRUE";
VAL_ 600 ALM1Diag11VltSts 0 "Boolean_FALSE" 1 "Boolean_TRUE";
VAL_ 600 ALM1Diag12BluSts 0 "Boolean_FALSE" 1 "Boolean_TRUE";
VAL_ 600 ALM1Diag12GreenSts 0 "Boolean_FALSE" 1 "Boolean_TRUE";
VAL_ 600 ALM1Diag12RedSts 0 "Boolean_FALSE" 1 "Boolean_TRUE";
VAL_ 600 ALM1Diag12TmpSts 0 "Boolean_FALSE" 1 "Boolean_TRUE";
VAL_ 600 ALM1Diag12VltSts 0 "Boolean_FALSE" 1 "Boolean_TRUE";
VAL_ 600 ALM1Diag13BluSts 0 "Boolean_FALSE" 1 "Boolean_TRUE";
VAL_ 600 ALM1Diag13GreenSts 0 "Boolean_FALSE" 1 "Boolean_TRUE";
VAL_ 600 ALM1Diag13RedSts 0 "Boolean_FALSE" 1 "Boolean_TRUE";
VAL_ 600 ALM1Diag13TmpSts 0 "Boolean_FALSE" 1 "Boolean_TRUE";
VAL_ 600 ALM1Diag13VltSts 0 "Boolean_FALSE" 1 "Boolean_TRUE";
VAL_ 600 ALM1Diag14BluSts 0 "Boolean_FALSE" 1 "Boolean_TRUE";
VAL_ 600 ALM1Diag14GreenSts 0 "Boolean_FALSE" 1 "Boolean_TRUE";
VAL_ 600 ALM1Diag14RedSts 0 "Boolean_FALSE" 1 "Boolean_TRUE";
VAL_ 600 ALM1Diag14TmpSts 0 "Boolean_FALSE" 1 "Boolean_TRUE";
VAL_ 600 ALM1Diag14VltSts 0 "Boolean_FALSE" 1 "Boolean_TRUE";
VAL_ 600 ALM1Diag15BluSts 0 "Boolean_FALSE" 1 "Boolean_TRUE";
VAL_ 600 ALM1Diag15GreenSts 0 "Boolean_FALSE" 1 "Boolean_TRUE";
VAL_ 600 ALM1Diag15RedSts 0 "Boolean_FALSE" 1 "Boolean_TRUE";
VAL_ 600 ALM1Diag15TmpSts 0 "Boolean_FALSE" 1 "Boolean_TRUE";
VAL_ 600 ALM1Diag15VltSts 0 "Boolean_FALSE" 1 "Boolean_TRUE";
VAL_ 600 ALM1Diag16BluSts 0 "Boolean_FALSE" 1 "Boolean_TRUE";
VAL_ 600 ALM1Diag16GreenSts 0 "Boolean_FALSE" 1 "Boolean_TRUE";
VAL_ 600 ALM1Diag16RedSts 0 "Boolean_FALSE" 1 "Boolean_TRUE";
VAL_ 600 ALM1Diag16TmpSts 0 "Boolean_FALSE" 1 "Boolean_TRUE";
VAL_ 600 ALM1Diag16VltSts 0 "Boolean_FALSE" 1 "Boolean_TRUE";
VAL_ 600 ALM1Diag1BluSts 0 "Boolean_FALSE" 1 "Boolean_TRUE";
VAL_ 600 ALM1Diag1GreenSts 0 "Boolean_FALSE" 1 "Boolean_TRUE";
VAL_ 600 ALM1Diag1RedSts 0 "Boolean_FALSE" 1 "Boolean_TRUE";
VAL_ 600 ALM1Diag1TmpSts 0 "Boolean_FALSE" 1 "Boolean_TRUE";
VAL_ 600 ALM1Diag1VltSts 0 "Boolean_FALSE" 1 "Boolean_TRUE";
VAL_ 600 ALM1Diag2BluSts 0 "Boolean_FALSE" 1 "Boolean_TRUE";
VAL_ 600 ALM1Diag2GreenSts 0 "Boolean_FALSE" 1 "Boolean_TRUE";
VAL_ 600 ALM1Diag2RedSts 0 "Boolean_FALSE" 1 "Boolean_TRUE";
VAL_ 600 ALM1Diag2TmpSts 0 "Boolean_FALSE" 1 "Boolean_TRUE";
VAL_ 600 ALM1Diag2VltSts 0 "Boolean_FALSE" 1 "Boolean_TRUE";
VAL_ 600 ALM1Diag3BluSts 0 "Boolean_FALSE" 1 "Boolean_TRUE";
VAL_ 600 ALM1Diag3GreenSts 0 "Boolean_FALSE" 1 "Boolean_TRUE";
VAL_ 600 ALM1Diag3RedSts 0 "Boolean_FALSE" 1 "Boolean_TRUE";
VAL_ 600 ALM1Diag3TmpSts 0 "Boolean_FALSE" 1 "Boolean_TRUE";
VAL_ 600 ALM1Diag3VltSts 0 "Boolean_FALSE" 1 "Boolean_TRUE";
VAL_ 600 ALM1Diag4BluSts 0 "Boolean_FALSE" 1 "Boolean_TRUE";
VAL_ 600 ALM1Diag4GreenSts 0 "Boolean_FALSE" 1 "Boolean_TRUE";
VAL_ 600 ALM1Diag4RedSts 0 "Boolean_FALSE" 1 "Boolean_TRUE";
VAL_ 600 ALM1Diag4TmpSts 0 "Boolean_FALSE" 1 "Boolean_TRUE";
VAL_ 600 ALM1Diag4VltSts 0 "Boolean_FALSE" 1 "Boolean_TRUE";
VAL_ 600 ALM1Diag5BluSts 0 "Boolean_FALSE" 1 "Boolean_TRUE";
VAL_ 600 ALM1Diag5GreenSts 0 "Boolean_FALSE" 1 "Boolean_TRUE";
VAL_ 600 ALM1Diag5RedSts 0 "Boolean_FALSE" 1 "Boolean_TRUE";
VAL_ 600 ALM1Diag5TmpSts 0 "Boolean_FALSE" 1 "Boolean_TRUE";
VAL_ 600 ALM1Diag5VltSts 0 "Boolean_FALSE" 1 "Boolean_TRUE";
VAL_ 600 ALM1Diag6BluSts 0 "Boolean_FALSE" 1 "Boolean_TRUE";
VAL_ 600 ALM1Diag6GreenSts 0 "Boolean_FALSE" 1 "Boolean_TRUE";
VAL_ 600 ALM1Diag6RedSts 0 "Boolean_FALSE" 1 "Boolean_TRUE";
VAL_ 600 ALM1Diag6TmpSts 0 "Boolean_FALSE" 1 "Boolean_TRUE";
VAL_ 600 ALM1Diag6VltSts 0 "Boolean_FALSE" 1 "Boolean_TRUE";
VAL_ 600 ALM1Diag7BluSts 0 "Boolean_FALSE" 1 "Boolean_TRUE";
VAL_ 600 ALM1Diag7GreenSts 0 "Boolean_FALSE" 1 "Boolean_TRUE";
VAL_ 600 ALM1Diag7RedSts 0 "Boolean_FALSE" 1 "Boolean_TRUE";
VAL_ 600 ALM1Diag7TmpSts 0 "Boolean_FALSE" 1 "Boolean_TRUE";
VAL_ 600 ALM1Diag7VltSts 0 "Boolean_FALSE" 1 "Boolean_TRUE";
VAL_ 600 ALM1Diag8BluSts 0 "Boolean_FALSE" 1 "Boolean_TRUE";
VAL_ 600 ALM1Diag8GreenSts 0 "Boolean_FALSE" 1 "Boolean_TRUE";
VAL_ 600 ALM1Diag8RedSts 0 "Boolean_FALSE" 1 "Boolean_TRUE";
VAL_ 600 ALM1Diag8TmpSts 0 "Boolean_FALSE" 1 "Boolean_TRUE";
VAL_ 600 ALM1Diag8VltSts 0 "Boolean_FALSE" 1 "Boolean_TRUE";
VAL_ 600 ALM1Diag9BluSts 0 "Boolean_FALSE" 1 "Boolean_TRUE";
VAL_ 600 ALM1Diag9GreenSts 0 "Boolean_FALSE" 1 "Boolean_TRUE";
VAL_ 600 ALM1Diag9RedSts 0 "Boolean_FALSE" 1 "Boolean_TRUE";
VAL_ 600 ALM1Diag9TmpSts 0 "Boolean_FALSE" 1 "Boolean_TRUE";
VAL_ 600 ALM1Diag9VltSts 0 "Boolean_FALSE" 1 "Boolean_TRUE";
VAL_ 600 ALM2Diag10BluSts 0 "Boolean_FALSE" 1 "Boolean_TRUE";
VAL_ 600 ALM2Diag10GreenSts 0 "Boolean_FALSE" 1 "Boolean_TRUE";
VAL_ 600 ALM2Diag10RedSts 0 "Boolean_FALSE" 1 "Boolean_TRUE";
VAL_ 600 ALM2Diag10TmpSts 0 "Boolean_FALSE" 1 "Boolean_TRUE";
VAL_ 600 ALM2Diag10VltSts 0 "Boolean_FALSE" 1 "Boolean_TRUE";
VAL_ 600 ALM2Diag11BluSts 0 "Boolean_FALSE" 1 "Boolean_TRUE";
VAL_ 600 ALM2Diag11GreenSts 0 "Boolean_FALSE" 1 "Boolean_TRUE";
VAL_ 600 ALM2Diag11RedSts 0 "Boolean_FALSE" 1 "Boolean_TRUE";
VAL_ 600 ALM2Diag11TmpSts 0 "Boolean_FALSE" 1 "Boolean_TRUE";
VAL_ 600 ALM2Diag11VltSts 0 "Boolean_FALSE" 1 "Boolean_TRUE";
VAL_ 600 ALM2Diag12BluSts 0 "Boolean_FALSE" 1 "Boolean_TRUE";
VAL_ 600 ALM2Diag12GreenSts 0 "Boolean_FALSE" 1 "Boolean_TRUE";
VAL_ 600 ALM2Diag12RedSts 0 "Boolean_FALSE" 1 "Boolean_TRUE";
VAL_ 600 ALM2Diag12TmpSts 0 "Boolean_FALSE" 1 "Boolean_TRUE";
VAL_ 600 ALM2Diag12VltSts 0 "Boolean_FALSE" 1 "Boolean_TRUE";
VAL_ 600 ALM2Diag13BluSts 0 "Boolean_FALSE" 1 "Boolean_TRUE";
VAL_ 600 ALM2Diag13GreenSts 0 "Boolean_FALSE" 1 "Boolean_TRUE";
VAL_ 600 ALM2Diag13RedSts 0 "Boolean_FALSE" 1 "Boolean_TRUE";
VAL_ 600 ALM2Diag13TmpSts 0 "Boolean_FALSE" 1 "Boolean_TRUE";
VAL_ 600 ALM2Diag13VltSts 0 "Boolean_FALSE" 1 "Boolean_TRUE";
VAL_ 600 ALM2Diag14BluSts 0 "Boolean_FALSE" 1 "Boolean_TRUE";
VAL_ 600 ALM2Diag14GreenSts 0 "Boolean_FALSE" 1 "Boolean_TRUE";
VAL_ 600 ALM2Diag14RedSts 0 "Boolean_FALSE" 1 "Boolean_TRUE";
VAL_ 600 ALM2Diag14TmpSts 0 "Boolean_FALSE" 1 "Boolean_TRUE";
VAL_ 600 ALM2Diag14VltSts 0 "Boolean_FALSE" 1 "Boolean_TRUE";
VAL_ 600 ALM2Diag15BluSts 0 "Boolean_FALSE" 1 "Boolean_TRUE";
VAL_ 600 ALM2Diag15GreenSts 0 "Boolean_FALSE" 1 "Boolean_TRUE";
VAL_ 600 ALM2Diag15RedSts 0 "Boolean_FALSE" 1 "Boolean_TRUE";
VAL_ 600 ALM2Diag15TmpSts 0 "Boolean_FALSE" 1 "Boolean_TRUE";
VAL_ 600 ALM2Diag15VltSts 0 "Boolean_FALSE" 1 "Boolean_TRUE";
VAL_ 600 ALM2Diag16BluSts 0 "Boolean_FALSE" 1 "Boolean_TRUE";
VAL_ 600 ALM2Diag16GreenSts 0 "Boolean_FALSE" 1 "Boolean_TRUE";
VAL_ 600 ALM2Diag16RedSts 0 "Boolean_FALSE" 1 "Boolean_TRUE";
VAL_ 600 ALM2Diag16TmpSts 0 "Boolean_FALSE" 1 "Boolean_TRUE";
VAL_ 600 ALM2Diag16VltSts 0 "Boolean_FALSE" 1 "Boolean_TRUE";
VAL_ 600 ALM2Diag1BluSts 0 "Boolean_FALSE" 1 "Boolean_TRUE";
VAL_ 600 ALM2Diag1GreenSts 0 "Boolean_FALSE" 1 "Boolean_TRUE";
VAL_ 600 ALM2Diag1RedSts 0 "Boolean_FALSE" 1 "Boolean_TRUE";
VAL_ 600 ALM2Diag1TmpSts 0 "Boolean_FALSE" 1 "Boolean_TRUE";
VAL_ 600 ALM2Diag1VltSts 0 "Boolean_FALSE" 1 "Boolean_TRUE";
VAL_ 600 ALM2Diag2BluSts 0 "Boolean_FALSE" 1 "Boolean_TRUE";
VAL_ 600 ALM2Diag2GreenSts 0 "Boolean_FALSE" 1 "Boolean_TRUE";
VAL_ 600 ALM2Diag2RedSts 0 "Boolean_FALSE" 1 "Boolean_TRUE";
VAL_ 600 ALM2Diag2TmpSts 0 "Boolean_FALSE" 1 "Boolean_TRUE";
VAL_ 600 ALM2Diag2VltSts 0 "Boolean_FALSE" 1 "Boolean_TRUE";
VAL_ 600 ALM2Diag3BluSts 0 "Boolean_FALSE" 1 "Boolean_TRUE";
VAL_ 600 ALM2Diag3GreenSts 0 "Boolean_FALSE" 1 "Boolean_TRUE";
VAL_ 600 ALM2Diag3RedSts 0 "Boolean_FALSE" 1 "Boolean_TRUE";
VAL_ 600 ALM2Diag3TmpSts 0 "Boolean_FALSE" 1 "Boolean_TRUE";
VAL_ 600 ALM2Diag3VltSts 0 "Boolean_FALSE" 1 "Boolean_TRUE";
VAL_ 600 ALM2Diag4BluSts 0 "Boolean_FALSE" 1 "Boolean_TRUE";
VAL_ 600 ALM2Diag4GreenSts 0 "Boolean_FALSE" 1 "Boolean_TRUE";
VAL_ 600 ALM2Diag4RedSts 0 "Boolean_FALSE" 1 "Boolean_TRUE";
VAL_ 600 ALM2Diag4TmpSts 0 "Boolean_FALSE" 1 "Boolean_TRUE";
VAL_ 600 ALM2Diag4VltSts 0 "Boolean_FALSE" 1 "Boolean_TRUE";
VAL_ 600 ALM2Diag5BluSts 0 "Boolean_FALSE" 1 "Boolean_TRUE";
VAL_ 600 ALM2Diag5GreenSts 0 "Boolean_FALSE" 1 "Boolean_TRUE";
VAL_ 600 ALM2Diag5RedSts 0 "Boolean_FALSE" 1 "Boolean_TRUE";
VAL_ 600 ALM2Diag5TmpSts 0 "Boolean_FALSE" 1 "Boolean_TRUE";
VAL_ 600 ALM2Diag5VltSts 0 "Boolean_FALSE" 1 "Boolean_TRUE";
VAL_ 600 ALM2Diag6BluSts 0 "Boolean_FALSE" 1 "Boolean_TRUE";
VAL_ 600 ALM2Diag6GreenSts 0 "Boolean_FALSE" 1 "Boolean_TRUE";
VAL_ 600 ALM2Diag6RedSts 0 "Boolean_FALSE" 1 "Boolean_TRUE";
VAL_ 600 ALM2Diag6TmpSts 0 "Boolean_FALSE" 1 "Boolean_TRUE";
VAL_ 600 ALM2Diag6VltSts 0 "Boolean_FALSE" 1 "Boolean_TRUE";
VAL_ 600 ALM2Diag7BluSts 0 "Boolean_FALSE" 1 "Boolean_TRUE";
VAL_ 600 ALM2Diag7GreenSts 0 "Boolean_FALSE" 1 "Boolean_TRUE";
VAL_ 600 ALM2Diag7RedSts 0 "Boolean_FALSE" 1 "Boolean_TRUE";
VAL_ 600 ALM2Diag7TmpSts 0 "Boolean_FALSE" 1 "Boolean_TRUE";
VAL_ 600 ALM2Diag7VltSts 0 "Boolean_FALSE" 1 "Boolean_TRUE";
VAL_ 600 ALM2Diag8BluSts 0 "Boolean_FALSE" 1 "Boolean_TRUE";
VAL_ 600 ALM2Diag8GreenSts 0 "Boolean_FALSE" 1 "Boolean_TRUE";
VAL_ 600 ALM2Diag8RedSts 0 "Boolean_FALSE" 1 "Boolean_TRUE";
VAL_ 600 ALM2Diag8TmpSts 0 "Boolean_FALSE" 1 "Boolean_TRUE";
VAL_ 600 ALM2Diag8VltSts 0 "Boolean_FALSE" 1 "Boolean_TRUE";
VAL_ 600 ALM2Diag9BluSts 0 "Boolean_FALSE" 1 "Boolean_TRUE";
VAL_ 600 ALM2Diag9GreenSts 0 "Boolean_FALSE" 1 "Boolean_TRUE";
VAL_ 600 ALM2Diag9RedSts 0 "Boolean_FALSE" 1 "Boolean_TRUE";
VAL_ 600 ALM2Diag9TmpSts 0 "Boolean_FALSE" 1 "Boolean_TRUE";
VAL_ 600 ALM2Diag9VltSts 0 "Boolean_FALSE" 1 "Boolean_TRUE";
VAL_ 600 ClimaActv 0 "OnOff1_Off" 1 "OnOff1_On";
VAL_ 600 ElecAirVentnAvlSts 0 "StsFd_None" 1 "StsFd_On" 2 "StsFd_Off" 3 "StsFd_Error" 4 "StsFd_Functionallimit" 5 "StsFd_Energylimit" 6 "StsFd_Resvd1" 7 "StsFd_Resvd2";
VAL_ 600 ElecDefrstReqMirrDefrstReq 0 "OnOff1_Off" 1 "OnOff1_On";
VAL_ 600 ElecDefrstReqWinDefrstFrntReq 0 "OnOff1_Off" 1 "OnOff1_On";
VAL_ 600 ElecDefrstReqWinDefrstReReq 0 "OnOff1_Off" 1 "OnOff1_On";
VAL_ 600 EvaprTReEvaprTQf 0 "HvacTIfQf_SnsrDataNotOk" 1 "HvacTIfQf_SnsrDataOk";
VAL_ 600 FogFlashPrevnActv 0 "Boolean_FALSE" 1 "Boolean_TRUE";
VAL_ 600 FragCh1UseUpWrn 0 "Warn2_NoWarn" 1 "Warn2_Warn";
VAL_ 600 FragCh2UseUpWrn 0 "Warn2_NoWarn" 1 "Warn2_Warn";
VAL_ 600 FragCh3UseUpWrn 0 "Warn2_NoWarn" 1 "Warn2_Warn";
VAL_ 600 FragCh4UseUpWrn 0 "Warn2_NoWarn" 1 "Warn2_Warn";
VAL_ 600 FragCh5UseUpWrn 0 "Warn2_NoWarn" 1 "Warn2_Warn";
VAL_ 600 FragLvlFrmClima 0 "RatUse_NoRequest" 1 "RatUse_Low" 2 "RatUse_Mid" 3 "RatUse_High";
VAL_ 600 FragStsFrmClima 1 "AirFragSts_OFF" 2 "AirFragSts_ON" 3 "AirFragSts_Error";
VAL_ 600 HvacHexAirTFirstLeHvacAirTForHeatrFrntQf 0 "OkNotOk_NotOk" 1 "OkNotOk_Ok";
VAL_ 600 HvacHexAirTFirstRiHvacAirTForHeatrFrntQf 0 "OkNotOk_NotOk" 1 "OkNotOk_Ok";
VAL_ 600 HvacHexAirTSecLeHvacAirTForHeatrFrntQf 0 "OkNotOk_NotOk" 1 "OkNotOk_Ok";
VAL_ 600 IntPm25HiPopUp 0 "IntPmHiPopUp_NoReq" 1 "IntPmHiPopUp_ClimaOn" 2 "IntPmHiPopUp_ClimaOnAndWinClsd" 3 "IntPmHiPopUp_Reserved";
VAL_ 600 PassSeatVentAvlSts 0 "StsFd_None" 1 "StsFd_On" 2 "StsFd_Off" 3 "StsFd_Error" 4 "StsFd_Functionallimit" 5 "StsFd_Energylimit" 6 "StsFd_Resvd1" 7 "StsFd_Resvd2";
VAL_ 600 PrkgClimaWarn 0 "ClimaWarn_NoWarn" 1 "ClimaWarn_FuLo" 2 "ClimaWarn_BattLo" 3 "ClimaWarn_FuAndBattLo" 4 "ClimaWarn_TLo" 5 "ClimaWarn_THi" 6 "ClimaWarn_Error" 7 "ClimaWarn_HVError" 8 "ClimaWarn_ActvnLimd";
VAL_ 600 SeatClimaDurgClimaHmiSeatHeatgForRowFirstLe 0 "SeatClimaLvl_Off" 1 "SeatClimaLvl_Lvl1" 2 "SeatClimaLvl_Lvl2" 3 "SeatClimaLvl_Lvl3";
VAL_ 600 SeatClimaDurgClimaHmiSeatHeatgForRowFirstRi 0 "SeatClimaLvl_Off" 1 "SeatClimaLvl_Lvl1" 2 "SeatClimaLvl_Lvl2" 3 "SeatClimaLvl_Lvl3";
VAL_ 600 SeatClimaDurgClimaHmiSeatHeatgForRowSecLe 0 "SeatClimaLvl_Off" 1 "SeatClimaLvl_Lvl1" 2 "SeatClimaLvl_Lvl2" 3 "SeatClimaLvl_Lvl3";
VAL_ 600 SeatClimaDurgClimaHmiSeatHeatgForRowSecRi 0 "SeatClimaLvl_Off" 1 "SeatClimaLvl_Lvl1" 2 "SeatClimaLvl_Lvl2" 3 "SeatClimaLvl_Lvl3";
VAL_ 600 SeatClimaDurgClimaHmiSeatVentnForRowFirstLe 0 "SeatClimaLvl_Off" 1 "SeatClimaLvl_Lvl1" 2 "SeatClimaLvl_Lvl2" 3 "SeatClimaLvl_Lvl3";
VAL_ 600 SeatClimaDurgClimaHmiSeatVentnForRowFirstRi 0 "SeatClimaLvl_Off" 1 "SeatClimaLvl_Lvl1" 2 "SeatClimaLvl_Lvl2" 3 "SeatClimaLvl_Lvl3";
VAL_ 600 SeatClimaDurgClimaHmiSeatVentnForRowSecLe 0 "SeatClimaLvl_Off" 1 "SeatClimaLvl_Lvl1" 2 "SeatClimaLvl_Lvl2" 3 "SeatClimaLvl_Lvl3";
VAL_ 600 SeatClimaDurgClimaHmiSeatVentnForRowSecRi 0 "SeatClimaLvl_Off" 1 "SeatClimaLvl_Lvl1" 2 "SeatClimaLvl_Lvl2" 3 "SeatClimaLvl_Lvl3";
VAL_ 803 ClimaCoolgReqLvl 0 "HvBattCoolgReq_NotReqd" 1 "HvBattCoolgReq_LoReq" 2 "HvBattCoolgReq_MedReq" 3 "HvBattCoolgReq_HiReq";
VAL_ 803 ClimaHeatgReqLvl 0 "HvBattCoolgReq_NotReqd" 1 "HvBattCoolgReq_LoReq" 2 "HvBattCoolgReq_MedReq" 3 "HvBattCoolgReq_HiReq";
VAL_ 803 CmptModForHp 0 "ModeCmptHp_vent" 1 "ModeCmptHp_cool" 2 "ModeCmptHp_hot" 3 "ModeCmptHp_cool_hot" 4 "ModeCmptHp_cool_defog" 5 "ModeCmptHp_hot_defog" 6 "ModeCmptHp_cool_hot_defog" 7 "ModeCmptHp_reserved";
VAL_ 803 CmptmtTReCmptmtTFrntQf 0 "CmptmtTFrntQf_SnsrDataUndefd" 1 "CmptmtTFrntQf_FanNotRunning" 2 "CmptmtTFrntQf_SnsrDataNotOk" 3 "CmptmtTFrntQf_SnsrDataOk";
VAL_ 803 CmptmtTReFanForCmptmtTRunng 0 "Flg1_Rst" 1 "Flg1_Set";
VAL_ 803 FrntHvacBlowerSts 0 "HvacFanSts_Off" 1 "HvacFanSts_On" 2 "HvacFanSts_Warning" 3 "HvacFanSts_Error";
VAL_ 803 HpReqCritSts 0 "OnOff1_Off" 1 "OnOff1_On";
VAL_ 803 HvacAirTForRowFirstAtFlrLeEvaprTQf 0 "HvacTIfQf_SnsrDataNotOk" 1 "HvacTIfQf_SnsrDataOk";
VAL_ 803 HvacAirTForRowFirstAtFlrRiEvaprTQf 0 "HvacTIfQf_SnsrDataNotOk" 1 "HvacTIfQf_SnsrDataOk";
VAL_ 803 HvacAirTForRowFirstAtVentLeEvaprTQf 0 "HvacTIfQf_SnsrDataNotOk" 1 "HvacTIfQf_SnsrDataOk";
VAL_ 803 HvacAirTForRowFirstAtVentRiEvaprTQf 0 "HvacTIfQf_SnsrDataNotOk" 1 "HvacTIfQf_SnsrDataOk";
VAL_ 803 HvacAirTForRowSecAtFlrLeEvaprTQf 0 "HvacTIfQf_SnsrDataNotOk" 1 "HvacTIfQf_SnsrDataOk";
VAL_ 803 HvacAirTForRowSecAtFlrRiEvaprTQf 0 "HvacTIfQf_SnsrDataNotOk" 1 "HvacTIfQf_SnsrDataOk";
VAL_ 803 HvacAirTForRowSecAtVentLeEvaprTQf 0 "HvacTIfQf_SnsrDataNotOk" 1 "HvacTIfQf_SnsrDataOk";
VAL_ 803 HvacAirTForRowSecAtVentRiEvaprTQf 0 "HvacTIfQf_SnsrDataNotOk" 1 "HvacTIfQf_SnsrDataOk";
VAL_ 803 HvacAirTForRowThrdAtFlrRiEvaprTQf 0 "HvacTIfQf_SnsrDataNotOk" 1 "HvacTIfQf_SnsrDataOk";
VAL_ 803 HvacAirTForRowThrdAtVentRiEvaprTQf 0 "HvacTIfQf_SnsrDataNotOk" 1 "HvacTIfQf_SnsrDataOk";
VAL_ 803 HvacCondsorTEvaprTQf 0 "HvacTIfQf_SnsrDataNotOk" 1 "HvacTIfQf_SnsrDataOk";
VAL_ 803 HvacCondsorTspEvaprTQf 0 "HvacTIfQf_SnsrDataNotOk" 1 "HvacTIfQf_SnsrDataOk";
VAL_ 803 HvacHeatrInletTempReqEvaprTQf 0 "HvacTIfQf_SnsrDataNotOk" 1 "HvacTIfQf_SnsrDataOk";
VAL_ 803 HvacOsaAndRecActrQfForHp 0 "Err1_NoErr" 1 "Err1_Err";
VAL_ 803 HvahHeatgReq 0 "OnOff1_Off" 1 "OnOff1_On";
VAL_ 803 MirrDefrstAtPassSts 0 "OnOff1_Off" 1 "OnOff1_On";
VAL_ 803 ReEvapVlvSts 0 "EvaprVlvSts_VlvReqdToClsd" 1 "EvaprVlvSts_VlvReqdToOpen" 2 "EvaprVlvSts_ElecErrByCircOpen" 3 "EvaprVlvSts_ElecErrShoToGnd" 4 "EvaprVlvSts_ElecErrShoToPwrSply" 5 "EvaprVlvSts_Resd";
VAL_ 803 ReHvacBlowerSts 0 "HvacFanSts_Off" 1 "HvacFanSts_On" 2 "HvacFanSts_Warning" 3 "HvacFanSts_Error";
VAL_ 803 ReHvacHexAirTHvacAirTForHeatrFrntQf 0 "OkNotOk_NotOk" 1 "OkNotOk_Ok";
VAL_ 803 RemClimaActv 0 "OnOff1_Off" 1 "OnOff1_On";
VAL_ 803 UBoostReqByClima 0 "ReqSts1_NotReqd" 1 "ReqSts1_Reqd";
SIG_GROUP_ 600 ALM1Diag1 1 : ALM1Diag1BluSts ALM1Diag1GreenSts ALM1Diag1RedSts ALM1Diag1TmpSts ALM1Diag1VltSts;
SIG_GROUP_ 600 ALM1Diag10 1 : ALM1Diag10BluSts ALM1Diag10GreenSts ALM1Diag10RedSts ALM1Diag10TmpSts ALM1Diag10VltSts;
SIG_GROUP_ 600 ALM1Diag11 1 : ALM1Diag11BluSts ALM1Diag11GreenSts ALM1Diag11RedSts ALM1Diag11TmpSts ALM1Diag11VltSts;
SIG_GROUP_ 600 ALM1Diag12 1 : ALM1Diag12BluSts ALM1Diag12GreenSts ALM1Diag12RedSts ALM1Diag12TmpSts ALM1Diag12VltSts;
SIG_GROUP_ 600 ALM1Diag13 1 : ALM1Diag13BluSts ALM1Diag13GreenSts ALM1Diag13RedSts ALM1Diag13TmpSts ALM1Diag13VltSts;
SIG_GROUP_ 600 ALM1Diag14 1 : ALM1Diag14BluSts ALM1Diag14GreenSts ALM1Diag14RedSts ALM1Diag14TmpSts ALM1Diag14VltSts;
SIG_GROUP_ 600 ALM1Diag15 1 : ALM1Diag15BluSts ALM1Diag15GreenSts ALM1Diag15RedSts ALM1Diag15TmpSts ALM1Diag15VltSts;
SIG_GROUP_ 600 ALM1Diag16 1 : ALM1Diag16BluSts ALM1Diag16GreenSts ALM1Diag16RedSts ALM1Diag16TmpSts ALM1Diag16VltSts;
SIG_GROUP_ 600 ALM1Diag2 1 : ALM1Diag2BluSts ALM1Diag2GreenSts ALM1Diag2RedSts ALM1Diag2TmpSts ALM1Diag2VltSts;
SIG_GROUP_ 600 ALM1Diag3 1 : ALM1Diag3BluSts ALM1Diag3GreenSts ALM1Diag3RedSts ALM1Diag3TmpSts ALM1Diag3VltSts;
SIG_GROUP_ 600 ALM1Diag4 1 : ALM1Diag4BluSts ALM1Diag4GreenSts ALM1Diag4RedSts ALM1Diag4TmpSts ALM1Diag4VltSts;
SIG_GROUP_ 600 ALM1Diag5 1 : ALM1Diag5BluSts ALM1Diag5GreenSts ALM1Diag5RedSts ALM1Diag5TmpSts ALM1Diag5VltSts;
SIG_GROUP_ 600 ALM1Diag6 1 : ALM1Diag6BluSts ALM1Diag6GreenSts ALM1Diag6RedSts ALM1Diag6TmpSts ALM1Diag6VltSts;
SIG_GROUP_ 600 ALM1Diag7 1 : ALM1Diag7BluSts ALM1Diag7GreenSts ALM1Diag7RedSts ALM1Diag7TmpSts ALM1Diag7VltSts;
SIG_GROUP_ 600 ALM1Diag8 1 : ALM1Diag8BluSts ALM1Diag8GreenSts ALM1Diag8RedSts ALM1Diag8TmpSts ALM1Diag8VltSts;
SIG_GROUP_ 600 ALM1Diag9 1 : ALM1Diag9BluSts ALM1Diag9GreenSts ALM1Diag9RedSts ALM1Diag9TmpSts ALM1Diag9VltSts;
SIG_GROUP_ 600 ALM2Diag1 1 : ALM2Diag1BluSts ALM2Diag1GreenSts ALM2Diag1RedSts ALM2Diag1TmpSts ALM2Diag1VltSts;
SIG_GROUP_ 600 ALM2Diag10 1 : ALM2Diag10BluSts ALM2Diag10GreenSts ALM2Diag10RedSts ALM2Diag10TmpSts ALM2Diag10VltSts;
SIG_GROUP_ 600 ALM2Diag11 1 : ALM2Diag11BluSts ALM2Diag11GreenSts ALM2Diag11RedSts ALM2Diag11TmpSts ALM2Diag11VltSts;
SIG_GROUP_ 600 ALM2Diag12 1 : ALM2Diag12BluSts ALM2Diag12GreenSts ALM2Diag12RedSts ALM2Diag12TmpSts ALM2Diag12VltSts;
SIG_GROUP_ 600 ALM2Diag13 1 : ALM2Diag13BluSts ALM2Diag13GreenSts ALM2Diag13RedSts ALM2Diag13TmpSts ALM2Diag13VltSts;
SIG_GROUP_ 600 ALM2Diag14 1 : ALM2Diag14BluSts ALM2Diag14GreenSts ALM2Diag14RedSts ALM2Diag14TmpSts ALM2Diag14VltSts;
SIG_GROUP_ 600 ALM2Diag15 1 : ALM2Diag15BluSts ALM2Diag15GreenSts ALM2Diag15RedSts ALM2Diag15TmpSts ALM2Diag15VltSts;
SIG_GROUP_ 600 ALM2Diag16 1 : ALM2Diag16BluSts ALM2Diag16GreenSts ALM2Diag16RedSts ALM2Diag16TmpSts ALM2Diag16VltSts;
SIG_GROUP_ 600 ALM2Diag2 1 : ALM2Diag2BluSts ALM2Diag2GreenSts ALM2Diag2RedSts ALM2Diag2TmpSts ALM2Diag2VltSts;
SIG_GROUP_ 600 ALM2Diag3 1 : ALM2Diag3BluSts ALM2Diag3GreenSts ALM2Diag3RedSts ALM2Diag3TmpSts ALM2Diag3VltSts;
SIG_GROUP_ 600 ALM2Diag4 1 : ALM2Diag4BluSts ALM2Diag4GreenSts ALM2Diag4RedSts ALM2Diag4TmpSts ALM2Diag4VltSts;
SIG_GROUP_ 600 ALM2Diag5 1 : ALM2Diag5BluSts ALM2Diag5GreenSts ALM2Diag5RedSts ALM2Diag5TmpSts ALM2Diag5VltSts;
SIG_GROUP_ 600 ALM2Diag6 1 : ALM2Diag6BluSts ALM2Diag6GreenSts ALM2Diag6RedSts ALM2Diag6TmpSts ALM2Diag6VltSts;
SIG_GROUP_ 600 ALM2Diag7 1 : ALM2Diag7BluSts ALM2Diag7GreenSts ALM2Diag7RedSts ALM2Diag7TmpSts ALM2Diag7VltSts;
SIG_GROUP_ 600 ALM2Diag8 1 : ALM2Diag8BluSts ALM2Diag8GreenSts ALM2Diag8RedSts ALM2Diag8TmpSts ALM2Diag8VltSts;
SIG_GROUP_ 600 ALM2Diag9 1 : ALM2Diag9BluSts ALM2Diag9GreenSts ALM2Diag9RedSts ALM2Diag9TmpSts ALM2Diag9VltSts;
SIG_GROUP_ 801 AmbTEstimd 1 : AmbTEstimdAmbTEstimd AmbTEstimdQf;
SIG_GROUP_ 520 AmbTRawAtPassSide 1 : AmbTRawAtPassSideAmbTVal AmbTRawAtPassSideQly;
SIG_GROUP_ 671 BltCrashNotif 1 : BltCrashNotifDrvr BltCrashNotifPass;
SIG_GROUP_ 801 CmptmtAirTEstimdExtd 1 : CmptmtAirTEstimdExtdComptmtT CmptmtAirTEstimdExtdQlyFlg;
SIG_GROUP_ 1184 CmptmtIntrMtrlTEstimd 1 : CmptmtIntrMtrlTEstimdMtrlSnsrT CmptmtIntrMtrlTEstimdMtrlSnsrTQly2;
SIG_GROUP_ 310 CmptmtTFrnt 1 : CmptmtTFrntCmptmtTFrnt CmptmtTFrntFanForCmptmtTRunng CmptmtTFrntQf;
SIG_GROUP_ 803 CmptmtTRe 1 : CmptmtTReCmptmtTFrnt CmptmtTReCmptmtTFrntQf CmptmtTReFanForCmptmtTRunng;
SIG_GROUP_ 328 CrabMovStLiReq 1 : CrabMovStLiReqChks CrabMovStLiReqCntr CrabMovStLiReqStLiReq;
SIG_GROUP_ 58 DoorPassReCinhIntFailInf 1 : DoorPassReCinhIntFailInfCinchFlt1 DoorPassReCinhIntFailInfCinchRestFlt;
SIG_GROUP_ 58 DoorPassReRelsFail 1 : DoorPassReRelsFailCinchOverTimed DoorPassReRelsFailFailure1 DoorPassReRelsFailMechRels;
SIG_GROUP_ 803 DvlpFrameForCCM 1 : DvlpFrameForCCMByte0 DvlpFrameForCCMByte1 DvlpFrameForCCMByte2 DvlpFrameForCCMByte3 DvlpFrameForCCMByte4 DvlpFrameForCCMByte5 DvlpFrameForCCMByte6 DvlpFrameForCCMByte7;
SIG_GROUP_ 600 ElecDefrstReq 1 : ElecDefrstReqMirrDefrstReq ElecDefrstReqWinDefrstFrntReq ElecDefrstReqWinDefrstReReq;
SIG_GROUP_ 310 EvaprTFrnt 1 : EvaprTFrntEvaprTFrnt EvaprTFrntEvaprTQf;
SIG_GROUP_ 600 EvaprTRe 1 : EvaprTReEvaprTFrnt EvaprTReEvaprTQf;
SIG_GROUP_ 803 HvacAirTForRowFirstAtFlrLe 1 : HvacAirTForRowFirstAtFlrLeEvaprTFrnt HvacAirTForRowFirstAtFlrLeEvaprTQf;
SIG_GROUP_ 803 HvacAirTForRowFirstAtFlrRi 1 : HvacAirTForRowFirstAtFlrRiEvaprTFrnt HvacAirTForRowFirstAtFlrRiEvaprTQf;
SIG_GROUP_ 803 HvacAirTForRowFirstAtVentLe 1 : HvacAirTForRowFirstAtVentLeEvaprTFrnt HvacAirTForRowFirstAtVentLeEvaprTQf;
SIG_GROUP_ 803 HvacAirTForRowFirstAtVentRi 1 : HvacAirTForRowFirstAtVentRiEvaprTFrnt HvacAirTForRowFirstAtVentRiEvaprTQf;
SIG_GROUP_ 803 HvacAirTForRowSecAtFlrLe 1 : HvacAirTForRowSecAtFlrLeEvaprTFrnt HvacAirTForRowSecAtFlrLeEvaprTQf;
SIG_GROUP_ 803 HvacAirTForRowSecAtFlrRi 1 : HvacAirTForRowSecAtFlrRiEvaprTFrnt HvacAirTForRowSecAtFlrRiEvaprTQf;
SIG_GROUP_ 803 HvacAirTForRowSecAtVentLe 1 : HvacAirTForRowSecAtVentLeEvaprTFrnt HvacAirTForRowSecAtVentLeEvaprTQf;
SIG_GROUP_ 803 HvacAirTForRowSecAtVentRi 1 : HvacAirTForRowSecAtVentRiEvaprTFrnt HvacAirTForRowSecAtVentRiEvaprTQf;
SIG_GROUP_ 803 HvacAirTForRowThrdAtFlrRi 1 : HvacAirTForRowThrdAtFlrRiEvaprTFrnt HvacAirTForRowThrdAtFlrRiEvaprTQf;
SIG_GROUP_ 803 HvacAirTForRowThrdAtVentRi 1 : HvacAirTForRowThrdAtVentRiEvaprTFrnt HvacAirTForRowThrdAtVentRiEvaprTQf;
SIG_GROUP_ 803 HvacCondsorT 1 : HvacCondsorTEvaprTFrnt HvacCondsorTEvaprTQf;
SIG_GROUP_ 803 HvacCondsorTsp 1 : HvacCondsorTspEvaprTFrnt HvacCondsorTspEvaprTQf;
SIG_GROUP_ 803 HvacHeatrInletTempReq 1 : HvacHeatrInletTempReqEvaprTFrnt HvacHeatrInletTempReqEvaprTQf;
SIG_GROUP_ 600 HvacHexAirTFirstLe 1 : HvacHexAirTFirstLeHvacAirTForHeatrFrnt HvacHexAirTFirstLeHvacAirTForHeatrFrntQf;
SIG_GROUP_ 600 HvacHexAirTFirstRi 1 : HvacHexAirTFirstRiHvacAirTForHeatrFrnt HvacHexAirTFirstRiHvacAirTForHeatrFrntQf;
SIG_GROUP_ 600 HvacHexAirTSecLe 1 : HvacHexAirTSecLeHvacAirTForHeatrFrnt HvacHexAirTSecLeHvacAirTForHeatrFrntQf;
SIG_GROUP_ 310 HvahAirTEstmd 1 : HvahAirTEstmdEvaprTFrnt HvahAirTEstmdEvaprTQf;
SIG_GROUP_ 328 LowSpdStrStLiReq 1 : LowSpdStrStLiReqChks LowSpdStrStLiReqCntr LowSpdStrStLiReqStLiReq;
SIG_GROUP_ 310 MirrPosnToSetTarPosnAtPass 1 : MirrPosnToSetTarPosnAtPassMirrAdjLeRi MirrPosnToSetTarPosnAtPassMirrAdjUpDown;
SIG_GROUP_ 328 NFCKeyReadStsToHMI2 1 : NFCKeyReadStsToHMI2Key0 NFCKeyReadStsToHMI2Key1 NFCKeyReadStsToHMI2Key10 NFCKeyReadStsToHMI2Key11 NFCKeyReadStsToHMI2Key12 NFCKeyReadStsToHMI2Key13 NFCKeyReadStsToHMI2Key14 NFCKeyReadStsToHMI2Key15 NFCKeyReadStsToHMI2Key16 NFCKeyReadStsToHMI2Key17 NFCKeyReadStsToHMI2Key18 NFCKeyReadStsToHMI2Key19 NFCKeyReadStsToHMI2Key2 NFCKeyReadStsToHMI2Key20 NFCKeyReadStsToHMI2Key21 NFCKeyReadStsToHMI2Key22 NFCKeyReadStsToHMI2Key23 NFCKeyReadStsToHMI2Key24 NFCKeyReadStsToHMI2Key25 NFCKeyReadStsToHMI2Key26 NFCKeyReadStsToHMI2Key27 NFCKeyReadStsToHMI2Key28 NFCKeyReadStsToHMI2Key29 NFCKeyReadStsToHMI2Key3 NFCKeyReadStsToHMI2Key30 NFCKeyReadStsToHMI2Key31 NFCKeyReadStsToHMI2Key32 NFCKeyReadStsToHMI2Key33 NFCKeyReadStsToHMI2Key34 NFCKeyReadStsToHMI2Key35 NFCKeyReadStsToHMI2Key4 NFCKeyReadStsToHMI2Key5 NFCKeyReadStsToHMI2Key6 NFCKeyReadStsToHMI2Key7 NFCKeyReadStsToHMI2Key8 NFCKeyReadStsToHMI2Key9;
SIG_GROUP_ 1184 OutdAirQly 1 : OutdAirQlyOutdAirQly OutdAirQlyQf;
SIG_GROUP_ 441 PassSeatCushDownPosPerc 1 : PassSeatCushDownPosPercSeatPosPerc PassSeatCushDownPosPercSeatPosQf;
SIG_GROUP_ 520 PassSeatIntgrSwtSts 1 : PassSeatIntgrSwtStsIntgrSwtHozlSts PassSeatIntgrSwtStsIntgrSwtRotSts PassSeatIntgrSwtStsIntgrSwtSelnSts PassSeatIntgrSwtStsIntgrSwtVertSts;
SIG_GROUP_ 310 PassSeatPosFrntExtPerc 1 : PassSeatPosFrntExtPercSeatPosPerc PassSeatPosFrntExtPercSeatPosQf;
SIG_GROUP_ 441 PassSeatPosPerc 1 : PassSeatPosPercSeatPosFrntHeiPerc PassSeatPosPercSeatPosFrntHeiQF PassSeatPosPercSeatPosHeiPerc PassSeatPosPercSeatPosHeiQF PassSeatPosPercSeatPosSldPerc PassSeatPosPercSeatPosSldQF;
SIG_GROUP_ 803 ReHvacHexAirT 1 : ReHvacHexAirTHvacAirTForHeatrFrnt ReHvacHexAirTHvacAirTForHeatrFrntQf;
SIG_GROUP_ 310 RemActvSts 1 : RemActvStsRemClimaActvSts RemActvStsRemDefrstSts;
SIG_GROUP_ 310 RemClimaElecDefrstReq 1 : RemClimaElecDefrstReqMirrDefrstReq RemClimaElecDefrstReqWinDefrstFrntReq RemClimaElecDefrstReqWinDefrstReReq;
SIG_GROUP_ 600 SeatClimaDurgClima 1 : SeatClimaDurgClimaHmiSeatHeatgForRowFirstLe SeatClimaDurgClimaHmiSeatHeatgForRowFirstRi SeatClimaDurgClimaHmiSeatHeatgForRowSecLe SeatClimaDurgClimaHmiSeatHeatgForRowSecRi SeatClimaDurgClimaHmiSeatVentnForRowFirstLe SeatClimaDurgClimaHmiSeatVentnForRowFirstRi SeatClimaDurgClimaHmiSeatVentnForRowSecLe SeatClimaDurgClimaHmiSeatVentnForRowSecRi;
SIG_GROUP_ 310 SeatMassgFctPass 1 : SeatMassgFctPassMassgInten SeatMassgFctPassMassgProg SeatMassgFctPassOnOff;
SIG_GROUP_ 671 SuspStabyCritFailrDetd 1 : SuspStabyCritFailrDetdChks SuspStabyCritFailrDetdCntr SuspStabyCritFailrDetdSts;
SIG_GROUP_ 1348 VFCVectorZCUDM 1 : VFCVectorZCUDMBlockID VFCVectorZCUDMVFCid0 VFCVectorZCUDMVFCid1 VFCVectorZCUDMVFCid10 VFCVectorZCUDMVFCid11 VFCVectorZCUDMVFCid12 VFCVectorZCUDMVFCid13 VFCVectorZCUDMVFCid14 VFCVectorZCUDMVFCid15 VFCVectorZCUDMVFCid16 VFCVectorZCUDMVFCid17 VFCVectorZCUDMVFCid18 VFCVectorZCUDMVFCid19 VFCVectorZCUDMVFCid2 VFCVectorZCUDMVFCid20 VFCVectorZCUDMVFCid21 VFCVectorZCUDMVFCid22 VFCVectorZCUDMVFCid23 VFCVectorZCUDMVFCid24 VFCVectorZCUDMVFCid25 VFCVectorZCUDMVFCid26 VFCVectorZCUDMVFCid27 VFCVectorZCUDMVFCid28 VFCVectorZCUDMVFCid29 VFCVectorZCUDMVFCid3 VFCVectorZCUDMVFCid30 VFCVectorZCUDMVFCid31 VFCVectorZCUDMVFCid32 VFCVectorZCUDMVFCid33 VFCVectorZCUDMVFCid34 VFCVectorZCUDMVFCid35 VFCVectorZCUDMVFCid36 VFCVectorZCUDMVFCid37 VFCVectorZCUDMVFCid38 VFCVectorZCUDMVFCid39 VFCVectorZCUDMVFCid4 VFCVectorZCUDMVFCid40 VFCVectorZCUDMVFCid41 VFCVectorZCUDMVFCid42 VFCVectorZCUDMVFCid43 VFCVectorZCUDMVFCid44 VFCVectorZCUDMVFCid45 VFCVectorZCUDMVFCid46 VFCVectorZCUDMVFCid47 VFCVectorZCUDMVFCid48 VFCVectorZCUDMVFCid49 VFCVectorZCUDMVFCid5 VFCVectorZCUDMVFCid50 VFCVectorZCUDMVFCid51 VFCVectorZCUDMVFCid52 VFCVectorZCUDMVFCid53 VFCVectorZCUDMVFCid54 VFCVectorZCUDMVFCid55 VFCVectorZCUDMVFCid56 VFCVectorZCUDMVFCid57 VFCVectorZCUDMVFCid58 VFCVectorZCUDMVFCid59 VFCVectorZCUDMVFCid6 VFCVectorZCUDMVFCid60 VFCVectorZCUDMVFCid61 VFCVectorZCUDMVFCid7 VFCVectorZCUDMVFCid8 VFCVectorZCUDMVFCid9;
SIG_GROUP_ 1379 ZCUPdevelpsignalgroupResp 1 : ZCUPdevelpsignalgroupRespFunctiondevpsignalgroup1 ZCUPdevelpsignalgroupRespFunctiondevpsignalgroup2 ZCUPdevelpsignalgroupRespFunctiondevpsignalgroup3 ZCUPdevelpsignalgroupRespFunctiondevpsignalgroup4 ZCUPdevelpsignalgroupRespFunctiondevpsignalgroup5 ZCUPdevelpsignalgroupRespFunctiondevpsignalgroup6 ZCUPdevelpsignalgroupRespFunctiondevpsignalgroup7 ZCUPdevelpsignalgroupRespFunctiondevpsignalgroup8;
