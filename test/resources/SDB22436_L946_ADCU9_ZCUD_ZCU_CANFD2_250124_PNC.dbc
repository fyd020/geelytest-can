// *************************************************************************** *
// *                                                                           *
// * Description:         CANDB File                                           *
// * Generated at:        2025-01-24 14:38                                     *
// * System:              SDB22436                                             *
// * Variant:             L946_ADCU9_ZCUD                                      *
// * Network:             ZCU_CANFD2                                           *
// *                                                                           *
// *************************************************************************** *
VERSION "ZCU_CANFD2"

NS_ :

BS_ :

BU_ :  ETC IHU ZCUD ZCUP

BO_ 52 ZCUDZCUCANFD2Fr26 : 64 ZCUD
 SG_ BodyDataTraceZCUDM1_UB : 511|1@0+ (1,0) [0|1] "" IHU,ZCUP
 SG_ BodyDataTraceZCUDM1Functiondevpsignalgroup1 : 7|8@0+ (1.0,0.0) [0.0|255.0] "Unitless" IHU,ZCUP
 SG_ BodyDataTraceZCUDM1Functiondevpsignalgroup2 : 15|8@0+ (1.0,0.0) [0.0|255.0] "Unitless" IHU,ZCUP
 SG_ BodyDataTraceZCUDM1Functiondevpsignalgroup3 : 23|8@0+ (1.0,0.0) [0.0|255.0] "Unitless" IHU,ZCUP
 SG_ BodyDataTraceZCUDM1Functiondevpsignalgroup4 : 31|8@0+ (1.0,0.0) [0.0|255.0] "Unitless" IHU,ZCUP
 SG_ BodyDataTraceZCUDM1Functiondevpsignalgroup5 : 39|8@0+ (1.0,0.0) [0.0|255.0] "Unitless" IHU,ZCUP
 SG_ BodyDataTraceZCUDM1Functiondevpsignalgroup6 : 47|8@0+ (1.0,0.0) [0.0|255.0] "Unitless" IHU,ZCUP
 SG_ BodyDataTraceZCUDM1Functiondevpsignalgroup7 : 55|8@0+ (1.0,0.0) [0.0|255.0] "Unitless" IHU,ZCUP
 SG_ BodyDataTraceZCUDM1Functiondevpsignalgroup8 : 63|8@0+ (1.0,0.0) [0.0|255.0] "Unitless" IHU,ZCUP
 SG_ BodyDataTraceZCUDM2_UB : 510|1@0+ (1,0) [0|1] "" IHU,ZCUP
 SG_ BodyDataTraceZCUDM2Functiondevpsignalgroup1 : 71|8@0+ (1.0,0.0) [0.0|255.0] "Unitless" IHU,ZCUP
 SG_ BodyDataTraceZCUDM2Functiondevpsignalgroup2 : 79|8@0+ (1.0,0.0) [0.0|255.0] "Unitless" IHU,ZCUP
 SG_ BodyDataTraceZCUDM2Functiondevpsignalgroup3 : 87|8@0+ (1.0,0.0) [0.0|255.0] "Unitless" IHU,ZCUP
 SG_ BodyDataTraceZCUDM2Functiondevpsignalgroup4 : 95|8@0+ (1.0,0.0) [0.0|255.0] "Unitless" IHU,ZCUP
 SG_ BodyDataTraceZCUDM2Functiondevpsignalgroup5 : 103|8@0+ (1.0,0.0) [0.0|255.0] "Unitless" IHU,ZCUP
 SG_ BodyDataTraceZCUDM2Functiondevpsignalgroup6 : 111|8@0+ (1.0,0.0) [0.0|255.0] "Unitless" IHU,ZCUP
 SG_ BodyDataTraceZCUDM2Functiondevpsignalgroup7 : 119|8@0+ (1.0,0.0) [0.0|255.0] "Unitless" IHU,ZCUP
 SG_ BodyDataTraceZCUDM2Functiondevpsignalgroup8 : 127|8@0+ (1.0,0.0) [0.0|255.0] "Unitless" IHU,ZCUP
 SG_ BodyDataTraceZCUDM3_UB : 509|1@0+ (1,0) [0|1] "" IHU,ZCUP
 SG_ BodyDataTraceZCUDM3Functiondevpsignalgroup1 : 135|8@0+ (1.0,0.0) [0.0|255.0] "Unitless" IHU,ZCUP
 SG_ BodyDataTraceZCUDM3Functiondevpsignalgroup2 : 143|8@0+ (1.0,0.0) [0.0|255.0] "Unitless" IHU,ZCUP
 SG_ BodyDataTraceZCUDM3Functiondevpsignalgroup3 : 151|8@0+ (1.0,0.0) [0.0|255.0] "Unitless" IHU,ZCUP
 SG_ BodyDataTraceZCUDM3Functiondevpsignalgroup4 : 159|8@0+ (1.0,0.0) [0.0|255.0] "Unitless" IHU,ZCUP
 SG_ BodyDataTraceZCUDM3Functiondevpsignalgroup5 : 167|8@0+ (1.0,0.0) [0.0|255.0] "Unitless" IHU,ZCUP
 SG_ BodyDataTraceZCUDM3Functiondevpsignalgroup6 : 175|8@0+ (1.0,0.0) [0.0|255.0] "Unitless" IHU,ZCUP
 SG_ BodyDataTraceZCUDM3Functiondevpsignalgroup7 : 183|8@0+ (1.0,0.0) [0.0|255.0] "Unitless" IHU,ZCUP
 SG_ BodyDataTraceZCUDM3Functiondevpsignalgroup8 : 191|8@0+ (1.0,0.0) [0.0|255.0] "Unitless" IHU,ZCUP
 SG_ BodyDataTraceZCUDM4_UB : 508|1@0+ (1,0) [0|1] "" IHU,ZCUP
 SG_ BodyDataTraceZCUDM4Functiondevpsignalgroup1 : 199|8@0+ (1.0,0.0) [0.0|255.0] "Unitless" IHU,ZCUP
 SG_ BodyDataTraceZCUDM4Functiondevpsignalgroup2 : 207|8@0+ (1.0,0.0) [0.0|255.0] "Unitless" IHU,ZCUP
 SG_ BodyDataTraceZCUDM4Functiondevpsignalgroup3 : 215|8@0+ (1.0,0.0) [0.0|255.0] "Unitless" IHU,ZCUP
 SG_ BodyDataTraceZCUDM4Functiondevpsignalgroup4 : 223|8@0+ (1.0,0.0) [0.0|255.0] "Unitless" IHU,ZCUP
 SG_ BodyDataTraceZCUDM4Functiondevpsignalgroup5 : 231|8@0+ (1.0,0.0) [0.0|255.0] "Unitless" IHU,ZCUP
 SG_ BodyDataTraceZCUDM4Functiondevpsignalgroup6 : 239|8@0+ (1.0,0.0) [0.0|255.0] "Unitless" IHU,ZCUP
 SG_ BodyDataTraceZCUDM4Functiondevpsignalgroup7 : 247|8@0+ (1.0,0.0) [0.0|255.0] "Unitless" IHU,ZCUP
 SG_ BodyDataTraceZCUDM4Functiondevpsignalgroup8 : 255|8@0+ (1.0,0.0) [0.0|255.0] "Unitless" IHU,ZCUP
 SG_ BodyDataTraceZCUDM5_UB : 507|1@0+ (1,0) [0|1] "" IHU,ZCUP
 SG_ BodyDataTraceZCUDM5Functiondevpsignalgroup1 : 263|8@0+ (1.0,0.0) [0.0|255.0] "Unitless" IHU,ZCUP
 SG_ BodyDataTraceZCUDM5Functiondevpsignalgroup2 : 271|8@0+ (1.0,0.0) [0.0|255.0] "Unitless" IHU,ZCUP
 SG_ BodyDataTraceZCUDM5Functiondevpsignalgroup3 : 279|8@0+ (1.0,0.0) [0.0|255.0] "Unitless" IHU,ZCUP
 SG_ BodyDataTraceZCUDM5Functiondevpsignalgroup4 : 287|8@0+ (1.0,0.0) [0.0|255.0] "Unitless" IHU,ZCUP
 SG_ BodyDataTraceZCUDM5Functiondevpsignalgroup5 : 295|8@0+ (1.0,0.0) [0.0|255.0] "Unitless" IHU,ZCUP
 SG_ BodyDataTraceZCUDM5Functiondevpsignalgroup6 : 303|8@0+ (1.0,0.0) [0.0|255.0] "Unitless" IHU,ZCUP
 SG_ BodyDataTraceZCUDM5Functiondevpsignalgroup7 : 311|8@0+ (1.0,0.0) [0.0|255.0] "Unitless" IHU,ZCUP
 SG_ BodyDataTraceZCUDM5Functiondevpsignalgroup8 : 319|8@0+ (1.0,0.0) [0.0|255.0] "Unitless" IHU,ZCUP
 SG_ BodyDataTraceZCUDM6_UB : 506|1@0+ (1,0) [0|1] "" IHU,ZCUP
 SG_ BodyDataTraceZCUDM6Functiondevpsignalgroup1 : 327|8@0+ (1.0,0.0) [0.0|255.0] "Unitless" IHU,ZCUP
 SG_ BodyDataTraceZCUDM6Functiondevpsignalgroup2 : 335|8@0+ (1.0,0.0) [0.0|255.0] "Unitless" IHU,ZCUP
 SG_ BodyDataTraceZCUDM6Functiondevpsignalgroup3 : 343|8@0+ (1.0,0.0) [0.0|255.0] "Unitless" IHU,ZCUP
 SG_ BodyDataTraceZCUDM6Functiondevpsignalgroup4 : 351|8@0+ (1.0,0.0) [0.0|255.0] "Unitless" IHU,ZCUP
 SG_ BodyDataTraceZCUDM6Functiondevpsignalgroup5 : 359|8@0+ (1.0,0.0) [0.0|255.0] "Unitless" IHU,ZCUP
 SG_ BodyDataTraceZCUDM6Functiondevpsignalgroup6 : 367|8@0+ (1.0,0.0) [0.0|255.0] "Unitless" IHU,ZCUP
 SG_ BodyDataTraceZCUDM6Functiondevpsignalgroup7 : 375|8@0+ (1.0,0.0) [0.0|255.0] "Unitless" IHU,ZCUP
 SG_ BodyDataTraceZCUDM6Functiondevpsignalgroup8 : 383|8@0+ (1.0,0.0) [0.0|255.0] "Unitless" IHU,ZCUP
 SG_ BodyDataTraceZCUDM7_UB : 505|1@0+ (1,0) [0|1] "" IHU,ZCUP
 SG_ BodyDataTraceZCUDM7Functiondevpsignalgroup1 : 391|8@0+ (1.0,0.0) [0.0|255.0] "Unitless" IHU,ZCUP
 SG_ BodyDataTraceZCUDM7Functiondevpsignalgroup2 : 399|8@0+ (1.0,0.0) [0.0|255.0] "Unitless" IHU,ZCUP
 SG_ BodyDataTraceZCUDM7Functiondevpsignalgroup3 : 407|8@0+ (1.0,0.0) [0.0|255.0] "Unitless" IHU,ZCUP
 SG_ BodyDataTraceZCUDM7Functiondevpsignalgroup4 : 415|8@0+ (1.0,0.0) [0.0|255.0] "Unitless" IHU,ZCUP
 SG_ BodyDataTraceZCUDM7Functiondevpsignalgroup5 : 423|8@0+ (1.0,0.0) [0.0|255.0] "Unitless" IHU,ZCUP
 SG_ BodyDataTraceZCUDM7Functiondevpsignalgroup6 : 431|8@0+ (1.0,0.0) [0.0|255.0] "Unitless" IHU,ZCUP
 SG_ BodyDataTraceZCUDM7Functiondevpsignalgroup7 : 439|8@0+ (1.0,0.0) [0.0|255.0] "Unitless" IHU,ZCUP
 SG_ BodyDataTraceZCUDM7Functiondevpsignalgroup8 : 447|8@0+ (1.0,0.0) [0.0|255.0] "Unitless" IHU,ZCUP

BO_ 552 ZCUDZCUCANFD2Fr27 : 64 ZCUD
 SG_ ECM4BigData_UB : 7|1@0+ (1,0) [0|1] "" IHU
 SG_ ECM4BigDataCnt : 6|7@0+ (1.0,0.0) [0.0|127.0] "Unitless" IHU
 SG_ ECM4BigDataData1 : 15|8@0+ (1.0,0.0) [0.0|255.0] "Unitless" IHU
 SG_ ECM4BigDataData10 : 87|8@0+ (1.0,0.0) [0.0|255.0] "Unitless" IHU
 SG_ ECM4BigDataData11 : 95|8@0+ (1.0,0.0) [0.0|255.0] "Unitless" IHU
 SG_ ECM4BigDataData12 : 103|8@0+ (1.0,0.0) [0.0|255.0] "Unitless" IHU
 SG_ ECM4BigDataData13 : 111|8@0+ (1.0,0.0) [0.0|255.0] "Unitless" IHU
 SG_ ECM4BigDataData14 : 119|8@0+ (1.0,0.0) [0.0|255.0] "Unitless" IHU
 SG_ ECM4BigDataData15 : 127|8@0+ (1.0,0.0) [0.0|255.0] "Unitless" IHU
 SG_ ECM4BigDataData16 : 135|8@0+ (1.0,0.0) [0.0|255.0] "Unitless" IHU
 SG_ ECM4BigDataData17 : 143|8@0+ (1.0,0.0) [0.0|255.0] "Unitless" IHU
 SG_ ECM4BigDataData18 : 151|8@0+ (1.0,0.0) [0.0|255.0] "Unitless" IHU
 SG_ ECM4BigDataData19 : 159|8@0+ (1.0,0.0) [0.0|255.0] "Unitless" IHU
 SG_ ECM4BigDataData2 : 23|8@0+ (1.0,0.0) [0.0|255.0] "Unitless" IHU
 SG_ ECM4BigDataData20 : 167|8@0+ (1.0,0.0) [0.0|255.0] "Unitless" IHU
 SG_ ECM4BigDataData21 : 175|8@0+ (1.0,0.0) [0.0|255.0] "Unitless" IHU
 SG_ ECM4BigDataData22 : 183|8@0+ (1.0,0.0) [0.0|255.0] "Unitless" IHU
 SG_ ECM4BigDataData23 : 191|8@0+ (1.0,0.0) [0.0|255.0] "Unitless" IHU
 SG_ ECM4BigDataData24 : 199|8@0+ (1.0,0.0) [0.0|255.0] "Unitless" IHU
 SG_ ECM4BigDataData25 : 207|8@0+ (1.0,0.0) [0.0|255.0] "Unitless" IHU
 SG_ ECM4BigDataData26 : 215|8@0+ (1.0,0.0) [0.0|255.0] "Unitless" IHU
 SG_ ECM4BigDataData27 : 223|8@0+ (1.0,0.0) [0.0|255.0] "Unitless" IHU
 SG_ ECM4BigDataData28 : 231|8@0+ (1.0,0.0) [0.0|255.0] "Unitless" IHU
 SG_ ECM4BigDataData29 : 239|8@0+ (1.0,0.0) [0.0|255.0] "Unitless" IHU
 SG_ ECM4BigDataData3 : 31|8@0+ (1.0,0.0) [0.0|255.0] "Unitless" IHU
 SG_ ECM4BigDataData30 : 247|8@0+ (1.0,0.0) [0.0|255.0] "Unitless" IHU
 SG_ ECM4BigDataData31 : 255|8@0+ (1.0,0.0) [0.0|255.0] "Unitless" IHU
 SG_ ECM4BigDataData32 : 263|8@0+ (1.0,0.0) [0.0|255.0] "Unitless" IHU
 SG_ ECM4BigDataData33 : 271|8@0+ (1.0,0.0) [0.0|255.0] "Unitless" IHU
 SG_ ECM4BigDataData34 : 279|8@0+ (1.0,0.0) [0.0|255.0] "Unitless" IHU
 SG_ ECM4BigDataData35 : 287|8@0+ (1.0,0.0) [0.0|255.0] "Unitless" IHU
 SG_ ECM4BigDataData36 : 295|8@0+ (1.0,0.0) [0.0|255.0] "Unitless" IHU
 SG_ ECM4BigDataData37 : 303|8@0+ (1.0,0.0) [0.0|255.0] "Unitless" IHU
 SG_ ECM4BigDataData38 : 311|8@0+ (1.0,0.0) [0.0|255.0] "Unitless" IHU
 SG_ ECM4BigDataData39 : 319|8@0+ (1.0,0.0) [0.0|255.0] "Unitless" IHU
 SG_ ECM4BigDataData4 : 39|8@0+ (1.0,0.0) [0.0|255.0] "Unitless" IHU
 SG_ ECM4BigDataData40 : 327|8@0+ (1.0,0.0) [0.0|255.0] "Unitless" IHU
 SG_ ECM4BigDataData41 : 335|8@0+ (1.0,0.0) [0.0|255.0] "Unitless" IHU
 SG_ ECM4BigDataData42 : 343|8@0+ (1.0,0.0) [0.0|255.0] "Unitless" IHU
 SG_ ECM4BigDataData43 : 351|8@0+ (1.0,0.0) [0.0|255.0] "Unitless" IHU
 SG_ ECM4BigDataData44 : 359|8@0+ (1.0,0.0) [0.0|255.0] "Unitless" IHU
 SG_ ECM4BigDataData45 : 367|8@0+ (1.0,0.0) [0.0|255.0] "Unitless" IHU
 SG_ ECM4BigDataData46 : 375|8@0+ (1.0,0.0) [0.0|255.0] "Unitless" IHU
 SG_ ECM4BigDataData47 : 383|8@0+ (1.0,0.0) [0.0|255.0] "Unitless" IHU
 SG_ ECM4BigDataData48 : 391|8@0+ (1.0,0.0) [0.0|255.0] "Unitless" IHU
 SG_ ECM4BigDataData49 : 399|8@0+ (1.0,0.0) [0.0|255.0] "Unitless" IHU
 SG_ ECM4BigDataData5 : 47|8@0+ (1.0,0.0) [0.0|255.0] "Unitless" IHU
 SG_ ECM4BigDataData50 : 407|8@0+ (1.0,0.0) [0.0|255.0] "Unitless" IHU
 SG_ ECM4BigDataData51 : 415|8@0+ (1.0,0.0) [0.0|255.0] "Unitless" IHU
 SG_ ECM4BigDataData52 : 423|8@0+ (1.0,0.0) [0.0|255.0] "Unitless" IHU
 SG_ ECM4BigDataData53 : 431|8@0+ (1.0,0.0) [0.0|255.0] "Unitless" IHU
 SG_ ECM4BigDataData54 : 439|8@0+ (1.0,0.0) [0.0|255.0] "Unitless" IHU
 SG_ ECM4BigDataData55 : 447|8@0+ (1.0,0.0) [0.0|255.0] "Unitless" IHU
 SG_ ECM4BigDataData56 : 455|8@0+ (1.0,0.0) [0.0|255.0] "Unitless" IHU
 SG_ ECM4BigDataData57 : 463|8@0+ (1.0,0.0) [0.0|255.0] "Unitless" IHU
 SG_ ECM4BigDataData58 : 471|8@0+ (1.0,0.0) [0.0|255.0] "Unitless" IHU
 SG_ ECM4BigDataData59 : 479|8@0+ (1.0,0.0) [0.0|255.0] "Unitless" IHU
 SG_ ECM4BigDataData6 : 55|8@0+ (1.0,0.0) [0.0|255.0] "Unitless" IHU
 SG_ ECM4BigDataData60 : 487|8@0+ (1.0,0.0) [0.0|255.0] "Unitless" IHU
 SG_ ECM4BigDataData61 : 495|8@0+ (1.0,0.0) [0.0|255.0] "Unitless" IHU
 SG_ ECM4BigDataData62 : 503|8@0+ (1.0,0.0) [0.0|255.0] "Unitless" IHU
 SG_ ECM4BigDataData63 : 511|8@0+ (1.0,0.0) [0.0|255.0] "Unitless" IHU
 SG_ ECM4BigDataData7 : 63|8@0+ (1.0,0.0) [0.0|255.0] "Unitless" IHU
 SG_ ECM4BigDataData8 : 71|8@0+ (1.0,0.0) [0.0|255.0] "Unitless" IHU
 SG_ ECM4BigDataData9 : 79|8@0+ (1.0,0.0) [0.0|255.0] "Unitless" IHU

BO_ 555 ZCUDZCUCANFD2Fr28 : 64 ZCUD
 SG_ PCMBigData_UB : 7|1@0+ (1,0) [0|1] "" IHU
 SG_ PCMBigDataCnt : 6|7@0+ (1.0,0.0) [0.0|127.0] "Unitless" IHU
 SG_ PCMBigDataData1 : 15|8@0+ (1.0,0.0) [0.0|255.0] "Unitless" IHU
 SG_ PCMBigDataData10 : 87|8@0+ (1.0,0.0) [0.0|255.0] "Unitless" IHU
 SG_ PCMBigDataData11 : 95|8@0+ (1.0,0.0) [0.0|255.0] "Unitless" IHU
 SG_ PCMBigDataData12 : 103|8@0+ (1.0,0.0) [0.0|255.0] "Unitless" IHU
 SG_ PCMBigDataData13 : 111|8@0+ (1.0,0.0) [0.0|255.0] "Unitless" IHU
 SG_ PCMBigDataData14 : 119|8@0+ (1.0,0.0) [0.0|255.0] "Unitless" IHU
 SG_ PCMBigDataData15 : 127|8@0+ (1.0,0.0) [0.0|255.0] "Unitless" IHU
 SG_ PCMBigDataData16 : 135|8@0+ (1.0,0.0) [0.0|255.0] "Unitless" IHU
 SG_ PCMBigDataData17 : 143|8@0+ (1.0,0.0) [0.0|255.0] "Unitless" IHU
 SG_ PCMBigDataData18 : 151|8@0+ (1.0,0.0) [0.0|255.0] "Unitless" IHU
 SG_ PCMBigDataData19 : 159|8@0+ (1.0,0.0) [0.0|255.0] "Unitless" IHU
 SG_ PCMBigDataData2 : 23|8@0+ (1.0,0.0) [0.0|255.0] "Unitless" IHU
 SG_ PCMBigDataData20 : 167|8@0+ (1.0,0.0) [0.0|255.0] "Unitless" IHU
 SG_ PCMBigDataData21 : 175|8@0+ (1.0,0.0) [0.0|255.0] "Unitless" IHU
 SG_ PCMBigDataData22 : 183|8@0+ (1.0,0.0) [0.0|255.0] "Unitless" IHU
 SG_ PCMBigDataData23 : 191|8@0+ (1.0,0.0) [0.0|255.0] "Unitless" IHU
 SG_ PCMBigDataData24 : 199|8@0+ (1.0,0.0) [0.0|255.0] "Unitless" IHU
 SG_ PCMBigDataData25 : 207|8@0+ (1.0,0.0) [0.0|255.0] "Unitless" IHU
 SG_ PCMBigDataData26 : 215|8@0+ (1.0,0.0) [0.0|255.0] "Unitless" IHU
 SG_ PCMBigDataData27 : 223|8@0+ (1.0,0.0) [0.0|255.0] "Unitless" IHU
 SG_ PCMBigDataData28 : 231|8@0+ (1.0,0.0) [0.0|255.0] "Unitless" IHU
 SG_ PCMBigDataData29 : 239|8@0+ (1.0,0.0) [0.0|255.0] "Unitless" IHU
 SG_ PCMBigDataData3 : 31|8@0+ (1.0,0.0) [0.0|255.0] "Unitless" IHU
 SG_ PCMBigDataData30 : 247|8@0+ (1.0,0.0) [0.0|255.0] "Unitless" IHU
 SG_ PCMBigDataData31 : 255|8@0+ (1.0,0.0) [0.0|255.0] "Unitless" IHU
 SG_ PCMBigDataData32 : 263|8@0+ (1.0,0.0) [0.0|255.0] "Unitless" IHU
 SG_ PCMBigDataData33 : 271|8@0+ (1.0,0.0) [0.0|255.0] "Unitless" IHU
 SG_ PCMBigDataData34 : 279|8@0+ (1.0,0.0) [0.0|255.0] "Unitless" IHU
 SG_ PCMBigDataData35 : 287|8@0+ (1.0,0.0) [0.0|255.0] "Unitless" IHU
 SG_ PCMBigDataData36 : 295|8@0+ (1.0,0.0) [0.0|255.0] "Unitless" IHU
 SG_ PCMBigDataData37 : 303|8@0+ (1.0,0.0) [0.0|255.0] "Unitless" IHU
 SG_ PCMBigDataData38 : 311|8@0+ (1.0,0.0) [0.0|255.0] "Unitless" IHU
 SG_ PCMBigDataData39 : 319|8@0+ (1.0,0.0) [0.0|255.0] "Unitless" IHU
 SG_ PCMBigDataData4 : 39|8@0+ (1.0,0.0) [0.0|255.0] "Unitless" IHU
 SG_ PCMBigDataData40 : 327|8@0+ (1.0,0.0) [0.0|255.0] "Unitless" IHU
 SG_ PCMBigDataData41 : 335|8@0+ (1.0,0.0) [0.0|255.0] "Unitless" IHU
 SG_ PCMBigDataData42 : 343|8@0+ (1.0,0.0) [0.0|255.0] "Unitless" IHU
 SG_ PCMBigDataData43 : 351|8@0+ (1.0,0.0) [0.0|255.0] "Unitless" IHU
 SG_ PCMBigDataData44 : 359|8@0+ (1.0,0.0) [0.0|255.0] "Unitless" IHU
 SG_ PCMBigDataData45 : 367|8@0+ (1.0,0.0) [0.0|255.0] "Unitless" IHU
 SG_ PCMBigDataData46 : 375|8@0+ (1.0,0.0) [0.0|255.0] "Unitless" IHU
 SG_ PCMBigDataData47 : 383|8@0+ (1.0,0.0) [0.0|255.0] "Unitless" IHU
 SG_ PCMBigDataData48 : 391|8@0+ (1.0,0.0) [0.0|255.0] "Unitless" IHU
 SG_ PCMBigDataData49 : 399|8@0+ (1.0,0.0) [0.0|255.0] "Unitless" IHU
 SG_ PCMBigDataData5 : 47|8@0+ (1.0,0.0) [0.0|255.0] "Unitless" IHU
 SG_ PCMBigDataData50 : 407|8@0+ (1.0,0.0) [0.0|255.0] "Unitless" IHU
 SG_ PCMBigDataData51 : 415|8@0+ (1.0,0.0) [0.0|255.0] "Unitless" IHU
 SG_ PCMBigDataData52 : 423|8@0+ (1.0,0.0) [0.0|255.0] "Unitless" IHU
 SG_ PCMBigDataData53 : 431|8@0+ (1.0,0.0) [0.0|255.0] "Unitless" IHU
 SG_ PCMBigDataData54 : 439|8@0+ (1.0,0.0) [0.0|255.0] "Unitless" IHU
 SG_ PCMBigDataData55 : 447|8@0+ (1.0,0.0) [0.0|255.0] "Unitless" IHU
 SG_ PCMBigDataData56 : 455|8@0+ (1.0,0.0) [0.0|255.0] "Unitless" IHU
 SG_ PCMBigDataData57 : 463|8@0+ (1.0,0.0) [0.0|255.0] "Unitless" IHU
 SG_ PCMBigDataData58 : 471|8@0+ (1.0,0.0) [0.0|255.0] "Unitless" IHU
 SG_ PCMBigDataData59 : 479|8@0+ (1.0,0.0) [0.0|255.0] "Unitless" IHU
 SG_ PCMBigDataData6 : 55|8@0+ (1.0,0.0) [0.0|255.0] "Unitless" IHU
 SG_ PCMBigDataData60 : 487|8@0+ (1.0,0.0) [0.0|255.0] "Unitless" IHU
 SG_ PCMBigDataData61 : 495|8@0+ (1.0,0.0) [0.0|255.0] "Unitless" IHU
 SG_ PCMBigDataData62 : 503|8@0+ (1.0,0.0) [0.0|255.0] "Unitless" IHU
 SG_ PCMBigDataData63 : 511|8@0+ (1.0,0.0) [0.0|255.0] "Unitless" IHU
 SG_ PCMBigDataData7 : 63|8@0+ (1.0,0.0) [0.0|255.0] "Unitless" IHU
 SG_ PCMBigDataData8 : 71|8@0+ (1.0,0.0) [0.0|255.0] "Unitless" IHU
 SG_ PCMBigDataData9 : 79|8@0+ (1.0,0.0) [0.0|255.0] "Unitless" IHU

BO_ 816 ZCUDZCUCANFD2Fr29 : 64 ZCUD
 SG_ BMXSDrvTq2VDM_UB : 480|1@0+ (1,0) [0|1] "" IHU
 SG_ BMXSDrvTq2VDMChks : 463|8@0+ (1.0,0.0) [0.0|255.0] "Unitless" IHU
 SG_ BMXSDrvTq2VDMCntr : 471|4@0+ (1.0,0.0) [0.0|15.0] "Unitless" IHU
 SG_ BMXSDrvTq2VDMTqVDM : 467|16@0- (1.0,0.0) [-20000.0|20000.0] "NewtonMeter" IHU
 SG_ BMXSDrvTq2VDMTqVDMCtrlMode : 483|1@0+ (1,0) [0|1] "" IHU
 SG_ BMXSDrvTq2VDMTqVDMQf : 482|2@0+ (1,0) [0|3] "" IHU
 SG_ VFCVectorSMB_UB : 71|1@0+ (1,0) [0|1] "" IHU
 SG_ VFCVectorSMBBlockID : 1|2@0+ (1.0,0.0) [0.0|3.0] "Unitless" IHU
 SG_ VFCVectorSMBL_UB : 70|1@0+ (1,0) [0|1] "" IHU
 SG_ VFCVectorSMBLBlockID : 73|2@0+ (1.0,0.0) [0.0|3.0] "Unitless" IHU
 SG_ VFCVectorSMBLVFCid0 : 74|1@0+ (1,0) [0|1] "" IHU
 SG_ VFCVectorSMBLVFCid1 : 75|1@0+ (1,0) [0|1] "" IHU
 SG_ VFCVectorSMBLVFCid10 : 84|1@0+ (1,0) [0|1] "" IHU
 SG_ VFCVectorSMBLVFCid11 : 85|1@0+ (1,0) [0|1] "" IHU
 SG_ VFCVectorSMBLVFCid12 : 86|1@0+ (1,0) [0|1] "" IHU
 SG_ VFCVectorSMBLVFCid13 : 87|1@0+ (1,0) [0|1] "" IHU
 SG_ VFCVectorSMBLVFCid14 : 88|1@0+ (1,0) [0|1] "" IHU
 SG_ VFCVectorSMBLVFCid15 : 89|1@0+ (1,0) [0|1] "" IHU
 SG_ VFCVectorSMBLVFCid16 : 90|1@0+ (1,0) [0|1] "" IHU
 SG_ VFCVectorSMBLVFCid17 : 91|1@0+ (1,0) [0|1] "" IHU
 SG_ VFCVectorSMBLVFCid18 : 92|1@0+ (1,0) [0|1] "" IHU
 SG_ VFCVectorSMBLVFCid19 : 93|1@0+ (1,0) [0|1] "" IHU
 SG_ VFCVectorSMBLVFCid2 : 76|1@0+ (1,0) [0|1] "" IHU
 SG_ VFCVectorSMBLVFCid20 : 94|1@0+ (1,0) [0|1] "" IHU
 SG_ VFCVectorSMBLVFCid21 : 95|1@0+ (1,0) [0|1] "" IHU
 SG_ VFCVectorSMBLVFCid22 : 96|1@0+ (1,0) [0|1] "" IHU
 SG_ VFCVectorSMBLVFCid23 : 97|1@0+ (1,0) [0|1] "" IHU
 SG_ VFCVectorSMBLVFCid24 : 98|1@0+ (1,0) [0|1] "" IHU
 SG_ VFCVectorSMBLVFCid25 : 99|1@0+ (1,0) [0|1] "" IHU
 SG_ VFCVectorSMBLVFCid26 : 100|1@0+ (1,0) [0|1] "" IHU
 SG_ VFCVectorSMBLVFCid27 : 101|1@0+ (1,0) [0|1] "" IHU
 SG_ VFCVectorSMBLVFCid28 : 102|1@0+ (1,0) [0|1] "" IHU
 SG_ VFCVectorSMBLVFCid29 : 103|1@0+ (1,0) [0|1] "" IHU
 SG_ VFCVectorSMBLVFCid3 : 77|1@0+ (1,0) [0|1] "" IHU
 SG_ VFCVectorSMBLVFCid30 : 104|1@0+ (1,0) [0|1] "" IHU
 SG_ VFCVectorSMBLVFCid31 : 105|1@0+ (1,0) [0|1] "" IHU
 SG_ VFCVectorSMBLVFCid32 : 106|1@0+ (1,0) [0|1] "" IHU
 SG_ VFCVectorSMBLVFCid33 : 107|1@0+ (1,0) [0|1] "" IHU
 SG_ VFCVectorSMBLVFCid34 : 108|1@0+ (1,0) [0|1] "" IHU
 SG_ VFCVectorSMBLVFCid35 : 109|1@0+ (1,0) [0|1] "" IHU
 SG_ VFCVectorSMBLVFCid36 : 110|1@0+ (1,0) [0|1] "" IHU
 SG_ VFCVectorSMBLVFCid37 : 111|1@0+ (1,0) [0|1] "" IHU
 SG_ VFCVectorSMBLVFCid38 : 112|1@0+ (1,0) [0|1] "" IHU
 SG_ VFCVectorSMBLVFCid39 : 113|1@0+ (1,0) [0|1] "" IHU
 SG_ VFCVectorSMBLVFCid4 : 78|1@0+ (1,0) [0|1] "" IHU
 SG_ VFCVectorSMBLVFCid40 : 114|1@0+ (1,0) [0|1] "" IHU
 SG_ VFCVectorSMBLVFCid41 : 115|1@0+ (1,0) [0|1] "" IHU
 SG_ VFCVectorSMBLVFCid42 : 116|1@0+ (1,0) [0|1] "" IHU
 SG_ VFCVectorSMBLVFCid43 : 117|1@0+ (1,0) [0|1] "" IHU
 SG_ VFCVectorSMBLVFCid44 : 118|1@0+ (1,0) [0|1] "" IHU
 SG_ VFCVectorSMBLVFCid45 : 119|1@0+ (1,0) [0|1] "" IHU
 SG_ VFCVectorSMBLVFCid46 : 120|1@0+ (1,0) [0|1] "" IHU
 SG_ VFCVectorSMBLVFCid47 : 121|1@0+ (1,0) [0|1] "" IHU
 SG_ VFCVectorSMBLVFCid48 : 122|1@0+ (1,0) [0|1] "" IHU
 SG_ VFCVectorSMBLVFCid49 : 123|1@0+ (1,0) [0|1] "" IHU
 SG_ VFCVectorSMBLVFCid5 : 79|1@0+ (1,0) [0|1] "" IHU
 SG_ VFCVectorSMBLVFCid50 : 124|1@0+ (1,0) [0|1] "" IHU
 SG_ VFCVectorSMBLVFCid51 : 125|1@0+ (1,0) [0|1] "" IHU
 SG_ VFCVectorSMBLVFCid52 : 126|1@0+ (1,0) [0|1] "" IHU
 SG_ VFCVectorSMBLVFCid53 : 127|1@0+ (1,0) [0|1] "" IHU
 SG_ VFCVectorSMBLVFCid54 : 128|1@0+ (1,0) [0|1] "" IHU
 SG_ VFCVectorSMBLVFCid55 : 129|1@0+ (1,0) [0|1] "" IHU
 SG_ VFCVectorSMBLVFCid56 : 130|1@0+ (1,0) [0|1] "" IHU
 SG_ VFCVectorSMBLVFCid57 : 131|1@0+ (1,0) [0|1] "" IHU
 SG_ VFCVectorSMBLVFCid58 : 132|1@0+ (1,0) [0|1] "" IHU
 SG_ VFCVectorSMBLVFCid59 : 133|1@0+ (1,0) [0|1] "" IHU
 SG_ VFCVectorSMBLVFCid6 : 80|1@0+ (1,0) [0|1] "" IHU
 SG_ VFCVectorSMBLVFCid60 : 134|1@0+ (1,0) [0|1] "" IHU
 SG_ VFCVectorSMBLVFCid61 : 135|1@0+ (1,0) [0|1] "" IHU
 SG_ VFCVectorSMBLVFCid7 : 81|1@0+ (1,0) [0|1] "" IHU
 SG_ VFCVectorSMBLVFCid8 : 82|1@0+ (1,0) [0|1] "" IHU
 SG_ VFCVectorSMBLVFCid9 : 83|1@0+ (1,0) [0|1] "" IHU
 SG_ VFCVectorSMBR_UB : 69|1@0+ (1,0) [0|1] "" IHU
 SG_ VFCVectorSMBRBlockID : 137|2@0+ (1.0,0.0) [0.0|3.0] "Unitless" IHU
 SG_ VFCVectorSMBRVFCid0 : 138|1@0+ (1,0) [0|1] "" IHU
 SG_ VFCVectorSMBRVFCid1 : 139|1@0+ (1,0) [0|1] "" IHU
 SG_ VFCVectorSMBRVFCid10 : 148|1@0+ (1,0) [0|1] "" IHU
 SG_ VFCVectorSMBRVFCid11 : 149|1@0+ (1,0) [0|1] "" IHU
 SG_ VFCVectorSMBRVFCid12 : 150|1@0+ (1,0) [0|1] "" IHU
 SG_ VFCVectorSMBRVFCid13 : 151|1@0+ (1,0) [0|1] "" IHU
 SG_ VFCVectorSMBRVFCid14 : 152|1@0+ (1,0) [0|1] "" IHU
 SG_ VFCVectorSMBRVFCid15 : 153|1@0+ (1,0) [0|1] "" IHU
 SG_ VFCVectorSMBRVFCid16 : 154|1@0+ (1,0) [0|1] "" IHU
 SG_ VFCVectorSMBRVFCid17 : 155|1@0+ (1,0) [0|1] "" IHU
 SG_ VFCVectorSMBRVFCid18 : 156|1@0+ (1,0) [0|1] "" IHU
 SG_ VFCVectorSMBRVFCid19 : 157|1@0+ (1,0) [0|1] "" IHU
 SG_ VFCVectorSMBRVFCid2 : 140|1@0+ (1,0) [0|1] "" IHU
 SG_ VFCVectorSMBRVFCid20 : 158|1@0+ (1,0) [0|1] "" IHU
 SG_ VFCVectorSMBRVFCid21 : 159|1@0+ (1,0) [0|1] "" IHU
 SG_ VFCVectorSMBRVFCid22 : 160|1@0+ (1,0) [0|1] "" IHU
 SG_ VFCVectorSMBRVFCid23 : 161|1@0+ (1,0) [0|1] "" IHU
 SG_ VFCVectorSMBRVFCid24 : 162|1@0+ (1,0) [0|1] "" IHU
 SG_ VFCVectorSMBRVFCid25 : 163|1@0+ (1,0) [0|1] "" IHU
 SG_ VFCVectorSMBRVFCid26 : 164|1@0+ (1,0) [0|1] "" IHU
 SG_ VFCVectorSMBRVFCid27 : 165|1@0+ (1,0) [0|1] "" IHU
 SG_ VFCVectorSMBRVFCid28 : 166|1@0+ (1,0) [0|1] "" IHU
 SG_ VFCVectorSMBRVFCid29 : 167|1@0+ (1,0) [0|1] "" IHU
 SG_ VFCVectorSMBRVFCid3 : 141|1@0+ (1,0) [0|1] "" IHU
 SG_ VFCVectorSMBRVFCid30 : 168|1@0+ (1,0) [0|1] "" IHU
 SG_ VFCVectorSMBRVFCid31 : 169|1@0+ (1,0) [0|1] "" IHU
 SG_ VFCVectorSMBRVFCid32 : 170|1@0+ (1,0) [0|1] "" IHU
 SG_ VFCVectorSMBRVFCid33 : 171|1@0+ (1,0) [0|1] "" IHU
 SG_ VFCVectorSMBRVFCid34 : 172|1@0+ (1,0) [0|1] "" IHU
 SG_ VFCVectorSMBRVFCid35 : 173|1@0+ (1,0) [0|1] "" IHU
 SG_ VFCVectorSMBRVFCid36 : 174|1@0+ (1,0) [0|1] "" IHU
 SG_ VFCVectorSMBRVFCid37 : 175|1@0+ (1,0) [0|1] "" IHU
 SG_ VFCVectorSMBRVFCid38 : 176|1@0+ (1,0) [0|1] "" IHU
 SG_ VFCVectorSMBRVFCid39 : 177|1@0+ (1,0) [0|1] "" IHU
 SG_ VFCVectorSMBRVFCid4 : 142|1@0+ (1,0) [0|1] "" IHU
 SG_ VFCVectorSMBRVFCid40 : 178|1@0+ (1,0) [0|1] "" IHU
 SG_ VFCVectorSMBRVFCid41 : 179|1@0+ (1,0) [0|1] "" IHU
 SG_ VFCVectorSMBRVFCid42 : 180|1@0+ (1,0) [0|1] "" IHU
 SG_ VFCVectorSMBRVFCid43 : 181|1@0+ (1,0) [0|1] "" IHU
 SG_ VFCVectorSMBRVFCid44 : 182|1@0+ (1,0) [0|1] "" IHU
 SG_ VFCVectorSMBRVFCid45 : 183|1@0+ (1,0) [0|1] "" IHU
 SG_ VFCVectorSMBRVFCid46 : 184|1@0+ (1,0) [0|1] "" IHU
 SG_ VFCVectorSMBRVFCid47 : 185|1@0+ (1,0) [0|1] "" IHU
 SG_ VFCVectorSMBRVFCid48 : 186|1@0+ (1,0) [0|1] "" IHU
 SG_ VFCVectorSMBRVFCid49 : 187|1@0+ (1,0) [0|1] "" IHU
 SG_ VFCVectorSMBRVFCid5 : 143|1@0+ (1,0) [0|1] "" IHU
 SG_ VFCVectorSMBRVFCid50 : 188|1@0+ (1,0) [0|1] "" IHU
 SG_ VFCVectorSMBRVFCid51 : 189|1@0+ (1,0) [0|1] "" IHU
 SG_ VFCVectorSMBRVFCid52 : 190|1@0+ (1,0) [0|1] "" IHU
 SG_ VFCVectorSMBRVFCid53 : 191|1@0+ (1,0) [0|1] "" IHU
 SG_ VFCVectorSMBRVFCid54 : 192|1@0+ (1,0) [0|1] "" IHU
 SG_ VFCVectorSMBRVFCid55 : 193|1@0+ (1,0) [0|1] "" IHU
 SG_ VFCVectorSMBRVFCid56 : 194|1@0+ (1,0) [0|1] "" IHU
 SG_ VFCVectorSMBRVFCid57 : 195|1@0+ (1,0) [0|1] "" IHU
 SG_ VFCVectorSMBRVFCid58 : 196|1@0+ (1,0) [0|1] "" IHU
 SG_ VFCVectorSMBRVFCid59 : 197|1@0+ (1,0) [0|1] "" IHU
 SG_ VFCVectorSMBRVFCid6 : 144|1@0+ (1,0) [0|1] "" IHU
 SG_ VFCVectorSMBRVFCid60 : 198|1@0+ (1,0) [0|1] "" IHU
 SG_ VFCVectorSMBRVFCid61 : 199|1@0+ (1,0) [0|1] "" IHU
 SG_ VFCVectorSMBRVFCid7 : 145|1@0+ (1,0) [0|1] "" IHU
 SG_ VFCVectorSMBRVFCid8 : 146|1@0+ (1,0) [0|1] "" IHU
 SG_ VFCVectorSMBRVFCid9 : 147|1@0+ (1,0) [0|1] "" IHU
 SG_ VFCVectorSMBVFCid0 : 2|1@0+ (1,0) [0|1] "" IHU
 SG_ VFCVectorSMBVFCid1 : 3|1@0+ (1,0) [0|1] "" IHU
 SG_ VFCVectorSMBVFCid10 : 12|1@0+ (1,0) [0|1] "" IHU
 SG_ VFCVectorSMBVFCid11 : 13|1@0+ (1,0) [0|1] "" IHU
 SG_ VFCVectorSMBVFCid12 : 14|1@0+ (1,0) [0|1] "" IHU
 SG_ VFCVectorSMBVFCid13 : 15|1@0+ (1,0) [0|1] "" IHU
 SG_ VFCVectorSMBVFCid14 : 16|1@0+ (1,0) [0|1] "" IHU
 SG_ VFCVectorSMBVFCid15 : 17|1@0+ (1,0) [0|1] "" IHU
 SG_ VFCVectorSMBVFCid16 : 18|1@0+ (1,0) [0|1] "" IHU
 SG_ VFCVectorSMBVFCid17 : 19|1@0+ (1,0) [0|1] "" IHU
 SG_ VFCVectorSMBVFCid18 : 20|1@0+ (1,0) [0|1] "" IHU
 SG_ VFCVectorSMBVFCid19 : 21|1@0+ (1,0) [0|1] "" IHU
 SG_ VFCVectorSMBVFCid2 : 4|1@0+ (1,0) [0|1] "" IHU
 SG_ VFCVectorSMBVFCid20 : 22|1@0+ (1,0) [0|1] "" IHU
 SG_ VFCVectorSMBVFCid21 : 23|1@0+ (1,0) [0|1] "" IHU
 SG_ VFCVectorSMBVFCid22 : 24|1@0+ (1,0) [0|1] "" IHU
 SG_ VFCVectorSMBVFCid23 : 25|1@0+ (1,0) [0|1] "" IHU
 SG_ VFCVectorSMBVFCid24 : 26|1@0+ (1,0) [0|1] "" IHU
 SG_ VFCVectorSMBVFCid25 : 27|1@0+ (1,0) [0|1] "" IHU
 SG_ VFCVectorSMBVFCid26 : 28|1@0+ (1,0) [0|1] "" IHU
 SG_ VFCVectorSMBVFCid27 : 29|1@0+ (1,0) [0|1] "" IHU
 SG_ VFCVectorSMBVFCid28 : 30|1@0+ (1,0) [0|1] "" IHU
 SG_ VFCVectorSMBVFCid29 : 31|1@0+ (1,0) [0|1] "" IHU
 SG_ VFCVectorSMBVFCid3 : 5|1@0+ (1,0) [0|1] "" IHU
 SG_ VFCVectorSMBVFCid30 : 32|1@0+ (1,0) [0|1] "" IHU
 SG_ VFCVectorSMBVFCid31 : 33|1@0+ (1,0) [0|1] "" IHU
 SG_ VFCVectorSMBVFCid32 : 34|1@0+ (1,0) [0|1] "" IHU
 SG_ VFCVectorSMBVFCid33 : 35|1@0+ (1,0) [0|1] "" IHU
 SG_ VFCVectorSMBVFCid34 : 36|1@0+ (1,0) [0|1] "" IHU
 SG_ VFCVectorSMBVFCid35 : 37|1@0+ (1,0) [0|1] "" IHU
 SG_ VFCVectorSMBVFCid36 : 38|1@0+ (1,0) [0|1] "" IHU
 SG_ VFCVectorSMBVFCid37 : 39|1@0+ (1,0) [0|1] "" IHU
 SG_ VFCVectorSMBVFCid38 : 40|1@0+ (1,0) [0|1] "" IHU
 SG_ VFCVectorSMBVFCid39 : 41|1@0+ (1,0) [0|1] "" IHU
 SG_ VFCVectorSMBVFCid4 : 6|1@0+ (1,0) [0|1] "" IHU
 SG_ VFCVectorSMBVFCid40 : 42|1@0+ (1,0) [0|1] "" IHU
 SG_ VFCVectorSMBVFCid41 : 43|1@0+ (1,0) [0|1] "" IHU
 SG_ VFCVectorSMBVFCid42 : 44|1@0+ (1,0) [0|1] "" IHU
 SG_ VFCVectorSMBVFCid43 : 45|1@0+ (1,0) [0|1] "" IHU
 SG_ VFCVectorSMBVFCid44 : 46|1@0+ (1,0) [0|1] "" IHU
 SG_ VFCVectorSMBVFCid45 : 47|1@0+ (1,0) [0|1] "" IHU
 SG_ VFCVectorSMBVFCid46 : 48|1@0+ (1,0) [0|1] "" IHU
 SG_ VFCVectorSMBVFCid47 : 49|1@0+ (1,0) [0|1] "" IHU
 SG_ VFCVectorSMBVFCid48 : 50|1@0+ (1,0) [0|1] "" IHU
 SG_ VFCVectorSMBVFCid49 : 51|1@0+ (1,0) [0|1] "" IHU
 SG_ VFCVectorSMBVFCid5 : 7|1@0+ (1,0) [0|1] "" IHU
 SG_ VFCVectorSMBVFCid50 : 52|1@0+ (1,0) [0|1] "" IHU
 SG_ VFCVectorSMBVFCid51 : 53|1@0+ (1,0) [0|1] "" IHU
 SG_ VFCVectorSMBVFCid52 : 54|1@0+ (1,0) [0|1] "" IHU
 SG_ VFCVectorSMBVFCid53 : 55|1@0+ (1,0) [0|1] "" IHU
 SG_ VFCVectorSMBVFCid54 : 56|1@0+ (1,0) [0|1] "" IHU
 SG_ VFCVectorSMBVFCid55 : 57|1@0+ (1,0) [0|1] "" IHU
 SG_ VFCVectorSMBVFCid56 : 58|1@0+ (1,0) [0|1] "" IHU
 SG_ VFCVectorSMBVFCid57 : 59|1@0+ (1,0) [0|1] "" IHU
 SG_ VFCVectorSMBVFCid58 : 60|1@0+ (1,0) [0|1] "" IHU
 SG_ VFCVectorSMBVFCid59 : 61|1@0+ (1,0) [0|1] "" IHU
 SG_ VFCVectorSMBVFCid6 : 8|1@0+ (1,0) [0|1] "" IHU
 SG_ VFCVectorSMBVFCid60 : 62|1@0+ (1,0) [0|1] "" IHU
 SG_ VFCVectorSMBVFCid61 : 63|1@0+ (1,0) [0|1] "" IHU
 SG_ VFCVectorSMBVFCid7 : 9|1@0+ (1,0) [0|1] "" IHU
 SG_ VFCVectorSMBVFCid8 : 10|1@0+ (1,0) [0|1] "" IHU
 SG_ VFCVectorSMBVFCid9 : 11|1@0+ (1,0) [0|1] "" IHU
 SG_ VFCVectorTRM_UB : 68|1@0+ (1,0) [0|1] "" IHU
 SG_ VFCVectorTRMBlockID : 201|2@0+ (1.0,0.0) [0.0|3.0] "Unitless" IHU
 SG_ VFCVectorTRMVFCid0 : 202|1@0+ (1,0) [0|1] "" IHU
 SG_ VFCVectorTRMVFCid1 : 203|1@0+ (1,0) [0|1] "" IHU
 SG_ VFCVectorTRMVFCid10 : 212|1@0+ (1,0) [0|1] "" IHU
 SG_ VFCVectorTRMVFCid11 : 213|1@0+ (1,0) [0|1] "" IHU
 SG_ VFCVectorTRMVFCid12 : 214|1@0+ (1,0) [0|1] "" IHU
 SG_ VFCVectorTRMVFCid13 : 215|1@0+ (1,0) [0|1] "" IHU
 SG_ VFCVectorTRMVFCid14 : 216|1@0+ (1,0) [0|1] "" IHU
 SG_ VFCVectorTRMVFCid15 : 217|1@0+ (1,0) [0|1] "" IHU
 SG_ VFCVectorTRMVFCid16 : 218|1@0+ (1,0) [0|1] "" IHU
 SG_ VFCVectorTRMVFCid17 : 219|1@0+ (1,0) [0|1] "" IHU
 SG_ VFCVectorTRMVFCid18 : 220|1@0+ (1,0) [0|1] "" IHU
 SG_ VFCVectorTRMVFCid19 : 221|1@0+ (1,0) [0|1] "" IHU
 SG_ VFCVectorTRMVFCid2 : 204|1@0+ (1,0) [0|1] "" IHU
 SG_ VFCVectorTRMVFCid20 : 222|1@0+ (1,0) [0|1] "" IHU
 SG_ VFCVectorTRMVFCid21 : 223|1@0+ (1,0) [0|1] "" IHU
 SG_ VFCVectorTRMVFCid22 : 224|1@0+ (1,0) [0|1] "" IHU
 SG_ VFCVectorTRMVFCid23 : 225|1@0+ (1,0) [0|1] "" IHU
 SG_ VFCVectorTRMVFCid24 : 226|1@0+ (1,0) [0|1] "" IHU
 SG_ VFCVectorTRMVFCid25 : 227|1@0+ (1,0) [0|1] "" IHU
 SG_ VFCVectorTRMVFCid26 : 228|1@0+ (1,0) [0|1] "" IHU
 SG_ VFCVectorTRMVFCid27 : 229|1@0+ (1,0) [0|1] "" IHU
 SG_ VFCVectorTRMVFCid28 : 230|1@0+ (1,0) [0|1] "" IHU
 SG_ VFCVectorTRMVFCid29 : 231|1@0+ (1,0) [0|1] "" IHU
 SG_ VFCVectorTRMVFCid3 : 205|1@0+ (1,0) [0|1] "" IHU
 SG_ VFCVectorTRMVFCid30 : 232|1@0+ (1,0) [0|1] "" IHU
 SG_ VFCVectorTRMVFCid31 : 233|1@0+ (1,0) [0|1] "" IHU
 SG_ VFCVectorTRMVFCid32 : 234|1@0+ (1,0) [0|1] "" IHU
 SG_ VFCVectorTRMVFCid33 : 235|1@0+ (1,0) [0|1] "" IHU
 SG_ VFCVectorTRMVFCid34 : 236|1@0+ (1,0) [0|1] "" IHU
 SG_ VFCVectorTRMVFCid35 : 237|1@0+ (1,0) [0|1] "" IHU
 SG_ VFCVectorTRMVFCid36 : 238|1@0+ (1,0) [0|1] "" IHU
 SG_ VFCVectorTRMVFCid37 : 239|1@0+ (1,0) [0|1] "" IHU
 SG_ VFCVectorTRMVFCid38 : 240|1@0+ (1,0) [0|1] "" IHU
 SG_ VFCVectorTRMVFCid39 : 241|1@0+ (1,0) [0|1] "" IHU
 SG_ VFCVectorTRMVFCid4 : 206|1@0+ (1,0) [0|1] "" IHU
 SG_ VFCVectorTRMVFCid40 : 242|1@0+ (1,0) [0|1] "" IHU
 SG_ VFCVectorTRMVFCid41 : 243|1@0+ (1,0) [0|1] "" IHU
 SG_ VFCVectorTRMVFCid42 : 244|1@0+ (1,0) [0|1] "" IHU
 SG_ VFCVectorTRMVFCid43 : 245|1@0+ (1,0) [0|1] "" IHU
 SG_ VFCVectorTRMVFCid44 : 246|1@0+ (1,0) [0|1] "" IHU
 SG_ VFCVectorTRMVFCid45 : 247|1@0+ (1,0) [0|1] "" IHU
 SG_ VFCVectorTRMVFCid46 : 248|1@0+ (1,0) [0|1] "" IHU
 SG_ VFCVectorTRMVFCid47 : 249|1@0+ (1,0) [0|1] "" IHU
 SG_ VFCVectorTRMVFCid48 : 250|1@0+ (1,0) [0|1] "" IHU
 SG_ VFCVectorTRMVFCid49 : 251|1@0+ (1,0) [0|1] "" IHU
 SG_ VFCVectorTRMVFCid5 : 207|1@0+ (1,0) [0|1] "" IHU
 SG_ VFCVectorTRMVFCid50 : 252|1@0+ (1,0) [0|1] "" IHU
 SG_ VFCVectorTRMVFCid51 : 253|1@0+ (1,0) [0|1] "" IHU
 SG_ VFCVectorTRMVFCid52 : 254|1@0+ (1,0) [0|1] "" IHU
 SG_ VFCVectorTRMVFCid53 : 255|1@0+ (1,0) [0|1] "" IHU
 SG_ VFCVectorTRMVFCid54 : 256|1@0+ (1,0) [0|1] "" IHU
 SG_ VFCVectorTRMVFCid55 : 257|1@0+ (1,0) [0|1] "" IHU
 SG_ VFCVectorTRMVFCid56 : 258|1@0+ (1,0) [0|1] "" IHU
 SG_ VFCVectorTRMVFCid57 : 259|1@0+ (1,0) [0|1] "" IHU
 SG_ VFCVectorTRMVFCid58 : 260|1@0+ (1,0) [0|1] "" IHU
 SG_ VFCVectorTRMVFCid59 : 261|1@0+ (1,0) [0|1] "" IHU
 SG_ VFCVectorTRMVFCid6 : 208|1@0+ (1,0) [0|1] "" IHU
 SG_ VFCVectorTRMVFCid60 : 262|1@0+ (1,0) [0|1] "" IHU
 SG_ VFCVectorTRMVFCid61 : 263|1@0+ (1,0) [0|1] "" IHU
 SG_ VFCVectorTRMVFCid7 : 209|1@0+ (1,0) [0|1] "" IHU
 SG_ VFCVectorTRMVFCid8 : 210|1@0+ (1,0) [0|1] "" IHU
 SG_ VFCVectorTRMVFCid9 : 211|1@0+ (1,0) [0|1] "" IHU

BO_ 832 ZCUDZCUCANFD2Fr30 : 64 ZCUD
 SG_ VFCVectorSMP_UB : 66|1@0+ (1,0) [0|1] "" IHU
 SG_ VFCVectorSMPBlockID : 329|2@0+ (1.0,0.0) [0.0|3.0] "Unitless" IHU
 SG_ VFCVectorSMPVFCid0 : 330|1@0+ (1,0) [0|1] "" IHU
 SG_ VFCVectorSMPVFCid1 : 331|1@0+ (1,0) [0|1] "" IHU
 SG_ VFCVectorSMPVFCid10 : 340|1@0+ (1,0) [0|1] "" IHU
 SG_ VFCVectorSMPVFCid11 : 341|1@0+ (1,0) [0|1] "" IHU
 SG_ VFCVectorSMPVFCid12 : 342|1@0+ (1,0) [0|1] "" IHU
 SG_ VFCVectorSMPVFCid13 : 343|1@0+ (1,0) [0|1] "" IHU
 SG_ VFCVectorSMPVFCid14 : 344|1@0+ (1,0) [0|1] "" IHU
 SG_ VFCVectorSMPVFCid15 : 345|1@0+ (1,0) [0|1] "" IHU
 SG_ VFCVectorSMPVFCid16 : 346|1@0+ (1,0) [0|1] "" IHU
 SG_ VFCVectorSMPVFCid17 : 347|1@0+ (1,0) [0|1] "" IHU
 SG_ VFCVectorSMPVFCid18 : 348|1@0+ (1,0) [0|1] "" IHU
 SG_ VFCVectorSMPVFCid19 : 349|1@0+ (1,0) [0|1] "" IHU
 SG_ VFCVectorSMPVFCid2 : 332|1@0+ (1,0) [0|1] "" IHU
 SG_ VFCVectorSMPVFCid20 : 350|1@0+ (1,0) [0|1] "" IHU
 SG_ VFCVectorSMPVFCid21 : 351|1@0+ (1,0) [0|1] "" IHU
 SG_ VFCVectorSMPVFCid22 : 352|1@0+ (1,0) [0|1] "" IHU
 SG_ VFCVectorSMPVFCid23 : 353|1@0+ (1,0) [0|1] "" IHU
 SG_ VFCVectorSMPVFCid24 : 354|1@0+ (1,0) [0|1] "" IHU
 SG_ VFCVectorSMPVFCid25 : 355|1@0+ (1,0) [0|1] "" IHU
 SG_ VFCVectorSMPVFCid26 : 356|1@0+ (1,0) [0|1] "" IHU
 SG_ VFCVectorSMPVFCid27 : 357|1@0+ (1,0) [0|1] "" IHU
 SG_ VFCVectorSMPVFCid28 : 358|1@0+ (1,0) [0|1] "" IHU
 SG_ VFCVectorSMPVFCid29 : 359|1@0+ (1,0) [0|1] "" IHU
 SG_ VFCVectorSMPVFCid3 : 333|1@0+ (1,0) [0|1] "" IHU
 SG_ VFCVectorSMPVFCid30 : 360|1@0+ (1,0) [0|1] "" IHU
 SG_ VFCVectorSMPVFCid31 : 361|1@0+ (1,0) [0|1] "" IHU
 SG_ VFCVectorSMPVFCid32 : 362|1@0+ (1,0) [0|1] "" IHU
 SG_ VFCVectorSMPVFCid33 : 363|1@0+ (1,0) [0|1] "" IHU
 SG_ VFCVectorSMPVFCid34 : 364|1@0+ (1,0) [0|1] "" IHU
 SG_ VFCVectorSMPVFCid35 : 365|1@0+ (1,0) [0|1] "" IHU
 SG_ VFCVectorSMPVFCid36 : 366|1@0+ (1,0) [0|1] "" IHU
 SG_ VFCVectorSMPVFCid37 : 367|1@0+ (1,0) [0|1] "" IHU
 SG_ VFCVectorSMPVFCid38 : 368|1@0+ (1,0) [0|1] "" IHU
 SG_ VFCVectorSMPVFCid39 : 369|1@0+ (1,0) [0|1] "" IHU
 SG_ VFCVectorSMPVFCid4 : 334|1@0+ (1,0) [0|1] "" IHU
 SG_ VFCVectorSMPVFCid40 : 370|1@0+ (1,0) [0|1] "" IHU
 SG_ VFCVectorSMPVFCid41 : 371|1@0+ (1,0) [0|1] "" IHU
 SG_ VFCVectorSMPVFCid42 : 372|1@0+ (1,0) [0|1] "" IHU
 SG_ VFCVectorSMPVFCid43 : 373|1@0+ (1,0) [0|1] "" IHU
 SG_ VFCVectorSMPVFCid44 : 374|1@0+ (1,0) [0|1] "" IHU
 SG_ VFCVectorSMPVFCid45 : 375|1@0+ (1,0) [0|1] "" IHU
 SG_ VFCVectorSMPVFCid46 : 376|1@0+ (1,0) [0|1] "" IHU
 SG_ VFCVectorSMPVFCid47 : 377|1@0+ (1,0) [0|1] "" IHU
 SG_ VFCVectorSMPVFCid48 : 378|1@0+ (1,0) [0|1] "" IHU
 SG_ VFCVectorSMPVFCid49 : 379|1@0+ (1,0) [0|1] "" IHU
 SG_ VFCVectorSMPVFCid5 : 335|1@0+ (1,0) [0|1] "" IHU
 SG_ VFCVectorSMPVFCid50 : 380|1@0+ (1,0) [0|1] "" IHU
 SG_ VFCVectorSMPVFCid51 : 381|1@0+ (1,0) [0|1] "" IHU
 SG_ VFCVectorSMPVFCid52 : 382|1@0+ (1,0) [0|1] "" IHU
 SG_ VFCVectorSMPVFCid53 : 383|1@0+ (1,0) [0|1] "" IHU
 SG_ VFCVectorSMPVFCid54 : 384|1@0+ (1,0) [0|1] "" IHU
 SG_ VFCVectorSMPVFCid55 : 385|1@0+ (1,0) [0|1] "" IHU
 SG_ VFCVectorSMPVFCid56 : 386|1@0+ (1,0) [0|1] "" IHU
 SG_ VFCVectorSMPVFCid57 : 387|1@0+ (1,0) [0|1] "" IHU
 SG_ VFCVectorSMPVFCid58 : 388|1@0+ (1,0) [0|1] "" IHU
 SG_ VFCVectorSMPVFCid59 : 389|1@0+ (1,0) [0|1] "" IHU
 SG_ VFCVectorSMPVFCid6 : 336|1@0+ (1,0) [0|1] "" IHU
 SG_ VFCVectorSMPVFCid60 : 390|1@0+ (1,0) [0|1] "" IHU
 SG_ VFCVectorSMPVFCid61 : 391|1@0+ (1,0) [0|1] "" IHU
 SG_ VFCVectorSMPVFCid7 : 337|1@0+ (1,0) [0|1] "" IHU
 SG_ VFCVectorSMPVFCid8 : 338|1@0+ (1,0) [0|1] "" IHU
 SG_ VFCVectorSMPVFCid9 : 339|1@0+ (1,0) [0|1] "" IHU

BO_ 920 ZCUDZCUCANFD2Fr31 : 64 ZCUD
 SG_ AccPWMPerdTi : 167|16@0+ (1.0,0.0) [0.0|65535.0] "Unitless" IHU
 SG_ AccPWMPerdTi_UB : 158|1@0+ (1,0) [0|1] "" IHU
 SG_ ActnOfCenHiMntdStopLamp : 157|1@0+ (1,0) [0|1] "" IHU
 SG_ ActnOfCenHiMntdStopLamp_UB : 156|1@0+ (1,0) [0|1] "" IHU
 SG_ ActnOfCenHiMntdStopLamp1 : 155|1@0+ (1,0) [0|1] "" IHU
 SG_ ActnOfCenHiMntdStopLamp1_UB : 154|1@0+ (1,0) [0|1] "" IHU
 SG_ ActnOfDaytiRunngLampDrv : 153|1@0+ (1,0) [0|1] "" IHU
 SG_ ActnOfDaytiRunngLampDrv_UB : 152|1@0+ (1,0) [0|1] "" IHU
 SG_ ActnOfFrntFogLampDrv : 183|1@0+ (1,0) [0|1] "" IHU
 SG_ ActnOfFrntFogLampDrv_UB : 182|1@0+ (1,0) [0|1] "" IHU
 SG_ ActnOfFrntPosnLampDrv : 181|1@0+ (1,0) [0|1] "" IHU
 SG_ ActnOfFrntPosnLampDrv_UB : 180|1@0+ (1,0) [0|1] "" IHU
 SG_ ActnOfFrntSideMkrLampDrv : 179|1@0+ (1,0) [0|1] "" IHU
 SG_ ActnOfFrntSideMkrLampDrv_UB : 178|1@0+ (1,0) [0|1] "" IHU
 SG_ ActnOfFrntSideMkrLampPass : 177|1@0+ (1,0) [0|1] "" IHU
 SG_ ActnOfFrntSideMkrLampPass_UB : 176|1@0+ (1,0) [0|1] "" IHU
 SG_ ActnOfLedCornrgLampLe : 191|1@0+ (1,0) [0|1] "" IHU
 SG_ ActnOfLedCornrgLampLe_UB : 190|1@0+ (1,0) [0|1] "" IHU
 SG_ ActnOfLedCornrgLampRi : 189|1@0+ (1,0) [0|1] "" IHU
 SG_ ActnOfLedCornrgLampRi_UB : 188|1@0+ (1,0) [0|1] "" IHU
 SG_ ActnOfLedDaytiRunngLamp : 187|1@0+ (1,0) [0|1] "" IHU
 SG_ ActnOfLedDaytiRunngLamp_UB : 186|1@0+ (1,0) [0|1] "" IHU
 SG_ ActnOfLedFrntCrossLamp : 185|1@0+ (1,0) [0|1] "" IHU
 SG_ ActnOfLedFrntCrossLamp_UB : 184|1@0+ (1,0) [0|1] "" IHU
 SG_ ActnOfLedFrntCrossLampDyn : 199|1@0+ (1,0) [0|1] "" IHU
 SG_ ActnOfLedFrntCrossLampDyn_UB : 198|1@0+ (1,0) [0|1] "" IHU
 SG_ ActnOfLedFrntFogLamp : 197|1@0+ (1,0) [0|1] "" IHU
 SG_ ActnOfLedFrntFogLamp_UB : 196|1@0+ (1,0) [0|1] "" IHU
 SG_ ActnOfLedGrilleLamp : 195|1@0+ (1,0) [0|1] "" IHU
 SG_ ActnOfLedGrilleLamp_UB : 194|1@0+ (1,0) [0|1] "" IHU
 SG_ ActnOfLedGrilleLampDyn : 193|1@0+ (1,0) [0|1] "" IHU
 SG_ ActnOfLedGrilleLampDyn_UB : 192|1@0+ (1,0) [0|1] "" IHU
 SG_ ActnOfLedLeLogoLamp : 207|1@0+ (1,0) [0|1] "" IHU
 SG_ ActnOfLedLeLogoLamp_UB : 206|1@0+ (1,0) [0|1] "" IHU
 SG_ ActnOfLedPosnLampDyn : 203|1@0+ (1,0) [0|1] "" IHU
 SG_ ActnOfLedPosnLampDyn_UB : 202|1@0+ (1,0) [0|1] "" IHU
 SG_ ActnOfLedReFogLamp : 201|1@0+ (1,0) [0|1] "" IHU
 SG_ ActnOfLedReFogLamp_UB : 200|1@0+ (1,0) [0|1] "" IHU
 SG_ ActnOfLedRePosnLamp : 215|1@0+ (1,0) [0|1] "" IHU
 SG_ ActnOfLedRePosnLamp_UB : 214|1@0+ (1,0) [0|1] "" IHU
 SG_ ActnOfLedRiLogoLamp : 213|1@0+ (1,0) [0|1] "" IHU
 SG_ ActnOfLedRiLogoLamp_UB : 212|1@0+ (1,0) [0|1] "" IHU
 SG_ ActnOfLedRiLogoLampDyn : 211|1@0+ (1,0) [0|1] "" IHU
 SG_ ActnOfLedRiLogoLampDyn_UB : 210|1@0+ (1,0) [0|1] "" IHU
 SG_ ActnOfLedRvsgLamp : 209|1@0+ (1,0) [0|1] "" IHU
 SG_ ActnOfLedRvsgLamp_UB : 208|1@0+ (1,0) [0|1] "" IHU
 SG_ ActnOfReFogLampPass : 223|1@0+ (1,0) [0|1] "" IHU
 SG_ ActnOfReFogLampPass_UB : 222|1@0+ (1,0) [0|1] "" IHU
 SG_ ActnOfRePosnLampDrv : 221|1@0+ (1,0) [0|1] "" IHU
 SG_ ActnOfRePosnLampDrv_UB : 220|1@0+ (1,0) [0|1] "" IHU
 SG_ ActnOfReSideMkrLampDrv : 219|1@0+ (1,0) [0|1] "" IHU
 SG_ ActnOfReSideMkrLampDrv_UB : 218|1@0+ (1,0) [0|1] "" IHU
 SG_ ActnOfReSideMkrLampPass : 217|1@0+ (1,0) [0|1] "" IHU
 SG_ ActnOfReSideMkrLampPass_UB : 216|1@0+ (1,0) [0|1] "" IHU
 SG_ ActnOfRvsgLampDrv : 231|1@0+ (1,0) [0|1] "" IHU
 SG_ ActnOfRvsgLampDrv_UB : 230|1@0+ (1,0) [0|1] "" IHU
 SG_ ActvnOfAfs : 229|1@0+ (1,0) [0|1] "" IHU
 SG_ ActvnOfAfs_UB : 228|1@0+ (1,0) [0|1] "" IHU
 SG_ ActvnOfAhl : 227|1@0+ (1,0) [0|1] "" IHU
 SG_ ActvnOfAhl_UB : 226|1@0+ (1,0) [0|1] "" IHU
 SG_ ActvnOfAlrmReqFromCmplxIf : 225|1@0+ (1,0) [0|1] "" IHU
 SG_ ActvnOfAlrmReqFromCmplxIf_UB : 224|1@0+ (1,0) [0|1] "" IHU
 SG_ ActvnOfBrkLi : 239|1@0+ (1,0) [0|1] "" IHU
 SG_ ActvnOfBrkLi_UB : 238|1@0+ (1,0) [0|1] "" IHU
 SG_ ActvnOfDbl : 237|1@0+ (1,0) [0|1] "" IHU
 SG_ ActvnOfDbl_UB : 236|1@0+ (1,0) [0|1] "" IHU
 SG_ ActvnOfDefrstFrnt : 235|1@0+ (1,0) [0|1] "" IHU
 SG_ ActvnOfDefrstFrnt_UB : 234|1@0+ (1,0) [0|1] "" IHU
 SG_ ActvnOfDefrstRe : 233|1@0+ (1,0) [0|1] "" IHU
 SG_ ActvnOfDefrstRe_UB : 232|1@0+ (1,0) [0|1] "" IHU
 SG_ ActvnOfDoorSwtIllmn : 247|1@0+ (1,0) [0|1] "" IHU
 SG_ ActvnOfDoorSwtIllmn_UB : 246|1@0+ (1,0) [0|1] "" IHU
 SG_ ActvnOfFootwellLamp : 255|8@0+ (1.0,0.0) [0.0|100.0] "%" IHU
 SG_ ActvnOfFootwellLamp_UB : 263|1@0+ (1,0) [0|1] "" IHU
 SG_ ActvnOfHndlDoorLi_UB : 262|1@0+ (1,0) [0|1] "" IHU
 SG_ ActvnOfHndlDoorLiHndlDoorLiDrvr : 271|1@0+ (1,0) [0|1] "" IHU
 SG_ ActvnOfHndlDoorLiHndlDoorLiDrvrRe : 270|1@0+ (1,0) [0|1] "" IHU
 SG_ ActvnOfHndlDoorLiHndlDoorLiPass : 269|1@0+ (1,0) [0|1] "" IHU
 SG_ ActvnOfHndlDoorLiHndlDoorLiPassRe : 268|1@0+ (1,0) [0|1] "" IHU
 SG_ ActvnOfReLogoLamp1 : 245|1@0+ (1,0) [0|1] "" IHU
 SG_ ActvnOfReLogoLamp1_UB : 244|1@0+ (1,0) [0|1] "" IHU
 SG_ ActvnOfRoofSwtIllmn : 243|1@0+ (1,0) [0|1] "" IHU
 SG_ ActvnOfRoofSwtIllmn_UB : 242|1@0+ (1,0) [0|1] "" IHU
 SG_ ActvnOfSillPlateIllmn : 279|8@0+ (1.0,0.0) [0.0|100.0] "%" IHU
 SG_ ActvnOfSillPlateIllmn_UB : 261|1@0+ (1,0) [0|1] "" IHU
 SG_ ActvnOfStrtIllmn : 287|8@0+ (1.0,0.0) [0.0|100.0] "%" IHU
 SG_ ActvnOfStrtIllmn_UB : 260|1@0+ (1,0) [0|1] "" IHU
 SG_ ActvnOfTouristMod : 241|1@0+ (1,0) [0|1] "" IHU
 SG_ ActvnOfTouristMod_UB : 240|1@0+ (1,0) [0|1] "" IHU
 SG_ ActvnOfWiprMech : 266|2@0+ (1.0,0.0) [0.0|3.0] "Unitless" IHU
 SG_ ActvnOfWiprMech_UB : 264|1@0+ (1,0) [0|1] "" IHU
 SG_ ActvnOfWshrFrntNotSafe : 259|1@0+ (1,0) [0|1] "" IHU
 SG_ ActvnOfWshrFrntNotSafe_UB : 258|1@0+ (1,0) [0|1] "" IHU
 SG_ ActvnOfWshrRe : 257|1@0+ (1,0) [0|1] "" IHU
 SG_ ActvnOfWshrRe_UB : 256|1@0+ (1,0) [0|1] "" IHU
 SG_ AlrmAcoustReq01 : 295|8@0+ (1,0) [0|255] "" IHU
 SG_ AlrmAcoustReq01_UB : 267|1@0+ (1,0) [0|1] "" IHU
 SG_ AlrmToExtrLiFbVisReq : 319|3@0+ (1,0) [0|7] "" IHU
 SG_ AlrmToExtrLiFbVisReq_UB : 310|1@0+ (1,0) [0|1] "" IHU
 SG_ AlrmToExtrLiVisReq : 303|8@0+ (1,0) [0|255] "" IHU
 SG_ AlrmToExtrLiVisReq_UB : 311|1@0+ (1,0) [0|1] "" IHU
 SG_ AutWinWipgCmd : 316|3@0+ (1,0) [0|7] "" IHU
 SG_ AutWinWipgCmd_UB : 309|1@0+ (1,0) [0|1] "" IHU
 SG_ BswCha1NmState : 327|3@0+ (1,0) [0|7] "" IHU
 SG_ BswCha1NmState_UB : 308|1@0+ (1,0) [0|1] "" IHU
 SG_ BswChainNmState : 324|3@0+ (1,0) [0|7] "" IHU
 SG_ BswChainNmState_UB : 307|1@0+ (1,0) [0|1] "" IHU
 SG_ BswCpu0LoadAvg : 335|7@0+ (1.0,0.0) [0.0|100.0] "%" IHU
 SG_ BswCpu0LoadAvg_UB : 328|1@0+ (1,0) [0|1] "" IHU
 SG_ BswCpu0LoadMax : 343|7@0+ (1.0,0.0) [0.0|100.0] "%" IHU
 SG_ BswCpu0LoadMax_UB : 336|1@0+ (1,0) [0|1] "" IHU
 SG_ BswCpu1LoadAvg : 351|7@0+ (1.0,0.0) [0.0|100.0] "%" IHU
 SG_ BswCpu1LoadAvg_UB : 344|1@0+ (1,0) [0|1] "" IHU
 SG_ BswCpu1LoadMax : 359|7@0+ (1.0,0.0) [0.0|100.0] "%" IHU
 SG_ BswCpu1LoadMax_UB : 352|1@0+ (1,0) [0|1] "" IHU
 SG_ BswCpu2LoadAvg : 367|7@0+ (1.0,0.0) [0.0|100.0] "%" IHU
 SG_ BswCpu2LoadAvg_UB : 360|1@0+ (1,0) [0|1] "" IHU
 SG_ BswCpu2LoadMax : 375|7@0+ (1.0,0.0) [0.0|100.0] "%" IHU
 SG_ BswCpu2LoadMax_UB : 368|1@0+ (1,0) [0|1] "" IHU
 SG_ BswCpu3LoadAvg : 383|7@0+ (1.0,0.0) [0.0|100.0] "%" IHU
 SG_ BswCpu3LoadAvg_UB : 376|1@0+ (1,0) [0|1] "" IHU
 SG_ BswCpu3LoadMax : 391|7@0+ (1.0,0.0) [0.0|100.0] "%" IHU
 SG_ BswCpu3LoadMax_UB : 384|1@0+ (1,0) [0|1] "" IHU
 SG_ BswCpu4LoadAvg : 399|7@0+ (1.0,0.0) [0.0|100.0] "%" IHU
 SG_ BswCpu4LoadAvg_UB : 392|1@0+ (1,0) [0|1] "" IHU
 SG_ BswCpu4LoadMax : 407|7@0+ (1.0,0.0) [0.0|100.0] "%" IHU
 SG_ BswCpu4LoadMax_UB : 400|1@0+ (1,0) [0|1] "" IHU
 SG_ BswCpu5LoadAvg : 415|7@0+ (1.0,0.0) [0.0|100.0] "%" IHU
 SG_ BswCpu5LoadAvg_UB : 408|1@0+ (1,0) [0|1] "" IHU
 SG_ BswCpu5LoadMax : 423|7@0+ (1.0,0.0) [0.0|100.0] "%" IHU
 SG_ BswCpu5LoadMax_UB : 416|1@0+ (1,0) [0|1] "" IHU
 SG_ BswIcState : 431|32@0+ (1.0,0.0) [0.0|4294967295.0] "Unitless" IHU
 SG_ BswIcState_UB : 306|1@0+ (1,0) [0|1] "" IHU
 SG_ BswKeepWakeUpReason : 463|8@0+ (1.0,0.0) [0.0|255.0] "Unitless" IHU
 SG_ BswKeepWakeUpReason_UB : 305|1@0+ (1,0) [0|1] "" IHU
 SG_ BswOsTaskTime : 471|16@0+ (1.0,0.0) [0.0|65535.0] "Unitless" IHU
 SG_ BswOsTaskTime_UB : 304|1@0+ (1,0) [0|1] "" IHU
 SG_ BswPriNmState : 487|3@0+ (1,0) [0|7] "" IHU
 SG_ BswPriNmState_UB : 484|1@0+ (1,0) [0|1] "" IHU
 SG_ BswPropNmState : 483|3@0+ (1,0) [0|7] "" IHU
 SG_ BswPropNmState_UB : 480|1@0+ (1,0) [0|1] "" IHU
 SG_ BswWakeupSourceState : 495|3@0+ (1,0) [0|7] "" IHU
 SG_ BswWakeupSourceState_UB : 492|1@0+ (1,0) [0|1] "" IHU
 SG_ DwnLoadStsFbOfHdlampLe : 7|2@0+ (1,0) [0|3] "" IHU
 SG_ DwnLoadStsFbOfHdlampLe_UB : 15|1@0+ (1,0) [0|1] "" IHU
 SG_ DwnLoadStsFbOfHdlampRi : 5|2@0+ (1,0) [0|3] "" IHU
 SG_ DwnLoadStsFbOfHdlampRi_UB : 14|1@0+ (1,0) [0|1] "" IHU
 SG_ DwnLoadStsFbOfLogoLampLe : 3|2@0+ (1,0) [0|3] "" IHU
 SG_ DwnLoadStsFbOfLogoLampLe_UB : 13|1@0+ (1,0) [0|1] "" IHU
 SG_ DwnLoadStsFbOfLogoLampRi : 1|2@0+ (1,0) [0|3] "" IHU
 SG_ DwnLoadStsFbOfLogoLampRi_UB : 12|1@0+ (1,0) [0|1] "" IHU
 SG_ ExtrLiShowActvnFrntLeFb : 23|2@0+ (1,0) [0|3] "" IHU
 SG_ ExtrLiShowActvnFrntLeFb_UB : 11|1@0+ (1,0) [0|1] "" IHU
 SG_ ExtrLiShowActvnFrntRiFb : 21|2@0+ (1,0) [0|3] "" IHU
 SG_ ExtrLiShowActvnFrntRiFb_UB : 10|1@0+ (1,0) [0|1] "" IHU
 SG_ ExtrLiShowActvnLeLogoFb : 19|2@0+ (1,0) [0|3] "" IHU
 SG_ ExtrLiShowActvnLeLogoFb_UB : 9|1@0+ (1,0) [0|1] "" IHU
 SG_ ExtrLiShowActvnRiLogoFb : 17|2@0+ (1,0) [0|3] "" IHU
 SG_ ExtrLiShowActvnRiLogoFb_UB : 8|1@0+ (1,0) [0|1] "" IHU
 SG_ HdlampLeInpSts1 : 31|1@0+ (1,0) [0|1] "" IHU
 SG_ HdlampLeInpSts1_UB : 30|1@0+ (1,0) [0|1] "" IHU
 SG_ HdlampLeInpSts2 : 29|1@0+ (1,0) [0|1] "" IHU
 SG_ HdlampLeInpSts2_UB : 28|1@0+ (1,0) [0|1] "" IHU
 SG_ HdlampRiInpSts1 : 27|1@0+ (1,0) [0|1] "" IHU
 SG_ HdlampRiInpSts1_UB : 26|1@0+ (1,0) [0|1] "" IHU
 SG_ HdlampRiInpSts2 : 25|1@0+ (1,0) [0|1] "" IHU
 SG_ HdlampRiInpSts2_UB : 24|1@0+ (1,0) [0|1] "" IHU
 SG_ ShortDropWinDrvrSts : 313|2@0+ (1,0) [0|3] "" IHU
 SG_ ShortDropWinDrvrSts_UB : 321|1@0+ (1,0) [0|1] "" IHU
 SG_ ShortDropWinReLeSts : 497|2@0+ (1,0) [0|3] "" IHU
 SG_ ShortDropWinReLeSts_UB : 320|1@0+ (1,0) [0|1] "" IHU
 SG_ SnsrSoundrBattBackedSts_UB : 504|1@0+ (1,0) [0|1] "" IHU
 SG_ SnsrSoundrBattBackedStsArmSts : 511|1@0+ (1,0) [0|1] "" IHU
 SG_ SnsrSoundrBattBackedStsCfgSts : 510|2@0+ (1,0) [0|3] "" IHU
 SG_ SnsrSoundrBattBackedStsSnsrInclnExist : 508|1@0+ (1,0) [0|1] "" IHU
 SG_ SnsrSoundrBattBackedStsSoundrBattBackedErrSts : 507|2@0+ (1,0) [0|3] "" IHU
 SG_ SnsrSoundrBattBackedStsSoundSts : 505|1@0+ (1,0) [0|1] "" IHU
 SG_ StsOfAfsLe : 39|2@0+ (1,0) [0|3] "" IHU
 SG_ StsOfAfsLe_UB : 47|1@0+ (1,0) [0|1] "" IHU
 SG_ StsOfAfsRi : 37|2@0+ (1,0) [0|3] "" IHU
 SG_ StsOfAfsRi_UB : 46|1@0+ (1,0) [0|1] "" IHU
 SG_ StsOfAhbcLe : 35|2@0+ (1,0) [0|3] "" IHU
 SG_ StsOfAhbcLe_UB : 45|1@0+ (1,0) [0|1] "" IHU
 SG_ StsOfAhbcRi : 33|2@0+ (1,0) [0|3] "" IHU
 SG_ StsOfAhbcRi_UB : 44|1@0+ (1,0) [0|1] "" IHU
 SG_ StsOfFrntSideMkrLampLe2 : 55|2@0+ (1,0) [0|3] "" IHU
 SG_ StsOfFrntSideMkrLampLe2_UB : 43|1@0+ (1,0) [0|1] "" IHU
 SG_ StsOfFrntSideMkrLampRi2 : 53|2@0+ (1,0) [0|3] "" IHU
 SG_ StsOfFrntSideMkrLampRi2_UB : 42|1@0+ (1,0) [0|1] "" IHU
 SG_ StsOfLedCornrgLampLe : 51|2@0+ (1,0) [0|3] "" IHU
 SG_ StsOfLedCornrgLampLe_UB : 41|1@0+ (1,0) [0|1] "" IHU
 SG_ StsOfLedCornrgLampRi : 49|2@0+ (1,0) [0|3] "" IHU
 SG_ StsOfLedCornrgLampRi_UB : 40|1@0+ (1,0) [0|1] "" IHU
 SG_ StsOfLedDaytiRunngLampLe : 63|2@0+ (1,0) [0|3] "" IHU
 SG_ StsOfLedDaytiRunngLampLe_UB : 71|1@0+ (1,0) [0|1] "" IHU
 SG_ StsOfLedDaytiRunngLampRi : 61|2@0+ (1,0) [0|3] "" IHU
 SG_ StsOfLedDaytiRunngLampRi_UB : 70|1@0+ (1,0) [0|1] "" IHU
 SG_ StsOfLedFrntFogLampLe : 59|2@0+ (1,0) [0|3] "" IHU
 SG_ StsOfLedFrntFogLampLe_UB : 69|1@0+ (1,0) [0|1] "" IHU
 SG_ StsOfLedFrntFogLampRi : 57|2@0+ (1,0) [0|3] "" IHU
 SG_ StsOfLedFrntFogLampRi_UB : 68|1@0+ (1,0) [0|1] "" IHU
 SG_ StsOfLedFrntPosnLampLe : 79|2@0+ (1,0) [0|3] "" IHU
 SG_ StsOfLedFrntPosnLampLe_UB : 67|1@0+ (1,0) [0|1] "" IHU
 SG_ StsOfLedFrntPosnLampRi : 77|2@0+ (1,0) [0|3] "" IHU
 SG_ StsOfLedFrntPosnLampRi_UB : 66|1@0+ (1,0) [0|1] "" IHU
 SG_ StsOfLedFrntTurnIndcrLe : 75|2@0+ (1,0) [0|3] "" IHU
 SG_ StsOfLedFrntTurnIndcrLe_UB : 65|1@0+ (1,0) [0|1] "" IHU
 SG_ StsOfLedFrntTurnIndcrRi : 73|2@0+ (1,0) [0|3] "" IHU
 SG_ StsOfLedFrntTurnIndcrRi_UB : 64|1@0+ (1,0) [0|1] "" IHU
 SG_ StsOfLedLeLogoLamp : 119|2@0+ (1,0) [0|3] "" IHU
 SG_ StsOfLedLeLogoLamp_UB : 127|1@0+ (1,0) [0|1] "" IHU
 SG_ StsOfLedRiLogoLamp : 117|2@0+ (1,0) [0|3] "" IHU
 SG_ StsOfLedRiLogoLamp_UB : 126|1@0+ (1,0) [0|1] "" IHU
 SG_ StsOfLvlgLe_UB : 89|1@0+ (1,0) [0|1] "" IHU
 SG_ StsOfLvlgLeChks : 87|8@0+ (1.0,0.0) [0.0|255.0] "Unitless" IHU
 SG_ StsOfLvlgLeCntr : 95|4@0+ (1.0,0.0) [0.0|15.0] "Unitless" IHU
 SG_ StsOfLvlgLeStsOfLvlgLe : 91|2@0+ (1,0) [0|3] "" IHU
 SG_ StsOfLvlgRi_UB : 88|1@0+ (1,0) [0|1] "" IHU
 SG_ StsOfLvlgRiChks : 103|8@0+ (1.0,0.0) [0.0|255.0] "Unitless" IHU
 SG_ StsOfLvlgRiCntr : 111|4@0+ (1.0,0.0) [0.0|15.0] "Unitless" IHU
 SG_ StsOfLvlgRiStsOfLvlgRi : 107|2@0+ (1,0) [0|3] "" IHU
 SG_ StsOfTouristModLe : 115|2@0+ (1,0) [0|3] "" IHU
 SG_ StsOfTouristModLe_UB : 125|1@0+ (1,0) [0|1] "" IHU
 SG_ StsOfTouristModRi : 113|2@0+ (1,0) [0|3] "" IHU
 SG_ StsOfTouristModRi_UB : 124|1@0+ (1,0) [0|1] "" IHU
 SG_ StsOfWelGbyFrntLe : 123|1@0+ (1,0) [0|1] "" IHU
 SG_ StsOfWelGbyFrntLe_UB : 122|1@0+ (1,0) [0|1] "" IHU
 SG_ StsOfWelGbyFrntRi : 121|1@0+ (1,0) [0|1] "" IHU
 SG_ StsOfWelGbyFrntRi_UB : 120|1@0+ (1,0) [0|1] "" IHU
 SG_ SunRoofAndCurtBtnSts2_UB : 503|1@0+ (1,0) [0|1] "" IHU
 SG_ SunRoofAndCurtBtnSts2Cntr : 499|2@0+ (1.0,0.0) [0.0|3.0] "Unitless" IHU
 SG_ SunRoofAndCurtBtnSts2Pos : 502|3@0+ (1,0) [0|7] "" IHU
 SG_ SunRoofImpctDetnSts2 : 490|3@0+ (1,0) [0|7] "" IHU
 SG_ SunRoofImpctDetnSts2_UB : 491|1@0+ (1,0) [0|1] "" IHU
 SG_ TCSDoorSts : 105|1@0+ (1,0) [0|1] "" IHU
 SG_ TCSDoorSts_UB : 104|1@0+ (1,0) [0|1] "" IHU
 SG_ WiprInPrkgPosnLoFromWMM : 151|1@0+ (1,0) [0|1] "" IHU
 SG_ WiprInPrkgPosnLoFromWMM_UB : 150|1@0+ (1,0) [0|1] "" IHU
 SG_ WiprInWipgArFromWMM : 149|1@0+ (1,0) [0|1] "" IHU
 SG_ WiprInWipgArFromWMM_UB : 148|1@0+ (1,0) [0|1] "" IHU
 SG_ WiprMotCrkAg : 143|8@0+ (1.0,0.0) [0.0|255.0] "Unitless" IHU
 SG_ WiprMotCrkAg_UB : 128|1@0+ (1,0) [0|1] "" IHU
 SG_ WiprMotDiagc_UB : 129|1@0+ (1,0) [0|1] "" IHU
 SG_ WiprMotDiagcWiprMotHiVoltDetd : 135|2@0+ (1,0) [0|3] "" IHU
 SG_ WiprMotDiagcWiprMotLoVoltDetd : 133|2@0+ (1,0) [0|3] "" IHU
 SG_ WiprMotDiagcWiprMotOvldDetd : 131|2@0+ (1,0) [0|3] "" IHU
 SG_ WiprMotErrSafe : 145|2@0+ (1,0) [0|3] "" IHU
 SG_ WiprMotErrSafe_UB : 159|1@0+ (1,0) [0|1] "" IHU
 SG_ WshngCycActvFromWMM : 147|1@0+ (1,0) [0|1] "" IHU
 SG_ WshngCycActvFromWMM_UB : 146|1@0+ (1,0) [0|1] "" IHU

BO_ 416 ZCUDZCUCANFD2Fr32 : 64 ZCUD
 SG_ AccPedlAna : 31|8@0+ (0.0196078431372549,0.0) [0.0|5.0] "Volt" IHU
 SG_ AccPedlAna_UB : 16|1@0+ (1,0) [0|1] "" IHU
 SG_ AccPedlPWM : 55|8@0+ (0.392156863,0.0) [0.0|100.00000006500001] "%" IHU
 SG_ AccPedlPWM_UB : 43|1@0+ (1,0) [0|1] "" IHU
 SG_ BattCoolgPwrPreTherm : 63|16@0- (1.0,0.0) [-32768.0|32767.0] "W" IHU
 SG_ BattCoolgPwrPreTherm_UB : 42|1@0+ (1,0) [0|1] "" IHU
 SG_ BattHeatgTargTempPreTherm : 79|8@0+ (1.0,-50.0) [-50.0|200.0] "degC" IHU
 SG_ BattHeatgTargTempPreTherm_UB : 41|1@0+ (1,0) [0|1] "" IHU
 SG_ BattVoltKL30 : 87|8@0+ (0.0784313725490196,0.0) [0.0|20.0] "Volt" IHU
 SG_ BattVoltKL30_UB : 40|1@0+ (1,0) [0|1] "" IHU
 SG_ ChillerOutCooltT : 39|11@0+ (0.1,-40.0) [-40.0|140.0] "degC" IHU
 SG_ ChillerOutCooltT_UB : 44|1@0+ (1,0) [0|1] "" IHU
 SG_ CnvnInhb : 127|1@0+ (1,0) [0|1] "" IHU
 SG_ CnvnInhb_UB : 126|1@0+ (1,0) [0|1] "" IHU
 SG_ CPSRClsReq : 125|1@0+ (1,0) [0|1] "" IHU
 SG_ CPSRClsReq_UB : 124|1@0+ (1,0) [0|1] "" IHU
 SG_ CPSRFbSt : 123|1@0+ (1,0) [0|1] "" IHU
 SG_ CPSRFbSt_UB : 122|1@0+ (1,0) [0|1] "" IHU
 SG_ EexvSts_UB : 17|1@0+ (1,0) [0|1] "" IHU
 SG_ EexvStsExvActrPosn : 7|10@0+ (0.2,0.0) [0.0|100.0] "%" IHU
 SG_ EexvStsExvBlkErr : 9|1@0+ (1,0) [0|1] "" IHU
 SG_ EexvStsExvCalibSts : 13|2@0+ (1,0) [0|3] "" IHU
 SG_ EexvStsExvElecStsErr : 23|3@0+ (1,0) [0|7] "" IHU
 SG_ EexvStsExvMovSts : 8|1@0+ (1,0) [0|1] "" IHU
 SG_ EexvStsExvOvrTempErr : 20|1@0+ (1,0) [0|1] "" IHU
 SG_ EexvStsExvOvrTrvlErr : 19|1@0+ (1,0) [0|1] "" IHU
 SG_ EexvStsExvPreHeatgSts : 18|1@0+ (1,0) [0|1] "" IHU
 SG_ EexvStsExvVoltgRangErr : 11|2@0+ (1,0) [0|3] "" IHU
 SG_ EtpActualSpeed_UB : 95|1@0+ (1,0) [0|1] "" IHU
 SG_ EtpActualSpeedBackup : 94|13@0+ (1.0,0.0) [0.0|8191.0] "Unitless" IHU
 SG_ EtpActualSpeedEtpActualSpeed : 111|13@0+ (1.0,0.0) [0.0|8191.0] "Unitless" IHU
 SG_ EtpActualSpeedSts : 97|2@0+ (1.0,0.0) [0.0|3.0] "Unitless" IHU
 SG_ EtpAngPosPlausSts : 121|1@0+ (1.0,0.0) [0.0|1.0] "Unitless" IHU
 SG_ EtpAngPosPlausSts_UB : 120|1@0+ (1,0) [0|1] "" IHU
 SG_ EtpASAStudyProcess : 141|1@0+ (1.0,0.0) [0.0|1.0] "Unitless" IHU
 SG_ EtpASAStudyProcess_UB : 140|1@0+ (1,0) [0|1] "" IHU
 SG_ EtpASAValueValid : 139|1@0+ (1.0,0.0) [0.0|1.0] "Unitless" IHU
 SG_ EtpASAValueValid_UB : 138|1@0+ (1,0) [0|1] "" IHU
 SG_ EtpBatteryVoltage : 135|9@0+ (0.1,0.0) [0.0|51.1] "Unitless" IHU
 SG_ EtpBatteryVoltage_UB : 142|1@0+ (1,0) [0|1] "" IHU
 SG_ EtpCanNodeLoss : 137|1@0+ (1.0,0.0) [0.0|1.0] "Unitless" IHU
 SG_ EtpCanNodeLoss_UB : 136|1@0+ (1,0) [0|1] "" IHU
 SG_ EtpCurrent_UB : 173|1@0+ (1,0) [0|1] "" IHU
 SG_ EtpCurrent_Backup : 145|10@0+ (0.1,0.0) [0.0|102.30000000000001] "Unitless" IHU
 SG_ EtpCurrentEtpCurrent : 167|10@0+ (0.1,0.0) [0.0|102.30000000000001] "Unitless" IHU
 SG_ EtpCurrentStsBackup : 147|2@0+ (1.0,0.0) [0.0|3.0] "Unitless" IHU
 SG_ EtpEnableOff : 151|1@0+ (1.0,0.0) [0.0|1.0] "Unitless" IHU
 SG_ EtpEnableOff_UB : 150|1@0+ (1,0) [0|1] "" IHU
 SG_ EtpEOPHydLeakSts : 149|1@0+ (1.0,0.0) [0.0|1.0] "Unitless" IHU
 SG_ EtpEOPHydLeakSts_UB : 148|1@0+ (1,0) [0|1] "" IHU
 SG_ EtpFaultSelfMos : 199|1@0+ (1.0,0.0) [0.0|1.0] "Unitless" IHU
 SG_ EtpFaultSelfMos_UB : 198|1@0+ (1,0) [0|1] "" IHU
 SG_ EtpGDUOverCurrent : 197|1@0+ (1.0,0.0) [0.0|1.0] "Unitless" IHU
 SG_ EtpGDUOverCurrent_UB : 196|1@0+ (1,0) [0|1] "" IHU
 SG_ EtpGmrSpiCommErr : 195|1@0+ (1.0,0.0) [0.0|1.0] "Unitless" IHU
 SG_ EtpGmrSpiCommErr_UB : 194|1@0+ (1,0) [0|1] "" IHU
 SG_ EtpHallSignal_UB : 180|1@0+ (1,0) [0|1] "" IHU
 SG_ EtpHallSignalError : 183|1@0+ (1.0,0.0) [0.0|1.0] "Unitless" IHU
 SG_ EtpHallSignalSt : 182|2@0+ (1.0,0.0) [0.0|3.0] "Unitless" IHU
 SG_ EtpIgnitionStatus : 193|1@0+ (1.0,0.0) [0.0|1.0] "Unitless" IHU
 SG_ EtpIgnitionStatus_UB : 192|1@0+ (1,0) [0|1] "" IHU
 SG_ EtpMcu_UB : 179|1@0+ (1,0) [0|1] "" IHU
 SG_ EtpMcuTemperature : 191|8@0+ (1.0,-50.0) [-50.0|205.0] "degC" IHU
 SG_ EtpMcuTOutRngHiSts : 178|1@0+ (1.0,0.0) [0.0|1.0] "Unitless" IHU
 SG_ EtpMcuTOutRngLoSts : 177|1@0+ (1.0,0.0) [0.0|1.0] "Unitless" IHU
 SG_ EtpMcuTStuckSts : 176|1@0+ (1.0,0.0) [0.0|1.0] "Unitless" IHU
 SG_ EtpMos_UB : 217|1@0+ (1,0) [0|1] "" IHU
 SG_ EtpMosTemperature : 207|8@0+ (1.0,-50.0) [-50.0|205.0] "degC" IHU
 SG_ EtpMosTemperatureBackup : 215|8@0+ (1.0,-50.0) [-50.0|205.0] "degC" IHU
 SG_ EtpMosTOpenSts : 223|1@0+ (1.0,0.0) [0.0|1.0] "Unitless" IHU
 SG_ EtpMosTOutRngHiSts : 222|1@0+ (1.0,0.0) [0.0|1.0] "Unitless" IHU
 SG_ EtpMosTOutRngLoSts : 221|1@0+ (1.0,0.0) [0.0|1.0] "Unitless" IHU
 SG_ EtpMosTShoBattSts : 220|1@0+ (1.0,0.0) [0.0|1.0] "Unitless" IHU
 SG_ EtpMosTShoGndSts : 219|1@0+ (1.0,0.0) [0.0|1.0] "Unitless" IHU
 SG_ EtpMosTStuckSts : 218|1@0+ (1.0,0.0) [0.0|1.0] "Unitless" IHU
 SG_ EtpOffseVoltageFailure : 261|1@0+ (1.0,0.0) [0.0|1.0] "Unitless" IHU
 SG_ EtpOffseVoltageFailure_UB : 260|1@0+ (1,0) [0|1] "" IHU
 SG_ EtpOverTemperature : 169|1@0+ (1.0,0.0) [0.0|1.0] "Unitless" IHU
 SG_ EtpOverTemperature_UB : 168|1@0+ (1,0) [0|1] "" IHU
 SG_ EtpOverTemperatureBackup : 171|2@0+ (1.0,0.0) [0.0|3.0] "Unitless" IHU
 SG_ EtpOverTemperatureBackup_UB : 172|1@0+ (1,0) [0|1] "" IHU
 SG_ EtpOverVoltage : 113|2@0+ (1.0,0.0) [0.0|3.0] "Unitless" IHU
 SG_ EtpOverVoltage_UB : 114|1@0+ (1,0) [0|1] "" IHU
 SG_ EtpPhase_UB : 262|1@0+ (1,0) [0|1] "" IHU
 SG_ EtpPhaseCurrent : 239|11@0+ (0.1,0.0) [0.0|204.70000000000002] "Unitless" IHU
 SG_ EtpPhaseCurrentBackup : 242|11@0+ (0.1,0.0) [0.0|204.70000000000002] "Unitless" IHU
 SG_ EtpPhaseCurrentStsBackup : 244|2@0+ (1.0,0.0) [0.0|3.0] "Unitless" IHU
 SG_ EtpPhaseOverCurrent : 263|1@0+ (1.0,0.0) [0.0|1.0] "Unitless" IHU
 SG_ EtpPumpReady : 287|1@0+ (1.0,0.0) [0.0|1.0] "Unitless" IHU
 SG_ EtpPumpReady_UB : 286|1@0+ (1,0) [0|1] "" IHU
 SG_ EtpResetReason : 258|3@0+ (1.0,0.0) [0.0|7.0] "Unitless" IHU
 SG_ EtpResetReason_UB : 259|1@0+ (1,0) [0|1] "" IHU
 SG_ EtpRunningStatus : 317|2@0+ (1.0,0.0) [0.0|3.0] "Unitless" IHU
 SG_ EtpRunningStatus_UB : 318|1@0+ (1,0) [0|1] "" IHU
 SG_ EtpSensorPowSupplyFau : 285|1@0+ (1.0,0.0) [0.0|1.0] "Unitless" IHU
 SG_ EtpSensorPowSupplyFau_UB : 284|1@0+ (1,0) [0|1] "" IHU
 SG_ EtpSpdBaseAngleValue : 283|1@0+ (1.0,0.0) [0.0|1.0] "Unitless" IHU
 SG_ EtpSpdBaseAngleValue_UB : 282|1@0+ (1,0) [0|1] "" IHU
 SG_ EtpSpdBaseAngleValueSts : 281|1@0+ (1.0,0.0) [0.0|1.0] "Unitless" IHU
 SG_ EtpSpdBaseAngleValueSts_UB : 280|1@0+ (1,0) [0|1] "" IHU
 SG_ EtpSpdBaseUVWIncPos : 271|13@0+ (1.0,0.0) [0.0|8191.0] "Unitless" IHU
 SG_ EtpSpdBaseUVWIncPos_UB : 274|1@0+ (1,0) [0|1] "" IHU
 SG_ EtpSpdBaseUVWIncPosSts : 273|1@0+ (1.0,0.0) [0.0|1.0] "Unitless" IHU
 SG_ EtpSpdBaseUVWIncPosSts_UB : 272|1@0+ (1,0) [0|1] "" IHU
 SG_ EtpStartFailure : 315|1@0+ (1.0,0.0) [0.0|1.0] "Unitless" IHU
 SG_ EtpStartFailure_UB : 314|1@0+ (1,0) [0|1] "" IHU
 SG_ EtpUnderSpeed : 295|2@0+ (1.0,0.0) [0.0|3.0] "Unitless" IHU
 SG_ EtpUnderSpeed_UB : 293|1@0+ (1,0) [0|1] "" IHU
 SG_ EtpUnderVoltage : 291|2@0+ (1.0,0.0) [0.0|3.0] "Unitless" IHU
 SG_ EtpUnderVoltage_UB : 292|1@0+ (1,0) [0|1] "" IHU
 SG_ EtpVHDVoltage_UB : 289|1@0+ (1,0) [0|1] "" IHU
 SG_ EtpVHDVoltageBackup : 288|9@0+ (0.1,0.0) [0.0|51.1] "Unitless" IHU
 SG_ EtpVHDVoltageEtpVHDVoltage : 311|9@0+ (0.1,0.0) [0.0|51.1] "Unitless" IHU
 SG_ EtpVoltagePlausSts : 313|1@0+ (1.0,0.0) [0.0|1.0] "Unitless" IHU
 SG_ EtpVoltagePlausSts_UB : 312|1@0+ (1,0) [0|1] "" IHU
 SG_ ExvSts_UB : 337|1@0+ (1,0) [0|1] "" IHU
 SG_ ExvStsExvActrPosn : 327|10@0+ (0.2,0.0) [0.0|100.0] "%" IHU
 SG_ ExvStsExvBlkErr : 329|1@0+ (1,0) [0|1] "" IHU
 SG_ ExvStsExvCalibSts : 333|2@0+ (1,0) [0|3] "" IHU
 SG_ ExvStsExvElecStsErr : 343|3@0+ (1,0) [0|7] "" IHU
 SG_ ExvStsExvMovSts : 328|1@0+ (1,0) [0|1] "" IHU
 SG_ ExvStsExvOvrTempErr : 340|1@0+ (1,0) [0|1] "" IHU
 SG_ ExvStsExvOvrTrvlErr : 339|1@0+ (1,0) [0|1] "" IHU
 SG_ ExvStsExvPreHeatgSts : 338|1@0+ (1,0) [0|1] "" IHU
 SG_ ExvStsExvVoltgRangErr : 331|2@0+ (1,0) [0|3] "" IHU
 SG_ FrntHeatPwrAllwd : 231|8@0+ (50.0,0.0) [0.0|12750.0] "W" IHU
 SG_ FrntHeatPwrAllwd_UB : 216|1@0+ (1,0) [0|1] "" IHU
 SG_ HvchOnForBattHeatg : 383|1@0+ (1,0) [0|1] "" IHU
 SG_ HvchOnForBattHeatg_UB : 382|1@0+ (1,0) [0|1] "" IHU
 SG_ HvClimaCoolgPwrCritDes : 391|16@0- (1.0,0.0) [-32768.0|32767.0] "W" IHU
 SG_ HvClimaCoolgPwrCritDes_UB : 381|1@0+ (1,0) [0|1] "" IHU
 SG_ HvClimaHeatgPwrCritDes : 407|16@0- (1.0,0.0) [-32768.0|32767.0] "W" IHU
 SG_ HvClimaHeatgPwrCritDes_UB : 380|1@0+ (1,0) [0|1] "" IHU
 SG_ HvCoolgPwrCritDes : 423|16@0- (1.0,0.0) [-32768.0|32767.0] "W" IHU
 SG_ HvCoolgPwrCritDes_UB : 379|1@0+ (1,0) [0|1] "" IHU
 SG_ HvCoolgPwrNormDes : 439|16@0- (1.0,0.0) [-32768.0|32767.0] "W" IHU
 SG_ HvCoolgPwrNormDes_UB : 378|1@0+ (1,0) [0|1] "" IHU
 SG_ HvHeatgPwrCritDes : 455|16@0- (1.0,0.0) [-32768.0|32767.0] "W" IHU
 SG_ HvHeatgPwrCritDes_UB : 377|1@0+ (1,0) [0|1] "" IHU
 SG_ HvHeatgPwrNormDes : 471|16@0- (1.0,0.0) [-32768.0|32767.0] "W" IHU
 SG_ HvHeatgPwrNormDes_UB : 376|1@0+ (1,0) [0|1] "" IHU
 SG_ IsgFlg20ForEOP : 505|1@0+ (1.0,0.0) [0.0|1.0] "Unitless" IHU
 SG_ IsgFlg20ForEOP_UB : 504|1@0+ (1,0) [0|1] "" IHU
 SG_ IsgForWRC_UB : 336|1@0+ (1,0) [0|1] "" IHU
 SG_ IsgForWRCIsgSpdForWRC : 351|16@0+ (1.0,-20000.0) [-20000.0|45535.0] "rpm" IHU
 SG_ IsgForWRCIsgTqEstForWRC : 367|16@0+ (1.0,-8000.0) [-8000.0|57535.0] "Unitless" IHU
 SG_ IsgOilPmpTargetSpeedForETP : 487|13@0+ (1.0,0.0) [0.0|8191.0] "Unitless" IHU
 SG_ IsgOilPmpTargetSpeedForETP_UB : 490|1@0+ (1,0) [0|1] "" IHU
 SG_ IsgOilPmpTemperatureForETP : 503|8@0+ (1.0,-50.0) [-50.0|205.0] "degC" IHU
 SG_ IsgOilPmpTemperatureForETP_UB : 511|1@0+ (1,0) [0|1] "" IHU
 SG_ IsgOPCStartOnForETP : 489|1@0+ (1.0,0.0) [0.0|1.0] "Unitless" IHU
 SG_ IsgOPCStartOnForETP_UB : 488|1@0+ (1,0) [0|1] "" IHU
 SG_ IsgTPlausStsForETP : 509|2@0+ (1.0,0.0) [0.0|3.0] "Unitless" IHU
 SG_ IsgTPlausStsForETP_UB : 510|1@0+ (1,0) [0|1] "" IHU
 SG_ LoTemEneStorage : 507|1@0+ (1,0) [0|1] "" IHU
 SG_ LoTemEneStorage_UB : 506|1@0+ (1,0) [0|1] "" IHU

BO_ 422 ZCUDZCUCANFD2Fr33 : 64 ZCUD
 SG_ EwpAflFlagCooling : 49|1@0+ (1,0) [0|1] "" IHU
 SG_ EwpAflFlagCooling_UB : 48|1@0+ (1,0) [0|1] "" IHU
 SG_ HvActvReq : 185|2@0+ (1,0) [0|3] "" IHU
 SG_ HvActvReq_UB : 186|1@0+ (1,0) [0|1] "" IHU
 SG_ IsgCoolgReqInvrCloud : 39|3@0+ (1,0) [0|7] "" IHU
 SG_ IsgCoolgReqInvrCloud_UB : 36|1@0+ (1,0) [0|1] "" IHU
 SG_ IsgCooltFlowMinReqCloud : 33|10@0+ (0.01,0.0) [0.0|10.23] "L / min" IHU
 SG_ IsgCooltFlowMinReqCloud_UB : 34|1@0+ (1,0) [0|1] "" IHU
 SG_ IsgCrashValueForETP : 55|2@0+ (1.0,0.0) [0.0|3.0] "Unitless" IHU
 SG_ IsgCrashValueForETP_UB : 53|1@0+ (1,0) [0|1] "" IHU
 SG_ IsgHeatFdBckCloud : 51|2@0+ (1,0) [0|3] "" IHU
 SG_ IsgHeatFdBckCloud_UB : 52|1@0+ (1,0) [0|1] "" IHU
 SG_ IvtrActId : 7|11@0+ (1.0,-1023.0) [-1023.0|1024.0] "Unitless" IHU
 SG_ IvtrActId_UB : 12|1@0+ (1,0) [0|1] "" IHU
 SG_ IvtrActIq : 10|11@0+ (1.0,-1023.0) [-1023.0|1024.0] "Unitless" IHU
 SG_ IvtrActIq_UB : 11|1@0+ (1,0) [0|1] "" IHU
 SG_ IvtrActvDchaSts : 31|8@0+ (1.0,0.0) [0.0|255.0] "Unitless" IHU
 SG_ IvtrActvDchaSts_UB : 35|1@0+ (1,0) [0|1] "" IHU
 SG_ IvtrDAxis_UB : 84|1@0+ (1,0) [0|1] "" IHU
 SG_ IvtrDAxisCurrtSp : 79|11@0+ (1.0,-1023.0) [-1023.0|1024.0] "Unitless" IHU
 SG_ IvtrDAxisU : 63|16@0+ (0.1,-1310.0) [-1310.0|5243.5] "Unitless" IHU
 SG_ IvtrDerating_UB : 81|1@0+ (1,0) [0|1] "" IHU
 SG_ IvtrDeratingReason : 95|8@0+ (1.0,0.0) [0.0|255.0] "Unitless" IHU
 SG_ IvtrDeratingSts : 80|1@0+ (1.0,0.0) [0.0|1.0] "Unitless" IHU
 SG_ IvtrGateSts : 103|8@0+ (1.0,0.0) [0.0|255.0] "Unitless" IHU
 SG_ IvtrGateSts_UB : 83|1@0+ (1,0) [0|1] "" IHU
 SG_ IvtrIgbtJunctionT : 111|8@0+ (1.0,-40.0) [-40.0|215.0] "degC" IHU
 SG_ IvtrIgbtJunctionT_UB : 82|1@0+ (1,0) [0|1] "" IHU
 SG_ IvtrModlnIdx : 119|8@0+ (1.0,0.0) [0.0|255.0] "Unitless" IHU
 SG_ IvtrModlnIdx_UB : 191|1@0+ (1,0) [0|1] "" IHU
 SG_ IvtrMotActModSts : 127|8@0+ (1.0,0.0) [0.0|255.0] "Unitless" IHU
 SG_ IvtrMotActModSts_UB : 190|1@0+ (1,0) [0|1] "" IHU
 SG_ IvtrOffsAg_UB : 189|1@0+ (1,0) [0|1] "" IHU
 SG_ IvtrOffsAgIvtrOffsAg : 135|32@0+ (0.000001,0.0) [0.0|4294.9672949999995] "Unitless" IHU
 SG_ IvtrOffsAgSts : 167|8@0+ (1.0,0.0) [0.0|255.0] "Unitless" IHU
 SG_ IvtrOilT : 175|8@0+ (1.0,-40.0) [-40.0|215.0] "degC" IHU
 SG_ IvtrOilT_UB : 188|1@0+ (1,0) [0|1] "" IHU
 SG_ IvtrOilTSnsrSplyV : 183|8@0+ (0.1,0.0) [0.0|25.5] "Unitless" IHU
 SG_ IvtrOilTSnsrSplyV_UB : 187|1@0+ (1,0) [0|1] "" IHU
 SG_ IvtrPhaPwmDuty_UB : 242|1@0+ (1,0) [0|1] "" IHU
 SG_ IvtrPhaPwmDutyIvtrPhaUPwmDuty : 271|8@0+ (1.0,0.0) [0.0|255.0] "Unitless" IHU
 SG_ IvtrPhaPwmDutyIvtrPhaVPwmDuty : 279|8@0+ (1.0,0.0) [0.0|255.0] "Unitless" IHU
 SG_ IvtrPhaPwmDutyIvtrPhaWPwmDuty : 287|8@0+ (1.0,0.0) [0.0|255.0] "Unitless" IHU
 SG_ IvtrQ_UB : 220|1@0+ (1,0) [0|1] "" IHU
 SG_ IvtrQAxisCurrtSp : 215|11@0+ (1.0,-1023.0) [-1023.0|1024.0] "Unitless" IHU
 SG_ IvtrQAxisU : 199|16@0+ (0.1,-1310.0) [-1310.0|5243.5] "Unitless" IHU
 SG_ IvtrReqIdWithLimn : 218|11@0+ (1.0,-1023.0) [-1023.0|1024.0] "Unitless" IHU
 SG_ IvtrReqIdWithLimn_UB : 219|1@0+ (1,0) [0|1] "" IHU
 SG_ IvtrReqIqWithLimn : 239|11@0+ (1.0,-1023.0) [-1023.0|1024.0] "Unitless" IHU
 SG_ IvtrReqIqWithLimn_UB : 244|1@0+ (1,0) [0|1] "" IHU
 SG_ IvtrResolverAg : 255|16@0+ (0.01,0.0) [0.0|655.35] "Unitless" IHU
 SG_ IvtrResolverAg_UB : 243|1@0+ (1,0) [0|1] "" IHU
 SG_ IvtrSfty_UB : 341|1@0+ (1,0) [0|1] "" IHU
 SG_ IvtrSftyFctMod : 303|8@0+ (1.0,0.0) [0.0|255.0] "Unitless" IHU
 SG_ IvtrSftySpd : 311|16@0+ (1.0,-20000.0) [-20000.0|45535.0] "rpm" IHU
 SG_ IvtrSftyTq : 327|16@0+ (1.0,-8000.0) [-8000.0|57535.0] "Unitless" IHU
 SG_ IvtrSftyTqQf : 343|2@0+ (1.0,0.0) [0.0|3.0] "Unitless" IHU
 SG_ IvtrTqDir : 295|8@0+ (1.0,0.0) [0.0|255.0] "Unitless" IHU
 SG_ IvtrTqDir_UB : 240|1@0+ (1,0) [0|1] "" IHU
 SG_ IvtrTraPhaCurrtAry_UB : 339|1@0+ (1,0) [0|1] "" IHU
 SG_ IvtrTraPhaCurrtAryU : 338|11@0+ (1.0,-1023.0) [-1023.0|1024.0] "Unitless" IHU
 SG_ IvtrTraPhaCurrtAryV : 359|11@0+ (1.0,-1023.0) [-1023.0|1024.0] "Unitless" IHU
 SG_ IvtrTraPhaCurrtAryW : 362|11@0+ (1.0,-1023.0) [-1023.0|1024.0] "Unitless" IHU
 SG_ MotorHeatrPwrCnsDes : 383|8@0+ (0.1,0.0) [0.0|25.5] "Unitless" IHU
 SG_ MotorHeatrPwrCnsDes_UB : 340|1@0+ (1,0) [0|1] "" IHU
 SG_ MotSpdForWRC : 391|16@0+ (1.0,-20000.0) [-20000.0|45535.0] "rpm" IHU
 SG_ MotSpdForWRC_UB : 423|1@0+ (1,0) [0|1] "" IHU
 SG_ MotTqEstForWRC : 407|16@0+ (1.0,-8000.0) [-8000.0|57535.0] "Unitless" IHU
 SG_ MotTqEstForWRC_UB : 422|1@0+ (1,0) [0|1] "" IHU
 SG_ OTAActvHVReq : 420|1@0+ (1,0) [0|1] "" IHU
 SG_ OTAActvHVReq_UB : 421|1@0+ (1,0) [0|1] "" IHU
 SG_ PredDrvPwrReq : 418|11@0+ (1.0,-1000.0) [-1000.0|1047.0] "kW" IHU
 SG_ PredDrvPwrReq_UB : 419|1@0+ (1,0) [0|1] "" IHU
 SG_ PredTarSoc : 497|10@0+ (0.1,0.0) [0.0|102.30000000000001] "%" IHU
 SG_ PredTarSoc_UB : 498|1@0+ (1,0) [0|1] "" IHU
 SG_ PrpsnAllwd : 502|1@0+ (1,0) [0|1] "" IHU
 SG_ PrpsnAllwd_UB : 501|1@0+ (1,0) [0|1] "" IHU
 SG_ PtTqMCU_UB : 503|1@0+ (1,0) [0|1] "" IHU
 SG_ PtTqMCUPtTqFrntMotMaxReq : 439|16@0+ (1.0,-8000.0) [-8000.0|57535.0] "Unitless" IHU
 SG_ PtTqMCUPtTqFrntMotMinReq : 455|16@0+ (1.0,-8000.0) [-8000.0|57535.0] "Unitless" IHU
 SG_ PtTqMCUPtTqReMotMaxReq : 471|16@0+ (1.0,-8000.0) [-8000.0|57535.0] "Unitless" IHU
 SG_ PtTqMCUPtTqReMotMinReq : 487|16@0+ (1.0,-8000.0) [-8000.0|57535.0] "Unitless" IHU
 SG_ RemStrt : 500|1@0+ (1,0) [0|1] "" IHU
 SG_ RemStrt_UB : 499|1@0+ (1,0) [0|1] "" IHU

CM_ SG_ 52 BodyDataTraceZCUDM1Functiondevpsignalgroup1 "ZCUDM internal signal group1.";
CM_ SG_ 52 BodyDataTraceZCUDM1Functiondevpsignalgroup2 "ZCUDM internal signal group2.";
CM_ SG_ 52 BodyDataTraceZCUDM1Functiondevpsignalgroup3 "ZCUDM internal signal group3.";
CM_ SG_ 52 BodyDataTraceZCUDM1Functiondevpsignalgroup4 "ZCUDM internal signal group4.";
CM_ SG_ 52 BodyDataTraceZCUDM1Functiondevpsignalgroup5 "ZCUDM internal signal group5.";
CM_ SG_ 52 BodyDataTraceZCUDM1Functiondevpsignalgroup6 "ZCUDM internal signal group6.";
CM_ SG_ 52 BodyDataTraceZCUDM1Functiondevpsignalgroup7 "ZCUDM internal signal group7.";
CM_ SG_ 52 BodyDataTraceZCUDM1Functiondevpsignalgroup8 "ZCUDM internal signal group8.";
CM_ SG_ 52 BodyDataTraceZCUDM2Functiondevpsignalgroup1 "ZCUDM internal signal group9.";
CM_ SG_ 52 BodyDataTraceZCUDM2Functiondevpsignalgroup2 "ZCUDM internal signal group10.";
CM_ SG_ 52 BodyDataTraceZCUDM2Functiondevpsignalgroup3 "ZCUDM internal signal group11.";
CM_ SG_ 52 BodyDataTraceZCUDM2Functiondevpsignalgroup4 "ZCUDM internal signal group12.";
CM_ SG_ 52 BodyDataTraceZCUDM2Functiondevpsignalgroup5 "ZCUDM internal signal group13.";
CM_ SG_ 52 BodyDataTraceZCUDM2Functiondevpsignalgroup6 "ZCUDM internal signal group14.";
CM_ SG_ 52 BodyDataTraceZCUDM2Functiondevpsignalgroup7 "ZCUDM internal signal group15.";
CM_ SG_ 52 BodyDataTraceZCUDM2Functiondevpsignalgroup8 "ZCUDM internal signal group16.";
CM_ SG_ 52 BodyDataTraceZCUDM3Functiondevpsignalgroup1 "ZCUDM internal signal group17.";
CM_ SG_ 52 BodyDataTraceZCUDM3Functiondevpsignalgroup2 "ZCUDM internal signal group18.";
CM_ SG_ 52 BodyDataTraceZCUDM3Functiondevpsignalgroup3 "ZCUDM internal signal group19.";
CM_ SG_ 52 BodyDataTraceZCUDM3Functiondevpsignalgroup4 "ZCUDM internal signal group20.";
CM_ SG_ 52 BodyDataTraceZCUDM3Functiondevpsignalgroup5 "ZCUDM internal signal group21.";
CM_ SG_ 52 BodyDataTraceZCUDM3Functiondevpsignalgroup6 "ZCUDM internal signal group22.";
CM_ SG_ 52 BodyDataTraceZCUDM3Functiondevpsignalgroup7 "ZCUDM internal signal group23.";
CM_ SG_ 52 BodyDataTraceZCUDM3Functiondevpsignalgroup8 "ZCUDM internal signal group24.";
CM_ SG_ 52 BodyDataTraceZCUDM4Functiondevpsignalgroup1 "ZCUDM internal signal group25.";
CM_ SG_ 52 BodyDataTraceZCUDM4Functiondevpsignalgroup2 "ZCUDM internal signal group26.";
CM_ SG_ 52 BodyDataTraceZCUDM4Functiondevpsignalgroup3 "ZCUDM internal signal group27.";
CM_ SG_ 52 BodyDataTraceZCUDM4Functiondevpsignalgroup4 "ZCUDM internal signal group28.";
CM_ SG_ 52 BodyDataTraceZCUDM4Functiondevpsignalgroup5 "ZCUDM internal signal group29";
CM_ SG_ 52 BodyDataTraceZCUDM4Functiondevpsignalgroup6 "ZCUDM internal signal group30.";
CM_ SG_ 52 BodyDataTraceZCUDM4Functiondevpsignalgroup7 "ZCUDM internal signal group31.";
CM_ SG_ 52 BodyDataTraceZCUDM4Functiondevpsignalgroup8 "ZCUDM internal signal group32.";
CM_ SG_ 52 BodyDataTraceZCUDM5Functiondevpsignalgroup1 "ZCUDM internal signal group33.";
CM_ SG_ 52 BodyDataTraceZCUDM5Functiondevpsignalgroup2 "ZCUDM internal signal group34.";
CM_ SG_ 52 BodyDataTraceZCUDM5Functiondevpsignalgroup3 "ZCUDM internal signal group35.";
CM_ SG_ 52 BodyDataTraceZCUDM5Functiondevpsignalgroup4 "ZCUDM internal signal group36.";
CM_ SG_ 52 BodyDataTraceZCUDM5Functiondevpsignalgroup5 "ZCUDM internal signal group37.";
CM_ SG_ 52 BodyDataTraceZCUDM5Functiondevpsignalgroup6 "ZCUDM internal signal group38.";
CM_ SG_ 52 BodyDataTraceZCUDM5Functiondevpsignalgroup7 "ZCUDM internal signal group39.";
CM_ SG_ 52 BodyDataTraceZCUDM5Functiondevpsignalgroup8 "ZCUDM internal signal group40.";
CM_ SG_ 52 BodyDataTraceZCUDM6Functiondevpsignalgroup1 "ZCUDM internal signal group41.";
CM_ SG_ 52 BodyDataTraceZCUDM6Functiondevpsignalgroup2 "ZCUDM internal signal group42.";
CM_ SG_ 52 BodyDataTraceZCUDM6Functiondevpsignalgroup3 "ZCUDM internal signal group43.";
CM_ SG_ 52 BodyDataTraceZCUDM6Functiondevpsignalgroup4 "ZCUDM internal signal group44.";
CM_ SG_ 52 BodyDataTraceZCUDM6Functiondevpsignalgroup5 "ZCUDM internal signal group45.";
CM_ SG_ 52 BodyDataTraceZCUDM6Functiondevpsignalgroup6 "ZCUDM internal signal group46.";
CM_ SG_ 52 BodyDataTraceZCUDM6Functiondevpsignalgroup7 "ZCUDM internal signal group47.";
CM_ SG_ 52 BodyDataTraceZCUDM6Functiondevpsignalgroup8 "ZCUDM internal signal group48.";
CM_ SG_ 52 BodyDataTraceZCUDM7Functiondevpsignalgroup1 "ZCUDM internal signal group49.";
CM_ SG_ 52 BodyDataTraceZCUDM7Functiondevpsignalgroup2 "ZCUDM internal signal group50.";
CM_ SG_ 52 BodyDataTraceZCUDM7Functiondevpsignalgroup3 "ZCUDM internal signal group51.";
CM_ SG_ 52 BodyDataTraceZCUDM7Functiondevpsignalgroup4 "ZCUDM internal signal group52.";
CM_ SG_ 52 BodyDataTraceZCUDM7Functiondevpsignalgroup5 "ZCUDM internal signal group53.";
CM_ SG_ 52 BodyDataTraceZCUDM7Functiondevpsignalgroup6 "ZCUDM internal signal group54.";
CM_ SG_ 52 BodyDataTraceZCUDM7Functiondevpsignalgroup7 "ZCUDM internal signal group55.";
CM_ SG_ 52 BodyDataTraceZCUDM7Functiondevpsignalgroup8 "ZCUDM internal signal group56.";
CM_ SG_ 552 ECM4BigDataCnt "The first byte of the CANFD frame, where the highest bit represents the UB signal and the remaining 7 bits represent the signal, which is used as the ID signal.";
CM_ SG_ 552 ECM4BigDataData1 "The second byte of the CANFD frame, used to transmit the ECU signal";
CM_ SG_ 552 ECM4BigDataData10 "The n+1(Data n) byte of the CANFD frame, used to transmit the ECU signal.";
CM_ SG_ 552 ECM4BigDataData11 "The n+1(Data n) byte of the CANFD frame, used to transmit the ECU signal.";
CM_ SG_ 552 ECM4BigDataData12 "The n+1(Data n) byte of the CANFD frame, used to transmit the ECU signal.";
CM_ SG_ 552 ECM4BigDataData13 "The n+1(Data n) byte of the CANFD frame, used to transmit the ECU signal.";
CM_ SG_ 552 ECM4BigDataData14 "The n+1(Data n) byte of the CANFD frame, used to transmit the ECU signal.";
CM_ SG_ 552 ECM4BigDataData15 "The n+1(Data n) byte of the CANFD frame, used to transmit the ECU signal.";
CM_ SG_ 552 ECM4BigDataData16 "The n+1(Data n) byte of the CANFD frame, used to transmit the ECU signal.";
CM_ SG_ 552 ECM4BigDataData17 "The n+1(Data n) byte of the CANFD frame, used to transmit the ECU signal.";
CM_ SG_ 552 ECM4BigDataData18 "The n+1(Data n) byte of the CANFD frame, used to transmit the ECU signal.";
CM_ SG_ 552 ECM4BigDataData19 "The n+1(Data n) byte of the CANFD frame, used to transmit the ECU signal.";
CM_ SG_ 552 ECM4BigDataData2 "The third byte of the CANFD frame, used to transmit the ECU signal.";
CM_ SG_ 552 ECM4BigDataData20 "The n+1(Data n) byte of the CANFD frame, used to transmit the ECU signal.";
CM_ SG_ 552 ECM4BigDataData21 "The n+1(Data n) byte of the CANFD frame, used to transmit the ECU signal.";
CM_ SG_ 552 ECM4BigDataData22 "The n+1(Data n) byte of the CANFD frame, used to transmit the ECU signal.";
CM_ SG_ 552 ECM4BigDataData23 "The n+1(Data n) byte of the CANFD frame, used to transmit the ECU signal.";
CM_ SG_ 552 ECM4BigDataData24 "The n+1(Data n) byte of the CANFD frame, used to transmit the ECU signal.";
CM_ SG_ 552 ECM4BigDataData25 "The n+1(Data n) byte of the CANFD frame, used to transmit the ECU signal.";
CM_ SG_ 552 ECM4BigDataData26 "The n+1(Data n) byte of the CANFD frame, used to transmit the ECU signal.";
CM_ SG_ 552 ECM4BigDataData27 "The n+1(Data n) byte of the CANFD frame, used to transmit the ECU signal.";
CM_ SG_ 552 ECM4BigDataData28 "The n+1(Data n) byte of the CANFD frame, used to transmit the ECU signal.";
CM_ SG_ 552 ECM4BigDataData29 "The n+1(Data n) byte of the CANFD frame, used to transmit the ECU signal.";
CM_ SG_ 552 ECM4BigDataData3 "The fourth byte of the CANFD frame, used to transmit the ECU signal.";
CM_ SG_ 552 ECM4BigDataData30 "The n+1(Data n) byte of the CANFD frame, used to transmit the ECU signal.";
CM_ SG_ 552 ECM4BigDataData31 "The n+1(Data n) byte of the CANFD frame, used to transmit the ECU signal.";
CM_ SG_ 552 ECM4BigDataData32 "The n+1(Data n) byte of the CANFD frame, used to transmit the ECU signal.";
CM_ SG_ 552 ECM4BigDataData33 "The n+1(Data n) byte of the CANFD frame, used to transmit the ECU signal.";
CM_ SG_ 552 ECM4BigDataData34 "The n+1(Data n) byte of the CANFD frame, used to transmit the ECU signal.";
CM_ SG_ 552 ECM4BigDataData35 "The n+1(Data n) byte of the CANFD frame, used to transmit the ECU signal.";
CM_ SG_ 552 ECM4BigDataData36 "The n+1(Data n) byte of the CANFD frame, used to transmit the ECU signal.";
CM_ SG_ 552 ECM4BigDataData37 "The n+1(Data n) byte of the CANFD frame, used to transmit the ECU signal.";
CM_ SG_ 552 ECM4BigDataData38 "The n+1(Data n) byte of the CANFD frame, used to transmit the ECU signal.";
CM_ SG_ 552 ECM4BigDataData39 "The n+1(Data n) byte of the CANFD frame, used to transmit the ECU signal.";
CM_ SG_ 552 ECM4BigDataData4 "The fifth byte of the CANFD frame, used to transmit the ECU signal.";
CM_ SG_ 552 ECM4BigDataData40 "The n+1(Data n) byte of the CANFD frame, used to transmit the ECU signal.";
CM_ SG_ 552 ECM4BigDataData41 "The n+1(Data n) byte of the CANFD frame, used to transmit the ECU signal.";
CM_ SG_ 552 ECM4BigDataData42 "The n+1(Data n) byte of the CANFD frame, used to transmit the ECU signal.";
CM_ SG_ 552 ECM4BigDataData43 "The n+1(Data n) byte of the CANFD frame, used to transmit the ECU signal.";
CM_ SG_ 552 ECM4BigDataData44 "The n+1(Data n) byte of the CANFD frame, used to transmit the ECU signal.";
CM_ SG_ 552 ECM4BigDataData45 "The n+1(Data n) byte of the CANFD frame, used to transmit the ECU signal.";
CM_ SG_ 552 ECM4BigDataData46 "The n+1(Data n) byte of the CANFD frame, used to transmit the ECU signal.";
CM_ SG_ 552 ECM4BigDataData47 "The n+1(Data n) byte of the CANFD frame, used to transmit the ECU signal.";
CM_ SG_ 552 ECM4BigDataData48 "The n+1(Data n) byte of the CANFD frame, used to transmit the ECU signal.";
CM_ SG_ 552 ECM4BigDataData49 "The n+1(Data n) byte of the CANFD frame, used to transmit the ECU signal.";
CM_ SG_ 552 ECM4BigDataData5 "The sixth byte of the CANFD frame, used to transmit the ECU signal.";
CM_ SG_ 552 ECM4BigDataData50 "The n+1(Data n) byte of the CANFD frame, used to transmit the ECU signal.";
CM_ SG_ 552 ECM4BigDataData51 "The n+1(Data n) byte of the CANFD frame, used to transmit the ECU signal.";
CM_ SG_ 552 ECM4BigDataData52 "The n+1(Data n) byte of the CANFD frame, used to transmit the ECU signal.";
CM_ SG_ 552 ECM4BigDataData53 "The n+1(Data n) byte of the CANFD frame, used to transmit the ECU signal.";
CM_ SG_ 552 ECM4BigDataData54 "The n+1(Data n) byte of the CANFD frame, used to transmit the ECU signal.";
CM_ SG_ 552 ECM4BigDataData55 "The n+1(Data n) byte of the CANFD frame, used to transmit the ECU signal.";
CM_ SG_ 552 ECM4BigDataData56 "The n+1(Data n) byte of the CANFD frame, used to transmit the ECU signal.";
CM_ SG_ 552 ECM4BigDataData57 "The n+1(Data n) byte of the CANFD frame, used to transmit the ECU signal.";
CM_ SG_ 552 ECM4BigDataData58 "The n+1(Data n) byte of the CANFD frame, used to transmit the ECU signal.";
CM_ SG_ 552 ECM4BigDataData59 "The n+1(Data n) byte of the CANFD frame, used to transmit the ECU signal.";
CM_ SG_ 552 ECM4BigDataData6 "The seventh byte of the CANFD frame, used to transmit the ECU signal.";
CM_ SG_ 552 ECM4BigDataData60 "The n+1(Data n) byte of the CANFD frame, used to transmit the ECU signal.";
CM_ SG_ 552 ECM4BigDataData61 "The n+1(Data n) byte of the CANFD frame, used to transmit the ECU signal.";
CM_ SG_ 552 ECM4BigDataData62 "The n+1(Data n) byte of the CANFD frame, used to transmit the ECU signal.";
CM_ SG_ 552 ECM4BigDataData63 "The n+1(Data n) byte of the CANFD frame, used to transmit the ECU signal.";
CM_ SG_ 552 ECM4BigDataData7 "The n+1(Data n) byte of the CANFD frame, used to transmit the ECU signal.";
CM_ SG_ 552 ECM4BigDataData8 "The n+1(Data n) byte of the CANFD frame, used to transmit the ECU signal.";
CM_ SG_ 552 ECM4BigDataData9 "The n+1(Data n) byte of the CANFD frame, used to transmit the ECU signal.";
CM_ SG_ 555 PCMBigDataCnt "counter";
CM_ SG_ 555 PCMBigDataData1 "bigdata to cloud";
CM_ SG_ 555 PCMBigDataData10 "bigdata to cloud";
CM_ SG_ 555 PCMBigDataData11 "bigdata to cloud";
CM_ SG_ 555 PCMBigDataData12 "bigdata to cloud";
CM_ SG_ 555 PCMBigDataData13 "bigdata to cloud";
CM_ SG_ 555 PCMBigDataData14 "bigdata to cloud";
CM_ SG_ 555 PCMBigDataData15 "bigdata to cloud";
CM_ SG_ 555 PCMBigDataData16 "bigdata to cloud";
CM_ SG_ 555 PCMBigDataData17 "bigdata to cloud";
CM_ SG_ 555 PCMBigDataData18 "bigdata to cloud";
CM_ SG_ 555 PCMBigDataData19 "bigdata to cloud";
CM_ SG_ 555 PCMBigDataData2 "bigdata to cloud";
CM_ SG_ 555 PCMBigDataData20 "bigdata to cloud";
CM_ SG_ 555 PCMBigDataData21 "bigdata to cloud";
CM_ SG_ 555 PCMBigDataData22 "bigdata to cloud";
CM_ SG_ 555 PCMBigDataData23 "bigdata to cloud";
CM_ SG_ 555 PCMBigDataData24 "bigdata to cloud";
CM_ SG_ 555 PCMBigDataData25 "bigdata to cloud";
CM_ SG_ 555 PCMBigDataData26 "bigdata to cloud";
CM_ SG_ 555 PCMBigDataData27 "bigdata to cloud";
CM_ SG_ 555 PCMBigDataData28 "bigdata to cloud";
CM_ SG_ 555 PCMBigDataData29 "bigdata to cloud";
CM_ SG_ 555 PCMBigDataData3 "bigdata to cloud";
CM_ SG_ 555 PCMBigDataData30 "bigdata to cloud";
CM_ SG_ 555 PCMBigDataData31 "bigdata to cloud";
CM_ SG_ 555 PCMBigDataData32 "bigdata to cloud";
CM_ SG_ 555 PCMBigDataData33 "bigdata to cloud";
CM_ SG_ 555 PCMBigDataData34 "bigdata to cloud";
CM_ SG_ 555 PCMBigDataData35 "bigdata to cloud";
CM_ SG_ 555 PCMBigDataData36 "bigdata to cloud";
CM_ SG_ 555 PCMBigDataData37 "bigdata to cloud";
CM_ SG_ 555 PCMBigDataData38 "bigdata to cloud";
CM_ SG_ 555 PCMBigDataData39 "bigdata to cloud";
CM_ SG_ 555 PCMBigDataData4 "bigdata to cloud";
CM_ SG_ 555 PCMBigDataData40 "bigdata to cloud";
CM_ SG_ 555 PCMBigDataData41 "bigdata to cloud";
CM_ SG_ 555 PCMBigDataData42 "bigdata to cloud";
CM_ SG_ 555 PCMBigDataData43 "bigdata to cloud";
CM_ SG_ 555 PCMBigDataData44 "bigdata to cloud";
CM_ SG_ 555 PCMBigDataData45 "bigdata to cloud";
CM_ SG_ 555 PCMBigDataData46 "bigdata to cloud";
CM_ SG_ 555 PCMBigDataData47 "bigdata to cloud";
CM_ SG_ 555 PCMBigDataData48 "bigdata to cloud";
CM_ SG_ 555 PCMBigDataData49 "bigdata to cloud";
CM_ SG_ 555 PCMBigDataData5 "bigdata to cloud";
CM_ SG_ 555 PCMBigDataData50 "bigdata to cloud";
CM_ SG_ 555 PCMBigDataData51 "bigdata to cloud";
CM_ SG_ 555 PCMBigDataData52 "bigdata to cloud";
CM_ SG_ 555 PCMBigDataData53 "bigdata to cloud";
CM_ SG_ 555 PCMBigDataData54 "bigdata to cloud";
CM_ SG_ 555 PCMBigDataData55 "bigdata to cloud";
CM_ SG_ 555 PCMBigDataData56 "bigdata to cloud";
CM_ SG_ 555 PCMBigDataData57 "bigdata to cloud";
CM_ SG_ 555 PCMBigDataData58 "bigdata to cloud";
CM_ SG_ 555 PCMBigDataData59 "bigdata to cloud";
CM_ SG_ 555 PCMBigDataData6 "bigdata to cloud";
CM_ SG_ 555 PCMBigDataData60 "bigdata to cloud";
CM_ SG_ 555 PCMBigDataData61 "bigdata to cloud";
CM_ SG_ 555 PCMBigDataData62 "bigdata to cloud";
CM_ SG_ 555 PCMBigDataData63 "bigdata to cloud";
CM_ SG_ 555 PCMBigDataData7 "bigdata to cloud";
CM_ SG_ 555 PCMBigDataData8 "bigdata to cloud";
CM_ SG_ 555 PCMBigDataData9 "bigdata to cloud";
CM_ SG_ 816 BMXSDrvTq2VDMChks "checksum";
CM_ SG_ 816 BMXSDrvTq2VDMCntr "rolling counter";
CM_ SG_ 816 BMXSDrvTq2VDMTqVDM "Power torque request signal";
CM_ SG_ 816 BMXSDrvTq2VDMTqVDMCtrlMode "Power torque request signal control mode";
CM_ SG_ 816 BMXSDrvTq2VDMTqVDMQf "Power torque request signal QF";
CM_ SG_ 816 VFCVectorSMBBlockID "BlockID";
CM_ SG_ 816 VFCVectorSMBLBlockID "BlockID";
CM_ SG_ 816 VFCVectorSMBLVFCid0 "SettingsComfort";
CM_ SG_ 816 VFCVectorSMBLVFCid1 "ParkingDrivingClimatization";
CM_ SG_ 816 VFCVectorSMBLVFCid10 "ExteriorLighting";
CM_ SG_ 816 VFCVectorSMBLVFCid11 "VFCid11";
CM_ SG_ 816 VFCVectorSMBLVFCid12 "Alarm";
CM_ SG_ 816 VFCVectorSMBLVFCid13 "VFCid13";
CM_ SG_ 816 VFCVectorSMBLVFCid14 "InteriorLighting";
CM_ SG_ 816 VFCVectorSMBLVFCid15 "VFCid15";
CM_ SG_ 816 VFCVectorSMBLVFCid16 "Locking";
CM_ SG_ 816 VFCVectorSMBLVFCid17 "RemoteKeyFunctionality";
CM_ SG_ 816 VFCVectorSMBLVFCid18 "PropulsionStart";
CM_ SG_ 816 VFCVectorSMBLVFCid19 "VFCid19";
CM_ SG_ 816 VFCVectorSMBLVFCid2 "PostClimatisation";
CM_ SG_ 816 VFCVectorSMBLVFCid20 "VFCid20";
CM_ SG_ 816 VFCVectorSMBLVFCid21 "PowerClosures";
CM_ SG_ 816 VFCVectorSMBLVFCid22 "VehicleDriving";
CM_ SG_ 816 VFCVectorSMBLVFCid23 "VFCid23";
CM_ SG_ 816 VFCVectorSMBLVFCid24 "SettingsProfile";
CM_ SG_ 816 VFCVectorSMBLVFCid25 "SeatComfortFunctions";
CM_ SG_ 816 VFCVectorSMBLVFCid26 "Brake";
CM_ SG_ 816 VFCVectorSMBLVFCid27 "InfotainmentPoll";
CM_ SG_ 816 VFCVectorSMBLVFCid28 "HVEnergyStorage";
CM_ SG_ 816 VFCVectorSMBLVFCid29 "VFCid29";
CM_ SG_ 816 VFCVectorSMBLVFCid3 "PowertrainParkingClimatization";
CM_ SG_ 816 VFCVectorSMBLVFCid30 "TelematicsConnectivity";
CM_ SG_ 816 VFCVectorSMBLVFCid31 "VFCid31";
CM_ SG_ 816 VFCVectorSMBLVFCid32 "VFCid32";
CM_ SG_ 816 VFCVectorSMBLVFCid33 "Diagnostics";
CM_ SG_ 816 VFCVectorSMBLVFCid34 "VehicleModeManagement";
CM_ SG_ 816 VFCVectorSMBLVFCid35 "TrailerCaravanFunctions";
CM_ SG_ 816 VFCVectorSMBLVFCid36 "Immobilizer";
CM_ SG_ 816 VFCVectorSMBLVFCid37 "Windows";
CM_ SG_ 816 VFCVectorSMBLVFCid38 "Visibility";
CM_ SG_ 816 VFCVectorSMBLVFCid39 "VFCid39";
CM_ SG_ 816 VFCVectorSMBLVFCid4 "VFCid4";
CM_ SG_ 816 VFCVectorSMBLVFCid40 "VFCid40";
CM_ SG_ 816 VFCVectorSMBLVFCid41 "InfotainmentPush";
CM_ SG_ 816 VFCVectorSMBLVFCid42 "ChargingHV";
CM_ SG_ 816 VFCVectorSMBLVFCid43 "BodyPreClimatisation";
CM_ SG_ 816 VFCVectorSMBLVFCid44 "Crash";
CM_ SG_ 816 VFCVectorSMBLVFCid45 "GlobalShortDuration";
CM_ SG_ 816 VFCVectorSMBLVFCid46 "ExteriorLightsHazard";
CM_ SG_ 816 VFCVectorSMBLVFCid47 "VFCid47";
CM_ SG_ 816 VFCVectorSMBLVFCid48 "DoorOpenWarning";
CM_ SG_ 816 VFCVectorSMBLVFCid49 "ChargingLVInit";
CM_ SG_ 816 VFCVectorSMBLVFCid5 "VFCid5";
CM_ SG_ 816 VFCVectorSMBLVFCid50 "VFCid50";
CM_ SG_ 816 VFCVectorSMBLVFCid51 "VFCid51";
CM_ SG_ 816 VFCVectorSMBLVFCid52 "HVBatteryThermalEventWarning";
CM_ SG_ 816 VFCVectorSMBLVFCid53 "VisualAssist";
CM_ SG_ 816 VFCVectorSMBLVFCid54 "PassiveSafety";
CM_ SG_ 816 VFCVectorSMBLVFCid55 "LifeDetection";
CM_ SG_ 816 VFCVectorSMBLVFCid56 "BackboneFlexray";
CM_ SG_ 816 VFCVectorSMBLVFCid57 "Functionmarket";
CM_ SG_ 816 VFCVectorSMBLVFCid58 "VFCid58";
CM_ SG_ 816 VFCVectorSMBLVFCid59 "VFCid59";
CM_ SG_ 816 VFCVectorSMBLVFCid6 "SettingsVehicle";
CM_ SG_ 816 VFCVectorSMBLVFCid60 "VFCid60";
CM_ SG_ 816 VFCVectorSMBLVFCid61 "VFCid61";
CM_ SG_ 816 VFCVectorSMBLVFCid7 "VFCid7";
CM_ SG_ 816 VFCVectorSMBLVFCid8 "VFCid8";
CM_ SG_ 816 VFCVectorSMBLVFCid9 "IPWakeup";
CM_ SG_ 816 VFCVectorSMBRBlockID "BlockID";
CM_ SG_ 816 VFCVectorSMBRVFCid0 "SettingsComfort";
CM_ SG_ 816 VFCVectorSMBRVFCid1 "ParkingDrivingClimatization";
CM_ SG_ 816 VFCVectorSMBRVFCid10 "ExteriorLighting";
CM_ SG_ 816 VFCVectorSMBRVFCid11 "VFCid11";
CM_ SG_ 816 VFCVectorSMBRVFCid12 "Alarm";
CM_ SG_ 816 VFCVectorSMBRVFCid13 "VFCid13";
CM_ SG_ 816 VFCVectorSMBRVFCid14 "InteriorLighting";
CM_ SG_ 816 VFCVectorSMBRVFCid15 "VFCid15";
CM_ SG_ 816 VFCVectorSMBRVFCid16 "Locking";
CM_ SG_ 816 VFCVectorSMBRVFCid17 "RemoteKeyFunctionality";
CM_ SG_ 816 VFCVectorSMBRVFCid18 "PropulsionStart";
CM_ SG_ 816 VFCVectorSMBRVFCid19 "VFCid19";
CM_ SG_ 816 VFCVectorSMBRVFCid2 "PostClimatisation";
CM_ SG_ 816 VFCVectorSMBRVFCid20 "VFCid20";
CM_ SG_ 816 VFCVectorSMBRVFCid21 "PowerClosures";
CM_ SG_ 816 VFCVectorSMBRVFCid22 "VehicleDriving";
CM_ SG_ 816 VFCVectorSMBRVFCid23 "VFCid23";
CM_ SG_ 816 VFCVectorSMBRVFCid24 "SettingsProfile";
CM_ SG_ 816 VFCVectorSMBRVFCid25 "SeatComfortFunctions";
CM_ SG_ 816 VFCVectorSMBRVFCid26 "Brake";
CM_ SG_ 816 VFCVectorSMBRVFCid27 "InfotainmentPoll";
CM_ SG_ 816 VFCVectorSMBRVFCid28 "HVEnergyStorage";
CM_ SG_ 816 VFCVectorSMBRVFCid29 "VFCid29";
CM_ SG_ 816 VFCVectorSMBRVFCid3 "PowertrainParkingClimatization";
CM_ SG_ 816 VFCVectorSMBRVFCid30 "TelematicsConnectivity";
CM_ SG_ 816 VFCVectorSMBRVFCid31 "VFCid31";
CM_ SG_ 816 VFCVectorSMBRVFCid32 "VFCid32";
CM_ SG_ 816 VFCVectorSMBRVFCid33 "Diagnostics";
CM_ SG_ 816 VFCVectorSMBRVFCid34 "VehicleModeManagement";
CM_ SG_ 816 VFCVectorSMBRVFCid35 "TrailerCaravanFunctions";
CM_ SG_ 816 VFCVectorSMBRVFCid36 "Immobilizer";
CM_ SG_ 816 VFCVectorSMBRVFCid37 "Windows";
CM_ SG_ 816 VFCVectorSMBRVFCid38 "Visibility";
CM_ SG_ 816 VFCVectorSMBRVFCid39 "VFCid39";
CM_ SG_ 816 VFCVectorSMBRVFCid4 "VFCid4";
CM_ SG_ 816 VFCVectorSMBRVFCid40 "VFCid40";
CM_ SG_ 816 VFCVectorSMBRVFCid41 "InfotainmentPush";
CM_ SG_ 816 VFCVectorSMBRVFCid42 "ChargingHV";
CM_ SG_ 816 VFCVectorSMBRVFCid43 "BodyPreClimatisation";
CM_ SG_ 816 VFCVectorSMBRVFCid44 "Crash";
CM_ SG_ 816 VFCVectorSMBRVFCid45 "GlobalShortDuration";
CM_ SG_ 816 VFCVectorSMBRVFCid46 "ExteriorLightsHazard";
CM_ SG_ 816 VFCVectorSMBRVFCid47 "VFCid47";
CM_ SG_ 816 VFCVectorSMBRVFCid48 "DoorOpenWarning";
CM_ SG_ 816 VFCVectorSMBRVFCid49 "ChargingLVInit";
CM_ SG_ 816 VFCVectorSMBRVFCid5 "VFCid5";
CM_ SG_ 816 VFCVectorSMBRVFCid50 "VFCid50";
CM_ SG_ 816 VFCVectorSMBRVFCid51 "VFCid51";
CM_ SG_ 816 VFCVectorSMBRVFCid52 "HVBatteryThermalEventWarning";
CM_ SG_ 816 VFCVectorSMBRVFCid53 "VisualAssist";
CM_ SG_ 816 VFCVectorSMBRVFCid54 "PassiveSafety";
CM_ SG_ 816 VFCVectorSMBRVFCid55 "LifeDetection";
CM_ SG_ 816 VFCVectorSMBRVFCid56 "BackboneFlexray";
CM_ SG_ 816 VFCVectorSMBRVFCid57 "Functionmarket";
CM_ SG_ 816 VFCVectorSMBRVFCid58 "VFCid58";
CM_ SG_ 816 VFCVectorSMBRVFCid59 "VFCid59";
CM_ SG_ 816 VFCVectorSMBRVFCid6 "SettingsVehicle";
CM_ SG_ 816 VFCVectorSMBRVFCid60 "VFCid60";
CM_ SG_ 816 VFCVectorSMBRVFCid61 "VFCid61";
CM_ SG_ 816 VFCVectorSMBRVFCid7 "VFCid7";
CM_ SG_ 816 VFCVectorSMBRVFCid8 "VFCid8";
CM_ SG_ 816 VFCVectorSMBRVFCid9 "IPWakeup";
CM_ SG_ 816 VFCVectorSMBVFCid0 "SettingsComfort";
CM_ SG_ 816 VFCVectorSMBVFCid1 "ParkingDrivingClimatization";
CM_ SG_ 816 VFCVectorSMBVFCid10 "ExteriorLighting";
CM_ SG_ 816 VFCVectorSMBVFCid11 "VFC11";
CM_ SG_ 816 VFCVectorSMBVFCid12 "Alarm";
CM_ SG_ 816 VFCVectorSMBVFCid13 "VFC13";
CM_ SG_ 816 VFCVectorSMBVFCid14 "InteriorLighting";
CM_ SG_ 816 VFCVectorSMBVFCid15 "VFC15";
CM_ SG_ 816 VFCVectorSMBVFCid16 "Locking";
CM_ SG_ 816 VFCVectorSMBVFCid17 "emoteKeyFunctionality";
CM_ SG_ 816 VFCVectorSMBVFCid18 "PropulsionStart";
CM_ SG_ 816 VFCVectorSMBVFCid19 "VFC19";
CM_ SG_ 816 VFCVectorSMBVFCid2 "PostClimatisation";
CM_ SG_ 816 VFCVectorSMBVFCid20 "VFC20";
CM_ SG_ 816 VFCVectorSMBVFCid21 "PowerClosures";
CM_ SG_ 816 VFCVectorSMBVFCid22 "VehicleDriving";
CM_ SG_ 816 VFCVectorSMBVFCid23 "VFC23";
CM_ SG_ 816 VFCVectorSMBVFCid24 "SettingsProfile";
CM_ SG_ 816 VFCVectorSMBVFCid25 "SeatComfortFunctions";
CM_ SG_ 816 VFCVectorSMBVFCid26 "Brake";
CM_ SG_ 816 VFCVectorSMBVFCid27 "InfotainmentPoll";
CM_ SG_ 816 VFCVectorSMBVFCid28 "HVEnergyStorage";
CM_ SG_ 816 VFCVectorSMBVFCid29 "VFC29";
CM_ SG_ 816 VFCVectorSMBVFCid3 "PowertrainParkingClimatization";
CM_ SG_ 816 VFCVectorSMBVFCid30 "TelematicsConnectivity";
CM_ SG_ 816 VFCVectorSMBVFCid31 "VFC31";
CM_ SG_ 816 VFCVectorSMBVFCid32 "VFC32";
CM_ SG_ 816 VFCVectorSMBVFCid33 "Diagnostics";
CM_ SG_ 816 VFCVectorSMBVFCid34 "VehicleModeManagement";
CM_ SG_ 816 VFCVectorSMBVFCid35 "TrailerCaravanFunctions";
CM_ SG_ 816 VFCVectorSMBVFCid36 "Immobilizer";
CM_ SG_ 816 VFCVectorSMBVFCid37 "Windows";
CM_ SG_ 816 VFCVectorSMBVFCid38 "Visibility";
CM_ SG_ 816 VFCVectorSMBVFCid39 "VFC39";
CM_ SG_ 816 VFCVectorSMBVFCid4 "VFC4";
CM_ SG_ 816 VFCVectorSMBVFCid40 "VFC40";
CM_ SG_ 816 VFCVectorSMBVFCid41 "InfotainmentPush";
CM_ SG_ 816 VFCVectorSMBVFCid42 "ChargingHV";
CM_ SG_ 816 VFCVectorSMBVFCid43 "BodyPreClimatisation";
CM_ SG_ 816 VFCVectorSMBVFCid44 "Crash";
CM_ SG_ 816 VFCVectorSMBVFCid45 "GlobalShortDuration";
CM_ SG_ 816 VFCVectorSMBVFCid46 "ExteriorLightsHazard";
CM_ SG_ 816 VFCVectorSMBVFCid47 "VFC47";
CM_ SG_ 816 VFCVectorSMBVFCid48 "DoorOpenWarning";
CM_ SG_ 816 VFCVectorSMBVFCid49 "ChargingLVInit";
CM_ SG_ 816 VFCVectorSMBVFCid5 "VFC5";
CM_ SG_ 816 VFCVectorSMBVFCid50 "VFC50";
CM_ SG_ 816 VFCVectorSMBVFCid51 "VFC51";
CM_ SG_ 816 VFCVectorSMBVFCid52 "HVBatteryThermalEventWarning";
CM_ SG_ 816 VFCVectorSMBVFCid53 "VisualAssist";
CM_ SG_ 816 VFCVectorSMBVFCid54 "PassiveSafety";
CM_ SG_ 816 VFCVectorSMBVFCid55 "LifeDetection";
CM_ SG_ 816 VFCVectorSMBVFCid56 "BackboneFlexray";
CM_ SG_ 816 VFCVectorSMBVFCid57 "Functionmarket";
CM_ SG_ 816 VFCVectorSMBVFCid58 "VFCid58";
CM_ SG_ 816 VFCVectorSMBVFCid59 "VFCid59";
CM_ SG_ 816 VFCVectorSMBVFCid6 "SettingsVehicle";
CM_ SG_ 816 VFCVectorSMBVFCid60 "VFCid60";
CM_ SG_ 816 VFCVectorSMBVFCid61 "VFCid61";
CM_ SG_ 816 VFCVectorSMBVFCid7 "VFC7";
CM_ SG_ 816 VFCVectorSMBVFCid8 "VFC8";
CM_ SG_ 816 VFCVectorSMBVFCid9 "IPWakeup";
CM_ SG_ 816 VFCVectorTRMBlockID "BlockID";
CM_ SG_ 816 VFCVectorTRMVFCid0 "SettingsComfort";
CM_ SG_ 816 VFCVectorTRMVFCid1 "ParkingDrivingClimatization";
CM_ SG_ 816 VFCVectorTRMVFCid10 "ExteriorLighting";
CM_ SG_ 816 VFCVectorTRMVFCid11 "VFC11";
CM_ SG_ 816 VFCVectorTRMVFCid12 "Alarm";
CM_ SG_ 816 VFCVectorTRMVFCid13 "VFC13";
CM_ SG_ 816 VFCVectorTRMVFCid14 "InteriorLighting";
CM_ SG_ 816 VFCVectorTRMVFCid15 "VFC15";
CM_ SG_ 816 VFCVectorTRMVFCid16 "Locking";
CM_ SG_ 816 VFCVectorTRMVFCid17 "emoteKeyFunctionality";
CM_ SG_ 816 VFCVectorTRMVFCid18 "PropulsionStart";
CM_ SG_ 816 VFCVectorTRMVFCid19 "VFC19";
CM_ SG_ 816 VFCVectorTRMVFCid2 "PostClimatisation";
CM_ SG_ 816 VFCVectorTRMVFCid20 "VFC20";
CM_ SG_ 816 VFCVectorTRMVFCid21 "PowerClosures";
CM_ SG_ 816 VFCVectorTRMVFCid22 "VehicleDriving";
CM_ SG_ 816 VFCVectorTRMVFCid23 "VFC23";
CM_ SG_ 816 VFCVectorTRMVFCid24 "SettingsProfile";
CM_ SG_ 816 VFCVectorTRMVFCid25 "SeatComfortFunctions";
CM_ SG_ 816 VFCVectorTRMVFCid26 "Brake";
CM_ SG_ 816 VFCVectorTRMVFCid27 "InfotainmentPoll";
CM_ SG_ 816 VFCVectorTRMVFCid28 "HVEnergyStorage";
CM_ SG_ 816 VFCVectorTRMVFCid29 "VFC29";
CM_ SG_ 816 VFCVectorTRMVFCid3 "PowertrainParkingClimatization";
CM_ SG_ 816 VFCVectorTRMVFCid30 "TelematicsConnectivity";
CM_ SG_ 816 VFCVectorTRMVFCid31 "VFC31";
CM_ SG_ 816 VFCVectorTRMVFCid32 "VFC32";
CM_ SG_ 816 VFCVectorTRMVFCid33 "Diagnostics";
CM_ SG_ 816 VFCVectorTRMVFCid34 "VehicleModeManagement";
CM_ SG_ 816 VFCVectorTRMVFCid35 "TrailerCaravanFunctions";
CM_ SG_ 816 VFCVectorTRMVFCid36 "Immobilizer";
CM_ SG_ 816 VFCVectorTRMVFCid37 "Windows";
CM_ SG_ 816 VFCVectorTRMVFCid38 "Visibility";
CM_ SG_ 816 VFCVectorTRMVFCid39 "VFC39";
CM_ SG_ 816 VFCVectorTRMVFCid4 "VFC4";
CM_ SG_ 816 VFCVectorTRMVFCid40 "VFC40";
CM_ SG_ 816 VFCVectorTRMVFCid41 "InfotainmentPush";
CM_ SG_ 816 VFCVectorTRMVFCid42 "ChargingHV";
CM_ SG_ 816 VFCVectorTRMVFCid43 "BodyPreClimatisation";
CM_ SG_ 816 VFCVectorTRMVFCid44 "Crash";
CM_ SG_ 816 VFCVectorTRMVFCid45 "GlobalShortDuration";
CM_ SG_ 816 VFCVectorTRMVFCid46 "ExteriorLightsHazard";
CM_ SG_ 816 VFCVectorTRMVFCid47 "VFC47";
CM_ SG_ 816 VFCVectorTRMVFCid48 "DoorOpenWarning";
CM_ SG_ 816 VFCVectorTRMVFCid49 "ChargingLVInit";
CM_ SG_ 816 VFCVectorTRMVFCid5 "VFC5";
CM_ SG_ 816 VFCVectorTRMVFCid50 "VFC50";
CM_ SG_ 816 VFCVectorTRMVFCid51 "VFC51";
CM_ SG_ 816 VFCVectorTRMVFCid52 "HVBatteryThermalEventWarning";
CM_ SG_ 816 VFCVectorTRMVFCid53 "VisualAssist";
CM_ SG_ 816 VFCVectorTRMVFCid54 "PassiveSafety";
CM_ SG_ 816 VFCVectorTRMVFCid55 "LifeDetection";
CM_ SG_ 816 VFCVectorTRMVFCid56 "BackboneFlexray";
CM_ SG_ 816 VFCVectorTRMVFCid57 "Functionmarket";
CM_ SG_ 816 VFCVectorTRMVFCid58 "VFCid58";
CM_ SG_ 816 VFCVectorTRMVFCid59 "VFCid59";
CM_ SG_ 816 VFCVectorTRMVFCid6 "SettingsVehicle";
CM_ SG_ 816 VFCVectorTRMVFCid60 "VFCid60";
CM_ SG_ 816 VFCVectorTRMVFCid61 "VFCid61";
CM_ SG_ 816 VFCVectorTRMVFCid7 "VFC7";
CM_ SG_ 816 VFCVectorTRMVFCid8 "VFC8";
CM_ SG_ 816 VFCVectorTRMVFCid9 "IPWakeup";
CM_ SG_ 832 VFCVectorSMPBlockID "BlockID";
CM_ SG_ 832 VFCVectorSMPVFCid0 "SettingsComfort";
CM_ SG_ 832 VFCVectorSMPVFCid1 "ParkingDrivingClimatization";
CM_ SG_ 832 VFCVectorSMPVFCid10 "ExteriorLighting";
CM_ SG_ 832 VFCVectorSMPVFCid11 "VFC11";
CM_ SG_ 832 VFCVectorSMPVFCid12 "Alarm";
CM_ SG_ 832 VFCVectorSMPVFCid13 "VFC13";
CM_ SG_ 832 VFCVectorSMPVFCid14 "InteriorLighting";
CM_ SG_ 832 VFCVectorSMPVFCid15 "VFC15";
CM_ SG_ 832 VFCVectorSMPVFCid16 "Locking";
CM_ SG_ 832 VFCVectorSMPVFCid17 "emoteKeyFunctionality";
CM_ SG_ 832 VFCVectorSMPVFCid18 "PropulsionStart";
CM_ SG_ 832 VFCVectorSMPVFCid19 "VFC19";
CM_ SG_ 832 VFCVectorSMPVFCid2 "PostClimatisation";
CM_ SG_ 832 VFCVectorSMPVFCid20 "VFC20";
CM_ SG_ 832 VFCVectorSMPVFCid21 "PowerClosures";
CM_ SG_ 832 VFCVectorSMPVFCid22 "VehicleDriving";
CM_ SG_ 832 VFCVectorSMPVFCid23 "VFC23";
CM_ SG_ 832 VFCVectorSMPVFCid24 "SettingsProfile";
CM_ SG_ 832 VFCVectorSMPVFCid25 "SeatComfortFunctions";
CM_ SG_ 832 VFCVectorSMPVFCid26 "Brake";
CM_ SG_ 832 VFCVectorSMPVFCid27 "InfotainmentPoll";
CM_ SG_ 832 VFCVectorSMPVFCid28 "HVEnergyStorage";
CM_ SG_ 832 VFCVectorSMPVFCid29 "VFC29";
CM_ SG_ 832 VFCVectorSMPVFCid3 "PowertrainParkingClimatization";
CM_ SG_ 832 VFCVectorSMPVFCid30 "TelematicsConnectivity";
CM_ SG_ 832 VFCVectorSMPVFCid31 "VFC31";
CM_ SG_ 832 VFCVectorSMPVFCid32 "VFC32";
CM_ SG_ 832 VFCVectorSMPVFCid33 "Diagnostics";
CM_ SG_ 832 VFCVectorSMPVFCid34 "VehicleModeManagement";
CM_ SG_ 832 VFCVectorSMPVFCid35 "TrailerCaravanFunctions";
CM_ SG_ 832 VFCVectorSMPVFCid36 "Immobilizer";
CM_ SG_ 832 VFCVectorSMPVFCid37 "Windows";
CM_ SG_ 832 VFCVectorSMPVFCid38 "Visibility";
CM_ SG_ 832 VFCVectorSMPVFCid39 "VFC39";
CM_ SG_ 832 VFCVectorSMPVFCid4 "VFC4";
CM_ SG_ 832 VFCVectorSMPVFCid40 "VFC40";
CM_ SG_ 832 VFCVectorSMPVFCid41 "InfotainmentPush";
CM_ SG_ 832 VFCVectorSMPVFCid42 "ChargingHV";
CM_ SG_ 832 VFCVectorSMPVFCid43 "BodyPreClimatisation";
CM_ SG_ 832 VFCVectorSMPVFCid44 "Crash";
CM_ SG_ 832 VFCVectorSMPVFCid45 "GlobalShortDuration";
CM_ SG_ 832 VFCVectorSMPVFCid46 "ExteriorLightsHazard";
CM_ SG_ 832 VFCVectorSMPVFCid47 "VFC47";
CM_ SG_ 832 VFCVectorSMPVFCid48 "DoorOpenWarning";
CM_ SG_ 832 VFCVectorSMPVFCid49 "ChargingLVInit";
CM_ SG_ 832 VFCVectorSMPVFCid5 "VFC5";
CM_ SG_ 832 VFCVectorSMPVFCid50 "VFC50";
CM_ SG_ 832 VFCVectorSMPVFCid51 "VFC51";
CM_ SG_ 832 VFCVectorSMPVFCid52 "HVBatteryThermalEventWarning";
CM_ SG_ 832 VFCVectorSMPVFCid53 "VisualAssist";
CM_ SG_ 832 VFCVectorSMPVFCid54 "PassiveSafety";
CM_ SG_ 832 VFCVectorSMPVFCid55 "LifeDetection";
CM_ SG_ 832 VFCVectorSMPVFCid56 "BackboneFlexray";
CM_ SG_ 832 VFCVectorSMPVFCid57 "Functionmarket";
CM_ SG_ 832 VFCVectorSMPVFCid58 "VFCid58";
CM_ SG_ 832 VFCVectorSMPVFCid59 "VFCid59";
CM_ SG_ 832 VFCVectorSMPVFCid6 "SettingsVehicle";
CM_ SG_ 832 VFCVectorSMPVFCid60 "VFCid60";
CM_ SG_ 832 VFCVectorSMPVFCid61 "VFCid61";
CM_ SG_ 832 VFCVectorSMPVFCid7 "VFC7";
CM_ SG_ 832 VFCVectorSMPVFCid8 "VFC8";
CM_ SG_ 832 VFCVectorSMPVFCid9 "IPWakeup";
CM_ SG_ 920 AccPWMPerdTi "Accelerator pedal PWM duty cycle";
CM_ SG_ 920 ActnOfCenHiMntdStopLamp "Activate Central High Mounted Stop Lamp.";
CM_ SG_ 920 ActnOfCenHiMntdStopLamp1 "signal of activate center high mounted stop lamp for Louts";
CM_ SG_ 920 ActnOfDaytiRunngLampDrv "Activate DRL Lamp of driver side";
CM_ SG_ 920 ActnOfFrntFogLampDrv "Activate front fog Lamp of driver side";
CM_ SG_ 920 ActnOfFrntPosnLampDrv "Activate front position Lamp of driver side";
CM_ SG_ 920 ActnOfFrntSideMkrLampDrv "Activate front side mark Lamp of driver side";
CM_ SG_ 920 ActnOfFrntSideMkrLampPass "Activate front side mark Lamp of passenger side";
CM_ SG_ 920 ActnOfLedCornrgLampLe "Acitvation of Led Cornering Lamp Left";
CM_ SG_ 920 ActnOfLedCornrgLampRi "Activate LED Cornering Lamp Right.";
CM_ SG_ 920 ActnOfLedDaytiRunngLamp "Activate LED Daytime Running Lamp.";
CM_ SG_ 920 ActnOfLedFrntCrossLamp "Activate LED Front Middle Cross Lamp.";
CM_ SG_ 920 ActnOfLedFrntCrossLampDyn "Activation of Front Middle Cross Lamp as part of Position Lights with dynamic pattern";
CM_ SG_ 920 ActnOfLedFrntFogLamp "Activate LED Front Fog Lamp.";
CM_ SG_ 920 ActnOfLedGrilleLamp "Activate LED Front Grille Lamp.";
CM_ SG_ 920 ActnOfLedGrilleLampDyn "Activation of Grille Lamp as part of Position Lights with dynamic pattern";
CM_ SG_ 920 ActnOfLedLeLogoLamp "Activate LED Left Logo Light Lamp.";
CM_ SG_ 920 ActnOfLedPosnLampDyn "Activation of Led Position Lamp Dynamic mode";
CM_ SG_ 920 ActnOfLedReFogLamp "Activate LED Rear Fog Lamp.";
CM_ SG_ 920 ActnOfLedRePosnLamp "Activate LED Position Lamp.";
CM_ SG_ 920 ActnOfLedRiLogoLamp "Activate LED Right Logo Light Lamp.";
CM_ SG_ 920 ActnOfLedRiLogoLampDyn "Activation of Right Logo Lamp as part of Charging Lights with dynamic pattern";
CM_ SG_ 920 ActnOfLedRvsgLamp "Activate LED Revering Lamp.";
CM_ SG_ 920 ActnOfReFogLampPass "Activate rear fog Lamp of passenger side";
CM_ SG_ 920 ActnOfRePosnLampDrv "Activate rear position Lamp of driver side";
CM_ SG_ 920 ActnOfReSideMkrLampDrv "Activate rear side mark Lamp of driver side";
CM_ SG_ 920 ActnOfReSideMkrLampPass "Activate rear side mark Lamp of passenger side";
CM_ SG_ 920 ActnOfRvsgLampDrv "Activate reverse Lamp of driver side";
CM_ SG_ 920 ActvnOfAfs "Activation of Aaptive Frontlight System ";
CM_ SG_ 920 ActvnOfAhl "Activate Auto Headlamp Leveling";
CM_ SG_ 920 ActvnOfAlrmReqFromCmplxIf "Sent from BBS polling LC to AlrmMgr. Is high when the IS requests to trigger the alarm or if the BBS does not respond to polling.";
CM_ SG_ 920 ActvnOfBrkLi "Activation of Break Light";
CM_ SG_ 920 ActvnOfDbl "Activate Bending Light.";
CM_ SG_ 920 ActvnOfDefrstFrnt "Activation of front defroster relay.";
CM_ SG_ 920 ActvnOfDefrstRe "Activation of electrical defroster rear.";
CM_ SG_ 920 ActvnOfDoorSwtIllmn "Activates or deactivates the symbol illumination of the DDS. Dependent on VMM signals mostly";
CM_ SG_ 920 ActvnOfFootwellLamp "CEM internal signal. PWM signal to control Ambient Light in Footwell.
Front and Rear.";
CM_ SG_ 920 ActvnOfHndlDoorLiHndlDoorLiDrvr "driver side handle light activate signal";
CM_ SG_ 920 ActvnOfHndlDoorLiHndlDoorLiDrvrRe "rear of driver side handle light activate signal";
CM_ SG_ 920 ActvnOfHndlDoorLiHndlDoorLiPass "passage side handle light activate signal";
CM_ SG_ 920 ActvnOfHndlDoorLiHndlDoorLiPassRe "rear of passage side handle light activate signal";
CM_ SG_ 920 ActvnOfReLogoLamp1 "Activate rear logo lamp";
CM_ SG_ 920 ActvnOfRoofSwtIllmn "Activates or deactivates the switch illumination of the OHx.";
CM_ SG_ 920 ActvnOfSillPlateIllmn "CEM internal signal. PWM signal to control Tread plate illumination.";
CM_ SG_ 920 ActvnOfStrtIllmn "CEM internal signal.
PWM signal to control Start button symbol illumination.";
CM_ SG_ 920 ActvnOfTouristMod "Activate Tourist Mode.";
CM_ SG_ 920 ActvnOfWiprMech "Activate wiper.   0, no relay activated.   1, Low speed relay activated.   2, High speed relay activated.   3, Not used";
CM_ SG_ 920 ActvnOfWshrFrntNotSafe "Signal between the non-safe LC to the safe LC. Indicates when the front washer pump is turned on.";
CM_ SG_ 920 ActvnOfWshrRe "Activate rear washer";
CM_ SG_ 920 AlrmAcoustReq01 "Request sent to Sound Signaling to sound vehicle horn. Used when BBS reports internal fault or BBS disconncted or vehicle horn configured instead of BBS. ";
CM_ SG_ 920 AlrmToExtrLiFbVisReq "Request from Alarm to Exterior light to flash exterior lights when vehicle is armed by passive arming.";
CM_ SG_ 920 AlrmToExtrLiVisReq "Request from Alarm to Exterior light to flash exterior lights when alarm is active.";
CM_ SG_ 920 AutWinWipgCmd "Wiping speed command.";
CM_ SG_ 920 BswCha1NmState "Chassis CAN1 network management status

";
CM_ SG_ 920 BswChainNmState "Chassis CAN2 network management status

";
CM_ SG_ 920 BswCpu0LoadAvg "CPU0 average load

";
CM_ SG_ 920 BswCpu0LoadMax "CPU0 maximum load

";
CM_ SG_ 920 BswCpu1LoadAvg "CPU1 average load
";
CM_ SG_ 920 BswCpu1LoadMax "CPU1 maximum load

";
CM_ SG_ 920 BswCpu2LoadAvg "CPU2 average load";
CM_ SG_ 920 BswCpu2LoadMax "CPU2 maximum load";
CM_ SG_ 920 BswCpu3LoadAvg "CPU3 average load";
CM_ SG_ 920 BswCpu3LoadMax "CPU3 maximum load";
CM_ SG_ 920 BswCpu4LoadAvg "CPU4 average load";
CM_ SG_ 920 BswCpu4LoadMax "CPU4 maximum load";
CM_ SG_ 920 BswCpu5LoadAvg "CPU5 average load";
CM_ SG_ 920 BswCpu5LoadMax "CPU5 maximum load";
CM_ SG_ 920 BswIcState "Peripheral chip status

";
CM_ SG_ 920 BswKeepWakeUpReason "Maintain source monitoring

";
CM_ SG_ 920 BswOsTaskTime "OS task runtime

";
CM_ SG_ 920 BswPriNmState "Private CAN network management status

";
CM_ SG_ 920 BswPropNmState "PT CAN network management

";
CM_ SG_ 920 BswWakeupSourceState "Wake up source monitoring

";
CM_ SG_ 920 DwnLoadStsFbOfHdlampLe "Download of Dynamic light sequence Feedback signal.";
CM_ SG_ 920 DwnLoadStsFbOfHdlampRi "Download of Dynamic light sequence Feedback signal.";
CM_ SG_ 920 DwnLoadStsFbOfLogoLampLe "Download status feedback of Left Logo Light lamp.";
CM_ SG_ 920 DwnLoadStsFbOfLogoLampRi "Download status feedback of Right Logo Light lamp.";
CM_ SG_ 920 ExtrLiShowActvnFrntLeFb "Activation of Exterior Light Show Feedback Frong Left Head Lamp";
CM_ SG_ 920 ExtrLiShowActvnFrntRiFb "Activation of Exterior Light Show Feedback Frong Right Head Lamp";
CM_ SG_ 920 ExtrLiShowActvnLeLogoFb "Activation of Exterior Light Show Feedback from Left Logo Light Lamp";
CM_ SG_ 920 ExtrLiShowActvnRiLogoFb "Activation of Exterior Light Show Feedback from Right Logo Light Lamp";
CM_ SG_ 920 HdlampLeInpSts1 "Ext. Light relay input driver warning and fault tracing";
CM_ SG_ 920 HdlampLeInpSts2 "Ignition relay input driver warning and fault tracing";
CM_ SG_ 920 HdlampRiInpSts1 "Ext. Light relay input driver warning and fault tracing";
CM_ SG_ 920 HdlampRiInpSts2 "Ignition relay input driver warning and fault tracing";
CM_ SG_ 920 ShortDropWinDrvrSts "Short drop a status sent back to locking to secure window is down and door is ready to be released. ";
CM_ SG_ 920 ShortDropWinReLeSts "Short drop a status sent back to locking to secure window is down and door is ready to be released. ";
CM_ SG_ 920 SnsrSoundrBattBackedStsArmSts "Status signal sent by BBS including status of arm, sounding, internal fault, indicating IS existence and configuration status.";
CM_ SG_ 920 SnsrSoundrBattBackedStsCfgSts "Status signal sent by BBS including status of arm, sounding, internal fault, indicating IS existence and configuration status.";
CM_ SG_ 920 SnsrSoundrBattBackedStsSnsrInclnExist "Status signal sent by BBS including status of arm, sounding, internal fault, indicating IS existence and configuration status.";
CM_ SG_ 920 SnsrSoundrBattBackedStsSoundrBattBackedErrSts "Status signal sent by BBS including status of arm, sounding, internal fault, indicating IS existence and configuration status.";
CM_ SG_ 920 SnsrSoundrBattBackedStsSoundSts "Status signal sent by BBS including status of arm, sounding, internal fault, indicating IS existence and configuration status.";
CM_ SG_ 920 StsOfAfsLe "Status of AFS light distribution Left.";
CM_ SG_ 920 StsOfAfsRi "Status of AFS light distribution Right.";
CM_ SG_ 920 StsOfAhbcLe "Status of Auto High Beam Control Left.";
CM_ SG_ 920 StsOfAhbcRi "Status of Auto High Beam Control Right.";
CM_ SG_ 920 StsOfFrntSideMkrLampLe2 "Status of Front Side Marker Lamp Left 2.";
CM_ SG_ 920 StsOfFrntSideMkrLampRi2 "Status of Front Side Marker Lamp Right 2.";
CM_ SG_ 920 StsOfLedCornrgLampLe "Status of Led Cornering Lamp Left.";
CM_ SG_ 920 StsOfLedCornrgLampRi "Status of Led Cornering Lamp Right.";
CM_ SG_ 920 StsOfLedDaytiRunngLampLe "Status of Led Day Time Running Lamp Left.";
CM_ SG_ 920 StsOfLedDaytiRunngLampRi "Status of Led Day Time Running Lamp Right.";
CM_ SG_ 920 StsOfLedFrntFogLampLe "Status of Led Front Fog Light Left.";
CM_ SG_ 920 StsOfLedFrntFogLampRi "Status of Led Front Fog Lamp Right.";
CM_ SG_ 920 StsOfLedFrntPosnLampLe "Status of Led Front Position Lamp Left.";
CM_ SG_ 920 StsOfLedFrntPosnLampRi "Status of Led Front Position Lamp Right.";
CM_ SG_ 920 StsOfLedFrntTurnIndcrLe "Status of Led Front Turn Indicator Left.";
CM_ SG_ 920 StsOfLedFrntTurnIndcrRi "Status of Front Turn Right Indicator";
CM_ SG_ 920 StsOfLedLeLogoLamp "Status of Led Left Logo Light Lamp";
CM_ SG_ 920 StsOfLedRiLogoLamp "Status of Led Right Logo Light Lamp";
CM_ SG_ 920 StsOfLvlgLeChks "Status of Head Lamp Leveling Motor Check Sum";
CM_ SG_ 920 StsOfLvlgLeCntr "Status of Head Lamp Leveling Motor Counter";
CM_ SG_ 920 StsOfLvlgLeStsOfLvlgLe "Status of Head Lamp Leveling Motor";
CM_ SG_ 920 StsOfLvlgRiChks "Status of Head Lamp Leveling Motor Check Sum";
CM_ SG_ 920 StsOfLvlgRiCntr "Status of Head Lamp Leveling Motor Counter";
CM_ SG_ 920 StsOfLvlgRiStsOfLvlgRi "Status of Head Lamp Leveling Motor";
CM_ SG_ 920 StsOfTouristModLe "Status of Tourist Mode Left.";
CM_ SG_ 920 StsOfTouristModRi "Status of Tourist Mode Right.";
CM_ SG_ 920 StsOfWelGbyFrntLe "status of welcome and goodbye light from HCML";
CM_ SG_ 920 StsOfWelGbyFrntRi "status of welcome and goodbye light from HCMR";
CM_ SG_ 920 SunRoofAndCurtBtnSts2Cntr "Counter";
CM_ SG_ 920 SunRoofAndCurtBtnSts2Pos "position";
CM_ SG_ 920 SunRoofImpctDetnSts2 "Sun Roof impact detection status.";
CM_ SG_ 920 TCSDoorSts "TCSDoorSts";
CM_ SG_ 920 WiprInPrkgPosnLoFromWMM "Information regarding wiper position on the windscreen";
CM_ SG_ 920 WiprInWipgArFromWMM "Information regarding wiper position on the windscreen.";
CM_ SG_ 920 WiprMotCrkAg "Wiper motor crank angle";
CM_ SG_ 920 WiprMotDiagcWiprMotHiVoltDetd "Information regarding overload, high voltage and low voltage on the wiper motor module.  High Voltage Detected (2-bit coded)";
CM_ SG_ 920 WiprMotDiagcWiprMotLoVoltDetd "Information regarding overload, high voltage and low voltage on the wiper motor module.  Low Voltage Detected (2-bit coded)";
CM_ SG_ 920 WiprMotDiagcWiprMotOvldDetd "Information regarding overload, high voltage and low voltage on the wiper motor module.  Overload detected (2-bit coded)";
CM_ SG_ 920 WiprMotErrSafe "Wiper Motor Error (2-bit coded, system safety relevant)";
CM_ SG_ 920 WshngCycActvFromWMM "Information regarding front washing cycle active or not.";
CM_ SG_ 416 AccPedlAna "Accelerator pedal ADC voltage signal";
CM_ SG_ 416 AccPedlPWM "Accelerator pedal PWM signal";
CM_ SG_ 416 BattCoolgPwrPreTherm "Cooling power";
CM_ SG_ 416 BattHeatgTargTempPreTherm "Predicted target temperature";
CM_ SG_ 416 BattVoltKL30 "Controller 30 terminal power supply";
CM_ SG_ 416 ChillerOutCooltT "Coolant temperature measured by sensors installed in chiller out.";
CM_ SG_ 416 CnvnInhb "Intelligent power supply suppression flag

";
CM_ SG_ 416 CPSRClsReq "CPSR relay control";
CM_ SG_ 416 CPSRFbSt "CPSR relay feedback";
CM_ SG_ 416 EexvStsExvActrPosn "Eexv actual position.";
CM_ SG_ 416 EexvStsExvBlkErr "Eexv blocked error";
CM_ SG_ 416 EexvStsExvCalibSts "Eexv calibration status.";
CM_ SG_ 416 EexvStsExvElecStsErr "Eexv electrical  error";
CM_ SG_ 416 EexvStsExvMovSts "Eexv move status.";
CM_ SG_ 416 EexvStsExvOvrTempErr "Eexv over-temp error";
CM_ SG_ 416 EexvStsExvOvrTrvlErr "Eexv over-travel error";
CM_ SG_ 416 EexvStsExvPreHeatgSts "Eexv pre-heating status.";
CM_ SG_ 416 EexvStsExvVoltgRangErr "Eexv voltage range error.";
CM_ SG_ 416 EtpActualSpeedBackup "speed calculation based on UVW signals or angle but Speed priority based on UVW";
CM_ SG_ 416 EtpActualSpeedEtpActualSpeed "speed calculation based on UVW signals or angle but Speed priority based on UVW";
CM_ SG_ 416 EtpActualSpeedSts "Actual speed status
3:the signal is accurate
2:a fault has been detected and affect the performance or durability of exceptional subscribers
1:the signal is set to its initial value becaus
0:there is a serious fault";
CM_ SG_ 416 EtpAngPosPlausSts "EOP shall detect the plausibility of Angle and UVW speed 
0:normal";
CM_ SG_ 416 EtpASAStudyProcess "0 No study
1 Studing";
CM_ SG_ 416 EtpASAValueValid "When Zero value has two same value,their checksum are the same.";
CM_ SG_ 416 EtpBatteryVoltage "Supply Voltage";
CM_ SG_ 416 EtpCanNodeLoss "1:CanNodeLoss";
CM_ SG_ 416 EtpCurrent_Backup "Bus current";
CM_ SG_ 416 EtpCurrentEtpCurrent "Bus current";
CM_ SG_ 416 EtpCurrentStsBackup "ETP Current status Detection 
0 Init
1 Precise
2 Not precise
3 ILLEGAL";
CM_ SG_ 416 EtpEnableOff "0: Motor run(opcstart = 1 and oilpmptargetspeed > 0)
1: Motor stop(opcstart = 0 or oilmptargetspeed = 0, or
TCU message is lost)";
CM_ SG_ 416 EtpEOPHydLeakSts "EOP shall detect if hydraulic leakage happened:hydraulic leakage happened";
CM_ SG_ 416 EtpFaultSelfMos "0:selfMos is successful,1:selfMos is fail";
CM_ SG_ 416 EtpGDUOverCurrent "1:GDUOverCurrent";
CM_ SG_ 416 EtpGmrSpiCommErr "The EOP shall feedback GMR SPI bus communication error :GMR SPI bus communication error ";
CM_ SG_ 416 EtpHallSignalError "error";
CM_ SG_ 416 EtpHallSignalSt "0:all hall signals have no fault
1:one of all hall signals are high or all low
2:two of all hall signals are high or all low
3:all hall signals are high or all low";
CM_ SG_ 416 EtpIgnitionStatus "ingition signal IgnitionStatus from Hardware pin
0:Enable signal is off,
1:Enable signal is on.";
CM_ SG_ 416 EtpMcuTemperature "ETPMcuTemperature ";
CM_ SG_ 416 EtpMcuTOutRngHiSts "Mcu emperature sensor signals out of range high";
CM_ SG_ 416 EtpMcuTOutRngLoSts "Mcu temperature sensor signals out of range low fault";
CM_ SG_ 416 EtpMcuTStuckSts "MCU Temperature remain unchanged for 1000ms";
CM_ SG_ 416 EtpMosTemperature "Mos Temperature";
CM_ SG_ 416 EtpMosTemperatureBackup "Mos Temperature";
CM_ SG_ 416 EtpMosTOpenSts "Mos temperature sensor signals circuit fault to short to open
1:short to open";
CM_ SG_ 416 EtpMosTOutRngHiSts "Mos emperature sensor signals out of range high";
CM_ SG_ 416 EtpMosTOutRngLoSts "Mos temperature sensor signals out of range low fault";
CM_ SG_ 416 EtpMosTShoBattSts "Mos temperature sensor signals circuit fault to short to battery
1:short to battery";
CM_ SG_ 416 EtpMosTShoGndSts "Mos temperature sensor signals circuit fault to short to ground
1:short to ground";
CM_ SG_ 416 EtpMosTStuckSts "Mos Temperature remain unchanged for 1000ms";
CM_ SG_ 416 EtpOffseVoltageFailure "Current sampling offset current voltage
0:false
1:true";
CM_ SG_ 416 EtpOverTemperature "over temperature";
CM_ SG_ 416 EtpOverTemperatureBackup "0 Normal temperature,1 High temperature,any of mos and mcu temperature is within
range,2 Over temperature, any of mos and mcu temperature is higher
than 135,3 Illegal";
CM_ SG_ 416 EtpOverVoltage "over GDU and Battery voltage ";
CM_ SG_ 416 EtpPhaseCurrent "Phase Current";
CM_ SG_ 416 EtpPhaseCurrentBackup "Phase Current";
CM_ SG_ 416 EtpPhaseCurrentStsBackup "Phase Current status Detection 
0 - Init
1 - Precise
2 - Not precise
3 - ILLEGAL";
CM_ SG_ 416 EtpPhaseOverCurrent "1:over phase current";
CM_ SG_ 416 EtpPumpReady "0:The system self-check failed
1: The system self-check is successful (the voltage is stable above 8V,
MOS self-check is passed, and the system is ready to be OK).";
CM_ SG_ 416 EtpResetReason "0:Power-On Reset
1:Low Voltage Reset
2:External pin RESET
3:PLL clock monitor reset
4:Oscillator Clock monitor reset
5:COP watchdog reset";
CM_ SG_ 416 EtpRunningStatus "0:0 speed mode
1: Motor operation mode
2: Derating operation mode
3: Failure mode";
CM_ SG_ 416 EtpSensorPowSupplyFau "Mcu Temperature Sensor Voltage plausibility Detection 
0:mormal";
CM_ SG_ 416 EtpSpdBaseAngleValue "speed calculation based on angle value signal ";
CM_ SG_ 416 EtpSpdBaseAngleValueSts "EOP shall detect the plausibility of Angle speed,0:normal,1:error";
CM_ SG_ 416 EtpSpdBaseUVWIncPos "Actaul Speed";
CM_ SG_ 416 EtpSpdBaseUVWIncPosSts "EOP shall detect the plausibility of UVW speed 
0:normal";
CM_ SG_ 416 EtpStartFailure "0:No Motor block
1: Motor block";
CM_ SG_ 416 EtpUnderSpeed "Judgment of maximum power speed";
CM_ SG_ 416 EtpUnderVoltage "under GDU and Battery voltage ";
CM_ SG_ 416 EtpVHDVoltageBackup "Mos Voltage";
CM_ SG_ 416 EtpVHDVoltageEtpVHDVoltage "Mos Voltage";
CM_ SG_ 416 EtpVoltagePlausSts "ETP BatteryVoltage and VHD Voltage Status Detection ";
CM_ SG_ 416 ExvStsExvActrPosn "Exv position status";
CM_ SG_ 416 ExvStsExvBlkErr "Exv blocked err.";
CM_ SG_ 416 ExvStsExvCalibSts "Exv calibration status";
CM_ SG_ 416 ExvStsExvElecStsErr "Exv electrical err.";
CM_ SG_ 416 ExvStsExvMovSts "Exv move status.";
CM_ SG_ 416 ExvStsExvOvrTempErr "Exv over-temp err.";
CM_ SG_ 416 ExvStsExvOvrTrvlErr "Exv over-travel err.";
CM_ SG_ 416 ExvStsExvPreHeatgSts "Exv preheating status.";
CM_ SG_ 416 ExvStsExvVoltgRangErr "Exv voltage err.";
CM_ SG_ 416 FrntHeatPwrAllwd "The allowed electrial energy for active heating of the front motor";
CM_ SG_ 416 HvchOnForBattHeatg "Transmission time of charging current";
CM_ SG_ 416 HvClimaCoolgPwrCritDes "Estimated power need critical use for climate cooling.";
CM_ SG_ 416 HvClimaHeatgPwrCritDes "Critical high voltage power need for climate heating.";
CM_ SG_ 416 HvCoolgPwrCritDes "Estimated power need critical use for battery cooling.";
CM_ SG_ 416 HvCoolgPwrNormDes "Estimated power need normal use for Cooling system.";
CM_ SG_ 416 HvHeatgPwrCritDes "Critical high voltage power need for battery heating.";
CM_ SG_ 416 HvHeatgPwrNormDes "Actual power desire from heating subsystem.";
CM_ SG_ 416 IsgFlg20ForEOP "Enable Of ID 20 ";
CM_ SG_ 416 IsgForWRCIsgSpdForWRC "Isg Speed for WRC";
CM_ SG_ 416 IsgForWRCIsgTqEstForWRC "Isg Tq Est for WRC";
CM_ SG_ 416 IsgOilPmpTargetSpeedForETP "Target Speed";
CM_ SG_ 416 IsgOilPmpTemperatureForETP "oil temperature";
CM_ SG_ 416 IsgOPCStartOnForETP "IsgOPCStartOnForETP";
CM_ SG_ 416 IsgTPlausStsForETP "0:Normal
1:Mos temperature sensor plausibility fault
2:Mcu temperature sensor plausibility fault
3:McuMos fault";
CM_ SG_ 416 LoTemEneStorage "flag of low temperature energy storage activation";
CM_ SG_ 422 EwpAflFlagCooling "ELDT afterrun cooling flag.";
CM_ SG_ 422 HvActvReq "Request for CPSR and power up high voltage system. During climatization and charging.";
CM_ SG_ 422 IsgCoolgReqInvrCloud "Request for increased cooling flow to Inverter for Cloud";
CM_ SG_ 422 IsgCooltFlowMinReqCloud "IsgCooltFlowMinReqCloud";
CM_ SG_ 422 IsgCrashValueForETP "EOP shall deactivate pump motor within 100 ms after crash is detected CrashValue,1:Crash";
CM_ SG_ 422 IsgHeatFdBckCloud "IsgHeatFdBckCloud";
CM_ SG_ 422 IvtrActId "Inverter actual Id";
CM_ SG_ 422 IvtrActIq "Inverter actual Iq";
CM_ SG_ 422 IvtrActvDchaSts "Active discharge status";
CM_ SG_ 422 IvtrDAxisCurrtSp "d axis current setpoint";
CM_ SG_ 422 IvtrDAxisU "d axis voltage";
CM_ SG_ 422 IvtrDeratingReason "Motor Derating reason of IEM/MGM";
CM_ SG_ 422 IvtrDeratingSts "IEM/MGM Derating Status";
CM_ SG_ 422 IvtrGateSts "Gate Status";
CM_ SG_ 422 IvtrIgbtJunctionT "Inverter IGBT Junction Temp";
CM_ SG_ 422 IvtrModlnIdx "Modulation index";
CM_ SG_ 422 IvtrMotActModSts "Inverter motor actual mode status";
CM_ SG_ 422 IvtrOffsAgIvtrOffsAg "IEM/MGM rotor offset angle";
CM_ SG_ 422 IvtrOffsAgSts "Offset angle status";
CM_ SG_ 422 IvtrOilT "Oil temperature sensor temperature value";
CM_ SG_ 422 IvtrOilTSnsrSplyV "Oil TempSensor SupplyVolt";
CM_ SG_ 422 IvtrPhaPwmDutyIvtrPhaUPwmDuty "Phase U PWM duty";
CM_ SG_ 422 IvtrPhaPwmDutyIvtrPhaVPwmDuty "Phase V PWM duty";
CM_ SG_ 422 IvtrPhaPwmDutyIvtrPhaWPwmDuty "Phase W PWM duty";
CM_ SG_ 422 IvtrQAxisCurrtSp "q axis current setpoint";
CM_ SG_ 422 IvtrQAxisU "q axis voltage";
CM_ SG_ 422 IvtrReqIdWithLimn "Inverter request Id with limitation";
CM_ SG_ 422 IvtrReqIqWithLimn "Inverter request Iq with limitation";
CM_ SG_ 422 IvtrResolverAg "Resolve angle";
CM_ SG_ 422 IvtrSftyFctMod "Safety Function Mode";
CM_ SG_ 422 IvtrSftySpd "Safety Speed";
CM_ SG_ 422 IvtrSftyTq "Safety Torque";
CM_ SG_ 422 IvtrSftyTqQf "Safety Torque Quality factor";
CM_ SG_ 422 IvtrTqDir "Torque Direction";
CM_ SG_ 422 IvtrTraPhaCurrtAryU "Transient Phase Current Array U";
CM_ SG_ 422 IvtrTraPhaCurrtAryV "Transient Phase Current Array V";
CM_ SG_ 422 IvtrTraPhaCurrtAryW "Transient Phase Current Array W";
CM_ SG_ 422 MotorHeatrPwrCnsDes "he motor actively heats the required power";
CM_ SG_ 422 MotSpdForWRC "Motor Speed for WRC";
CM_ SG_ 422 MotTqEstForWRC "Motor Tq Est for WRC";
CM_ SG_ 422 OTAActvHVReq "OTA request to activate high voltage flag bit";
CM_ SG_ 422 PredDrvPwrReq "Predict drive power requests";
CM_ SG_ 422 PredTarSoc "Predict the SOC arrival at destination";
CM_ SG_ 422 PrpsnAllwd "Driver allowed";
CM_ SG_ 422 PtTqMCUPtTqFrntMotMaxReq "PtTqFrntMotMaxReq";
CM_ SG_ 422 PtTqMCUPtTqFrntMotMinReq "PtTqFrntMotMinReq";
CM_ SG_ 422 PtTqMCUPtTqReMotMaxReq "PtTqReMotMaxReq";
CM_ SG_ 422 PtTqMCUPtTqReMotMinReq "PtTqReMotMinReq";
CM_ SG_ 422 RemStrt "Remote start status

";
BA_DEF_ BO_ "CANFD_BRS" ENUM "0","1";
BA_DEF_ BO_ "GenMsgCycleTime" INT 0 65536; // [ms]
BA_DEF_ BO_ "GenMsgDelayTime" INT 0 65536; // [ms]
BA_DEF_ BO_ "GenMsgSendType" ENUM "cyclic", "spontaneous", "not-used", "not-used", "not-used", "cyclicAndSpontaneous", "not-used", "cyclicIfActive", "NoMsgSendType"; // [us]
BA_DEF_ BO_ "GenMsgStartDelayTime" INT 0 65536; // [ms]
BA_DEF_ BO_ "VFrameFormat" ENUM "StandardCAN","ExtendedCAN","reserved","J1939PG","reserved","reserved","reserved","reserved","reserved","reserved","reserved","reserved","reserved","reserved","StandardCAN_FD","ExtendedCAN_FD";
BA_DEF_ SG_ "GenSigSendType" ENUM "Cyclic","OnWrite","OnWriteWithRepetition","OnChange","OnChangeWithRepetition","IfActive","IfActiveWithRepetition","NoSigSendType";
BA_DEF_ SG_ "GenSigStartValue" HEX 0 80000000;
BA_DEF_ BO_ "GenMsgILSupport" ENUM "No","Yes";
BA_DEF_ BO_ "NmAsrMessage" ENUM "No","Yes";
BA_DEF_ SG_ "GenSigFuncType" ENUM "NoFunction","n/a","n/a","n/a","n/a","n/a","n/a","n/a","n/a","n/a","n/a","n/a","n/a","n/a","n/a","CHK","CNTR","n/a","n/a","n/a","CNTR_AR_01","CRC_AR_01_BOTH","CRC_AR_01_ALT","CRC_AR_01_LOW","CRC_AR_01_NIBBLE","CNTR_AR_04","CRC_AR_04A","CNTR_AR_05","CRC_AR_05";
BA_DEF_ SG_ "GenSigDataID" STRING;
BA_DEF_DEF_ "CANFD_BRS" "1";
BA_DEF_DEF_ "GenSigStartValue" 0;
BA_DEF_DEF_ "VFrameFormat" "J1939PG";
BA_DEF_DEF_ "GenSigSendType" "NoSigSendType";
BA_DEF_DEF_ "GenMsgCycleTime" 0;
BA_DEF_DEF_ "GenMsgDelayTime" 0;
BA_DEF_DEF_ "GenMsgStartDelayTime" 0;
BA_DEF_DEF_ "GenMsgSendType" "NoMsgSendType";
BA_DEF_DEF_ "GenMsgILSupport" "Yes";
BA_DEF_DEF_ "NmAsrMessage" "No";
BA_DEF_DEF_ "GenSigFuncType" "NoFunction";
BA_DEF_DEF_ "GenSigDataID" "";
// Frame: ZCUDZCUCANFD2Fr26
BA_ "GenMsgCycleTime" BO_ 52 100.000;
BA_ "GenMsgSendType" BO_ 52 0;
BA_ "VFrameFormat" BO_ 52 14;
// Frame: ZCUDZCUCANFD2Fr27
BA_ "GenMsgDelayTime" BO_ 552 10.000;
BA_ "GenMsgSendType" BO_ 552 1;
BA_ "VFrameFormat" BO_ 552 14;
// Frame: ZCUDZCUCANFD2Fr28
BA_ "GenMsgDelayTime" BO_ 555 10.000;
BA_ "GenMsgSendType" BO_ 555 1;
BA_ "VFrameFormat" BO_ 555 14;
// Frame: ZCUDZCUCANFD2Fr29
BA_ "GenMsgCycleTime" BO_ 816 500.000;
BA_ "GenMsgSendType" BO_ 816 0;
BA_ "VFrameFormat" BO_ 816 14;
// Frame: ZCUDZCUCANFD2Fr30
BA_ "GenMsgCycleTime" BO_ 832 500.000;
BA_ "GenMsgSendType" BO_ 832 0;
BA_ "VFrameFormat" BO_ 832 14;
// Frame: ZCUDZCUCANFD2Fr31
BA_ "GenMsgCycleTime" BO_ 920 800.000;
BA_ "GenMsgSendType" BO_ 920 0;
BA_ "VFrameFormat" BO_ 920 14;
// Frame: ZCUDZCUCANFD2Fr32
BA_ "GenMsgCycleTime" BO_ 416 100.000;
BA_ "GenMsgSendType" BO_ 416 0;
BA_ "VFrameFormat" BO_ 416 14;
// Frame: ZCUDZCUCANFD2Fr33
BA_ "GenMsgDelayTime" BO_ 422 10.000;
BA_ "GenMsgSendType" BO_ 422 1;
BA_ "VFrameFormat" BO_ 422 14;
BA_ "GenSigSendType" SG_ 920 ActnOfCenHiMntdStopLamp 0;
BA_ "GenSigSendType" SG_ 920 ActnOfCenHiMntdStopLamp1 0;
BA_ "GenSigSendType" SG_ 920 ActnOfDaytiRunngLampDrv 0;
BA_ "GenSigSendType" SG_ 920 ActnOfFrntFogLampDrv 0;
BA_ "GenSigSendType" SG_ 920 ActnOfFrntPosnLampDrv 0;
BA_ "GenSigSendType" SG_ 920 ActnOfFrntSideMkrLampDrv 0;
BA_ "GenSigSendType" SG_ 920 ActnOfFrntSideMkrLampPass 0;
BA_ "GenSigSendType" SG_ 920 ActnOfLedCornrgLampLe 0;
BA_ "GenSigSendType" SG_ 920 ActnOfLedCornrgLampRi 0;
BA_ "GenSigSendType" SG_ 920 ActnOfLedDaytiRunngLamp 0;
BA_ "GenSigSendType" SG_ 920 ActnOfLedFrntCrossLamp 0;
BA_ "GenSigSendType" SG_ 920 ActnOfLedFrntCrossLampDyn 0;
BA_ "GenSigSendType" SG_ 920 ActnOfLedFrntFogLamp 0;
BA_ "GenSigSendType" SG_ 920 ActnOfLedGrilleLamp 0;
BA_ "GenSigSendType" SG_ 920 ActnOfLedGrilleLampDyn 0;
BA_ "GenSigSendType" SG_ 920 ActnOfLedLeLogoLamp 0;
BA_ "GenSigSendType" SG_ 920 ActnOfLedPosnLampDyn 0;
BA_ "GenSigSendType" SG_ 920 ActnOfLedReFogLamp 0;
BA_ "GenSigSendType" SG_ 920 ActnOfLedRePosnLamp 0;
BA_ "GenSigSendType" SG_ 920 ActnOfLedRiLogoLamp 0;
BA_ "GenSigSendType" SG_ 920 ActnOfLedRiLogoLampDyn 0;
BA_ "GenSigSendType" SG_ 920 ActnOfLedRvsgLamp 0;
BA_ "GenSigSendType" SG_ 920 ActnOfReFogLampPass 0;
BA_ "GenSigSendType" SG_ 920 ActnOfRePosnLampDrv 0;
BA_ "GenSigSendType" SG_ 920 ActnOfReSideMkrLampDrv 0;
BA_ "GenSigSendType" SG_ 920 ActnOfReSideMkrLampPass 0;
BA_ "GenSigSendType" SG_ 920 ActnOfRvsgLampDrv 0;
BA_ "GenSigSendType" SG_ 920 ActvnOfAfs 0;
BA_ "GenSigSendType" SG_ 920 ActvnOfAhl 0;
BA_ "GenSigSendType" SG_ 920 ActvnOfAlrmReqFromCmplxIf 0;
BA_ "GenSigSendType" SG_ 920 ActvnOfBrkLi 0;
BA_ "GenSigSendType" SG_ 920 ActvnOfDbl 0;
BA_ "GenSigSendType" SG_ 920 ActvnOfDefrstFrnt 0;
BA_ "GenSigSendType" SG_ 920 ActvnOfDefrstRe 0;
BA_ "GenSigSendType" SG_ 920 ActvnOfDoorSwtIllmn 0;
BA_ "GenSigSendType" SG_ 920 ActvnOfFootwellLamp 0;
BA_ "GenSigSendType" SG_ 920 ActvnOfHndlDoorLiHndlDoorLiDrvr 0;
BA_ "GenSigSendType" SG_ 920 ActvnOfHndlDoorLiHndlDoorLiDrvrRe 0;
BA_ "GenSigSendType" SG_ 920 ActvnOfHndlDoorLiHndlDoorLiPass 0;
BA_ "GenSigSendType" SG_ 920 ActvnOfHndlDoorLiHndlDoorLiPassRe 0;
BA_ "GenSigSendType" SG_ 920 ActvnOfReLogoLamp1 0;
BA_ "GenSigSendType" SG_ 920 ActvnOfRoofSwtIllmn 0;
BA_ "GenSigSendType" SG_ 920 ActvnOfSillPlateIllmn 0;
BA_ "GenSigSendType" SG_ 920 ActvnOfStrtIllmn 0;
BA_ "GenSigSendType" SG_ 920 ActvnOfTouristMod 0;
BA_ "GenSigSendType" SG_ 920 ActvnOfWiprMech 0;
BA_ "GenSigSendType" SG_ 920 ActvnOfWshrFrntNotSafe 0;
BA_ "GenSigSendType" SG_ 920 ActvnOfWshrRe 0;
BA_ "GenSigSendType" SG_ 920 AlrmAcoustReq01 0;
BA_ "GenSigSendType" SG_ 920 AlrmToExtrLiFbVisReq 0;
BA_ "GenSigSendType" SG_ 920 AlrmToExtrLiVisReq 0;
BA_ "GenSigSendType" SG_ 920 AutWinWipgCmd 0;
BA_ "GenSigDataID" SG_ 816 BMXSDrvTq2VDMChks "0x1A86";
BA_ "GenSigFuncType" SG_ 816 BMXSDrvTq2VDMChks 15;
BA_ "GenSigSendType" SG_ 816 BMXSDrvTq2VDMChks 0;
BA_ "GenSigFuncType" SG_ 816 BMXSDrvTq2VDMCntr 16;
BA_ "GenSigSendType" SG_ 816 BMXSDrvTq2VDMCntr 0;
BA_ "GenSigSendType" SG_ 816 BMXSDrvTq2VDMTqVDM 0;
BA_ "GenSigSendType" SG_ 816 BMXSDrvTq2VDMTqVDMCtrlMode 0;
BA_ "GenSigSendType" SG_ 816 BMXSDrvTq2VDMTqVDMQf 0;
BA_ "GenSigStartValue" SG_ 816 BMXSDrvTq2VDMTqVDMQf 3;
BA_ "GenSigStartValue" SG_ 416 BattHeatgTargTempPreTherm 50;
BA_ "GenSigSendType" SG_ 52 BodyDataTraceZCUDM1Functiondevpsignalgroup1 0;
BA_ "GenSigSendType" SG_ 52 BodyDataTraceZCUDM1Functiondevpsignalgroup2 0;
BA_ "GenSigSendType" SG_ 52 BodyDataTraceZCUDM1Functiondevpsignalgroup3 0;
BA_ "GenSigSendType" SG_ 52 BodyDataTraceZCUDM1Functiondevpsignalgroup4 0;
BA_ "GenSigSendType" SG_ 52 BodyDataTraceZCUDM1Functiondevpsignalgroup5 0;
BA_ "GenSigSendType" SG_ 52 BodyDataTraceZCUDM1Functiondevpsignalgroup6 0;
BA_ "GenSigSendType" SG_ 52 BodyDataTraceZCUDM1Functiondevpsignalgroup7 0;
BA_ "GenSigSendType" SG_ 52 BodyDataTraceZCUDM1Functiondevpsignalgroup8 0;
BA_ "GenSigSendType" SG_ 52 BodyDataTraceZCUDM2Functiondevpsignalgroup1 0;
BA_ "GenSigSendType" SG_ 52 BodyDataTraceZCUDM2Functiondevpsignalgroup2 0;
BA_ "GenSigSendType" SG_ 52 BodyDataTraceZCUDM2Functiondevpsignalgroup3 0;
BA_ "GenSigSendType" SG_ 52 BodyDataTraceZCUDM2Functiondevpsignalgroup4 0;
BA_ "GenSigSendType" SG_ 52 BodyDataTraceZCUDM2Functiondevpsignalgroup5 0;
BA_ "GenSigSendType" SG_ 52 BodyDataTraceZCUDM2Functiondevpsignalgroup6 0;
BA_ "GenSigSendType" SG_ 52 BodyDataTraceZCUDM2Functiondevpsignalgroup7 0;
BA_ "GenSigSendType" SG_ 52 BodyDataTraceZCUDM2Functiondevpsignalgroup8 0;
BA_ "GenSigSendType" SG_ 52 BodyDataTraceZCUDM3Functiondevpsignalgroup1 0;
BA_ "GenSigSendType" SG_ 52 BodyDataTraceZCUDM3Functiondevpsignalgroup2 0;
BA_ "GenSigSendType" SG_ 52 BodyDataTraceZCUDM3Functiondevpsignalgroup3 0;
BA_ "GenSigSendType" SG_ 52 BodyDataTraceZCUDM3Functiondevpsignalgroup4 0;
BA_ "GenSigSendType" SG_ 52 BodyDataTraceZCUDM3Functiondevpsignalgroup5 0;
BA_ "GenSigSendType" SG_ 52 BodyDataTraceZCUDM3Functiondevpsignalgroup6 0;
BA_ "GenSigSendType" SG_ 52 BodyDataTraceZCUDM3Functiondevpsignalgroup7 0;
BA_ "GenSigSendType" SG_ 52 BodyDataTraceZCUDM3Functiondevpsignalgroup8 0;
BA_ "GenSigSendType" SG_ 52 BodyDataTraceZCUDM4Functiondevpsignalgroup1 0;
BA_ "GenSigSendType" SG_ 52 BodyDataTraceZCUDM4Functiondevpsignalgroup2 0;
BA_ "GenSigSendType" SG_ 52 BodyDataTraceZCUDM4Functiondevpsignalgroup3 0;
BA_ "GenSigSendType" SG_ 52 BodyDataTraceZCUDM4Functiondevpsignalgroup4 0;
BA_ "GenSigSendType" SG_ 52 BodyDataTraceZCUDM4Functiondevpsignalgroup5 0;
BA_ "GenSigSendType" SG_ 52 BodyDataTraceZCUDM4Functiondevpsignalgroup6 0;
BA_ "GenSigSendType" SG_ 52 BodyDataTraceZCUDM4Functiondevpsignalgroup7 0;
BA_ "GenSigSendType" SG_ 52 BodyDataTraceZCUDM4Functiondevpsignalgroup8 0;
BA_ "GenSigSendType" SG_ 52 BodyDataTraceZCUDM5Functiondevpsignalgroup1 0;
BA_ "GenSigSendType" SG_ 52 BodyDataTraceZCUDM5Functiondevpsignalgroup2 0;
BA_ "GenSigSendType" SG_ 52 BodyDataTraceZCUDM5Functiondevpsignalgroup3 0;
BA_ "GenSigSendType" SG_ 52 BodyDataTraceZCUDM5Functiondevpsignalgroup4 0;
BA_ "GenSigSendType" SG_ 52 BodyDataTraceZCUDM5Functiondevpsignalgroup5 0;
BA_ "GenSigSendType" SG_ 52 BodyDataTraceZCUDM5Functiondevpsignalgroup6 0;
BA_ "GenSigSendType" SG_ 52 BodyDataTraceZCUDM5Functiondevpsignalgroup7 0;
BA_ "GenSigSendType" SG_ 52 BodyDataTraceZCUDM5Functiondevpsignalgroup8 0;
BA_ "GenSigSendType" SG_ 52 BodyDataTraceZCUDM6Functiondevpsignalgroup1 0;
BA_ "GenSigSendType" SG_ 52 BodyDataTraceZCUDM6Functiondevpsignalgroup2 0;
BA_ "GenSigSendType" SG_ 52 BodyDataTraceZCUDM6Functiondevpsignalgroup3 0;
BA_ "GenSigSendType" SG_ 52 BodyDataTraceZCUDM6Functiondevpsignalgroup4 0;
BA_ "GenSigSendType" SG_ 52 BodyDataTraceZCUDM6Functiondevpsignalgroup5 0;
BA_ "GenSigSendType" SG_ 52 BodyDataTraceZCUDM6Functiondevpsignalgroup6 0;
BA_ "GenSigSendType" SG_ 52 BodyDataTraceZCUDM6Functiondevpsignalgroup7 0;
BA_ "GenSigSendType" SG_ 52 BodyDataTraceZCUDM6Functiondevpsignalgroup8 0;
BA_ "GenSigSendType" SG_ 52 BodyDataTraceZCUDM7Functiondevpsignalgroup1 0;
BA_ "GenSigSendType" SG_ 52 BodyDataTraceZCUDM7Functiondevpsignalgroup2 0;
BA_ "GenSigSendType" SG_ 52 BodyDataTraceZCUDM7Functiondevpsignalgroup3 0;
BA_ "GenSigSendType" SG_ 52 BodyDataTraceZCUDM7Functiondevpsignalgroup4 0;
BA_ "GenSigSendType" SG_ 52 BodyDataTraceZCUDM7Functiondevpsignalgroup5 0;
BA_ "GenSigSendType" SG_ 52 BodyDataTraceZCUDM7Functiondevpsignalgroup6 0;
BA_ "GenSigSendType" SG_ 52 BodyDataTraceZCUDM7Functiondevpsignalgroup7 0;
BA_ "GenSigSendType" SG_ 52 BodyDataTraceZCUDM7Functiondevpsignalgroup8 0;
BA_ "GenSigStartValue" SG_ 416 ChillerOutCooltT 400;
BA_ "GenSigSendType" SG_ 920 DwnLoadStsFbOfHdlampLe 0;
BA_ "GenSigSendType" SG_ 920 DwnLoadStsFbOfHdlampRi 0;
BA_ "GenSigSendType" SG_ 920 DwnLoadStsFbOfLogoLampLe 0;
BA_ "GenSigSendType" SG_ 920 DwnLoadStsFbOfLogoLampRi 0;
BA_ "GenSigSendType" SG_ 552 ECM4BigDataCnt 0;
BA_ "GenSigSendType" SG_ 552 ECM4BigDataData1 0;
BA_ "GenSigSendType" SG_ 552 ECM4BigDataData10 0;
BA_ "GenSigSendType" SG_ 552 ECM4BigDataData11 0;
BA_ "GenSigSendType" SG_ 552 ECM4BigDataData12 0;
BA_ "GenSigSendType" SG_ 552 ECM4BigDataData13 0;
BA_ "GenSigSendType" SG_ 552 ECM4BigDataData14 0;
BA_ "GenSigSendType" SG_ 552 ECM4BigDataData15 0;
BA_ "GenSigSendType" SG_ 552 ECM4BigDataData16 0;
BA_ "GenSigSendType" SG_ 552 ECM4BigDataData17 0;
BA_ "GenSigSendType" SG_ 552 ECM4BigDataData18 0;
BA_ "GenSigSendType" SG_ 552 ECM4BigDataData19 0;
BA_ "GenSigSendType" SG_ 552 ECM4BigDataData2 0;
BA_ "GenSigSendType" SG_ 552 ECM4BigDataData20 0;
BA_ "GenSigSendType" SG_ 552 ECM4BigDataData21 0;
BA_ "GenSigSendType" SG_ 552 ECM4BigDataData22 0;
BA_ "GenSigSendType" SG_ 552 ECM4BigDataData23 0;
BA_ "GenSigSendType" SG_ 552 ECM4BigDataData24 0;
BA_ "GenSigSendType" SG_ 552 ECM4BigDataData25 0;
BA_ "GenSigSendType" SG_ 552 ECM4BigDataData26 0;
BA_ "GenSigSendType" SG_ 552 ECM4BigDataData27 0;
BA_ "GenSigSendType" SG_ 552 ECM4BigDataData28 0;
BA_ "GenSigSendType" SG_ 552 ECM4BigDataData29 0;
BA_ "GenSigSendType" SG_ 552 ECM4BigDataData3 0;
BA_ "GenSigSendType" SG_ 552 ECM4BigDataData30 0;
BA_ "GenSigSendType" SG_ 552 ECM4BigDataData31 0;
BA_ "GenSigSendType" SG_ 552 ECM4BigDataData32 0;
BA_ "GenSigSendType" SG_ 552 ECM4BigDataData33 0;
BA_ "GenSigSendType" SG_ 552 ECM4BigDataData34 0;
BA_ "GenSigSendType" SG_ 552 ECM4BigDataData35 0;
BA_ "GenSigSendType" SG_ 552 ECM4BigDataData36 0;
BA_ "GenSigSendType" SG_ 552 ECM4BigDataData37 0;
BA_ "GenSigSendType" SG_ 552 ECM4BigDataData38 0;
BA_ "GenSigSendType" SG_ 552 ECM4BigDataData39 0;
BA_ "GenSigSendType" SG_ 552 ECM4BigDataData4 0;
BA_ "GenSigSendType" SG_ 552 ECM4BigDataData40 0;
BA_ "GenSigSendType" SG_ 552 ECM4BigDataData41 0;
BA_ "GenSigSendType" SG_ 552 ECM4BigDataData42 0;
BA_ "GenSigSendType" SG_ 552 ECM4BigDataData43 0;
BA_ "GenSigSendType" SG_ 552 ECM4BigDataData44 0;
BA_ "GenSigSendType" SG_ 552 ECM4BigDataData45 0;
BA_ "GenSigSendType" SG_ 552 ECM4BigDataData46 0;
BA_ "GenSigSendType" SG_ 552 ECM4BigDataData47 0;
BA_ "GenSigSendType" SG_ 552 ECM4BigDataData48 0;
BA_ "GenSigSendType" SG_ 552 ECM4BigDataData49 0;
BA_ "GenSigSendType" SG_ 552 ECM4BigDataData5 0;
BA_ "GenSigSendType" SG_ 552 ECM4BigDataData50 0;
BA_ "GenSigSendType" SG_ 552 ECM4BigDataData51 0;
BA_ "GenSigSendType" SG_ 552 ECM4BigDataData52 0;
BA_ "GenSigSendType" SG_ 552 ECM4BigDataData53 0;
BA_ "GenSigSendType" SG_ 552 ECM4BigDataData54 0;
BA_ "GenSigSendType" SG_ 552 ECM4BigDataData55 0;
BA_ "GenSigSendType" SG_ 552 ECM4BigDataData56 0;
BA_ "GenSigSendType" SG_ 552 ECM4BigDataData57 0;
BA_ "GenSigSendType" SG_ 552 ECM4BigDataData58 0;
BA_ "GenSigSendType" SG_ 552 ECM4BigDataData59 0;
BA_ "GenSigSendType" SG_ 552 ECM4BigDataData6 0;
BA_ "GenSigSendType" SG_ 552 ECM4BigDataData60 0;
BA_ "GenSigSendType" SG_ 552 ECM4BigDataData61 0;
BA_ "GenSigSendType" SG_ 552 ECM4BigDataData62 0;
BA_ "GenSigSendType" SG_ 552 ECM4BigDataData63 0;
BA_ "GenSigSendType" SG_ 552 ECM4BigDataData7 0;
BA_ "GenSigSendType" SG_ 552 ECM4BigDataData8 0;
BA_ "GenSigSendType" SG_ 552 ECM4BigDataData9 0;
BA_ "GenSigStartValue" SG_ 416 EtpMcuTemperature 50;
BA_ "GenSigStartValue" SG_ 416 EtpMosTemperature 50;
BA_ "GenSigStartValue" SG_ 416 EtpMosTemperatureBackup 50;
BA_ "GenSigSendType" SG_ 920 ExtrLiShowActvnFrntLeFb 0;
BA_ "GenSigSendType" SG_ 920 ExtrLiShowActvnFrntRiFb 0;
BA_ "GenSigSendType" SG_ 920 ExtrLiShowActvnLeLogoFb 0;
BA_ "GenSigSendType" SG_ 920 ExtrLiShowActvnRiLogoFb 0;
BA_ "GenSigSendType" SG_ 920 HdlampLeInpSts1 0;
BA_ "GenSigSendType" SG_ 920 HdlampLeInpSts2 0;
BA_ "GenSigSendType" SG_ 920 HdlampRiInpSts1 0;
BA_ "GenSigSendType" SG_ 920 HdlampRiInpSts2 0;
BA_ "GenSigStartValue" SG_ 416 IsgForWRCIsgSpdForWRC 20000;
BA_ "GenSigStartValue" SG_ 416 IsgForWRCIsgTqEstForWRC 8000;
BA_ "GenSigStartValue" SG_ 416 IsgOilPmpTemperatureForETP 50;
BA_ "GenSigStartValue" SG_ 422 IvtrActId 1023;
BA_ "GenSigStartValue" SG_ 422 IvtrActIq 1023;
BA_ "GenSigStartValue" SG_ 422 IvtrDAxisCurrtSp 1023;
BA_ "GenSigStartValue" SG_ 422 IvtrDAxisU 13100;
BA_ "GenSigStartValue" SG_ 422 IvtrIgbtJunctionT 40;
BA_ "GenSigStartValue" SG_ 422 IvtrOilT 40;
BA_ "GenSigStartValue" SG_ 422 IvtrQAxisCurrtSp 1023;
BA_ "GenSigStartValue" SG_ 422 IvtrQAxisU 13100;
BA_ "GenSigStartValue" SG_ 422 IvtrReqIdWithLimn 1023;
BA_ "GenSigStartValue" SG_ 422 IvtrReqIqWithLimn 1023;
BA_ "GenSigStartValue" SG_ 422 IvtrSftySpd 20000;
BA_ "GenSigStartValue" SG_ 422 IvtrSftyTq 8000;
BA_ "GenSigStartValue" SG_ 422 IvtrTraPhaCurrtAryU 1023;
BA_ "GenSigStartValue" SG_ 422 IvtrTraPhaCurrtAryV 1023;
BA_ "GenSigStartValue" SG_ 422 IvtrTraPhaCurrtAryW 1023;
BA_ "GenSigStartValue" SG_ 422 MotSpdForWRC 20000;
BA_ "GenSigStartValue" SG_ 422 MotTqEstForWRC 8000;
BA_ "GenSigSendType" SG_ 555 PCMBigDataCnt 0;
BA_ "GenSigSendType" SG_ 555 PCMBigDataData1 0;
BA_ "GenSigSendType" SG_ 555 PCMBigDataData10 0;
BA_ "GenSigSendType" SG_ 555 PCMBigDataData11 0;
BA_ "GenSigSendType" SG_ 555 PCMBigDataData12 0;
BA_ "GenSigSendType" SG_ 555 PCMBigDataData13 0;
BA_ "GenSigSendType" SG_ 555 PCMBigDataData14 0;
BA_ "GenSigSendType" SG_ 555 PCMBigDataData15 0;
BA_ "GenSigSendType" SG_ 555 PCMBigDataData16 0;
BA_ "GenSigSendType" SG_ 555 PCMBigDataData17 0;
BA_ "GenSigSendType" SG_ 555 PCMBigDataData18 0;
BA_ "GenSigSendType" SG_ 555 PCMBigDataData19 0;
BA_ "GenSigSendType" SG_ 555 PCMBigDataData2 0;
BA_ "GenSigSendType" SG_ 555 PCMBigDataData20 0;
BA_ "GenSigSendType" SG_ 555 PCMBigDataData21 0;
BA_ "GenSigSendType" SG_ 555 PCMBigDataData22 0;
BA_ "GenSigSendType" SG_ 555 PCMBigDataData23 0;
BA_ "GenSigSendType" SG_ 555 PCMBigDataData24 0;
BA_ "GenSigSendType" SG_ 555 PCMBigDataData25 0;
BA_ "GenSigSendType" SG_ 555 PCMBigDataData26 0;
BA_ "GenSigSendType" SG_ 555 PCMBigDataData27 0;
BA_ "GenSigSendType" SG_ 555 PCMBigDataData28 0;
BA_ "GenSigSendType" SG_ 555 PCMBigDataData29 0;
BA_ "GenSigSendType" SG_ 555 PCMBigDataData3 0;
BA_ "GenSigSendType" SG_ 555 PCMBigDataData30 0;
BA_ "GenSigSendType" SG_ 555 PCMBigDataData31 0;
BA_ "GenSigSendType" SG_ 555 PCMBigDataData32 0;
BA_ "GenSigSendType" SG_ 555 PCMBigDataData33 0;
BA_ "GenSigSendType" SG_ 555 PCMBigDataData34 0;
BA_ "GenSigSendType" SG_ 555 PCMBigDataData35 0;
BA_ "GenSigSendType" SG_ 555 PCMBigDataData36 0;
BA_ "GenSigSendType" SG_ 555 PCMBigDataData37 0;
BA_ "GenSigSendType" SG_ 555 PCMBigDataData38 0;
BA_ "GenSigSendType" SG_ 555 PCMBigDataData39 0;
BA_ "GenSigSendType" SG_ 555 PCMBigDataData4 0;
BA_ "GenSigSendType" SG_ 555 PCMBigDataData40 0;
BA_ "GenSigSendType" SG_ 555 PCMBigDataData41 0;
BA_ "GenSigSendType" SG_ 555 PCMBigDataData42 0;
BA_ "GenSigSendType" SG_ 555 PCMBigDataData43 0;
BA_ "GenSigSendType" SG_ 555 PCMBigDataData44 0;
BA_ "GenSigSendType" SG_ 555 PCMBigDataData45 0;
BA_ "GenSigSendType" SG_ 555 PCMBigDataData46 0;
BA_ "GenSigSendType" SG_ 555 PCMBigDataData47 0;
BA_ "GenSigSendType" SG_ 555 PCMBigDataData48 0;
BA_ "GenSigSendType" SG_ 555 PCMBigDataData49 0;
BA_ "GenSigSendType" SG_ 555 PCMBigDataData5 0;
BA_ "GenSigSendType" SG_ 555 PCMBigDataData50 0;
BA_ "GenSigSendType" SG_ 555 PCMBigDataData51 0;
BA_ "GenSigSendType" SG_ 555 PCMBigDataData52 0;
BA_ "GenSigSendType" SG_ 555 PCMBigDataData53 0;
BA_ "GenSigSendType" SG_ 555 PCMBigDataData54 0;
BA_ "GenSigSendType" SG_ 555 PCMBigDataData55 0;
BA_ "GenSigSendType" SG_ 555 PCMBigDataData56 0;
BA_ "GenSigSendType" SG_ 555 PCMBigDataData57 0;
BA_ "GenSigSendType" SG_ 555 PCMBigDataData58 0;
BA_ "GenSigSendType" SG_ 555 PCMBigDataData59 0;
BA_ "GenSigSendType" SG_ 555 PCMBigDataData6 0;
BA_ "GenSigSendType" SG_ 555 PCMBigDataData60 0;
BA_ "GenSigSendType" SG_ 555 PCMBigDataData61 0;
BA_ "GenSigSendType" SG_ 555 PCMBigDataData62 0;
BA_ "GenSigSendType" SG_ 555 PCMBigDataData63 0;
BA_ "GenSigSendType" SG_ 555 PCMBigDataData7 0;
BA_ "GenSigSendType" SG_ 555 PCMBigDataData8 0;
BA_ "GenSigSendType" SG_ 555 PCMBigDataData9 0;
BA_ "GenSigStartValue" SG_ 422 PredDrvPwrReq 1000;
BA_ "GenSigStartValue" SG_ 422 PtTqMCUPtTqFrntMotMaxReq 8000;
BA_ "GenSigStartValue" SG_ 422 PtTqMCUPtTqFrntMotMinReq 8000;
BA_ "GenSigStartValue" SG_ 422 PtTqMCUPtTqReMotMaxReq 8000;
BA_ "GenSigStartValue" SG_ 422 PtTqMCUPtTqReMotMinReq 8000;
BA_ "GenSigSendType" SG_ 920 ShortDropWinDrvrSts 0;
BA_ "GenSigSendType" SG_ 920 ShortDropWinReLeSts 0;
BA_ "GenSigSendType" SG_ 920 StsOfAfsLe 0;
BA_ "GenSigSendType" SG_ 920 StsOfAfsRi 0;
BA_ "GenSigSendType" SG_ 920 StsOfAhbcLe 0;
BA_ "GenSigSendType" SG_ 920 StsOfAhbcRi 0;
BA_ "GenSigSendType" SG_ 920 StsOfFrntSideMkrLampLe2 0;
BA_ "GenSigSendType" SG_ 920 StsOfFrntSideMkrLampRi2 0;
BA_ "GenSigSendType" SG_ 920 StsOfLedCornrgLampLe 0;
BA_ "GenSigSendType" SG_ 920 StsOfLedCornrgLampRi 0;
BA_ "GenSigSendType" SG_ 920 StsOfLedDaytiRunngLampLe 0;
BA_ "GenSigSendType" SG_ 920 StsOfLedDaytiRunngLampRi 0;
BA_ "GenSigSendType" SG_ 920 StsOfLedFrntFogLampLe 0;
BA_ "GenSigSendType" SG_ 920 StsOfLedFrntFogLampRi 0;
BA_ "GenSigSendType" SG_ 920 StsOfLedFrntPosnLampLe 0;
BA_ "GenSigSendType" SG_ 920 StsOfLedFrntPosnLampRi 0;
BA_ "GenSigSendType" SG_ 920 StsOfLedFrntTurnIndcrLe 0;
BA_ "GenSigSendType" SG_ 920 StsOfLedFrntTurnIndcrRi 0;
BA_ "GenSigSendType" SG_ 920 StsOfLedLeLogoLamp 0;
BA_ "GenSigSendType" SG_ 920 StsOfLedRiLogoLamp 0;
BA_ "GenSigSendType" SG_ 920 StsOfLvlgLeChks 0;
BA_ "GenSigSendType" SG_ 920 StsOfLvlgLeCntr 0;
BA_ "GenSigSendType" SG_ 920 StsOfLvlgLeStsOfLvlgLe 0;
BA_ "GenSigSendType" SG_ 920 StsOfLvlgRiChks 0;
BA_ "GenSigSendType" SG_ 920 StsOfLvlgRiCntr 0;
BA_ "GenSigSendType" SG_ 920 StsOfLvlgRiStsOfLvlgRi 0;
BA_ "GenSigSendType" SG_ 920 StsOfTouristModLe 0;
BA_ "GenSigSendType" SG_ 920 StsOfTouristModRi 0;
BA_ "GenSigSendType" SG_ 920 StsOfWelGbyFrntLe 0;
BA_ "GenSigSendType" SG_ 920 StsOfWelGbyFrntRi 0;
BA_ "GenSigSendType" SG_ 920 SunRoofAndCurtBtnSts2Cntr 0;
BA_ "GenSigSendType" SG_ 920 SunRoofAndCurtBtnSts2Pos 0;
BA_ "GenSigSendType" SG_ 920 SunRoofImpctDetnSts2 0;
BA_ "GenSigSendType" SG_ 920 TCSDoorSts 0;
BA_ "GenSigSendType" SG_ 816 VFCVectorSMBLBlockID 0;
BA_ "GenSigSendType" SG_ 816 VFCVectorSMBLVFCid0 0;
BA_ "GenSigSendType" SG_ 816 VFCVectorSMBLVFCid1 0;
BA_ "GenSigSendType" SG_ 816 VFCVectorSMBLVFCid10 0;
BA_ "GenSigSendType" SG_ 816 VFCVectorSMBLVFCid11 0;
BA_ "GenSigSendType" SG_ 816 VFCVectorSMBLVFCid12 0;
BA_ "GenSigSendType" SG_ 816 VFCVectorSMBLVFCid13 0;
BA_ "GenSigSendType" SG_ 816 VFCVectorSMBLVFCid14 0;
BA_ "GenSigSendType" SG_ 816 VFCVectorSMBLVFCid15 0;
BA_ "GenSigSendType" SG_ 816 VFCVectorSMBLVFCid16 0;
BA_ "GenSigSendType" SG_ 816 VFCVectorSMBLVFCid17 0;
BA_ "GenSigSendType" SG_ 816 VFCVectorSMBLVFCid18 0;
BA_ "GenSigSendType" SG_ 816 VFCVectorSMBLVFCid19 0;
BA_ "GenSigSendType" SG_ 816 VFCVectorSMBLVFCid2 0;
BA_ "GenSigSendType" SG_ 816 VFCVectorSMBLVFCid20 0;
BA_ "GenSigSendType" SG_ 816 VFCVectorSMBLVFCid21 0;
BA_ "GenSigSendType" SG_ 816 VFCVectorSMBLVFCid22 0;
BA_ "GenSigSendType" SG_ 816 VFCVectorSMBLVFCid23 0;
BA_ "GenSigSendType" SG_ 816 VFCVectorSMBLVFCid24 0;
BA_ "GenSigSendType" SG_ 816 VFCVectorSMBLVFCid25 0;
BA_ "GenSigSendType" SG_ 816 VFCVectorSMBLVFCid26 0;
BA_ "GenSigSendType" SG_ 816 VFCVectorSMBLVFCid27 0;
BA_ "GenSigSendType" SG_ 816 VFCVectorSMBLVFCid28 0;
BA_ "GenSigSendType" SG_ 816 VFCVectorSMBLVFCid29 0;
BA_ "GenSigSendType" SG_ 816 VFCVectorSMBLVFCid3 0;
BA_ "GenSigSendType" SG_ 816 VFCVectorSMBLVFCid30 0;
BA_ "GenSigSendType" SG_ 816 VFCVectorSMBLVFCid31 0;
BA_ "GenSigSendType" SG_ 816 VFCVectorSMBLVFCid32 0;
BA_ "GenSigSendType" SG_ 816 VFCVectorSMBLVFCid33 0;
BA_ "GenSigSendType" SG_ 816 VFCVectorSMBLVFCid34 0;
BA_ "GenSigSendType" SG_ 816 VFCVectorSMBLVFCid35 0;
BA_ "GenSigSendType" SG_ 816 VFCVectorSMBLVFCid36 0;
BA_ "GenSigSendType" SG_ 816 VFCVectorSMBLVFCid37 0;
BA_ "GenSigSendType" SG_ 816 VFCVectorSMBLVFCid38 0;
BA_ "GenSigSendType" SG_ 816 VFCVectorSMBLVFCid39 0;
BA_ "GenSigSendType" SG_ 816 VFCVectorSMBLVFCid4 0;
BA_ "GenSigSendType" SG_ 816 VFCVectorSMBLVFCid40 0;
BA_ "GenSigSendType" SG_ 816 VFCVectorSMBLVFCid41 0;
BA_ "GenSigSendType" SG_ 816 VFCVectorSMBLVFCid42 0;
BA_ "GenSigSendType" SG_ 816 VFCVectorSMBLVFCid43 0;
BA_ "GenSigSendType" SG_ 816 VFCVectorSMBLVFCid44 0;
BA_ "GenSigSendType" SG_ 816 VFCVectorSMBLVFCid45 0;
BA_ "GenSigSendType" SG_ 816 VFCVectorSMBLVFCid46 0;
BA_ "GenSigSendType" SG_ 816 VFCVectorSMBLVFCid47 0;
BA_ "GenSigSendType" SG_ 816 VFCVectorSMBLVFCid48 0;
BA_ "GenSigSendType" SG_ 816 VFCVectorSMBLVFCid49 0;
BA_ "GenSigSendType" SG_ 816 VFCVectorSMBLVFCid5 0;
BA_ "GenSigSendType" SG_ 816 VFCVectorSMBLVFCid50 0;
BA_ "GenSigSendType" SG_ 816 VFCVectorSMBLVFCid51 0;
BA_ "GenSigSendType" SG_ 816 VFCVectorSMBLVFCid52 0;
BA_ "GenSigSendType" SG_ 816 VFCVectorSMBLVFCid53 0;
BA_ "GenSigSendType" SG_ 816 VFCVectorSMBLVFCid54 0;
BA_ "GenSigSendType" SG_ 816 VFCVectorSMBLVFCid55 0;
BA_ "GenSigSendType" SG_ 816 VFCVectorSMBLVFCid56 0;
BA_ "GenSigSendType" SG_ 816 VFCVectorSMBLVFCid57 0;
BA_ "GenSigSendType" SG_ 816 VFCVectorSMBLVFCid58 0;
BA_ "GenSigSendType" SG_ 816 VFCVectorSMBLVFCid59 0;
BA_ "GenSigSendType" SG_ 816 VFCVectorSMBLVFCid6 0;
BA_ "GenSigSendType" SG_ 816 VFCVectorSMBLVFCid60 0;
BA_ "GenSigSendType" SG_ 816 VFCVectorSMBLVFCid61 0;
BA_ "GenSigSendType" SG_ 816 VFCVectorSMBLVFCid7 0;
BA_ "GenSigSendType" SG_ 816 VFCVectorSMBLVFCid8 0;
BA_ "GenSigSendType" SG_ 816 VFCVectorSMBLVFCid9 0;
BA_ "GenSigSendType" SG_ 816 VFCVectorSMBRBlockID 0;
BA_ "GenSigSendType" SG_ 816 VFCVectorSMBRVFCid0 0;
BA_ "GenSigSendType" SG_ 816 VFCVectorSMBRVFCid1 0;
BA_ "GenSigSendType" SG_ 816 VFCVectorSMBRVFCid10 0;
BA_ "GenSigSendType" SG_ 816 VFCVectorSMBRVFCid11 0;
BA_ "GenSigSendType" SG_ 816 VFCVectorSMBRVFCid12 0;
BA_ "GenSigSendType" SG_ 816 VFCVectorSMBRVFCid13 0;
BA_ "GenSigSendType" SG_ 816 VFCVectorSMBRVFCid14 0;
BA_ "GenSigSendType" SG_ 816 VFCVectorSMBRVFCid15 0;
BA_ "GenSigSendType" SG_ 816 VFCVectorSMBRVFCid16 0;
BA_ "GenSigSendType" SG_ 816 VFCVectorSMBRVFCid17 0;
BA_ "GenSigSendType" SG_ 816 VFCVectorSMBRVFCid18 0;
BA_ "GenSigSendType" SG_ 816 VFCVectorSMBRVFCid19 0;
BA_ "GenSigSendType" SG_ 816 VFCVectorSMBRVFCid2 0;
BA_ "GenSigSendType" SG_ 816 VFCVectorSMBRVFCid20 0;
BA_ "GenSigSendType" SG_ 816 VFCVectorSMBRVFCid21 0;
BA_ "GenSigSendType" SG_ 816 VFCVectorSMBRVFCid22 0;
BA_ "GenSigSendType" SG_ 816 VFCVectorSMBRVFCid23 0;
BA_ "GenSigSendType" SG_ 816 VFCVectorSMBRVFCid24 0;
BA_ "GenSigSendType" SG_ 816 VFCVectorSMBRVFCid25 0;
BA_ "GenSigSendType" SG_ 816 VFCVectorSMBRVFCid26 0;
BA_ "GenSigSendType" SG_ 816 VFCVectorSMBRVFCid27 0;
BA_ "GenSigSendType" SG_ 816 VFCVectorSMBRVFCid28 0;
BA_ "GenSigSendType" SG_ 816 VFCVectorSMBRVFCid29 0;
BA_ "GenSigSendType" SG_ 816 VFCVectorSMBRVFCid3 0;
BA_ "GenSigSendType" SG_ 816 VFCVectorSMBRVFCid30 0;
BA_ "GenSigSendType" SG_ 816 VFCVectorSMBRVFCid31 0;
BA_ "GenSigSendType" SG_ 816 VFCVectorSMBRVFCid32 0;
BA_ "GenSigSendType" SG_ 816 VFCVectorSMBRVFCid33 0;
BA_ "GenSigSendType" SG_ 816 VFCVectorSMBRVFCid34 0;
BA_ "GenSigSendType" SG_ 816 VFCVectorSMBRVFCid35 0;
BA_ "GenSigSendType" SG_ 816 VFCVectorSMBRVFCid36 0;
BA_ "GenSigSendType" SG_ 816 VFCVectorSMBRVFCid37 0;
BA_ "GenSigSendType" SG_ 816 VFCVectorSMBRVFCid38 0;
BA_ "GenSigSendType" SG_ 816 VFCVectorSMBRVFCid39 0;
BA_ "GenSigSendType" SG_ 816 VFCVectorSMBRVFCid4 0;
BA_ "GenSigSendType" SG_ 816 VFCVectorSMBRVFCid40 0;
BA_ "GenSigSendType" SG_ 816 VFCVectorSMBRVFCid41 0;
BA_ "GenSigSendType" SG_ 816 VFCVectorSMBRVFCid42 0;
BA_ "GenSigSendType" SG_ 816 VFCVectorSMBRVFCid43 0;
BA_ "GenSigSendType" SG_ 816 VFCVectorSMBRVFCid44 0;
BA_ "GenSigSendType" SG_ 816 VFCVectorSMBRVFCid45 0;
BA_ "GenSigSendType" SG_ 816 VFCVectorSMBRVFCid46 0;
BA_ "GenSigSendType" SG_ 816 VFCVectorSMBRVFCid47 0;
BA_ "GenSigSendType" SG_ 816 VFCVectorSMBRVFCid48 0;
BA_ "GenSigSendType" SG_ 816 VFCVectorSMBRVFCid49 0;
BA_ "GenSigSendType" SG_ 816 VFCVectorSMBRVFCid5 0;
BA_ "GenSigSendType" SG_ 816 VFCVectorSMBRVFCid50 0;
BA_ "GenSigSendType" SG_ 816 VFCVectorSMBRVFCid51 0;
BA_ "GenSigSendType" SG_ 816 VFCVectorSMBRVFCid52 0;
BA_ "GenSigSendType" SG_ 816 VFCVectorSMBRVFCid53 0;
BA_ "GenSigSendType" SG_ 816 VFCVectorSMBRVFCid54 0;
BA_ "GenSigSendType" SG_ 816 VFCVectorSMBRVFCid55 0;
BA_ "GenSigSendType" SG_ 816 VFCVectorSMBRVFCid56 0;
BA_ "GenSigSendType" SG_ 816 VFCVectorSMBRVFCid57 0;
BA_ "GenSigSendType" SG_ 816 VFCVectorSMBRVFCid58 0;
BA_ "GenSigSendType" SG_ 816 VFCVectorSMBRVFCid59 0;
BA_ "GenSigSendType" SG_ 816 VFCVectorSMBRVFCid6 0;
BA_ "GenSigSendType" SG_ 816 VFCVectorSMBRVFCid60 0;
BA_ "GenSigSendType" SG_ 816 VFCVectorSMBRVFCid61 0;
BA_ "GenSigSendType" SG_ 816 VFCVectorSMBRVFCid7 0;
BA_ "GenSigSendType" SG_ 816 VFCVectorSMBRVFCid8 0;
BA_ "GenSigSendType" SG_ 816 VFCVectorSMBRVFCid9 0;
BA_ "GenSigSendType" SG_ 832 VFCVectorSMPBlockID 0;
BA_ "GenSigSendType" SG_ 832 VFCVectorSMPVFCid0 0;
BA_ "GenSigSendType" SG_ 832 VFCVectorSMPVFCid1 0;
BA_ "GenSigSendType" SG_ 832 VFCVectorSMPVFCid10 0;
BA_ "GenSigSendType" SG_ 832 VFCVectorSMPVFCid11 0;
BA_ "GenSigSendType" SG_ 832 VFCVectorSMPVFCid12 0;
BA_ "GenSigSendType" SG_ 832 VFCVectorSMPVFCid13 0;
BA_ "GenSigSendType" SG_ 832 VFCVectorSMPVFCid14 0;
BA_ "GenSigSendType" SG_ 832 VFCVectorSMPVFCid15 0;
BA_ "GenSigSendType" SG_ 832 VFCVectorSMPVFCid16 0;
BA_ "GenSigSendType" SG_ 832 VFCVectorSMPVFCid17 0;
BA_ "GenSigSendType" SG_ 832 VFCVectorSMPVFCid18 0;
BA_ "GenSigSendType" SG_ 832 VFCVectorSMPVFCid19 0;
BA_ "GenSigSendType" SG_ 832 VFCVectorSMPVFCid2 0;
BA_ "GenSigSendType" SG_ 832 VFCVectorSMPVFCid20 0;
BA_ "GenSigSendType" SG_ 832 VFCVectorSMPVFCid21 0;
BA_ "GenSigSendType" SG_ 832 VFCVectorSMPVFCid22 0;
BA_ "GenSigSendType" SG_ 832 VFCVectorSMPVFCid23 0;
BA_ "GenSigSendType" SG_ 832 VFCVectorSMPVFCid24 0;
BA_ "GenSigSendType" SG_ 832 VFCVectorSMPVFCid25 0;
BA_ "GenSigSendType" SG_ 832 VFCVectorSMPVFCid26 0;
BA_ "GenSigSendType" SG_ 832 VFCVectorSMPVFCid27 0;
BA_ "GenSigSendType" SG_ 832 VFCVectorSMPVFCid28 0;
BA_ "GenSigSendType" SG_ 832 VFCVectorSMPVFCid29 0;
BA_ "GenSigSendType" SG_ 832 VFCVectorSMPVFCid3 0;
BA_ "GenSigSendType" SG_ 832 VFCVectorSMPVFCid30 0;
BA_ "GenSigSendType" SG_ 832 VFCVectorSMPVFCid31 0;
BA_ "GenSigSendType" SG_ 832 VFCVectorSMPVFCid32 0;
BA_ "GenSigSendType" SG_ 832 VFCVectorSMPVFCid33 0;
BA_ "GenSigSendType" SG_ 832 VFCVectorSMPVFCid34 0;
BA_ "GenSigSendType" SG_ 832 VFCVectorSMPVFCid35 0;
BA_ "GenSigSendType" SG_ 832 VFCVectorSMPVFCid36 0;
BA_ "GenSigSendType" SG_ 832 VFCVectorSMPVFCid37 0;
BA_ "GenSigSendType" SG_ 832 VFCVectorSMPVFCid38 0;
BA_ "GenSigSendType" SG_ 832 VFCVectorSMPVFCid39 0;
BA_ "GenSigSendType" SG_ 832 VFCVectorSMPVFCid4 0;
BA_ "GenSigSendType" SG_ 832 VFCVectorSMPVFCid40 0;
BA_ "GenSigSendType" SG_ 832 VFCVectorSMPVFCid41 0;
BA_ "GenSigSendType" SG_ 832 VFCVectorSMPVFCid42 0;
BA_ "GenSigSendType" SG_ 832 VFCVectorSMPVFCid43 0;
BA_ "GenSigSendType" SG_ 832 VFCVectorSMPVFCid44 0;
BA_ "GenSigSendType" SG_ 832 VFCVectorSMPVFCid45 0;
BA_ "GenSigSendType" SG_ 832 VFCVectorSMPVFCid46 0;
BA_ "GenSigSendType" SG_ 832 VFCVectorSMPVFCid47 0;
BA_ "GenSigSendType" SG_ 832 VFCVectorSMPVFCid48 0;
BA_ "GenSigSendType" SG_ 832 VFCVectorSMPVFCid49 0;
BA_ "GenSigSendType" SG_ 832 VFCVectorSMPVFCid5 0;
BA_ "GenSigSendType" SG_ 832 VFCVectorSMPVFCid50 0;
BA_ "GenSigSendType" SG_ 832 VFCVectorSMPVFCid51 0;
BA_ "GenSigSendType" SG_ 832 VFCVectorSMPVFCid52 0;
BA_ "GenSigSendType" SG_ 832 VFCVectorSMPVFCid53 0;
BA_ "GenSigSendType" SG_ 832 VFCVectorSMPVFCid54 0;
BA_ "GenSigSendType" SG_ 832 VFCVectorSMPVFCid55 0;
BA_ "GenSigSendType" SG_ 832 VFCVectorSMPVFCid56 0;
BA_ "GenSigSendType" SG_ 832 VFCVectorSMPVFCid57 0;
BA_ "GenSigSendType" SG_ 832 VFCVectorSMPVFCid58 0;
BA_ "GenSigSendType" SG_ 832 VFCVectorSMPVFCid59 0;
BA_ "GenSigSendType" SG_ 832 VFCVectorSMPVFCid6 0;
BA_ "GenSigSendType" SG_ 832 VFCVectorSMPVFCid60 0;
BA_ "GenSigSendType" SG_ 832 VFCVectorSMPVFCid61 0;
BA_ "GenSigSendType" SG_ 832 VFCVectorSMPVFCid7 0;
BA_ "GenSigSendType" SG_ 832 VFCVectorSMPVFCid8 0;
BA_ "GenSigSendType" SG_ 832 VFCVectorSMPVFCid9 0;
BA_ "GenSigSendType" SG_ 816 VFCVectorTRMBlockID 0;
BA_ "GenSigSendType" SG_ 816 VFCVectorTRMVFCid0 0;
BA_ "GenSigSendType" SG_ 816 VFCVectorTRMVFCid1 0;
BA_ "GenSigSendType" SG_ 816 VFCVectorTRMVFCid10 0;
BA_ "GenSigSendType" SG_ 816 VFCVectorTRMVFCid11 0;
BA_ "GenSigSendType" SG_ 816 VFCVectorTRMVFCid12 0;
BA_ "GenSigSendType" SG_ 816 VFCVectorTRMVFCid13 0;
BA_ "GenSigSendType" SG_ 816 VFCVectorTRMVFCid14 0;
BA_ "GenSigSendType" SG_ 816 VFCVectorTRMVFCid15 0;
BA_ "GenSigSendType" SG_ 816 VFCVectorTRMVFCid16 0;
BA_ "GenSigSendType" SG_ 816 VFCVectorTRMVFCid17 0;
BA_ "GenSigSendType" SG_ 816 VFCVectorTRMVFCid18 0;
BA_ "GenSigSendType" SG_ 816 VFCVectorTRMVFCid19 0;
BA_ "GenSigSendType" SG_ 816 VFCVectorTRMVFCid2 0;
BA_ "GenSigSendType" SG_ 816 VFCVectorTRMVFCid20 0;
BA_ "GenSigSendType" SG_ 816 VFCVectorTRMVFCid21 0;
BA_ "GenSigSendType" SG_ 816 VFCVectorTRMVFCid22 0;
BA_ "GenSigSendType" SG_ 816 VFCVectorTRMVFCid23 0;
BA_ "GenSigSendType" SG_ 816 VFCVectorTRMVFCid24 0;
BA_ "GenSigSendType" SG_ 816 VFCVectorTRMVFCid25 0;
BA_ "GenSigSendType" SG_ 816 VFCVectorTRMVFCid26 0;
BA_ "GenSigSendType" SG_ 816 VFCVectorTRMVFCid27 0;
BA_ "GenSigSendType" SG_ 816 VFCVectorTRMVFCid28 0;
BA_ "GenSigSendType" SG_ 816 VFCVectorTRMVFCid29 0;
BA_ "GenSigSendType" SG_ 816 VFCVectorTRMVFCid3 0;
BA_ "GenSigSendType" SG_ 816 VFCVectorTRMVFCid30 0;
BA_ "GenSigSendType" SG_ 816 VFCVectorTRMVFCid31 0;
BA_ "GenSigSendType" SG_ 816 VFCVectorTRMVFCid32 0;
BA_ "GenSigSendType" SG_ 816 VFCVectorTRMVFCid33 0;
BA_ "GenSigSendType" SG_ 816 VFCVectorTRMVFCid34 0;
BA_ "GenSigSendType" SG_ 816 VFCVectorTRMVFCid35 0;
BA_ "GenSigSendType" SG_ 816 VFCVectorTRMVFCid36 0;
BA_ "GenSigSendType" SG_ 816 VFCVectorTRMVFCid37 0;
BA_ "GenSigSendType" SG_ 816 VFCVectorTRMVFCid38 0;
BA_ "GenSigSendType" SG_ 816 VFCVectorTRMVFCid39 0;
BA_ "GenSigSendType" SG_ 816 VFCVectorTRMVFCid4 0;
BA_ "GenSigSendType" SG_ 816 VFCVectorTRMVFCid40 0;
BA_ "GenSigSendType" SG_ 816 VFCVectorTRMVFCid41 0;
BA_ "GenSigSendType" SG_ 816 VFCVectorTRMVFCid42 0;
BA_ "GenSigSendType" SG_ 816 VFCVectorTRMVFCid43 0;
BA_ "GenSigSendType" SG_ 816 VFCVectorTRMVFCid44 0;
BA_ "GenSigSendType" SG_ 816 VFCVectorTRMVFCid45 0;
BA_ "GenSigSendType" SG_ 816 VFCVectorTRMVFCid46 0;
BA_ "GenSigSendType" SG_ 816 VFCVectorTRMVFCid47 0;
BA_ "GenSigSendType" SG_ 816 VFCVectorTRMVFCid48 0;
BA_ "GenSigSendType" SG_ 816 VFCVectorTRMVFCid49 0;
BA_ "GenSigSendType" SG_ 816 VFCVectorTRMVFCid5 0;
BA_ "GenSigSendType" SG_ 816 VFCVectorTRMVFCid50 0;
BA_ "GenSigSendType" SG_ 816 VFCVectorTRMVFCid51 0;
BA_ "GenSigSendType" SG_ 816 VFCVectorTRMVFCid52 0;
BA_ "GenSigSendType" SG_ 816 VFCVectorTRMVFCid53 0;
BA_ "GenSigSendType" SG_ 816 VFCVectorTRMVFCid54 0;
BA_ "GenSigSendType" SG_ 816 VFCVectorTRMVFCid55 0;
BA_ "GenSigSendType" SG_ 816 VFCVectorTRMVFCid56 0;
BA_ "GenSigSendType" SG_ 816 VFCVectorTRMVFCid57 0;
BA_ "GenSigSendType" SG_ 816 VFCVectorTRMVFCid58 0;
BA_ "GenSigSendType" SG_ 816 VFCVectorTRMVFCid59 0;
BA_ "GenSigSendType" SG_ 816 VFCVectorTRMVFCid6 0;
BA_ "GenSigSendType" SG_ 816 VFCVectorTRMVFCid60 0;
BA_ "GenSigSendType" SG_ 816 VFCVectorTRMVFCid61 0;
BA_ "GenSigSendType" SG_ 816 VFCVectorTRMVFCid7 0;
BA_ "GenSigSendType" SG_ 816 VFCVectorTRMVFCid8 0;
BA_ "GenSigSendType" SG_ 816 VFCVectorTRMVFCid9 0;
BA_ "GenSigSendType" SG_ 920 WiprInPrkgPosnLoFromWMM 0;
BA_ "GenSigSendType" SG_ 920 WiprInWipgArFromWMM 0;
BA_ "GenSigSendType" SG_ 920 WiprMotCrkAg 0;
BA_ "GenSigSendType" SG_ 920 WiprMotDiagcWiprMotHiVoltDetd 0;
BA_ "GenSigStartValue" SG_ 920 WiprMotDiagcWiprMotHiVoltDetd 1;
BA_ "GenSigSendType" SG_ 920 WiprMotDiagcWiprMotLoVoltDetd 0;
BA_ "GenSigStartValue" SG_ 920 WiprMotDiagcWiprMotLoVoltDetd 1;
BA_ "GenSigSendType" SG_ 920 WiprMotDiagcWiprMotOvldDetd 0;
BA_ "GenSigStartValue" SG_ 920 WiprMotDiagcWiprMotOvldDetd 1;
BA_ "GenSigSendType" SG_ 920 WiprMotErrSafe 0;
BA_ "GenSigStartValue" SG_ 920 WiprMotErrSafe 1;
BA_ "GenSigSendType" SG_ 920 WshngCycActvFromWMM 0;
VAL_ 816 BMXSDrvTq2VDMTqVDMCtrlMode 0 "Boolean_FALSE" 1 "Boolean_TRUE";
VAL_ 816 BMXSDrvTq2VDMTqVDMQf 0 "GenQf1_UndefindDataAccur" 1 "GenQf1_TmpUndefdData" 2 "GenQf1_DataAccurNotWithinSpcn" 3 "GenQf1_AccurData";
VAL_ 816 VFCVectorSMBLVFCid0 0 "VFCOnOff_Off" 1 "VFCOnOff_On";
VAL_ 816 VFCVectorSMBLVFCid1 0 "VFCOnOff_Off" 1 "VFCOnOff_On";
VAL_ 816 VFCVectorSMBLVFCid10 0 "VFCOnOff_Off" 1 "VFCOnOff_On";
VAL_ 816 VFCVectorSMBLVFCid11 0 "VFCOnOff_Off" 1 "VFCOnOff_On";
VAL_ 816 VFCVectorSMBLVFCid12 0 "VFCOnOff_Off" 1 "VFCOnOff_On";
VAL_ 816 VFCVectorSMBLVFCid13 0 "VFCOnOff_Off" 1 "VFCOnOff_On";
VAL_ 816 VFCVectorSMBLVFCid14 0 "VFCOnOff_Off" 1 "VFCOnOff_On";
VAL_ 816 VFCVectorSMBLVFCid15 0 "VFCOnOff_Off" 1 "VFCOnOff_On";
VAL_ 816 VFCVectorSMBLVFCid16 0 "VFCOnOff_Off" 1 "VFCOnOff_On";
VAL_ 816 VFCVectorSMBLVFCid17 0 "VFCOnOff_Off" 1 "VFCOnOff_On";
VAL_ 816 VFCVectorSMBLVFCid18 0 "VFCOnOff_Off" 1 "VFCOnOff_On";
VAL_ 816 VFCVectorSMBLVFCid19 0 "VFCOnOff_Off" 1 "VFCOnOff_On";
VAL_ 816 VFCVectorSMBLVFCid2 0 "VFCOnOff_Off" 1 "VFCOnOff_On";
VAL_ 816 VFCVectorSMBLVFCid20 0 "VFCOnOff_Off" 1 "VFCOnOff_On";
VAL_ 816 VFCVectorSMBLVFCid21 0 "VFCOnOff_Off" 1 "VFCOnOff_On";
VAL_ 816 VFCVectorSMBLVFCid22 0 "VFCOnOff_Off" 1 "VFCOnOff_On";
VAL_ 816 VFCVectorSMBLVFCid23 0 "VFCOnOff_Off" 1 "VFCOnOff_On";
VAL_ 816 VFCVectorSMBLVFCid24 0 "VFCOnOff_Off" 1 "VFCOnOff_On";
VAL_ 816 VFCVectorSMBLVFCid25 0 "VFCOnOff_Off" 1 "VFCOnOff_On";
VAL_ 816 VFCVectorSMBLVFCid26 0 "VFCOnOff_Off" 1 "VFCOnOff_On";
VAL_ 816 VFCVectorSMBLVFCid27 0 "VFCOnOff_Off" 1 "VFCOnOff_On";
VAL_ 816 VFCVectorSMBLVFCid28 0 "VFCOnOff_Off" 1 "VFCOnOff_On";
VAL_ 816 VFCVectorSMBLVFCid29 0 "VFCOnOff_Off" 1 "VFCOnOff_On";
VAL_ 816 VFCVectorSMBLVFCid3 0 "VFCOnOff_Off" 1 "VFCOnOff_On";
VAL_ 816 VFCVectorSMBLVFCid30 0 "VFCOnOff_Off" 1 "VFCOnOff_On";
VAL_ 816 VFCVectorSMBLVFCid31 0 "VFCOnOff_Off" 1 "VFCOnOff_On";
VAL_ 816 VFCVectorSMBLVFCid32 0 "VFCOnOff_Off" 1 "VFCOnOff_On";
VAL_ 816 VFCVectorSMBLVFCid33 0 "VFCOnOff_Off" 1 "VFCOnOff_On";
VAL_ 816 VFCVectorSMBLVFCid34 0 "VFCOnOff_Off" 1 "VFCOnOff_On";
VAL_ 816 VFCVectorSMBLVFCid35 0 "VFCOnOff_Off" 1 "VFCOnOff_On";
VAL_ 816 VFCVectorSMBLVFCid36 0 "VFCOnOff_Off" 1 "VFCOnOff_On";
VAL_ 816 VFCVectorSMBLVFCid37 0 "VFCOnOff_Off" 1 "VFCOnOff_On";
VAL_ 816 VFCVectorSMBLVFCid38 0 "VFCOnOff_Off" 1 "VFCOnOff_On";
VAL_ 816 VFCVectorSMBLVFCid39 0 "VFCOnOff_Off" 1 "VFCOnOff_On";
VAL_ 816 VFCVectorSMBLVFCid4 0 "VFCOnOff_Off" 1 "VFCOnOff_On";
VAL_ 816 VFCVectorSMBLVFCid40 0 "VFCOnOff_Off" 1 "VFCOnOff_On";
VAL_ 816 VFCVectorSMBLVFCid41 0 "VFCOnOff_Off" 1 "VFCOnOff_On";
VAL_ 816 VFCVectorSMBLVFCid42 0 "VFCOnOff_Off" 1 "VFCOnOff_On";
VAL_ 816 VFCVectorSMBLVFCid43 0 "VFCOnOff_Off" 1 "VFCOnOff_On";
VAL_ 816 VFCVectorSMBLVFCid44 0 "VFCOnOff_Off" 1 "VFCOnOff_On";
VAL_ 816 VFCVectorSMBLVFCid45 0 "VFCOnOff_Off" 1 "VFCOnOff_On";
VAL_ 816 VFCVectorSMBLVFCid46 0 "VFCOnOff_Off" 1 "VFCOnOff_On";
VAL_ 816 VFCVectorSMBLVFCid47 0 "VFCOnOff_Off" 1 "VFCOnOff_On";
VAL_ 816 VFCVectorSMBLVFCid48 0 "VFCOnOff_Off" 1 "VFCOnOff_On";
VAL_ 816 VFCVectorSMBLVFCid49 0 "VFCOnOff_Off" 1 "VFCOnOff_On";
VAL_ 816 VFCVectorSMBLVFCid5 0 "VFCOnOff_Off" 1 "VFCOnOff_On";
VAL_ 816 VFCVectorSMBLVFCid50 0 "VFCOnOff_Off" 1 "VFCOnOff_On";
VAL_ 816 VFCVectorSMBLVFCid51 0 "VFCOnOff_Off" 1 "VFCOnOff_On";
VAL_ 816 VFCVectorSMBLVFCid52 0 "VFCOnOff_Off" 1 "VFCOnOff_On";
VAL_ 816 VFCVectorSMBLVFCid53 0 "VFCOnOff_Off" 1 "VFCOnOff_On";
VAL_ 816 VFCVectorSMBLVFCid54 0 "VFCOnOff_Off" 1 "VFCOnOff_On";
VAL_ 816 VFCVectorSMBLVFCid55 0 "VFCOnOff_Off" 1 "VFCOnOff_On";
VAL_ 816 VFCVectorSMBLVFCid56 0 "VFCOnOff_Off" 1 "VFCOnOff_On";
VAL_ 816 VFCVectorSMBLVFCid57 0 "VFCOnOff_Off" 1 "VFCOnOff_On";
VAL_ 816 VFCVectorSMBLVFCid58 0 "VFCOnOff_Off" 1 "VFCOnOff_On";
VAL_ 816 VFCVectorSMBLVFCid59 0 "VFCOnOff_Off" 1 "VFCOnOff_On";
VAL_ 816 VFCVectorSMBLVFCid6 0 "VFCOnOff_Off" 1 "VFCOnOff_On";
VAL_ 816 VFCVectorSMBLVFCid60 0 "VFCOnOff_Off" 1 "VFCOnOff_On";
VAL_ 816 VFCVectorSMBLVFCid61 0 "VFCOnOff_Off" 1 "VFCOnOff_On";
VAL_ 816 VFCVectorSMBLVFCid7 0 "VFCOnOff_Off" 1 "VFCOnOff_On";
VAL_ 816 VFCVectorSMBLVFCid8 0 "VFCOnOff_Off" 1 "VFCOnOff_On";
VAL_ 816 VFCVectorSMBLVFCid9 0 "VFCOnOff_Off" 1 "VFCOnOff_On";
VAL_ 816 VFCVectorSMBRVFCid0 0 "VFCOnOff_Off" 1 "VFCOnOff_On";
VAL_ 816 VFCVectorSMBRVFCid1 0 "VFCOnOff_Off" 1 "VFCOnOff_On";
VAL_ 816 VFCVectorSMBRVFCid10 0 "VFCOnOff_Off" 1 "VFCOnOff_On";
VAL_ 816 VFCVectorSMBRVFCid11 0 "VFCOnOff_Off" 1 "VFCOnOff_On";
VAL_ 816 VFCVectorSMBRVFCid12 0 "VFCOnOff_Off" 1 "VFCOnOff_On";
VAL_ 816 VFCVectorSMBRVFCid13 0 "VFCOnOff_Off" 1 "VFCOnOff_On";
VAL_ 816 VFCVectorSMBRVFCid14 0 "VFCOnOff_Off" 1 "VFCOnOff_On";
VAL_ 816 VFCVectorSMBRVFCid15 0 "VFCOnOff_Off" 1 "VFCOnOff_On";
VAL_ 816 VFCVectorSMBRVFCid16 0 "VFCOnOff_Off" 1 "VFCOnOff_On";
VAL_ 816 VFCVectorSMBRVFCid17 0 "VFCOnOff_Off" 1 "VFCOnOff_On";
VAL_ 816 VFCVectorSMBRVFCid18 0 "VFCOnOff_Off" 1 "VFCOnOff_On";
VAL_ 816 VFCVectorSMBRVFCid19 0 "VFCOnOff_Off" 1 "VFCOnOff_On";
VAL_ 816 VFCVectorSMBRVFCid2 0 "VFCOnOff_Off" 1 "VFCOnOff_On";
VAL_ 816 VFCVectorSMBRVFCid20 0 "VFCOnOff_Off" 1 "VFCOnOff_On";
VAL_ 816 VFCVectorSMBRVFCid21 0 "VFCOnOff_Off" 1 "VFCOnOff_On";
VAL_ 816 VFCVectorSMBRVFCid22 0 "VFCOnOff_Off" 1 "VFCOnOff_On";
VAL_ 816 VFCVectorSMBRVFCid23 0 "VFCOnOff_Off" 1 "VFCOnOff_On";
VAL_ 816 VFCVectorSMBRVFCid24 0 "VFCOnOff_Off" 1 "VFCOnOff_On";
VAL_ 816 VFCVectorSMBRVFCid25 0 "VFCOnOff_Off" 1 "VFCOnOff_On";
VAL_ 816 VFCVectorSMBRVFCid26 0 "VFCOnOff_Off" 1 "VFCOnOff_On";
VAL_ 816 VFCVectorSMBRVFCid27 0 "VFCOnOff_Off" 1 "VFCOnOff_On";
VAL_ 816 VFCVectorSMBRVFCid28 0 "VFCOnOff_Off" 1 "VFCOnOff_On";
VAL_ 816 VFCVectorSMBRVFCid29 0 "VFCOnOff_Off" 1 "VFCOnOff_On";
VAL_ 816 VFCVectorSMBRVFCid3 0 "VFCOnOff_Off" 1 "VFCOnOff_On";
VAL_ 816 VFCVectorSMBRVFCid30 0 "VFCOnOff_Off" 1 "VFCOnOff_On";
VAL_ 816 VFCVectorSMBRVFCid31 0 "VFCOnOff_Off" 1 "VFCOnOff_On";
VAL_ 816 VFCVectorSMBRVFCid32 0 "VFCOnOff_Off" 1 "VFCOnOff_On";
VAL_ 816 VFCVectorSMBRVFCid33 0 "VFCOnOff_Off" 1 "VFCOnOff_On";
VAL_ 816 VFCVectorSMBRVFCid34 0 "VFCOnOff_Off" 1 "VFCOnOff_On";
VAL_ 816 VFCVectorSMBRVFCid35 0 "VFCOnOff_Off" 1 "VFCOnOff_On";
VAL_ 816 VFCVectorSMBRVFCid36 0 "VFCOnOff_Off" 1 "VFCOnOff_On";
VAL_ 816 VFCVectorSMBRVFCid37 0 "VFCOnOff_Off" 1 "VFCOnOff_On";
VAL_ 816 VFCVectorSMBRVFCid38 0 "VFCOnOff_Off" 1 "VFCOnOff_On";
VAL_ 816 VFCVectorSMBRVFCid39 0 "VFCOnOff_Off" 1 "VFCOnOff_On";
VAL_ 816 VFCVectorSMBRVFCid4 0 "VFCOnOff_Off" 1 "VFCOnOff_On";
VAL_ 816 VFCVectorSMBRVFCid40 0 "VFCOnOff_Off" 1 "VFCOnOff_On";
VAL_ 816 VFCVectorSMBRVFCid41 0 "VFCOnOff_Off" 1 "VFCOnOff_On";
VAL_ 816 VFCVectorSMBRVFCid42 0 "VFCOnOff_Off" 1 "VFCOnOff_On";
VAL_ 816 VFCVectorSMBRVFCid43 0 "VFCOnOff_Off" 1 "VFCOnOff_On";
VAL_ 816 VFCVectorSMBRVFCid44 0 "VFCOnOff_Off" 1 "VFCOnOff_On";
VAL_ 816 VFCVectorSMBRVFCid45 0 "VFCOnOff_Off" 1 "VFCOnOff_On";
VAL_ 816 VFCVectorSMBRVFCid46 0 "VFCOnOff_Off" 1 "VFCOnOff_On";
VAL_ 816 VFCVectorSMBRVFCid47 0 "VFCOnOff_Off" 1 "VFCOnOff_On";
VAL_ 816 VFCVectorSMBRVFCid48 0 "VFCOnOff_Off" 1 "VFCOnOff_On";
VAL_ 816 VFCVectorSMBRVFCid49 0 "VFCOnOff_Off" 1 "VFCOnOff_On";
VAL_ 816 VFCVectorSMBRVFCid5 0 "VFCOnOff_Off" 1 "VFCOnOff_On";
VAL_ 816 VFCVectorSMBRVFCid50 0 "VFCOnOff_Off" 1 "VFCOnOff_On";
VAL_ 816 VFCVectorSMBRVFCid51 0 "VFCOnOff_Off" 1 "VFCOnOff_On";
VAL_ 816 VFCVectorSMBRVFCid52 0 "VFCOnOff_Off" 1 "VFCOnOff_On";
VAL_ 816 VFCVectorSMBRVFCid53 0 "VFCOnOff_Off" 1 "VFCOnOff_On";
VAL_ 816 VFCVectorSMBRVFCid54 0 "VFCOnOff_Off" 1 "VFCOnOff_On";
VAL_ 816 VFCVectorSMBRVFCid55 0 "VFCOnOff_Off" 1 "VFCOnOff_On";
VAL_ 816 VFCVectorSMBRVFCid56 0 "VFCOnOff_Off" 1 "VFCOnOff_On";
VAL_ 816 VFCVectorSMBRVFCid57 0 "VFCOnOff_Off" 1 "VFCOnOff_On";
VAL_ 816 VFCVectorSMBRVFCid58 0 "VFCOnOff_Off" 1 "VFCOnOff_On";
VAL_ 816 VFCVectorSMBRVFCid59 0 "VFCOnOff_Off" 1 "VFCOnOff_On";
VAL_ 816 VFCVectorSMBRVFCid6 0 "VFCOnOff_Off" 1 "VFCOnOff_On";
VAL_ 816 VFCVectorSMBRVFCid60 0 "VFCOnOff_Off" 1 "VFCOnOff_On";
VAL_ 816 VFCVectorSMBRVFCid61 0 "VFCOnOff_Off" 1 "VFCOnOff_On";
VAL_ 816 VFCVectorSMBRVFCid7 0 "VFCOnOff_Off" 1 "VFCOnOff_On";
VAL_ 816 VFCVectorSMBRVFCid8 0 "VFCOnOff_Off" 1 "VFCOnOff_On";
VAL_ 816 VFCVectorSMBRVFCid9 0 "VFCOnOff_Off" 1 "VFCOnOff_On";
VAL_ 816 VFCVectorSMBVFCid0 0 "VFCOnOff_Off" 1 "VFCOnOff_On";
VAL_ 816 VFCVectorSMBVFCid1 0 "VFCOnOff_Off" 1 "VFCOnOff_On";
VAL_ 816 VFCVectorSMBVFCid10 0 "VFCOnOff_Off" 1 "VFCOnOff_On";
VAL_ 816 VFCVectorSMBVFCid11 0 "VFCOnOff_Off" 1 "VFCOnOff_On";
VAL_ 816 VFCVectorSMBVFCid12 0 "VFCOnOff_Off" 1 "VFCOnOff_On";
VAL_ 816 VFCVectorSMBVFCid13 0 "VFCOnOff_Off" 1 "VFCOnOff_On";
VAL_ 816 VFCVectorSMBVFCid14 0 "VFCOnOff_Off" 1 "VFCOnOff_On";
VAL_ 816 VFCVectorSMBVFCid15 0 "VFCOnOff_Off" 1 "VFCOnOff_On";
VAL_ 816 VFCVectorSMBVFCid16 0 "VFCOnOff_Off" 1 "VFCOnOff_On";
VAL_ 816 VFCVectorSMBVFCid17 0 "VFCOnOff_Off" 1 "VFCOnOff_On";
VAL_ 816 VFCVectorSMBVFCid18 0 "VFCOnOff_Off" 1 "VFCOnOff_On";
VAL_ 816 VFCVectorSMBVFCid19 0 "VFCOnOff_Off" 1 "VFCOnOff_On";
VAL_ 816 VFCVectorSMBVFCid2 0 "VFCOnOff_Off" 1 "VFCOnOff_On";
VAL_ 816 VFCVectorSMBVFCid20 0 "VFCOnOff_Off" 1 "VFCOnOff_On";
VAL_ 816 VFCVectorSMBVFCid21 0 "VFCOnOff_Off" 1 "VFCOnOff_On";
VAL_ 816 VFCVectorSMBVFCid22 0 "VFCOnOff_Off" 1 "VFCOnOff_On";
VAL_ 816 VFCVectorSMBVFCid23 0 "VFCOnOff_Off" 1 "VFCOnOff_On";
VAL_ 816 VFCVectorSMBVFCid24 0 "VFCOnOff_Off" 1 "VFCOnOff_On";
VAL_ 816 VFCVectorSMBVFCid25 0 "VFCOnOff_Off" 1 "VFCOnOff_On";
VAL_ 816 VFCVectorSMBVFCid26 0 "VFCOnOff_Off" 1 "VFCOnOff_On";
VAL_ 816 VFCVectorSMBVFCid27 0 "VFCOnOff_Off" 1 "VFCOnOff_On";
VAL_ 816 VFCVectorSMBVFCid28 0 "VFCOnOff_Off" 1 "VFCOnOff_On";
VAL_ 816 VFCVectorSMBVFCid29 0 "VFCOnOff_Off" 1 "VFCOnOff_On";
VAL_ 816 VFCVectorSMBVFCid3 0 "VFCOnOff_Off" 1 "VFCOnOff_On";
VAL_ 816 VFCVectorSMBVFCid30 0 "VFCOnOff_Off" 1 "VFCOnOff_On";
VAL_ 816 VFCVectorSMBVFCid31 0 "VFCOnOff_Off" 1 "VFCOnOff_On";
VAL_ 816 VFCVectorSMBVFCid32 0 "VFCOnOff_Off" 1 "VFCOnOff_On";
VAL_ 816 VFCVectorSMBVFCid33 0 "VFCOnOff_Off" 1 "VFCOnOff_On";
VAL_ 816 VFCVectorSMBVFCid34 0 "VFCOnOff_Off" 1 "VFCOnOff_On";
VAL_ 816 VFCVectorSMBVFCid35 0 "VFCOnOff_Off" 1 "VFCOnOff_On";
VAL_ 816 VFCVectorSMBVFCid36 0 "VFCOnOff_Off" 1 "VFCOnOff_On";
VAL_ 816 VFCVectorSMBVFCid37 0 "VFCOnOff_Off" 1 "VFCOnOff_On";
VAL_ 816 VFCVectorSMBVFCid38 0 "VFCOnOff_Off" 1 "VFCOnOff_On";
VAL_ 816 VFCVectorSMBVFCid39 0 "VFCOnOff_Off" 1 "VFCOnOff_On";
VAL_ 816 VFCVectorSMBVFCid4 0 "VFCOnOff_Off" 1 "VFCOnOff_On";
VAL_ 816 VFCVectorSMBVFCid40 0 "VFCOnOff_Off" 1 "VFCOnOff_On";
VAL_ 816 VFCVectorSMBVFCid41 0 "VFCOnOff_Off" 1 "VFCOnOff_On";
VAL_ 816 VFCVectorSMBVFCid42 0 "VFCOnOff_Off" 1 "VFCOnOff_On";
VAL_ 816 VFCVectorSMBVFCid43 0 "VFCOnOff_Off" 1 "VFCOnOff_On";
VAL_ 816 VFCVectorSMBVFCid44 0 "VFCOnOff_Off" 1 "VFCOnOff_On";
VAL_ 816 VFCVectorSMBVFCid45 0 "VFCOnOff_Off" 1 "VFCOnOff_On";
VAL_ 816 VFCVectorSMBVFCid46 0 "VFCOnOff_Off" 1 "VFCOnOff_On";
VAL_ 816 VFCVectorSMBVFCid47 0 "VFCOnOff_Off" 1 "VFCOnOff_On";
VAL_ 816 VFCVectorSMBVFCid48 0 "VFCOnOff_Off" 1 "VFCOnOff_On";
VAL_ 816 VFCVectorSMBVFCid49 0 "VFCOnOff_Off" 1 "VFCOnOff_On";
VAL_ 816 VFCVectorSMBVFCid5 0 "VFCOnOff_Off" 1 "VFCOnOff_On";
VAL_ 816 VFCVectorSMBVFCid50 0 "VFCOnOff_Off" 1 "VFCOnOff_On";
VAL_ 816 VFCVectorSMBVFCid51 0 "VFCOnOff_Off" 1 "VFCOnOff_On";
VAL_ 816 VFCVectorSMBVFCid52 0 "VFCOnOff_Off" 1 "VFCOnOff_On";
VAL_ 816 VFCVectorSMBVFCid53 0 "VFCOnOff_Off" 1 "VFCOnOff_On";
VAL_ 816 VFCVectorSMBVFCid54 0 "VFCOnOff_Off" 1 "VFCOnOff_On";
VAL_ 816 VFCVectorSMBVFCid55 0 "VFCOnOff_Off" 1 "VFCOnOff_On";
VAL_ 816 VFCVectorSMBVFCid56 0 "VFCOnOff_Off" 1 "VFCOnOff_On";
VAL_ 816 VFCVectorSMBVFCid57 0 "VFCOnOff_Off" 1 "VFCOnOff_On";
VAL_ 816 VFCVectorSMBVFCid58 0 "VFCOnOff_Off" 1 "VFCOnOff_On";
VAL_ 816 VFCVectorSMBVFCid59 0 "VFCOnOff_Off" 1 "VFCOnOff_On";
VAL_ 816 VFCVectorSMBVFCid6 0 "VFCOnOff_Off" 1 "VFCOnOff_On";
VAL_ 816 VFCVectorSMBVFCid60 0 "VFCOnOff_Off" 1 "VFCOnOff_On";
VAL_ 816 VFCVectorSMBVFCid61 0 "VFCOnOff_Off" 1 "VFCOnOff_On";
VAL_ 816 VFCVectorSMBVFCid7 0 "VFCOnOff_Off" 1 "VFCOnOff_On";
VAL_ 816 VFCVectorSMBVFCid8 0 "VFCOnOff_Off" 1 "VFCOnOff_On";
VAL_ 816 VFCVectorSMBVFCid9 0 "VFCOnOff_Off" 1 "VFCOnOff_On";
VAL_ 816 VFCVectorTRMVFCid0 0 "VFCOnOff_Off" 1 "VFCOnOff_On";
VAL_ 816 VFCVectorTRMVFCid1 0 "VFCOnOff_Off" 1 "VFCOnOff_On";
VAL_ 816 VFCVectorTRMVFCid10 0 "VFCOnOff_Off" 1 "VFCOnOff_On";
VAL_ 816 VFCVectorTRMVFCid11 0 "VFCOnOff_Off" 1 "VFCOnOff_On";
VAL_ 816 VFCVectorTRMVFCid12 0 "VFCOnOff_Off" 1 "VFCOnOff_On";
VAL_ 816 VFCVectorTRMVFCid13 0 "VFCOnOff_Off" 1 "VFCOnOff_On";
VAL_ 816 VFCVectorTRMVFCid14 0 "VFCOnOff_Off" 1 "VFCOnOff_On";
VAL_ 816 VFCVectorTRMVFCid15 0 "VFCOnOff_Off" 1 "VFCOnOff_On";
VAL_ 816 VFCVectorTRMVFCid16 0 "VFCOnOff_Off" 1 "VFCOnOff_On";
VAL_ 816 VFCVectorTRMVFCid17 0 "VFCOnOff_Off" 1 "VFCOnOff_On";
VAL_ 816 VFCVectorTRMVFCid18 0 "VFCOnOff_Off" 1 "VFCOnOff_On";
VAL_ 816 VFCVectorTRMVFCid19 0 "VFCOnOff_Off" 1 "VFCOnOff_On";
VAL_ 816 VFCVectorTRMVFCid2 0 "VFCOnOff_Off" 1 "VFCOnOff_On";
VAL_ 816 VFCVectorTRMVFCid20 0 "VFCOnOff_Off" 1 "VFCOnOff_On";
VAL_ 816 VFCVectorTRMVFCid21 0 "VFCOnOff_Off" 1 "VFCOnOff_On";
VAL_ 816 VFCVectorTRMVFCid22 0 "VFCOnOff_Off" 1 "VFCOnOff_On";
VAL_ 816 VFCVectorTRMVFCid23 0 "VFCOnOff_Off" 1 "VFCOnOff_On";
VAL_ 816 VFCVectorTRMVFCid24 0 "VFCOnOff_Off" 1 "VFCOnOff_On";
VAL_ 816 VFCVectorTRMVFCid25 0 "VFCOnOff_Off" 1 "VFCOnOff_On";
VAL_ 816 VFCVectorTRMVFCid26 0 "VFCOnOff_Off" 1 "VFCOnOff_On";
VAL_ 816 VFCVectorTRMVFCid27 0 "VFCOnOff_Off" 1 "VFCOnOff_On";
VAL_ 816 VFCVectorTRMVFCid28 0 "VFCOnOff_Off" 1 "VFCOnOff_On";
VAL_ 816 VFCVectorTRMVFCid29 0 "VFCOnOff_Off" 1 "VFCOnOff_On";
VAL_ 816 VFCVectorTRMVFCid3 0 "VFCOnOff_Off" 1 "VFCOnOff_On";
VAL_ 816 VFCVectorTRMVFCid30 0 "VFCOnOff_Off" 1 "VFCOnOff_On";
VAL_ 816 VFCVectorTRMVFCid31 0 "VFCOnOff_Off" 1 "VFCOnOff_On";
VAL_ 816 VFCVectorTRMVFCid32 0 "VFCOnOff_Off" 1 "VFCOnOff_On";
VAL_ 816 VFCVectorTRMVFCid33 0 "VFCOnOff_Off" 1 "VFCOnOff_On";
VAL_ 816 VFCVectorTRMVFCid34 0 "VFCOnOff_Off" 1 "VFCOnOff_On";
VAL_ 816 VFCVectorTRMVFCid35 0 "VFCOnOff_Off" 1 "VFCOnOff_On";
VAL_ 816 VFCVectorTRMVFCid36 0 "VFCOnOff_Off" 1 "VFCOnOff_On";
VAL_ 816 VFCVectorTRMVFCid37 0 "VFCOnOff_Off" 1 "VFCOnOff_On";
VAL_ 816 VFCVectorTRMVFCid38 0 "VFCOnOff_Off" 1 "VFCOnOff_On";
VAL_ 816 VFCVectorTRMVFCid39 0 "VFCOnOff_Off" 1 "VFCOnOff_On";
VAL_ 816 VFCVectorTRMVFCid4 0 "VFCOnOff_Off" 1 "VFCOnOff_On";
VAL_ 816 VFCVectorTRMVFCid40 0 "VFCOnOff_Off" 1 "VFCOnOff_On";
VAL_ 816 VFCVectorTRMVFCid41 0 "VFCOnOff_Off" 1 "VFCOnOff_On";
VAL_ 816 VFCVectorTRMVFCid42 0 "VFCOnOff_Off" 1 "VFCOnOff_On";
VAL_ 816 VFCVectorTRMVFCid43 0 "VFCOnOff_Off" 1 "VFCOnOff_On";
VAL_ 816 VFCVectorTRMVFCid44 0 "VFCOnOff_Off" 1 "VFCOnOff_On";
VAL_ 816 VFCVectorTRMVFCid45 0 "VFCOnOff_Off" 1 "VFCOnOff_On";
VAL_ 816 VFCVectorTRMVFCid46 0 "VFCOnOff_Off" 1 "VFCOnOff_On";
VAL_ 816 VFCVectorTRMVFCid47 0 "VFCOnOff_Off" 1 "VFCOnOff_On";
VAL_ 816 VFCVectorTRMVFCid48 0 "VFCOnOff_Off" 1 "VFCOnOff_On";
VAL_ 816 VFCVectorTRMVFCid49 0 "VFCOnOff_Off" 1 "VFCOnOff_On";
VAL_ 816 VFCVectorTRMVFCid5 0 "VFCOnOff_Off" 1 "VFCOnOff_On";
VAL_ 816 VFCVectorTRMVFCid50 0 "VFCOnOff_Off" 1 "VFCOnOff_On";
VAL_ 816 VFCVectorTRMVFCid51 0 "VFCOnOff_Off" 1 "VFCOnOff_On";
VAL_ 816 VFCVectorTRMVFCid52 0 "VFCOnOff_Off" 1 "VFCOnOff_On";
VAL_ 816 VFCVectorTRMVFCid53 0 "VFCOnOff_Off" 1 "VFCOnOff_On";
VAL_ 816 VFCVectorTRMVFCid54 0 "VFCOnOff_Off" 1 "VFCOnOff_On";
VAL_ 816 VFCVectorTRMVFCid55 0 "VFCOnOff_Off" 1 "VFCOnOff_On";
VAL_ 816 VFCVectorTRMVFCid56 0 "VFCOnOff_Off" 1 "VFCOnOff_On";
VAL_ 816 VFCVectorTRMVFCid57 0 "VFCOnOff_Off" 1 "VFCOnOff_On";
VAL_ 816 VFCVectorTRMVFCid58 0 "VFCOnOff_Off" 1 "VFCOnOff_On";
VAL_ 816 VFCVectorTRMVFCid59 0 "VFCOnOff_Off" 1 "VFCOnOff_On";
VAL_ 816 VFCVectorTRMVFCid6 0 "VFCOnOff_Off" 1 "VFCOnOff_On";
VAL_ 816 VFCVectorTRMVFCid60 0 "VFCOnOff_Off" 1 "VFCOnOff_On";
VAL_ 816 VFCVectorTRMVFCid61 0 "VFCOnOff_Off" 1 "VFCOnOff_On";
VAL_ 816 VFCVectorTRMVFCid7 0 "VFCOnOff_Off" 1 "VFCOnOff_On";
VAL_ 816 VFCVectorTRMVFCid8 0 "VFCOnOff_Off" 1 "VFCOnOff_On";
VAL_ 816 VFCVectorTRMVFCid9 0 "VFCOnOff_Off" 1 "VFCOnOff_On";
VAL_ 832 VFCVectorSMPVFCid0 0 "VFCOnOff_Off" 1 "VFCOnOff_On";
VAL_ 832 VFCVectorSMPVFCid1 0 "VFCOnOff_Off" 1 "VFCOnOff_On";
VAL_ 832 VFCVectorSMPVFCid10 0 "VFCOnOff_Off" 1 "VFCOnOff_On";
VAL_ 832 VFCVectorSMPVFCid11 0 "VFCOnOff_Off" 1 "VFCOnOff_On";
VAL_ 832 VFCVectorSMPVFCid12 0 "VFCOnOff_Off" 1 "VFCOnOff_On";
VAL_ 832 VFCVectorSMPVFCid13 0 "VFCOnOff_Off" 1 "VFCOnOff_On";
VAL_ 832 VFCVectorSMPVFCid14 0 "VFCOnOff_Off" 1 "VFCOnOff_On";
VAL_ 832 VFCVectorSMPVFCid15 0 "VFCOnOff_Off" 1 "VFCOnOff_On";
VAL_ 832 VFCVectorSMPVFCid16 0 "VFCOnOff_Off" 1 "VFCOnOff_On";
VAL_ 832 VFCVectorSMPVFCid17 0 "VFCOnOff_Off" 1 "VFCOnOff_On";
VAL_ 832 VFCVectorSMPVFCid18 0 "VFCOnOff_Off" 1 "VFCOnOff_On";
VAL_ 832 VFCVectorSMPVFCid19 0 "VFCOnOff_Off" 1 "VFCOnOff_On";
VAL_ 832 VFCVectorSMPVFCid2 0 "VFCOnOff_Off" 1 "VFCOnOff_On";
VAL_ 832 VFCVectorSMPVFCid20 0 "VFCOnOff_Off" 1 "VFCOnOff_On";
VAL_ 832 VFCVectorSMPVFCid21 0 "VFCOnOff_Off" 1 "VFCOnOff_On";
VAL_ 832 VFCVectorSMPVFCid22 0 "VFCOnOff_Off" 1 "VFCOnOff_On";
VAL_ 832 VFCVectorSMPVFCid23 0 "VFCOnOff_Off" 1 "VFCOnOff_On";
VAL_ 832 VFCVectorSMPVFCid24 0 "VFCOnOff_Off" 1 "VFCOnOff_On";
VAL_ 832 VFCVectorSMPVFCid25 0 "VFCOnOff_Off" 1 "VFCOnOff_On";
VAL_ 832 VFCVectorSMPVFCid26 0 "VFCOnOff_Off" 1 "VFCOnOff_On";
VAL_ 832 VFCVectorSMPVFCid27 0 "VFCOnOff_Off" 1 "VFCOnOff_On";
VAL_ 832 VFCVectorSMPVFCid28 0 "VFCOnOff_Off" 1 "VFCOnOff_On";
VAL_ 832 VFCVectorSMPVFCid29 0 "VFCOnOff_Off" 1 "VFCOnOff_On";
VAL_ 832 VFCVectorSMPVFCid3 0 "VFCOnOff_Off" 1 "VFCOnOff_On";
VAL_ 832 VFCVectorSMPVFCid30 0 "VFCOnOff_Off" 1 "VFCOnOff_On";
VAL_ 832 VFCVectorSMPVFCid31 0 "VFCOnOff_Off" 1 "VFCOnOff_On";
VAL_ 832 VFCVectorSMPVFCid32 0 "VFCOnOff_Off" 1 "VFCOnOff_On";
VAL_ 832 VFCVectorSMPVFCid33 0 "VFCOnOff_Off" 1 "VFCOnOff_On";
VAL_ 832 VFCVectorSMPVFCid34 0 "VFCOnOff_Off" 1 "VFCOnOff_On";
VAL_ 832 VFCVectorSMPVFCid35 0 "VFCOnOff_Off" 1 "VFCOnOff_On";
VAL_ 832 VFCVectorSMPVFCid36 0 "VFCOnOff_Off" 1 "VFCOnOff_On";
VAL_ 832 VFCVectorSMPVFCid37 0 "VFCOnOff_Off" 1 "VFCOnOff_On";
VAL_ 832 VFCVectorSMPVFCid38 0 "VFCOnOff_Off" 1 "VFCOnOff_On";
VAL_ 832 VFCVectorSMPVFCid39 0 "VFCOnOff_Off" 1 "VFCOnOff_On";
VAL_ 832 VFCVectorSMPVFCid4 0 "VFCOnOff_Off" 1 "VFCOnOff_On";
VAL_ 832 VFCVectorSMPVFCid40 0 "VFCOnOff_Off" 1 "VFCOnOff_On";
VAL_ 832 VFCVectorSMPVFCid41 0 "VFCOnOff_Off" 1 "VFCOnOff_On";
VAL_ 832 VFCVectorSMPVFCid42 0 "VFCOnOff_Off" 1 "VFCOnOff_On";
VAL_ 832 VFCVectorSMPVFCid43 0 "VFCOnOff_Off" 1 "VFCOnOff_On";
VAL_ 832 VFCVectorSMPVFCid44 0 "VFCOnOff_Off" 1 "VFCOnOff_On";
VAL_ 832 VFCVectorSMPVFCid45 0 "VFCOnOff_Off" 1 "VFCOnOff_On";
VAL_ 832 VFCVectorSMPVFCid46 0 "VFCOnOff_Off" 1 "VFCOnOff_On";
VAL_ 832 VFCVectorSMPVFCid47 0 "VFCOnOff_Off" 1 "VFCOnOff_On";
VAL_ 832 VFCVectorSMPVFCid48 0 "VFCOnOff_Off" 1 "VFCOnOff_On";
VAL_ 832 VFCVectorSMPVFCid49 0 "VFCOnOff_Off" 1 "VFCOnOff_On";
VAL_ 832 VFCVectorSMPVFCid5 0 "VFCOnOff_Off" 1 "VFCOnOff_On";
VAL_ 832 VFCVectorSMPVFCid50 0 "VFCOnOff_Off" 1 "VFCOnOff_On";
VAL_ 832 VFCVectorSMPVFCid51 0 "VFCOnOff_Off" 1 "VFCOnOff_On";
VAL_ 832 VFCVectorSMPVFCid52 0 "VFCOnOff_Off" 1 "VFCOnOff_On";
VAL_ 832 VFCVectorSMPVFCid53 0 "VFCOnOff_Off" 1 "VFCOnOff_On";
VAL_ 832 VFCVectorSMPVFCid54 0 "VFCOnOff_Off" 1 "VFCOnOff_On";
VAL_ 832 VFCVectorSMPVFCid55 0 "VFCOnOff_Off" 1 "VFCOnOff_On";
VAL_ 832 VFCVectorSMPVFCid56 0 "VFCOnOff_Off" 1 "VFCOnOff_On";
VAL_ 832 VFCVectorSMPVFCid57 0 "VFCOnOff_Off" 1 "VFCOnOff_On";
VAL_ 832 VFCVectorSMPVFCid58 0 "VFCOnOff_Off" 1 "VFCOnOff_On";
VAL_ 832 VFCVectorSMPVFCid59 0 "VFCOnOff_Off" 1 "VFCOnOff_On";
VAL_ 832 VFCVectorSMPVFCid6 0 "VFCOnOff_Off" 1 "VFCOnOff_On";
VAL_ 832 VFCVectorSMPVFCid60 0 "VFCOnOff_Off" 1 "VFCOnOff_On";
VAL_ 832 VFCVectorSMPVFCid61 0 "VFCOnOff_Off" 1 "VFCOnOff_On";
VAL_ 832 VFCVectorSMPVFCid7 0 "VFCOnOff_Off" 1 "VFCOnOff_On";
VAL_ 832 VFCVectorSMPVFCid8 0 "VFCOnOff_Off" 1 "VFCOnOff_On";
VAL_ 832 VFCVectorSMPVFCid9 0 "VFCOnOff_Off" 1 "VFCOnOff_On";
VAL_ 920 ActnOfCenHiMntdStopLamp 0 "OnOff1_Off" 1 "OnOff1_On";
VAL_ 920 ActnOfCenHiMntdStopLamp1 0 "OnOff1_Off" 1 "OnOff1_On";
VAL_ 920 ActnOfDaytiRunngLampDrv 0 "OnOff1_Off" 1 "OnOff1_On";
VAL_ 920 ActnOfFrntFogLampDrv 0 "OnOff1_Off" 1 "OnOff1_On";
VAL_ 920 ActnOfFrntPosnLampDrv 0 "OnOff1_Off" 1 "OnOff1_On";
VAL_ 920 ActnOfFrntSideMkrLampDrv 0 "OnOff1_Off" 1 "OnOff1_On";
VAL_ 920 ActnOfFrntSideMkrLampPass 0 "OnOff1_Off" 1 "OnOff1_On";
VAL_ 920 ActnOfLedCornrgLampLe 0 "OnOff1_Off" 1 "OnOff1_On";
VAL_ 920 ActnOfLedCornrgLampRi 0 "OnOff1_Off" 1 "OnOff1_On";
VAL_ 920 ActnOfLedDaytiRunngLamp 0 "OnOff1_Off" 1 "OnOff1_On";
VAL_ 920 ActnOfLedFrntCrossLamp 0 "OnOff1_Off" 1 "OnOff1_On";
VAL_ 920 ActnOfLedFrntCrossLampDyn 0 "OnOff1_Off" 1 "OnOff1_On";
VAL_ 920 ActnOfLedFrntFogLamp 0 "OnOff1_Off" 1 "OnOff1_On";
VAL_ 920 ActnOfLedGrilleLamp 0 "OnOff1_Off" 1 "OnOff1_On";
VAL_ 920 ActnOfLedGrilleLampDyn 0 "OnOff1_Off" 1 "OnOff1_On";
VAL_ 920 ActnOfLedLeLogoLamp 0 "OnOff1_Off" 1 "OnOff1_On";
VAL_ 920 ActnOfLedPosnLampDyn 0 "OnOff1_Off" 1 "OnOff1_On";
VAL_ 920 ActnOfLedReFogLamp 0 "OnOff1_Off" 1 "OnOff1_On";
VAL_ 920 ActnOfLedRePosnLamp 0 "OnOff1_Off" 1 "OnOff1_On";
VAL_ 920 ActnOfLedRiLogoLamp 0 "OnOff1_Off" 1 "OnOff1_On";
VAL_ 920 ActnOfLedRiLogoLampDyn 0 "OnOff1_Off" 1 "OnOff1_On";
VAL_ 920 ActnOfLedRvsgLamp 0 "OnOff1_Off" 1 "OnOff1_On";
VAL_ 920 ActnOfReFogLampPass 0 "OnOff1_Off" 1 "OnOff1_On";
VAL_ 920 ActnOfRePosnLampDrv 0 "OnOff1_Off" 1 "OnOff1_On";
VAL_ 920 ActnOfReSideMkrLampDrv 0 "OnOff1_Off" 1 "OnOff1_On";
VAL_ 920 ActnOfReSideMkrLampPass 0 "OnOff1_Off" 1 "OnOff1_On";
VAL_ 920 ActnOfRvsgLampDrv 0 "OnOff1_Off" 1 "OnOff1_On";
VAL_ 920 ActvnOfAfs 0 "OnOff1_Off" 1 "OnOff1_On";
VAL_ 920 ActvnOfAhl 0 "OnOff1_Off" 1 "OnOff1_On";
VAL_ 920 ActvnOfAlrmReqFromCmplxIf 0 "OnOff1_Off" 1 "OnOff1_On";
VAL_ 920 ActvnOfBrkLi 0 "OnOff1_Off" 1 "OnOff1_On";
VAL_ 920 ActvnOfDbl 0 "OnOff1_Off" 1 "OnOff1_On";
VAL_ 920 ActvnOfDefrstFrnt 0 "OnOff1_Off" 1 "OnOff1_On";
VAL_ 920 ActvnOfDefrstRe 0 "OnOff1_Off" 1 "OnOff1_On";
VAL_ 920 ActvnOfDoorSwtIllmn 0 "Boolean_FALSE" 1 "Boolean_TRUE";
VAL_ 920 ActvnOfHndlDoorLiHndlDoorLiDrvr 0 "OnOff1_Off" 1 "OnOff1_On";
VAL_ 920 ActvnOfHndlDoorLiHndlDoorLiDrvrRe 0 "OnOff1_Off" 1 "OnOff1_On";
VAL_ 920 ActvnOfHndlDoorLiHndlDoorLiPass 0 "OnOff1_Off" 1 "OnOff1_On";
VAL_ 920 ActvnOfHndlDoorLiHndlDoorLiPassRe 0 "OnOff1_Off" 1 "OnOff1_On";
VAL_ 920 ActvnOfReLogoLamp1 0 "OnOff1_Off" 1 "OnOff1_On";
VAL_ 920 ActvnOfRoofSwtIllmn 0 "Boolean_FALSE" 1 "Boolean_TRUE";
VAL_ 920 ActvnOfTouristMod 0 "OnOff1_Off" 1 "OnOff1_On";
VAL_ 920 ActvnOfWshrFrntNotSafe 0 "OnOff1_Off" 1 "OnOff1_On";
VAL_ 920 ActvnOfWshrRe 0 "OnOff1_Off" 1 "OnOff1_On";
VAL_ 920 AlrmAcoustReq01 0 "AlrmAcoustReq_AlrmAcoustReqOff" 1 "AlrmAcoustReq_AlrmAcoustReq1";
VAL_ 920 AlrmToExtrLiFbVisReq 0 "LockActvn2_LockActvnOff" 1 "LockActvn2_LockActvnUnlck" 2 "LockActvn2_LockActvnLock" 3 "LockActvn2_LockActvnSafe" 4 "LockActvn2_LockActvnUnlckByCrash";
VAL_ 920 AlrmToExtrLiVisReq 0 "ExtrLiVisReq_ExtrLiVisReqAlrmOff" 1 "ExtrLiVisReq_ExtrLiVisReqAlrm1" 2 "ExtrLiVisReq_ExtrLiVisReqAlrm2";
VAL_ 920 AutWinWipgCmd 0 "WipgSpd2_WipgSpd0Rpm" 1 "WipgSpd2_WipgSpd40Rpm" 2 "WipgSpd2_WipgSpd43Rpm" 3 "WipgSpd2_WipgSpd46Rpm" 4 "WipgSpd2_WipgSpd50Rpm" 5 "WipgSpd2_WipgSpd54Rpm" 6 "WipgSpd2_WipgSpd57Rpm" 7 "WipgSpd2_WipgSpd60Rpm";
VAL_ 920 BswCha1NmState 0 "BswCANNmState_NotKnown" 1 "BswCANNmState_BusSleep" 2 "BswCANNmState_PrepareBusSleep" 3 "BswCANNmState_ReadySleep" 4 "BswCANNmState_NormalOperation" 5 "BswCANNmState_RepeatMessage" 6 "BswCANNmState_Reserved1" 7 "BswCANNmState_Reserved2";
VAL_ 920 BswChainNmState 0 "BswCANNmState_NotKnown" 1 "BswCANNmState_BusSleep" 2 "BswCANNmState_PrepareBusSleep" 3 "BswCANNmState_ReadySleep" 4 "BswCANNmState_NormalOperation" 5 "BswCANNmState_RepeatMessage" 6 "BswCANNmState_Reserved1" 7 "BswCANNmState_Reserved2";
VAL_ 920 BswPriNmState 0 "BswCANNmState_NotKnown" 1 "BswCANNmState_BusSleep" 2 "BswCANNmState_PrepareBusSleep" 3 "BswCANNmState_ReadySleep" 4 "BswCANNmState_NormalOperation" 5 "BswCANNmState_RepeatMessage" 6 "BswCANNmState_Reserved1" 7 "BswCANNmState_Reserved2";
VAL_ 920 BswPropNmState 0 "BswCANNmState_NotKnown" 1 "BswCANNmState_BusSleep" 2 "BswCANNmState_PrepareBusSleep" 3 "BswCANNmState_ReadySleep" 4 "BswCANNmState_NormalOperation" 5 "BswCANNmState_RepeatMessage" 6 "BswCANNmState_Reserved1" 7 "BswCANNmState_Reserved2";
VAL_ 920 BswWakeupSourceState 0 "BswWakeupSourceState_NoWakeup" 1 "BswWakeupSourceState_KL15" 2 "BswWakeupSourceState_PublicCAN" 3 "BswWakeupSourceState_RTC" 4 "BswWakeupSourceState_CEMHardware" 5 "BswWakeupSourceState_PrivateCAN" 6 "BswWakeupSourceState_Aplus" 7 "BswWakeupSourceState_Reserved";
VAL_ 920 DwnLoadStsFbOfHdlampLe 0 "Sts_Resd" 1 "Sts_Err" 2 "Sts_CmplOk" 3 "Sts_InProgs";
VAL_ 920 DwnLoadStsFbOfHdlampRi 0 "Sts_Resd" 1 "Sts_Err" 2 "Sts_CmplOk" 3 "Sts_InProgs";
VAL_ 920 DwnLoadStsFbOfLogoLampLe 0 "Sts_Resd" 1 "Sts_Err" 2 "Sts_CmplOk" 3 "Sts_InProgs";
VAL_ 920 DwnLoadStsFbOfLogoLampRi 0 "Sts_Resd" 1 "Sts_Err" 2 "Sts_CmplOk" 3 "Sts_InProgs";
VAL_ 920 ExtrLiShowActvnFrntLeFb 0 "Sts_Resd" 1 "Sts_Err" 2 "Sts_CmplOk" 3 "Sts_InProgs";
VAL_ 920 ExtrLiShowActvnFrntRiFb 0 "Sts_Resd" 1 "Sts_Err" 2 "Sts_CmplOk" 3 "Sts_InProgs";
VAL_ 920 ExtrLiShowActvnLeLogoFb 0 "Sts_Resd" 1 "Sts_Err" 2 "Sts_CmplOk" 3 "Sts_InProgs";
VAL_ 920 ExtrLiShowActvnRiLogoFb 0 "Sts_Resd" 1 "Sts_Err" 2 "Sts_CmplOk" 3 "Sts_InProgs";
VAL_ 920 HdlampLeInpSts1 0 "Boolean_FALSE" 1 "Boolean_TRUE";
VAL_ 920 HdlampLeInpSts2 0 "Boolean_FALSE" 1 "Boolean_TRUE";
VAL_ 920 HdlampRiInpSts1 0 "Boolean_FALSE" 1 "Boolean_TRUE";
VAL_ 920 HdlampRiInpSts2 0 "Boolean_FALSE" 1 "Boolean_TRUE";
VAL_ 920 ShortDropWinDrvrSts 0 "ShortDropSts_Idle" 1 "ShortDropSts_WindowDown" 2 "ShortDropSts_WindowClosed" 3 "ShortDropSts_NotUsed";
VAL_ 920 ShortDropWinReLeSts 0 "ShortDropSts_Idle" 1 "ShortDropSts_WindowDown" 2 "ShortDropSts_WindowClosed" 3 "ShortDropSts_NotUsed";
VAL_ 920 SnsrSoundrBattBackedStsArmSts 0 "ArmingTyp1_Disarmd" 1 "ArmingTyp1_Armd";
VAL_ 920 SnsrSoundrBattBackedStsCfgSts 0 "CfgSts_NotCfgd" 1 "CfgSts_InProgs" 2 "CfgSts_Rx" 3 "CfgSts_Cfgd";
VAL_ 920 SnsrSoundrBattBackedStsSnsrInclnExist 0 "Boolean_FALSE" 1 "Boolean_TRUE";
VAL_ 920 SnsrSoundrBattBackedStsSoundrBattBackedErrSts 0 "SnsrAlrmErrSts_NotTest" 1 "SnsrAlrmErrSts_Passd" 2 "SnsrAlrmErrSts_Faild";
VAL_ 920 SnsrSoundrBattBackedStsSoundSts 0 "OnOff1_Off" 1 "OnOff1_On";
VAL_ 920 StsOfAfsLe 0 "DevSts4_Off" 1 "DevSts4_On" 2 "DevSts4_Err" 3 "DevSts4_Resd";
VAL_ 920 StsOfAfsRi 0 "DevSts4_Off" 1 "DevSts4_On" 2 "DevSts4_Err" 3 "DevSts4_Resd";
VAL_ 920 StsOfAhbcLe 0 "DevSts4_Off" 1 "DevSts4_On" 2 "DevSts4_Err" 3 "DevSts4_Resd";
VAL_ 920 StsOfAhbcRi 0 "DevSts4_Off" 1 "DevSts4_On" 2 "DevSts4_Err" 3 "DevSts4_Resd";
VAL_ 920 StsOfFrntSideMkrLampLe2 0 "DevSts4_Off" 1 "DevSts4_On" 2 "DevSts4_Err" 3 "DevSts4_Resd";
VAL_ 920 StsOfFrntSideMkrLampRi2 0 "DevSts4_Off" 1 "DevSts4_On" 2 "DevSts4_Err" 3 "DevSts4_Resd";
VAL_ 920 StsOfLedCornrgLampLe 0 "DevSts4_Off" 1 "DevSts4_On" 2 "DevSts4_Err" 3 "DevSts4_Resd";
VAL_ 920 StsOfLedCornrgLampRi 0 "DevSts4_Off" 1 "DevSts4_On" 2 "DevSts4_Err" 3 "DevSts4_Resd";
VAL_ 920 StsOfLedDaytiRunngLampLe 0 "DevSts4_Off" 1 "DevSts4_On" 2 "DevSts4_Err" 3 "DevSts4_Resd";
VAL_ 920 StsOfLedDaytiRunngLampRi 0 "DevSts4_Off" 1 "DevSts4_On" 2 "DevSts4_Err" 3 "DevSts4_Resd";
VAL_ 920 StsOfLedFrntFogLampLe 0 "DevSts4_Off" 1 "DevSts4_On" 2 "DevSts4_Err" 3 "DevSts4_Resd";
VAL_ 920 StsOfLedFrntFogLampRi 0 "DevSts4_Off" 1 "DevSts4_On" 2 "DevSts4_Err" 3 "DevSts4_Resd";
VAL_ 920 StsOfLedFrntPosnLampLe 0 "DevSts4_Off" 1 "DevSts4_On" 2 "DevSts4_Err" 3 "DevSts4_Resd";
VAL_ 920 StsOfLedFrntPosnLampRi 0 "DevSts4_Off" 1 "DevSts4_On" 2 "DevSts4_Err" 3 "DevSts4_Resd";
VAL_ 920 StsOfLedFrntTurnIndcrLe 0 "DevSts4_Off" 1 "DevSts4_On" 2 "DevSts4_Err" 3 "DevSts4_Resd";
VAL_ 920 StsOfLedFrntTurnIndcrRi 0 "DevSts4_Off" 1 "DevSts4_On" 2 "DevSts4_Err" 3 "DevSts4_Resd";
VAL_ 920 StsOfLedLeLogoLamp 0 "DevSts4_Off" 1 "DevSts4_On" 2 "DevSts4_Err" 3 "DevSts4_Resd";
VAL_ 920 StsOfLedRiLogoLamp 0 "DevSts4_Off" 1 "DevSts4_On" 2 "DevSts4_Err" 3 "DevSts4_Resd";
VAL_ 920 StsOfLvlgLeStsOfLvlgLe 0 "DevSts4_Off" 1 "DevSts4_On" 2 "DevSts4_Err" 3 "DevSts4_Resd";
VAL_ 920 StsOfLvlgRiStsOfLvlgRi 0 "DevSts4_Off" 1 "DevSts4_On" 2 "DevSts4_Err" 3 "DevSts4_Resd";
VAL_ 920 StsOfTouristModLe 0 "DevSts4_Off" 1 "DevSts4_On" 2 "DevSts4_Err" 3 "DevSts4_Resd";
VAL_ 920 StsOfTouristModRi 0 "DevSts4_Off" 1 "DevSts4_On" 2 "DevSts4_Err" 3 "DevSts4_Resd";
VAL_ 920 StsOfWelGbyFrntLe 0 "OnOff1_Off" 1 "OnOff1_On";
VAL_ 920 StsOfWelGbyFrntRi 0 "OnOff1_Off" 1 "OnOff1_On";
VAL_ 920 SunRoofAndCurtBtnSts2Pos 0 "SunRoofAndCurtBtnStsTyp2_Idle" 1 "SunRoofAndCurtBtnStsTyp2_BackwStep1" 2 "SunRoofAndCurtBtnStsTyp2_BackwStep2" 3 "SunRoofAndCurtBtnStsTyp2_ForwStep1" 4 "SunRoofAndCurtBtnStsTyp2_ForwStep2" 5 "SunRoofAndCurtBtnStsTyp2_TiltUpStep1" 6 "SunRoofAndCurtBtnStsTyp2_TiltDwnStep1" 7 "SunRoofAndCurtBtnStsTyp2_Failr";
VAL_ 920 SunRoofImpctDetnSts2 0 "SunRoofAndCurtImpctDetnStsTyp_ImpctDetnDi" 1 "SunRoofAndCurtImpctDetnStsTyp_ImpctDetnEna" 2 "SunRoofAndCurtImpctDetnStsTyp_ClsPinch" 3 "SunRoofAndCurtImpctDetnStsTyp_ClsBlk" 4 "SunRoofAndCurtImpctDetnStsTyp_OpenPinch" 5 "SunRoofAndCurtImpctDetnStsTyp_OpenBlk";
VAL_ 920 TCSDoorSts 0 "OnOff1_Off" 1 "OnOff1_On";
VAL_ 920 WiprInPrkgPosnLoFromWMM 0 "OnOff1_Off" 1 "OnOff1_On";
VAL_ 920 WiprInWipgArFromWMM 0 "OnOff1_Off" 1 "OnOff1_On";
VAL_ 920 WiprMotDiagcWiprMotHiVoltDetd 0 "OnOffCrit1_NotVld1" 1 "OnOffCrit1_Off" 2 "OnOffCrit1_On" 3 "OnOffCrit1_NotVld2";
VAL_ 920 WiprMotDiagcWiprMotLoVoltDetd 0 "OnOffCrit1_NotVld1" 1 "OnOffCrit1_Off" 2 "OnOffCrit1_On" 3 "OnOffCrit1_NotVld2";
VAL_ 920 WiprMotDiagcWiprMotOvldDetd 0 "OnOffCrit1_NotVld1" 1 "OnOffCrit1_Off" 2 "OnOffCrit1_On" 3 "OnOffCrit1_NotVld2";
VAL_ 920 WiprMotErrSafe 0 "OnOffCrit1_NotVld1" 1 "OnOffCrit1_Off" 2 "OnOffCrit1_On" 3 "OnOffCrit1_NotVld2";
VAL_ 920 WshngCycActvFromWMM 0 "OnOff1_Off" 1 "OnOff1_On";
VAL_ 416 CnvnInhb 0 "InhibitSts_NotInhibited" 1 "InhibitSts_Inhibited";
VAL_ 416 CPSRClsReq 0 "OpenClose_Open" 1 "OpenClose_Close";
VAL_ 416 CPSRFbSt 0 "OpenClose_Open" 1 "OpenClose_Close";
VAL_ 416 EexvStsExvBlkErr 0 "Err1_NoErr" 1 "Err1_Err";
VAL_ 416 EexvStsExvCalibSts 0 "ExvCalibSts_NotInitialized" 1 "ExvCalibSts_InitializationInProcess" 2 "ExvCalibSts_Initialized" 3 "ExvCalibSts_Reserved";
VAL_ 416 EexvStsExvElecStsErr 0 "ExvElecStsErr_NoError" 1 "ExvElecStsErr_OpenCircuit" 2 "ExvElecStsErr_ShortCircuit" 3 "ExvElecStsErr_OverTemperatureShutdown" 4 "ExvElecStsErr_IndeterminateElectricFault" 5 "ExvElecStsErr_Reserved";
VAL_ 416 EexvStsExvMovSts 0 "ExvMovSts_NotMove" 1 "ExvMovSts_Moving";
VAL_ 416 EexvStsExvOvrTempErr 0 "Err1_NoErr" 1 "Err1_Err";
VAL_ 416 EexvStsExvOvrTrvlErr 0 "Err1_NoErr" 1 "Err1_Err";
VAL_ 416 EexvStsExvPreHeatgSts 0 "OnOff1_Off" 1 "OnOff1_On";
VAL_ 416 EexvStsExvVoltgRangErr 0 "VoltgRangErr_NoErr" 1 "VoltgRangErr_UnderVoltageErr" 2 "VoltgRangErr_OverVoltageErr" 3 "VoltgRangErr_Reserved";
VAL_ 416 ExvStsExvBlkErr 0 "Err1_NoErr" 1 "Err1_Err";
VAL_ 416 ExvStsExvCalibSts 0 "ExvCalibSts_NotInitialized" 1 "ExvCalibSts_InitializationInProcess" 2 "ExvCalibSts_Initialized" 3 "ExvCalibSts_Reserved";
VAL_ 416 ExvStsExvElecStsErr 0 "ExvElecStsErr_NoError" 1 "ExvElecStsErr_OpenCircuit" 2 "ExvElecStsErr_ShortCircuit" 3 "ExvElecStsErr_OverTemperatureShutdown" 4 "ExvElecStsErr_IndeterminateElectricFault" 5 "ExvElecStsErr_Reserved";
VAL_ 416 ExvStsExvMovSts 0 "ExvMovSts_NotMove" 1 "ExvMovSts_Moving";
VAL_ 416 ExvStsExvOvrTempErr 0 "Err1_NoErr" 1 "Err1_Err";
VAL_ 416 ExvStsExvOvrTrvlErr 0 "Err1_NoErr" 1 "Err1_Err";
VAL_ 416 ExvStsExvPreHeatgSts 0 "OnOff1_Off" 1 "OnOff1_On";
VAL_ 416 ExvStsExvVoltgRangErr 0 "VoltgRangErr_NoErr" 1 "VoltgRangErr_UnderVoltageErr" 2 "VoltgRangErr_OverVoltageErr" 3 "VoltgRangErr_Reserved";
VAL_ 416 HvchOnForBattHeatg 0 "OnOff1_Off" 1 "OnOff1_On";
VAL_ 416 LoTemEneStorage 0 "Boolean_FALSE" 1 "Boolean_TRUE";
VAL_ 422 EwpAflFlagCooling 0 "Boolean_FALSE" 1 "Boolean_TRUE";
VAL_ 422 HvActvReq 0 "HvCpsrOnOff_Off" 1 "HvCpsrOnOff_CpsrOn" 2 "HvCpsrOnOff_HvOn" 3 "HvCpsrOnOff_Error";
VAL_ 422 IsgCoolgReqInvrCloud 0 "HvCoolg1_NoRequestForMoreCoolantPower" 1 "HvCoolg1_IncreaseLevel1ForMoreCoolantPower" 2 "HvCoolg1_IncreaseLevel2ForMoreCoolantPower" 3 "HvCoolg1_MaxCoolingPower" 4 "HvCoolg1_NotDefined";
VAL_ 422 IsgHeatFdBckCloud 0 "IsgHeatFdBck_On" 1 "IsgHeatFdBck_Off" 2 "IsgHeatFdBck_Inhibt" 3 "IsgHeatFdBck_Reserved";
VAL_ 422 OTAActvHVReq 0 "OnOff1_Off" 1 "OnOff1_On";
VAL_ 422 PrpsnAllwd 0 "Boolean_FALSE" 1 "Boolean_TRUE";
VAL_ 422 RemStrt 0 "NotActvActv1_NotActv" 1 "NotActvActv1_Actv";
SIG_GROUP_ 920 ActvnOfHndlDoorLi 1 : ActvnOfHndlDoorLiHndlDoorLiDrvr ActvnOfHndlDoorLiHndlDoorLiDrvrRe ActvnOfHndlDoorLiHndlDoorLiPass ActvnOfHndlDoorLiHndlDoorLiPassRe;
SIG_GROUP_ 816 BMXSDrvTq2VDM 1 : BMXSDrvTq2VDMChks BMXSDrvTq2VDMCntr BMXSDrvTq2VDMTqVDM BMXSDrvTq2VDMTqVDMCtrlMode BMXSDrvTq2VDMTqVDMQf;
SIG_GROUP_ 52 BodyDataTraceZCUDM1 1 : BodyDataTraceZCUDM1Functiondevpsignalgroup1 BodyDataTraceZCUDM1Functiondevpsignalgroup2 BodyDataTraceZCUDM1Functiondevpsignalgroup3 BodyDataTraceZCUDM1Functiondevpsignalgroup4 BodyDataTraceZCUDM1Functiondevpsignalgroup5 BodyDataTraceZCUDM1Functiondevpsignalgroup6 BodyDataTraceZCUDM1Functiondevpsignalgroup7 BodyDataTraceZCUDM1Functiondevpsignalgroup8;
SIG_GROUP_ 52 BodyDataTraceZCUDM2 1 : BodyDataTraceZCUDM2Functiondevpsignalgroup1 BodyDataTraceZCUDM2Functiondevpsignalgroup2 BodyDataTraceZCUDM2Functiondevpsignalgroup3 BodyDataTraceZCUDM2Functiondevpsignalgroup4 BodyDataTraceZCUDM2Functiondevpsignalgroup5 BodyDataTraceZCUDM2Functiondevpsignalgroup6 BodyDataTraceZCUDM2Functiondevpsignalgroup7 BodyDataTraceZCUDM2Functiondevpsignalgroup8;
SIG_GROUP_ 52 BodyDataTraceZCUDM3 1 : BodyDataTraceZCUDM3Functiondevpsignalgroup1 BodyDataTraceZCUDM3Functiondevpsignalgroup2 BodyDataTraceZCUDM3Functiondevpsignalgroup3 BodyDataTraceZCUDM3Functiondevpsignalgroup4 BodyDataTraceZCUDM3Functiondevpsignalgroup5 BodyDataTraceZCUDM3Functiondevpsignalgroup6 BodyDataTraceZCUDM3Functiondevpsignalgroup7 BodyDataTraceZCUDM3Functiondevpsignalgroup8;
SIG_GROUP_ 52 BodyDataTraceZCUDM4 1 : BodyDataTraceZCUDM4Functiondevpsignalgroup1 BodyDataTraceZCUDM4Functiondevpsignalgroup2 BodyDataTraceZCUDM4Functiondevpsignalgroup3 BodyDataTraceZCUDM4Functiondevpsignalgroup4 BodyDataTraceZCUDM4Functiondevpsignalgroup5 BodyDataTraceZCUDM4Functiondevpsignalgroup6 BodyDataTraceZCUDM4Functiondevpsignalgroup7 BodyDataTraceZCUDM4Functiondevpsignalgroup8;
SIG_GROUP_ 52 BodyDataTraceZCUDM5 1 : BodyDataTraceZCUDM5Functiondevpsignalgroup1 BodyDataTraceZCUDM5Functiondevpsignalgroup2 BodyDataTraceZCUDM5Functiondevpsignalgroup3 BodyDataTraceZCUDM5Functiondevpsignalgroup4 BodyDataTraceZCUDM5Functiondevpsignalgroup5 BodyDataTraceZCUDM5Functiondevpsignalgroup6 BodyDataTraceZCUDM5Functiondevpsignalgroup7 BodyDataTraceZCUDM5Functiondevpsignalgroup8;
SIG_GROUP_ 52 BodyDataTraceZCUDM6 1 : BodyDataTraceZCUDM6Functiondevpsignalgroup1 BodyDataTraceZCUDM6Functiondevpsignalgroup2 BodyDataTraceZCUDM6Functiondevpsignalgroup3 BodyDataTraceZCUDM6Functiondevpsignalgroup4 BodyDataTraceZCUDM6Functiondevpsignalgroup5 BodyDataTraceZCUDM6Functiondevpsignalgroup6 BodyDataTraceZCUDM6Functiondevpsignalgroup7 BodyDataTraceZCUDM6Functiondevpsignalgroup8;
SIG_GROUP_ 52 BodyDataTraceZCUDM7 1 : BodyDataTraceZCUDM7Functiondevpsignalgroup1 BodyDataTraceZCUDM7Functiondevpsignalgroup2 BodyDataTraceZCUDM7Functiondevpsignalgroup3 BodyDataTraceZCUDM7Functiondevpsignalgroup4 BodyDataTraceZCUDM7Functiondevpsignalgroup5 BodyDataTraceZCUDM7Functiondevpsignalgroup6 BodyDataTraceZCUDM7Functiondevpsignalgroup7 BodyDataTraceZCUDM7Functiondevpsignalgroup8;
SIG_GROUP_ 416 EexvSts 1 : EexvStsExvActrPosn EexvStsExvBlkErr EexvStsExvCalibSts EexvStsExvElecStsErr EexvStsExvMovSts EexvStsExvOvrTempErr EexvStsExvOvrTrvlErr EexvStsExvPreHeatgSts EexvStsExvVoltgRangErr;
SIG_GROUP_ 416 EtpActualSpeed 1 : EtpActualSpeedBackup EtpActualSpeedEtpActualSpeed EtpActualSpeedSts;
SIG_GROUP_ 416 EtpCurrent 1 : EtpCurrent_Backup EtpCurrentEtpCurrent EtpCurrentStsBackup;
SIG_GROUP_ 416 EtpHallSignal 1 : EtpHallSignalError EtpHallSignalSt;
SIG_GROUP_ 416 EtpMcu 1 : EtpMcuTemperature EtpMcuTOutRngHiSts EtpMcuTOutRngLoSts EtpMcuTStuckSts;
SIG_GROUP_ 416 EtpMos 1 : EtpMosTemperature EtpMosTemperatureBackup EtpMosTOpenSts EtpMosTOutRngHiSts EtpMosTOutRngLoSts EtpMosTShoBattSts EtpMosTShoGndSts EtpMosTStuckSts;
SIG_GROUP_ 416 EtpPhase 1 : EtpPhaseCurrent EtpPhaseCurrentBackup EtpPhaseCurrentStsBackup EtpPhaseOverCurrent;
SIG_GROUP_ 416 EtpVHDVoltage 1 : EtpVHDVoltageBackup EtpVHDVoltageEtpVHDVoltage;
SIG_GROUP_ 416 ExvSts 1 : ExvStsExvActrPosn ExvStsExvBlkErr ExvStsExvCalibSts ExvStsExvElecStsErr ExvStsExvMovSts ExvStsExvOvrTempErr ExvStsExvOvrTrvlErr ExvStsExvPreHeatgSts ExvStsExvVoltgRangErr;
SIG_GROUP_ 416 IsgForWRC 1 : IsgForWRCIsgSpdForWRC IsgForWRCIsgTqEstForWRC;
SIG_GROUP_ 920 SnsrSoundrBattBackedSts 1 : SnsrSoundrBattBackedStsArmSts SnsrSoundrBattBackedStsCfgSts SnsrSoundrBattBackedStsSnsrInclnExist SnsrSoundrBattBackedStsSoundrBattBackedErrSts SnsrSoundrBattBackedStsSoundSts;
SIG_GROUP_ 920 StsOfLvlgLe 1 : StsOfLvlgLeChks StsOfLvlgLeCntr StsOfLvlgLeStsOfLvlgLe;
SIG_GROUP_ 920 StsOfLvlgRi 1 : StsOfLvlgRiChks StsOfLvlgRiCntr StsOfLvlgRiStsOfLvlgRi;
SIG_GROUP_ 920 SunRoofAndCurtBtnSts2 1 : SunRoofAndCurtBtnSts2Cntr SunRoofAndCurtBtnSts2Pos;
SIG_GROUP_ 816 VFCVectorSMB 1 : VFCVectorSMBBlockID VFCVectorSMBVFCid0 VFCVectorSMBVFCid1 VFCVectorSMBVFCid10 VFCVectorSMBVFCid11 VFCVectorSMBVFCid12 VFCVectorSMBVFCid13 VFCVectorSMBVFCid14 VFCVectorSMBVFCid15 VFCVectorSMBVFCid16 VFCVectorSMBVFCid17 VFCVectorSMBVFCid18 VFCVectorSMBVFCid19 VFCVectorSMBVFCid2 VFCVectorSMBVFCid20 VFCVectorSMBVFCid21 VFCVectorSMBVFCid22 VFCVectorSMBVFCid23 VFCVectorSMBVFCid24 VFCVectorSMBVFCid25 VFCVectorSMBVFCid26 VFCVectorSMBVFCid27 VFCVectorSMBVFCid28 VFCVectorSMBVFCid29 VFCVectorSMBVFCid3 VFCVectorSMBVFCid30 VFCVectorSMBVFCid31 VFCVectorSMBVFCid32 VFCVectorSMBVFCid33 VFCVectorSMBVFCid34 VFCVectorSMBVFCid35 VFCVectorSMBVFCid36 VFCVectorSMBVFCid37 VFCVectorSMBVFCid38 VFCVectorSMBVFCid39 VFCVectorSMBVFCid4 VFCVectorSMBVFCid40 VFCVectorSMBVFCid41 VFCVectorSMBVFCid42 VFCVectorSMBVFCid43 VFCVectorSMBVFCid44 VFCVectorSMBVFCid45 VFCVectorSMBVFCid46 VFCVectorSMBVFCid47 VFCVectorSMBVFCid48 VFCVectorSMBVFCid49 VFCVectorSMBVFCid5 VFCVectorSMBVFCid50 VFCVectorSMBVFCid51 VFCVectorSMBVFCid52 VFCVectorSMBVFCid53 VFCVectorSMBVFCid54 VFCVectorSMBVFCid55 VFCVectorSMBVFCid56 VFCVectorSMBVFCid57 VFCVectorSMBVFCid58 VFCVectorSMBVFCid59 VFCVectorSMBVFCid6 VFCVectorSMBVFCid60 VFCVectorSMBVFCid61 VFCVectorSMBVFCid7 VFCVectorSMBVFCid8 VFCVectorSMBVFCid9;
SIG_GROUP_ 816 VFCVectorSMBL 1 : VFCVectorSMBLBlockID VFCVectorSMBLVFCid0 VFCVectorSMBLVFCid1 VFCVectorSMBLVFCid10 VFCVectorSMBLVFCid11 VFCVectorSMBLVFCid12 VFCVectorSMBLVFCid13 VFCVectorSMBLVFCid14 VFCVectorSMBLVFCid15 VFCVectorSMBLVFCid16 VFCVectorSMBLVFCid17 VFCVectorSMBLVFCid18 VFCVectorSMBLVFCid19 VFCVectorSMBLVFCid2 VFCVectorSMBLVFCid20 VFCVectorSMBLVFCid21 VFCVectorSMBLVFCid22 VFCVectorSMBLVFCid23 VFCVectorSMBLVFCid24 VFCVectorSMBLVFCid25 VFCVectorSMBLVFCid26 VFCVectorSMBLVFCid27 VFCVectorSMBLVFCid28 VFCVectorSMBLVFCid29 VFCVectorSMBLVFCid3 VFCVectorSMBLVFCid30 VFCVectorSMBLVFCid31 VFCVectorSMBLVFCid32 VFCVectorSMBLVFCid33 VFCVectorSMBLVFCid34 VFCVectorSMBLVFCid35 VFCVectorSMBLVFCid36 VFCVectorSMBLVFCid37 VFCVectorSMBLVFCid38 VFCVectorSMBLVFCid39 VFCVectorSMBLVFCid4 VFCVectorSMBLVFCid40 VFCVectorSMBLVFCid41 VFCVectorSMBLVFCid42 VFCVectorSMBLVFCid43 VFCVectorSMBLVFCid44 VFCVectorSMBLVFCid45 VFCVectorSMBLVFCid46 VFCVectorSMBLVFCid47 VFCVectorSMBLVFCid48 VFCVectorSMBLVFCid49 VFCVectorSMBLVFCid5 VFCVectorSMBLVFCid50 VFCVectorSMBLVFCid51 VFCVectorSMBLVFCid52 VFCVectorSMBLVFCid53 VFCVectorSMBLVFCid54 VFCVectorSMBLVFCid55 VFCVectorSMBLVFCid56 VFCVectorSMBLVFCid57 VFCVectorSMBLVFCid58 VFCVectorSMBLVFCid59 VFCVectorSMBLVFCid6 VFCVectorSMBLVFCid60 VFCVectorSMBLVFCid61 VFCVectorSMBLVFCid7 VFCVectorSMBLVFCid8 VFCVectorSMBLVFCid9;
SIG_GROUP_ 816 VFCVectorSMBR 1 : VFCVectorSMBRBlockID VFCVectorSMBRVFCid0 VFCVectorSMBRVFCid1 VFCVectorSMBRVFCid10 VFCVectorSMBRVFCid11 VFCVectorSMBRVFCid12 VFCVectorSMBRVFCid13 VFCVectorSMBRVFCid14 VFCVectorSMBRVFCid15 VFCVectorSMBRVFCid16 VFCVectorSMBRVFCid17 VFCVectorSMBRVFCid18 VFCVectorSMBRVFCid19 VFCVectorSMBRVFCid2 VFCVectorSMBRVFCid20 VFCVectorSMBRVFCid21 VFCVectorSMBRVFCid22 VFCVectorSMBRVFCid23 VFCVectorSMBRVFCid24 VFCVectorSMBRVFCid25 VFCVectorSMBRVFCid26 VFCVectorSMBRVFCid27 VFCVectorSMBRVFCid28 VFCVectorSMBRVFCid29 VFCVectorSMBRVFCid3 VFCVectorSMBRVFCid30 VFCVectorSMBRVFCid31 VFCVectorSMBRVFCid32 VFCVectorSMBRVFCid33 VFCVectorSMBRVFCid34 VFCVectorSMBRVFCid35 VFCVectorSMBRVFCid36 VFCVectorSMBRVFCid37 VFCVectorSMBRVFCid38 VFCVectorSMBRVFCid39 VFCVectorSMBRVFCid4 VFCVectorSMBRVFCid40 VFCVectorSMBRVFCid41 VFCVectorSMBRVFCid42 VFCVectorSMBRVFCid43 VFCVectorSMBRVFCid44 VFCVectorSMBRVFCid45 VFCVectorSMBRVFCid46 VFCVectorSMBRVFCid47 VFCVectorSMBRVFCid48 VFCVectorSMBRVFCid49 VFCVectorSMBRVFCid5 VFCVectorSMBRVFCid50 VFCVectorSMBRVFCid51 VFCVectorSMBRVFCid52 VFCVectorSMBRVFCid53 VFCVectorSMBRVFCid54 VFCVectorSMBRVFCid55 VFCVectorSMBRVFCid56 VFCVectorSMBRVFCid57 VFCVectorSMBRVFCid58 VFCVectorSMBRVFCid59 VFCVectorSMBRVFCid6 VFCVectorSMBRVFCid60 VFCVectorSMBRVFCid61 VFCVectorSMBRVFCid7 VFCVectorSMBRVFCid8 VFCVectorSMBRVFCid9;
SIG_GROUP_ 832 VFCVectorSMP 1 : VFCVectorSMPBlockID VFCVectorSMPVFCid0 VFCVectorSMPVFCid1 VFCVectorSMPVFCid10 VFCVectorSMPVFCid11 VFCVectorSMPVFCid12 VFCVectorSMPVFCid13 VFCVectorSMPVFCid14 VFCVectorSMPVFCid15 VFCVectorSMPVFCid16 VFCVectorSMPVFCid17 VFCVectorSMPVFCid18 VFCVectorSMPVFCid19 VFCVectorSMPVFCid2 VFCVectorSMPVFCid20 VFCVectorSMPVFCid21 VFCVectorSMPVFCid22 VFCVectorSMPVFCid23 VFCVectorSMPVFCid24 VFCVectorSMPVFCid25 VFCVectorSMPVFCid26 VFCVectorSMPVFCid27 VFCVectorSMPVFCid28 VFCVectorSMPVFCid29 VFCVectorSMPVFCid3 VFCVectorSMPVFCid30 VFCVectorSMPVFCid31 VFCVectorSMPVFCid32 VFCVectorSMPVFCid33 VFCVectorSMPVFCid34 VFCVectorSMPVFCid35 VFCVectorSMPVFCid36 VFCVectorSMPVFCid37 VFCVectorSMPVFCid38 VFCVectorSMPVFCid39 VFCVectorSMPVFCid4 VFCVectorSMPVFCid40 VFCVectorSMPVFCid41 VFCVectorSMPVFCid42 VFCVectorSMPVFCid43 VFCVectorSMPVFCid44 VFCVectorSMPVFCid45 VFCVectorSMPVFCid46 VFCVectorSMPVFCid47 VFCVectorSMPVFCid48 VFCVectorSMPVFCid49 VFCVectorSMPVFCid5 VFCVectorSMPVFCid50 VFCVectorSMPVFCid51 VFCVectorSMPVFCid52 VFCVectorSMPVFCid53 VFCVectorSMPVFCid54 VFCVectorSMPVFCid55 VFCVectorSMPVFCid56 VFCVectorSMPVFCid57 VFCVectorSMPVFCid58 VFCVectorSMPVFCid59 VFCVectorSMPVFCid6 VFCVectorSMPVFCid60 VFCVectorSMPVFCid61 VFCVectorSMPVFCid7 VFCVectorSMPVFCid8 VFCVectorSMPVFCid9;
SIG_GROUP_ 816 VFCVectorTRM 1 : VFCVectorTRMBlockID VFCVectorTRMVFCid0 VFCVectorTRMVFCid1 VFCVectorTRMVFCid10 VFCVectorTRMVFCid11 VFCVectorTRMVFCid12 VFCVectorTRMVFCid13 VFCVectorTRMVFCid14 VFCVectorTRMVFCid15 VFCVectorTRMVFCid16 VFCVectorTRMVFCid17 VFCVectorTRMVFCid18 VFCVectorTRMVFCid19 VFCVectorTRMVFCid2 VFCVectorTRMVFCid20 VFCVectorTRMVFCid21 VFCVectorTRMVFCid22 VFCVectorTRMVFCid23 VFCVectorTRMVFCid24 VFCVectorTRMVFCid25 VFCVectorTRMVFCid26 VFCVectorTRMVFCid27 VFCVectorTRMVFCid28 VFCVectorTRMVFCid29 VFCVectorTRMVFCid3 VFCVectorTRMVFCid30 VFCVectorTRMVFCid31 VFCVectorTRMVFCid32 VFCVectorTRMVFCid33 VFCVectorTRMVFCid34 VFCVectorTRMVFCid35 VFCVectorTRMVFCid36 VFCVectorTRMVFCid37 VFCVectorTRMVFCid38 VFCVectorTRMVFCid39 VFCVectorTRMVFCid4 VFCVectorTRMVFCid40 VFCVectorTRMVFCid41 VFCVectorTRMVFCid42 VFCVectorTRMVFCid43 VFCVectorTRMVFCid44 VFCVectorTRMVFCid45 VFCVectorTRMVFCid46 VFCVectorTRMVFCid47 VFCVectorTRMVFCid48 VFCVectorTRMVFCid49 VFCVectorTRMVFCid5 VFCVectorTRMVFCid50 VFCVectorTRMVFCid51 VFCVectorTRMVFCid52 VFCVectorTRMVFCid53 VFCVectorTRMVFCid54 VFCVectorTRMVFCid55 VFCVectorTRMVFCid56 VFCVectorTRMVFCid57 VFCVectorTRMVFCid58 VFCVectorTRMVFCid59 VFCVectorTRMVFCid6 VFCVectorTRMVFCid60 VFCVectorTRMVFCid61 VFCVectorTRMVFCid7 VFCVectorTRMVFCid8 VFCVectorTRMVFCid9;
SIG_GROUP_ 920 WiprMotDiagc 1 : WiprMotDiagcWiprMotHiVoltDetd WiprMotDiagcWiprMotLoVoltDetd WiprMotDiagcWiprMotOvldDetd;
