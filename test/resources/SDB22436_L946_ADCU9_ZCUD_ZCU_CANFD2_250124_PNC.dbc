// *************************************************************************** *
// *                                                                           *
// * Description:         CANDB File                                           *
// * Generated at:        2025-01-24 14:38                                     *
// * System:              SDB22436                                             *
// * Variant:             L946_ADCU9_ZCUD                                      *
// * Network:             ZCU_CANFD2                                           *
// *                                                                           *
// *************************************************************************** *
VERSION "ZCU_CANFD2"

NS_ :

BS_ :

BU_ :  ETC IHU ZCUD ZCUP

BO_ 336 ZCUDZCUCANFD2Fr05 : 64 ZCUD
 SG_ ActvnOfHzrd : 7|8@0+ (1.0,0.0) [0.0|100.0] "%" IHU
 SG_ ActvnOfHzrd_UB : 25|1@0+ (1,0) [0|1] "" IHU
 SG_ BookChrgnTarValFb : 63|10@0+ (0.1,0.0) [0.0|100.0] "%" IHU
 SG_ BookChrgnTarValFb_UB : 69|1@0+ (1,0) [0|1] "" IHU
 SG_ ChrgLidRearLockCmd : 23|3@0+ (1,0) [0|7] "" IHU,ZCUP
 SG_ ChrgLidRearLockCmd_UB : 36|1@0+ (1,0) [0|1] "" IHU,ZCUP
 SG_ ChrgnOrDisChrgnStsFb : 55|5@0+ (1,0) [0|31] "" IHU
 SG_ ChrgnOrDisChrgnStsFb_UB : 24|1@0+ (1,0) [0|1] "" IHU
 SG_ CrashUnlckPosHldng : 428|1@0+ (1,0) [0|1] "" IHU,ZCUP
 SG_ CrashUnlckPosHldng_UB : 416|1@0+ (1,0) [0|1] "" IHU,ZCUP
 SG_ DispOfPrpsnMod : 11|4@0+ (1,0) [0|15] "" IHU
 SG_ DispOfPrpsnMod_UB : 35|1@0+ (1,0) [0|1] "" IHU
 SG_ DoorSldngLeReCinFail_UB : 472|1@0+ (1,0) [0|1] "" IHU
 SG_ DoorSldngLeReCinFailCinchFlt1 : 474|1@0+ (1,0) [0|1] "" IHU
 SG_ DoorSldngLeReCinFailCinchRestFlt : 473|1@0+ (1,0) [0|1] "" IHU
 SG_ DoorSldngLeRePreConNotFulfil : 468|1@0+ (1,0) [0|1] "" IHU
 SG_ DoorSldngLeRePreConNotFulfil_UB : 467|1@0+ (1,0) [0|1] "" IHU
 SG_ DoorSldngLeReSts_UB : 489|1@0+ (1,0) [0|1] "" IHU
 SG_ DoorSldngLeReStsDoorOpenSts : 494|4@0+ (1,0) [0|15] "" IHU
 SG_ DoorSldngLeReStsFrstTmLveAbnd : 490|1@0+ (1,0) [0|1] "" IHU
 SG_ DoorSldngRiReCinFail_UB : 485|1@0+ (1,0) [0|1] "" IHU
 SG_ DoorSldngRiReCinFailCinchFlt1 : 487|1@0+ (1,0) [0|1] "" IHU
 SG_ DoorSldngRiReCinFailCinchRestFlt : 486|1@0+ (1,0) [0|1] "" IHU
 SG_ DoorSldngRiReOpenEnaSts : 466|1@0+ (1,0) [0|1] "" ZCUP
 SG_ DoorSldngRiReOpenEnaSts_UB : 465|1@0+ (1,0) [0|1] "" ZCUP
 SG_ DoorSldngRiRePreConNotFulfil : 464|1@0+ (1,0) [0|1] "" IHU
 SG_ DoorSldngRiRePreConNotFulfil_UB : 479|1@0+ (1,0) [0|1] "" IHU
 SG_ DoorSldngRiReSts_UB : 495|1@0+ (1,0) [0|1] "" IHU
 SG_ DoorSldngRiReStsDoorOpenSts : 483|4@0+ (1,0) [0|15] "" IHU
 SG_ DoorSldngRiReStsFrstTmLveAbnd : 484|1@0+ (1,0) [0|1] "" IHU
 SG_ DstEstimdToEmptyForDrvgElec : 79|10@0+ (1.0,0.0) [0.0|1023.0] "KiloMtr" IHU
 SG_ DstEstimdToEmptyForDrvgElec_UB : 14|1@0+ (1,0) [0|1] "" IHU
 SG_ DstFromDestinationFb : 31|3@0+ (1,0) [0|7] "" IHU
 SG_ DstFromDestinationFb_UB : 33|1@0+ (1,0) [0|1] "" IHU
 SG_ DstToEmptyIndcdDstToEmpty1 : 455|13@0+ (1.0,0.0) [0.0|8191.0] "KiloMtr" IHU
 SG_ DstToEmptyIndcdDstToEmpty1_UB : 440|1@0+ (1,0) [0|1] "" IHU
 SG_ DstToEmptyIndcdDstToEmpty2 : 500|13@0+ (1.0,0.0) [0.0|8191.0] "KiloMtr" IHU
 SG_ DstToEmptyIndcdDstToEmpty2_UB : 501|1@0+ (1,0) [0|1] "" IHU
 SG_ ElecMot2SpdActSgn : 255|15@0- (1.0,0.0) [-16384.0|16383.0] "rpm" IHU
 SG_ ElecMot2SpdActSgn_UB : 256|1@0+ (1,0) [0|1] "" IHU
 SG_ ElecMot2SpdReq : 311|15@0- (1.0,0.0) [-16384.0|16383.0] "rpm" IHU
 SG_ ElecMot2SpdReq_UB : 312|1@0+ (1,0) [0|1] "" IHU
 SG_ ElecMot2TqAct_UB : 347|1@0+ (1,0) [0|1] "" IHU
 SG_ ElecMot2TqActChks : 327|8@0+ (1.0,0.0) [0.0|255.0] "Unitless" IHU
 SG_ ElecMot2TqActCntr : 351|4@0+ (1.0,0.0) [0.0|15.0] "Unitless" IHU
 SG_ ElecMot2TqActIsgTqAct : 335|14@0+ (1.0,-8188.0) [-8188.0|8192.0] "NewtonMeter" IHU
 SG_ ElecMot2TqActQualityFactor : 337|2@0+ (1,0) [0|3] "" IHU
 SG_ ElecMot2TqAllwd_UB : 346|1@0+ (1,0) [0|1] "" IHU
 SG_ ElecMot2TqAllwdChks : 359|8@0+ (1.0,0.0) [0.0|255.0] "Unitless" IHU
 SG_ ElecMot2TqAllwdCntr : 367|4@0+ (1.0,0.0) [0.0|15.0] "Unitless" IHU
 SG_ ElecMot2TqAllwdIsgTqAllwd : 363|4@0+ (1.0,0.0) [0.0|15.0] "Unitless" IHU
 SG_ ElecMot2TqAvl_UB : 345|1@0+ (1,0) [0|1] "" IHU
 SG_ ElecMot2TqAvlIsgTqAvlMax : 373|14@0+ (1.0,-8188.0) [-8188.0|8192.0] "NewtonMeter" IHU
 SG_ ElecMot2TqAvlIsgTqAvlMin : 391|14@0+ (1.0,-8188.0) [-8188.0|8192.0] "NewtonMeter" IHU
 SG_ ElecMot2TqReq : 407|14@0+ (1.0,-8188.0) [-8188.0|8192.0] "NewtonMeter" IHU
 SG_ ElecMot2TqReq_UB : 344|1@0+ (1,0) [0|1] "" IHU
 SG_ FrntSeatEEInhbRowSecLe : 393|1@0+ (1,0) [0|1] "" ZCUP
 SG_ FrntSeatEEInhbRowSecLe_UB : 392|1@0+ (1,0) [0|1] "" ZCUP
 SG_ FrntSeatEEInhbRowSecRi : 425|1@0+ (1,0) [0|1] "" ZCUP
 SG_ FrntSeatEEInhbRowSecRi_UB : 424|1@0+ (1,0) [0|1] "" ZCUP
 SG_ IndirectLifeDetnAndCareDiWarn : 478|1@0+ (1,0) [0|1] "" IHU
 SG_ IndirectLifeDetnAndCareDiWarn_UB : 477|1@0+ (1,0) [0|1] "" IHU
 SG_ IndirectLifeDetnAndCareLvl1Warn : 476|1@0+ (1,0) [0|1] "" IHU
 SG_ IndirectLifeDetnAndCareLvl1Warn_UB : 475|1@0+ (1,0) [0|1] "" IHU
 SG_ KeyLostWarnIndcn : 13|2@0+ (1,0) [0|3] "" IHU
 SG_ KeyLostWarnIndcn_UB : 32|1@0+ (1,0) [0|1] "" IHU
 SG_ KeyRmnIndcn : 17|1@0+ (1,0) [0|1] "" IHU
 SG_ KeyRmnIndcn_UB : 47|1@0+ (1,0) [0|1] "" IHU
 SG_ LiLvrSwt1 : 241|1@0+ (1,0) [0|1] "" IHU
 SG_ LiLvrSwt1_UB : 240|1@0+ (1,0) [0|1] "" IHU
 SG_ LockgFbAudioReq : 28|3@0+ (1,0) [0|7] "" IHU
 SG_ LockgFbAudioReq_UB : 46|1@0+ (1,0) [0|1] "" IHU
 SG_ LockgFbAudioWarn : 374|1@0+ (1,0) [0|1] "" IHU
 SG_ LockgFbAudioWarn_UB : 375|1@0+ (1,0) [0|1] "" IHU
 SG_ MemBtnPsd_UB : 84|1@0+ (1,0) [0|1] "" IHU
 SG_ MemBtnPsdMemBtn1 : 43|1@0+ (1,0) [0|1] "" IHU
 SG_ MemBtnPsdMemBtn2 : 42|1@0+ (1,0) [0|1] "" IHU
 SG_ MemBtnPsdMemBtn3 : 41|1@0+ (1,0) [0|1] "" IHU
 SG_ MemBtnPsdMemButM : 40|1@0+ (1,0) [0|1] "" IHU
 SG_ PassElecRunngBdSts : 16|1@0+ (1,0) [0|1] "" IHU
 SG_ PassElecRunngBdSts_UB : 34|1@0+ (1,0) [0|1] "" IHU
 SG_ RoofDispCtrlReqFromSecLe : 458|1@0+ (1,0) [0|1] "" IHU
 SG_ RoofDispCtrlReqFromSecLe_UB : 457|1@0+ (1,0) [0|1] "" IHU
 SG_ RoofDispCtrlReqFromSecRi : 456|1@0+ (1,0) [0|1] "" IHU
 SG_ RoofDispCtrlReqFromSecRi_UB : 503|1@0+ (1,0) [0|1] "" IHU
 SG_ RowFrstPassDivePosPerc_UB : 431|1@0+ (1,0) [0|1] "" IHU
 SG_ RowFrstPassDivePosPercSeatPosPerc : 439|10@0+ (0.1,0.0) [0.0|100.0] "%" IHU
 SG_ RowFrstPassDivePosPercSeatPosQf : 445|2@0+ (1,0) [0|3] "" IHU
 SG_ RowSecLeSeatAutMovmtSts : 67|2@0+ (1,0) [0|3] "" IHU
 SG_ RowSecLeSeatAutMovmtSts_UB : 68|1@0+ (1,0) [0|1] "" IHU
 SG_ RowSecLeSeatInAutMovmt : 20|1@0+ (1,0) [0|1] "" IHU
 SG_ RowSecLeSeatInAutMovmt_UB : 19|1@0+ (1,0) [0|1] "" IHU
 SG_ RowSecLeSeatRotSts : 471|1@0+ (1,0) [0|1] "" ZCUP
 SG_ RowSecLeSeatRotSts_UB : 502|1@0+ (1,0) [0|1] "" ZCUP
 SG_ RowSecRiSeatAutMovmtSts : 65|2@0+ (1,0) [0|3] "" IHU
 SG_ RowSecRiSeatAutMovmtSts_UB : 85|1@0+ (1,0) [0|1] "" IHU
 SG_ RowSecRiSeatInAutMovmt : 18|1@0+ (1,0) [0|1] "" IHU
 SG_ RowSecRiSeatInAutMovmt_UB : 15|1@0+ (1,0) [0|1] "" IHU
 SG_ RowSecRiSeatRotSts : 470|1@0+ (1,0) [0|1] "" ZCUP
 SG_ RowSecRiSeatRotSts_UB : 469|1@0+ (1,0) [0|1] "" ZCUP
 SG_ RowThrdLeSeatAutMovmtSts : 247|2@0+ (1,0) [0|3] "" IHU
 SG_ RowThrdLeSeatAutMovmtSts_UB : 245|1@0+ (1,0) [0|1] "" IHU
 SG_ RowThrdRiSeatAutMovmtSts : 243|2@0+ (1,0) [0|3] "" IHU
 SG_ RowThrdRiSeatAutMovmtSts_UB : 244|1@0+ (1,0) [0|1] "" IHU
 SG_ SecRowSeatHeatgActlPwrCnsLe : 103|8@0+ (1.0,0.0) [0.0|255.0] "Unitless" ZCUP
 SG_ SecRowSeatHeatgActlPwrCnsLe_UB : 231|1@0+ (1,0) [0|1] "" ZCUP
 SG_ SecRowSeatHeatgActlPwrCnsRi : 111|8@0+ (1.0,0.0) [0.0|255.0] "Unitless" ZCUP
 SG_ SecRowSeatHeatgActlPwrCnsRi_UB : 230|1@0+ (1,0) [0|1] "" ZCUP
 SG_ SecRowSeatHeatgDesPwrCnsLe : 135|8@0+ (1.0,0.0) [0.0|255.0] "Unitless" ZCUP
 SG_ SecRowSeatHeatgDesPwrCnsLe_UB : 229|1@0+ (1,0) [0|1] "" ZCUP
 SG_ SecRowSeatHeatgDesPwrCnsRi : 143|8@0+ (1.0,0.0) [0.0|255.0] "Unitless" ZCUP
 SG_ SecRowSeatHeatgDesPwrCnsRi_UB : 228|1@0+ (1,0) [0|1] "" ZCUP
 SG_ SecRowSeatVentnActlPwrCnsLe : 119|8@0+ (1.0,0.0) [0.0|255.0] "Unitless" ZCUP
 SG_ SecRowSeatVentnActlPwrCnsLe_UB : 227|1@0+ (1,0) [0|1] "" ZCUP
 SG_ SecRowSeatVentnActlPwrCnsRi : 127|8@0+ (1.0,0.0) [0.0|255.0] "Unitless" ZCUP
 SG_ SecRowSeatVentnActlPwrCnsRi_UB : 226|1@0+ (1,0) [0|1] "" ZCUP
 SG_ SecRowSeatVentnDesPwrCnsLe : 151|8@0+ (1.0,0.0) [0.0|255.0] "Unitless" ZCUP
 SG_ SecRowSeatVentnDesPwrCnsLe_UB : 225|1@0+ (1,0) [0|1] "" ZCUP
 SG_ SecRowSeatVentnDesPwrCnsRi : 159|8@0+ (1.0,0.0) [0.0|255.0] "Unitless" ZCUP
 SG_ SecRowSeatVentnDesPwrCnsRi_UB : 224|1@0+ (1,0) [0|1] "" ZCUP
 SG_ ShortDropWinDrvrReSts : 50|2@0+ (1,0) [0|3] "" IHU,ZCUP
 SG_ ShortDropWinDrvrReSts_UB : 45|1@0+ (1,0) [0|1] "" IHU,ZCUP
 SG_ TailgCllsnRiskSts : 429|1@0+ (1,0) [0|1] "" IHU
 SG_ TailgCllsnRiskSts_UB : 430|1@0+ (1,0) [0|1] "" IHU
 SG_ ThrdRowSeatHeatgActlPwrCnsLe : 167|8@0+ (1.0,0.0) [0.0|255.0] "Unitless" ZCUP
 SG_ ThrdRowSeatHeatgActlPwrCnsLe_UB : 239|1@0+ (1,0) [0|1] "" ZCUP
 SG_ ThrdRowSeatHeatgActlPwrCnsRi : 175|8@0+ (1.0,0.0) [0.0|255.0] "Unitless" ZCUP
 SG_ ThrdRowSeatHeatgActlPwrCnsRi_UB : 238|1@0+ (1,0) [0|1] "" ZCUP
 SG_ ThrdRowSeatHeatgDesPwrCnsLe : 183|8@0+ (1.0,0.0) [0.0|255.0] "Unitless" ZCUP
 SG_ ThrdRowSeatHeatgDesPwrCnsLe_UB : 237|1@0+ (1,0) [0|1] "" ZCUP
 SG_ ThrdRowSeatHeatgDesPwrCnsRi : 191|8@0+ (1.0,0.0) [0.0|255.0] "Unitless" ZCUP
 SG_ ThrdRowSeatHeatgDesPwrCnsRi_UB : 236|1@0+ (1,0) [0|1] "" ZCUP
 SG_ ThrdRowSeatVentnActlPwrCnsLe : 199|8@0+ (1.0,0.0) [0.0|255.0] "Unitless" ZCUP
 SG_ ThrdRowSeatVentnActlPwrCnsLe_UB : 235|1@0+ (1,0) [0|1] "" ZCUP
 SG_ ThrdRowSeatVentnActlPwrCnsRi : 207|8@0+ (1.0,0.0) [0.0|255.0] "Unitless" ZCUP
 SG_ ThrdRowSeatVentnActlPwrCnsRi_UB : 234|1@0+ (1,0) [0|1] "" ZCUP
 SG_ ThrdRowSeatVentnDesPwrCnsLe : 215|8@0+ (1.0,0.0) [0.0|255.0] "Unitless" ZCUP
 SG_ ThrdRowSeatVentnDesPwrCnsLe_UB : 233|1@0+ (1,0) [0|1] "" ZCUP
 SG_ ThrdRowSeatVentnDesPwrCnsRi : 223|8@0+ (1.0,0.0) [0.0|255.0] "Unitless" ZCUP
 SG_ ThrdRowSeatVentnDesPwrCnsRi_UB : 232|1@0+ (1,0) [0|1] "" ZCUP
 SG_ WadeProtnIndcn : 39|3@0+ (1,0) [0|7] "" IHU
 SG_ WadeProtnIndcn_UB : 44|1@0+ (1,0) [0|1] "" IHU

BO_ 53 ZCUDZCUCANFD2Fr06 : 64 ZCUD
 SG_ ActnOfDynChrgnInEITL : 154|1@0+ (1,0) [0|1] "" IHU
 SG_ ActnOfDynChrgnInEITL_UB : 153|1@0+ (1,0) [0|1] "" IHU
 SG_ ActvnOfIndcr_UB : 6|1@0+ (1,0) [0|1] "" IHU,ZCUP
 SG_ ActvnOfIndcrIndcrOut : 5|2@0+ (1,0) [0|3] "" IHU,ZCUP
 SG_ ActvnOfIndcrIndcrOutChks : 15|8@0+ (1.0,0.0) [0.0|255.0] "Unitless" IHU,ZCUP
 SG_ ActvnOfIndcrIndcrOutCntr : 3|4@0+ (1.0,0.0) [0.0|15.0] "Unitless" IHU,ZCUP
 SG_ ActvnOfMusicShowforEITL : 59|1@0+ (1,0) [0|1] "" IHU
 SG_ ActvnOfMusicShowforEITL_UB : 58|1@0+ (1,0) [0|1] "" IHU
 SG_ ActvnOfParkShowforEITL : 57|1@0+ (1,0) [0|1] "" IHU
 SG_ ActvnOfParkShowforEITL_UB : 56|1@0+ (1,0) [0|1] "" IHU
 SG_ ActvnOfVSTDInEITL : 506|2@0+ (1,0) [0|3] "" IHU
 SG_ ActvnOfVSTDInEITL_UB : 504|1@0+ (1,0) [0|1] "" IHU
 SG_ BLEKeySearchReq_UB : 249|1@0+ (1,0) [0|1] "" IHU
 SG_ BLEKeySearchReqKeyLocn : 279|4@0+ (1,0) [0|15] "" IHU
 SG_ BLEKeySearchReqTirgger : 275|4@0+ (1,0) [0|15] "" IHU
 SG_ ChdLockDrvrReSts : 115|2@0+ (1,0) [0|3] "" IHU,ZCUP
 SG_ ChdLockDrvrReSts_UB : 113|1@0+ (1,0) [0|1] "" IHU,ZCUP
 SG_ ChdLockLeftCmd : 71|2@0+ (1,0) [0|3] "" IHU,ZCUP
 SG_ ChdLockLeftCmd_UB : 17|1@0+ (1,0) [0|1] "" IHU,ZCUP
 SG_ ChdLockRightCmd : 69|2@0+ (1,0) [0|3] "" IHU,ZCUP
 SG_ ChdLockRightCmd_UB : 18|1@0+ (1,0) [0|1] "" IHU,ZCUP
 SG_ CrashStsSafe_UB : 480|1@0+ (1,0) [0|1] "" ZCUP
 SG_ CrashStsSafeChks : 495|8@0+ (1.0,0.0) [0.0|255.0] "Unitless" ZCUP
 SG_ CrashStsSafeCntr : 503|4@0+ (1.0,0.0) [0.0|15.0] "Unitless" ZCUP
 SG_ CrashStsSafeSts : 499|1@0+ (1,0) [0|1] "" ZCUP
 SG_ DoorDrvrHndlSts : 127|3@0+ (1,0) [0|7] "" IHU
 SG_ DoorDrvrHndlSts_UB : 112|1@0+ (1,0) [0|1] "" IHU
 SG_ DoorDrvrReCinhIntFailInf_UB : 442|1@0+ (1,0) [0|1] "" IHU,ZCUP
 SG_ DoorDrvrReCinhIntFailInfCinchFlt1 : 471|1@0+ (1,0) [0|1] "" IHU,ZCUP
 SG_ DoorDrvrReCinhIntFailInfCinchRestFlt : 470|1@0+ (1,0) [0|1] "" IHU,ZCUP
 SG_ DoorDrvrReHndlSts : 124|3@0+ (1,0) [0|7] "" IHU,ZCUP
 SG_ DoorDrvrReHndlSts_UB : 121|1@0+ (1,0) [0|1] "" IHU,ZCUP
 SG_ DoorDrvrReLatPosn : 483|2@0+ (1,0) [0|3] "" IHU,ZCUP
 SG_ DoorDrvrReLatPosn_UB : 481|1@0+ (1,0) [0|1] "" IHU,ZCUP
 SG_ DoorDrvrReLockSts : 67|2@0+ (1,0) [0|3] "" IHU,ZCUP
 SG_ DoorDrvrReLockSts_UB : 20|1@0+ (1,0) [0|1] "" IHU,ZCUP
 SG_ DoorDrvrReOpenLowReqOutdSwt1 : 469|2@0+ (1,0) [0|3] "" IHU,ZCUP
 SG_ DoorDrvrReOpenLowReqOutdSwt1_UB : 467|1@0+ (1,0) [0|1] "" IHU,ZCUP
 SG_ DoorDrvrReOpenReqInsdSwt1 : 466|2@0+ (1,0) [0|3] "" IHU,ZCUP
 SG_ DoorDrvrReOpenReqInsdSwt1_UB : 464|1@0+ (1,0) [0|1] "" IHU,ZCUP
 SG_ DoorDrvrReRelsFail_UB : 144|1@0+ (1,0) [0|1] "" IHU,ZCUP
 SG_ DoorDrvrReRelsFailCinchOverTimed : 147|1@0+ (1,0) [0|1] "" IHU,ZCUP
 SG_ DoorDrvrReRelsFailFailure1 : 146|1@0+ (1,0) [0|1] "" IHU,ZCUP
 SG_ DoorDrvrReRelsFailMechRels : 145|1@0+ (1,0) [0|1] "" IHU,ZCUP
 SG_ DoorLeReHndlSts : 135|3@0+ (1,0) [0|7] "" IHU
 SG_ DoorLeReHndlSts_UB : 120|1@0+ (1,0) [0|1] "" IHU
 SG_ DoorLeReLatPosn : 479|2@0+ (1,0) [0|3] "" IHU,ZCUP
 SG_ DoorLeReLatPosn_UB : 477|1@0+ (1,0) [0|1] "" IHU,ZCUP
 SG_ DoorLeReLockCmd : 55|4@0+ (1,0) [0|15] "" IHU,ZCUP
 SG_ DoorLeReLockCmd_UB : 21|1@0+ (1,0) [0|1] "" IHU,ZCUP
 SG_ DoorLeReRelsReq : 476|2@0+ (1,0) [0|3] "" IHU,ZCUP
 SG_ DoorLeReRelsReq_UB : 474|1@0+ (1,0) [0|1] "" IHU,ZCUP
 SG_ DoorPassLockCmd : 51|4@0+ (1,0) [0|15] "" IHU,ZCUP
 SG_ DoorPassLockCmd_UB : 22|1@0+ (1,0) [0|1] "" IHU,ZCUP
 SG_ DoorPassRelsReq : 473|2@0+ (1,0) [0|3] "" IHU,ZCUP
 SG_ DoorPassRelsReq_UB : 487|1@0+ (1,0) [0|1] "" IHU,ZCUP
 SG_ DoorRiReLockCmd : 63|4@0+ (1,0) [0|15] "" IHU,ZCUP
 SG_ DoorRiReLockCmd_UB : 23|1@0+ (1,0) [0|1] "" IHU,ZCUP
 SG_ DoorRiReRelsReq : 486|2@0+ (1,0) [0|3] "" IHU,ZCUP
 SG_ DoorRiReRelsReq_UB : 484|1@0+ (1,0) [0|1] "" IHU,ZCUP
 SG_ EpbLampReqSec_UB : 361|1@0+ (1,0) [0|1] "" IHU
 SG_ EpbLampReqSecChks : 359|8@0+ (1.0,0.0) [0.0|255.0] "Unitless" IHU
 SG_ EpbLampReqSecCntr : 367|4@0+ (1.0,0.0) [0.0|15.0] "Unitless" IHU
 SG_ EpbLampReqSecEpbLampReq : 363|2@0+ (1,0) [0|3] "" IHU
 SG_ ExtrLiRlySafe : 498|1@0+ (1,0) [0|1] "" IHU,ZCUP
 SG_ ExtrLiRlySafe_UB : 497|1@0+ (1,0) [0|1] "" IHU,ZCUP
 SG_ IceBreakDoorDrvrReActv : 496|1@0+ (1,0) [0|1] "" IHU,ZCUP
 SG_ IceBreakDoorDrvrReActv_UB : 511|1@0+ (1,0) [0|1] "" IHU,ZCUP
 SG_ IsgIDc : 247|14@0+ (0.1,-818.8) [-818.8|819.2] "A" IHU
 SG_ IsgIDc_UB : 169|1@0+ (1,0) [0|1] "" IHU
 SG_ IsgSpdActSgn : 263|16@0+ (1.0,-20000.0) [-20000.0|45535.0] "rpm" IHU
 SG_ IsgSpdActSgn_UB : 19|1@0+ (1,0) [0|1] "" IHU
 SG_ IsgTqReq : 167|14@0+ (1.0,-8188.0) [-8188.0|8192.0] "NewtonMeter" IHU
 SG_ IsgTqReq_UB : 152|1@0+ (1,0) [0|1] "" IHU
 SG_ OverBoostSts : 65|1@0+ (1,0) [0|1] "" IHU
 SG_ OverBoostSts_UB : 41|1@0+ (1,0) [0|1] "" IHU
 SG_ PanicAlrmSts : 64|1@0+ (1,0) [0|1] "" IHU
 SG_ PanicAlrmSts_UB : 42|1@0+ (1,0) [0|1] "" IHU
 SG_ PawlDrvrReSwt : 510|1@0+ (1,0) [0|1] "" IHU,ZCUP
 SG_ PawlDrvrReSwt_UB : 509|1@0+ (1,0) [0|1] "" IHU,ZCUP
 SG_ PawlDrvrSwt : 508|1@0+ (1,0) [0|1] "" IHU,ZCUP
 SG_ PawlDrvrSwt_UB : 507|1@0+ (1,0) [0|1] "" IHU,ZCUP
 SG_ PrpsnHvBattUsgModAct : 130|3@0+ (1,0) [0|7] "" IHU
 SG_ PrpsnHvBattUsgModAct_UB : 131|1@0+ (1,0) [0|1] "" IHU
 SG_ PrpsnHvBattUsgOfDispSoc : 143|7@0+ (1.0,0.0) [0.0|100.0] "%" IHU
 SG_ PrpsnHvBattUsgOfDispSoc_UB : 136|1@0+ (1,0) [0|1] "" IHU
 SG_ PtModAct : 151|2@0+ (1,0) [0|3] "" IHU
 SG_ PtModAct_UB : 132|1@0+ (1,0) [0|1] "" IHU
 SG_ PtTqAtWhlFrntAct_UB : 232|1@0+ (1,0) [0|1] "" IHU
 SG_ PtTqAtWhlFrntActChks : 231|8@0+ (1.0,0.0) [0.0|255.0] "Unitless" IHU
 SG_ PtTqAtWhlFrntActCntr : 239|4@0+ (1.0,0.0) [0.0|15.0] "Unitless" IHU
 SG_ PtTqAtWhlFrntActPtTqAtAxleFrntAct : 183|16@0- (1.0,0.0) [-20000.0|20000.0] "NewtonMeter" IHU
 SG_ PtTqAtWhlFrntActPtTqAtWhlFrntLeAct : 199|16@0- (1.0,0.0) [-20000.0|20000.0] "NewtonMeter" IHU
 SG_ PtTqAtWhlFrntActPtTqAtWhlFrntRiAct : 215|16@0- (1.0,0.0) [-20000.0|20000.0] "NewtonMeter" IHU
 SG_ PtTqAtWhlFrntActPtTqAtWhlsFrntQly : 235|3@0+ (1,0) [0|7] "" IHU
 SG_ RecOfImpct2_UB : 7|1@0+ (1,0) [0|1] "" IHU
 SG_ RecOfImpct2ImpctDvxSigned : 16|9@0+ (1.0,-255.0) [-255.0|257.0] "Km/h" IHU
 SG_ RecOfImpct2ImpctDvySigned : 39|9@0+ (1.0,-255.0) [-255.0|257.0] "Km/h" IHU
 SG_ RowSecLeBtnPsd : 46|1@0+ (1,0) [0|1] "" IHU
 SG_ RowSecLeBtnPsd_UB : 45|1@0+ (1,0) [0|1] "" IHU
 SG_ RowSecLeInclPosAngle : 303|8@0+ (1.0,0.0) [0.0|180.0] "Deg" IHU,ZCUP
 SG_ RowSecLeInclPosAngle_UB : 343|1@0+ (1,0) [0|1] "" IHU,ZCUP
 SG_ RowSecLeLegRstHeiPosPerc_UB : 159|1@0+ (1,0) [0|1] "" IHU
 SG_ RowSecLeLegRstHeiPosPercSeatPosPerc : 393|10@0+ (0.1,0.0) [0.0|100.0] "%" IHU
 SG_ RowSecLeLegRstHeiPosPercSeatPosQf : 395|2@0+ (1,0) [0|3] "" IHU
 SG_ RowSecLeLegRstLenPosPerc_UB : 158|1@0+ (1,0) [0|1] "" IHU
 SG_ RowSecLeLegRstLenPosPercSeatPosPerc : 415|10@0+ (0.1,0.0) [0.0|100.0] "%" IHU
 SG_ RowSecLeLegRstLenPosPercSeatPosQf : 421|2@0+ (1,0) [0|3] "" IHU
 SG_ RowSecLeSeatRotPosPerc : 455|8@0- (1.0,0.0) [-128.0|127.0] "Unitless" IHU,ZCUP
 SG_ RowSecLeSeatRotPosPerc_UB : 440|1@0+ (1,0) [0|1] "" IHU,ZCUP
 SG_ RowSecLeSldPosPerc_UB : 342|1@0+ (1,0) [0|1] "" IHU
 SG_ RowSecLeSldPosPercSeatPosPerc : 319|10@0+ (0.1,0.0) [0.0|100.0] "%" IHU
 SG_ RowSecLeSldPosPercSeatPosQf : 325|2@0+ (1,0) [0|3] "" IHU
 SG_ RowSecRiBtnPsd : 40|1@0+ (1,0) [0|1] "" IHU
 SG_ RowSecRiBtnPsd_UB : 360|1@0+ (1,0) [0|1] "" IHU
 SG_ RowSecRiInclPosAngle : 311|8@0+ (1.0,0.0) [0.0|180.0] "Deg" IHU,ZCUP
 SG_ RowSecRiInclPosAngle_UB : 341|1@0+ (1,0) [0|1] "" IHU,ZCUP
 SG_ RowSecRiLegRstHeiPosPerc_UB : 157|1@0+ (1,0) [0|1] "" IHU
 SG_ RowSecRiLegRstHeiPosPercSeatPosPerc : 417|10@0+ (0.1,0.0) [0.0|100.0] "%" IHU
 SG_ RowSecRiLegRstHeiPosPercSeatPosQf : 419|2@0+ (1,0) [0|3] "" IHU
 SG_ RowSecRiLegRstLenPosPerc_UB : 443|1@0+ (1,0) [0|1] "" IHU
 SG_ RowSecRiLegRstLenPosPercSeatPosPerc : 439|10@0+ (0.1,0.0) [0.0|100.0] "%" IHU
 SG_ RowSecRiLegRstLenPosPercSeatPosQf : 445|2@0+ (1,0) [0|3] "" IHU
 SG_ RowSecRiSeatRotPosPerc : 463|8@0- (1.0,0.0) [-128.0|127.0] "Unitless" IHU,ZCUP
 SG_ RowSecRiSeatRotPosPerc_UB : 441|1@0+ (1,0) [0|1] "" IHU,ZCUP
 SG_ RowSecRiSldPosPerc_UB : 340|1@0+ (1,0) [0|1] "" IHU
 SG_ RowSecRiSldPosPercSeatPosPerc : 321|10@0+ (0.1,0.0) [0.0|100.0] "%" IHU
 SG_ RowSecRiSldPosPercSeatPosQf : 323|2@0+ (1,0) [0|3] "" IHU
 SG_ SteerWhlBtnPsd : 339|1@0+ (1,0) [0|1] "" IHU
 SG_ SteerWhlBtnPsd_UB : 338|1@0+ (1,0) [0|1] "" IHU
 SG_ SteerWhlInMovmt : 337|1@0+ (1,0) [0|1] "" IHU
 SG_ SteerWhlInMovmt_UB : 336|1@0+ (1,0) [0|1] "" IHU
 SG_ SteerWhlSnsr_UB : 43|1@0+ (1,0) [0|1] "" IHU,ZCUP
 SG_ SteerWhlSnsrAg : 78|15@0- (0.0009765625,0.0) [-14.5|14.5] "rad" IHU,ZCUP
 SG_ SteerWhlSnsrAgSpd : 103|14@0- (0.0078125,0.0) [-50.0|50.0] "rad/s" IHU,ZCUP
 SG_ SteerWhlSnsrChks : 95|8@0+ (1.0,0.0) [0.0|255.0] "Unitless" IHU,ZCUP
 SG_ SteerWhlSnsrCntr : 119|4@0+ (1.0,0.0) [0.0|15.0] "Unitless" IHU,ZCUP
 SG_ SteerWhlSnsrQf : 105|2@0+ (1,0) [0|3] "" IHU,ZCUP
 SG_ TrRelsFailtoHMI : 79|1@0+ (1,0) [0|1] "" IHU
 SG_ TrRelsFailtoHMI_UB : 44|1@0+ (1,0) [0|1] "" IHU
 SG_ WadeProtnSts : 149|1@0+ (1,0) [0|1] "" IHU,ZCUP
 SG_ WadeProtnSts_UB : 148|1@0+ (1,0) [0|1] "" IHU,ZCUP
 SG_ WhlFailrSts : 351|8@0+ (1.0,0.0) [0.0|255.0] "Unitless" IHU
 SG_ WhlFailrSts_UB : 168|1@0+ (1,0) [0|1] "" IHU
 SG_ WinSwtReq_UB : 396|1@0+ (1,0) [0|1] "" IHU,ZCUP
 SG_ WinSwtReqChks : 375|8@0+ (1.0,0.0) [0.0|255.0] "Unitless" IHU,ZCUP
 SG_ WinSwtReqCntr : 383|4@0+ (1.0,0.0) [0.0|15.0] "Unitless" IHU,ZCUP
 SG_ WinSwtReqFrntLe : 379|3@0+ (1,0) [0|7] "" IHU,ZCUP
 SG_ WinSwtReqFrntRi : 391|3@0+ (1,0) [0|7] "" IHU,ZCUP
 SG_ WinSwtReqReLe : 388|3@0+ (1,0) [0|7] "" IHU,ZCUP
 SG_ WinSwtReqReRi : 399|3@0+ (1,0) [0|7] "" IHU,ZCUP

BO_ 312 ZCUDZCUCANFD2Fr07 : 64 ZCUD
 SG_ ActvnOfPasSideDoorIllmn : 7|8@0+ (1.0,0.0) [0.0|100.0] "%" IHU,ZCUP
 SG_ ActvnOfPasSideDoorIllmn_UB : 91|1@0+ (1,0) [0|1] "" IHU,ZCUP
 SG_ ActvnOfPasSideStepIllmn : 15|8@0+ (1.0,0.0) [0.0|100.0] "%" IHU,ZCUP
 SG_ ActvnOfPasSideStepIllmn_UB : 90|1@0+ (1,0) [0|1] "" IHU,ZCUP
 SG_ ActvnOfRePasDoorIllmn : 23|8@0+ (1.0,0.0) [0.0|100.0] "%" IHU,ZCUP
 SG_ ActvnOfRePasDoorIllmn_UB : 89|1@0+ (1,0) [0|1] "" IHU,ZCUP
 SG_ ActvnOfRePasSideStepIllmn : 31|8@0+ (1.0,0.0) [0.0|100.0] "%" IHU,ZCUP
 SG_ ActvnOfRePasSideStepIllmn_UB : 88|1@0+ (1,0) [0|1] "" IHU,ZCUP
 SG_ ActvnOfSwtIllmnSply : 39|8@0+ (1.0,0.0) [0.0|100.0] "%" IHU,ZCUP
 SG_ ActvnOfSwtIllmnSply_UB : 359|1@0+ (1,0) [0|1] "" IHU,ZCUP
 SG_ AntithftActvnNotif : 47|1@0+ (1,0) [0|1] "" IHU
 SG_ AntithftActvnNotif_UB : 358|1@0+ (1,0) [0|1] "" IHU
 SG_ BattCooltIndcnReq : 46|1@0+ (1,0) [0|1] "" IHU
 SG_ BattCooltIndcnReq_UB : 357|1@0+ (1,0) [0|1] "" IHU
 SG_ BattSocRaw : 409|10@0+ (0.1,0.0) [0.0|100.0] "%" IHU
 SG_ BattSocRaw_UB : 438|1@0+ (1,0) [0|1] "" IHU
 SG_ BattURaw : 431|9@0+ (0.025,5.0) [5.0|17.775] "Volt" IHU
 SG_ BattURaw_UB : 437|1@0+ (1,0) [0|1] "" IHU
 SG_ BrkBoostErrIndcnReq : 281|1@0+ (1,0) [0|1] "" IHU
 SG_ BrkBoostErrIndcnReq_UB : 280|1@0+ (1,0) [0|1] "" IHU
 SG_ ChrgnByEngStsDurgDcha : 75|3@0+ (1,0) [0|7] "" IHU
 SG_ ChrgnByEngStsDurgDcha_UB : 353|1@0+ (1,0) [0|1] "" IHU
 SG_ ChrgnWarn : 212|1@0+ (1,0) [0|1] "" IHU
 SG_ ChrgnWarn_UB : 211|1@0+ (1,0) [0|1] "" IHU
 SG_ DispElecPwr_UB : 92|1@0+ (1,0) [0|1] "" IHU
 SG_ DispElecPwrAbs : 87|10@0+ (0.5,0.0) [0.0|511.0] "kW" IHU
 SG_ DispElecPwrSts : 93|1@0+ (1,0) [0|1] "" IHU
 SG_ DispOfBrkPwrPercRgnMin : 471|10@0- (0.1,-50.0) [-100.0|1.1000000000000014] "%" IHU
 SG_ DispOfBrkPwrPercRgnMin_UB : 210|1@0+ (1,0) [0|1] "" IHU
 SG_ DispOfPrpsnPwrPercElecMax : 473|10@0+ (0.1,0.0) [0.0|102.30000000000001] "%" IHU
 SG_ DispOfPrpsnPwrPercElecMax_UB : 209|1@0+ (1,0) [0|1] "" IHU
 SG_ DoorDrvrCinhIntFailInf_UB : 285|1@0+ (1,0) [0|1] "" IHU
 SG_ DoorDrvrCinhIntFailInfCinchFlt1 : 287|1@0+ (1,0) [0|1] "" IHU
 SG_ DoorDrvrCinhIntFailInfCinchRestFlt : 286|1@0+ (1,0) [0|1] "" IHU
 SG_ DoorDrvrRelsFail_UB : 292|1@0+ (1,0) [0|1] "" IHU
 SG_ DoorDrvrRelsFailCinchOverTimed : 295|1@0+ (1,0) [0|1] "" IHU
 SG_ DoorDrvrRelsFailFailure1 : 294|1@0+ (1,0) [0|1] "" IHU
 SG_ DoorDrvrRelsFailMechRels : 293|1@0+ (1,0) [0|1] "" IHU
 SG_ DoorLeReCinhIntFailInf_UB : 282|1@0+ (1,0) [0|1] "" IHU
 SG_ DoorLeReCinhIntFailInfCinchFlt1 : 284|1@0+ (1,0) [0|1] "" IHU
 SG_ DoorLeReCinhIntFailInfCinchRestFlt : 283|1@0+ (1,0) [0|1] "" IHU
 SG_ DoorLeReRelsFail_UB : 288|1@0+ (1,0) [0|1] "" IHU
 SG_ DoorLeReRelsFailCinchOverTimed : 291|1@0+ (1,0) [0|1] "" IHU
 SG_ DoorLeReRelsFailFailure1 : 290|1@0+ (1,0) [0|1] "" IHU
 SG_ DoorLeReRelsFailMechRels : 289|1@0+ (1,0) [0|1] "" IHU
 SG_ DrvrSeatActvSpplFct : 142|3@0+ (1,0) [0|7] "" IHU
 SG_ DrvrSeatActvSpplFct_UB : 139|1@0+ (1,0) [0|1] "" IHU
 SG_ DrvrSeatBtnPsd : 67|1@0+ (1,0) [0|1] "" IHU
 SG_ DrvrSeatBtnPsd_UB : 66|1@0+ (1,0) [0|1] "" IHU
 SG_ DrvrSeatExtAdjAllowd : 65|1@0+ (1,0) [0|1] "" IHU
 SG_ DrvrSeatExtAdjAllowd_UB : 64|1@0+ (1,0) [0|1] "" IHU
 SG_ DrvrSeatHeatgLvlSts : 79|2@0+ (1,0) [0|3] "" IHU,ZCUP
 SG_ DrvrSeatHeatgLvlSts_UB : 72|1@0+ (1,0) [0|1] "" IHU,ZCUP
 SG_ DrvrSeatSwtSts_UB : 138|1@0+ (1,0) [0|1] "" IHU
 SG_ DrvrSeatSwtStsDrvrSeatSwtAdjmtOfSpplFctHozlSts : 137|2@0+ (1,0) [0|3] "" IHU
 SG_ DrvrSeatSwtStsDrvrSeatSwtAdjmtOfSpplFctVertSts : 151|2@0+ (1,0) [0|3] "" IHU
 SG_ DrvrSeatSwtStsDrvrSeatSwtHdrstHozlSts : 149|2@0+ (1,0) [0|3] "" IHU
 SG_ DrvrSeatSwtStsDrvrSeatSwtHdrstVertSts : 147|2@0+ (1,0) [0|3] "" IHU
 SG_ DrvrSeatSwtStsDrvrSeatSwtHeiFrntSts : 145|2@0+ (1,0) [0|3] "" IHU
 SG_ DrvrSeatSwtStsDrvrSeatSwtHeiSts : 159|2@0+ (1,0) [0|3] "" IHU
 SG_ DrvrSeatSwtStsDrvrSeatSwtInclSts : 157|2@0+ (1,0) [0|3] "" IHU
 SG_ DrvrSeatSwtStsDrvrSeatSwtSelnOfSpplFctSts : 155|2@0+ (1,0) [0|3] "" IHU
 SG_ DrvrSeatSwtStsDrvrSeatSwtSldSts : 153|2@0+ (1,0) [0|3] "" IHU
 SG_ DrvrSeatVentAvlSts : 498|3@0+ (1,0) [0|7] "" IHU,ZCUP
 SG_ DrvrSeatVentAvlSts_UB : 511|1@0+ (1,0) [0|1] "" IHU,ZCUP
 SG_ DstEstimdToEmptyForTarSoc1 : 495|10@0+ (1.0,0.0) [0.0|1023.0] "KiloMtr" IHU
 SG_ DstEstimdToEmptyForTarSoc1_UB : 208|1@0+ (1,0) [0|1] "" IHU
 SG_ DstEstimdToEmptyForTarSoc2 : 103|10@0+ (1.0,0.0) [0.0|1023.0] "KiloMtr" IHU
 SG_ DstEstimdToEmptyForTarSoc2_UB : 109|1@0+ (1,0) [0|1] "" IHU
 SG_ DstTrvldFromBodyBkp : 167|21@0+ (1.0,0.0) [0.0|2000000.0] "km" IHU
 SG_ DstTrvldFromBodyBkp_UB : 178|1@0+ (1,0) [0|1] "" IHU
 SG_ DstTrvldVldFromBodyBkp : 177|1@0+ (1,0) [0|1] "" IHU
 SG_ DstTrvldVldFromBodyBkp_UB : 176|1@0+ (1,0) [0|1] "" IHU
 SG_ EgyRegenEgyAct : 191|13@0+ (20.0,0.0) [0.0|163820.0] "Wh" IHU
 SG_ EgyRegenEgyAct_UB : 352|1@0+ (1,0) [0|1] "" IHU
 SG_ EngCooltIndcnReq : 45|4@0+ (1,0) [0|15] "" IHU
 SG_ EngCooltIndcnReq_UB : 41|1@0+ (1,0) [0|1] "" IHU
 SG_ EngCooltTPercForDisp : 462|7@0+ (1.0,0.0) [0.0|100.0] "%" IHU
 SG_ EngCooltTPercForDisp_UB : 355|1@0+ (1,0) [0|1] "" IHU
 SG_ EngFltIndcn_UB : 411|1@0+ (1,0) [0|1] "" IHU
 SG_ EngFltIndcn1 : 319|1@0+ (1,0) [0|1] "" IHU
 SG_ EngFltIndcn10 : 318|1@0+ (1,0) [0|1] "" IHU
 SG_ EngFltIndcn11 : 317|1@0+ (1,0) [0|1] "" IHU
 SG_ EngFltIndcn12 : 316|1@0+ (1,0) [0|1] "" IHU
 SG_ EngFltIndcn13 : 315|1@0+ (1,0) [0|1] "" IHU
 SG_ EngFltIndcn14 : 314|1@0+ (1,0) [0|1] "" IHU
 SG_ EngFltIndcn15 : 313|1@0+ (1,0) [0|1] "" IHU
 SG_ EngFltIndcn16 : 312|1@0+ (1,0) [0|1] "" IHU
 SG_ EngFltIndcn17 : 327|1@0+ (1,0) [0|1] "" IHU
 SG_ EngFltIndcn18 : 326|1@0+ (1,0) [0|1] "" IHU
 SG_ EngFltIndcn19 : 325|1@0+ (1,0) [0|1] "" IHU
 SG_ EngFltIndcn2 : 324|1@0+ (1,0) [0|1] "" IHU
 SG_ EngFltIndcn20 : 323|1@0+ (1,0) [0|1] "" IHU
 SG_ EngFltIndcn21 : 322|1@0+ (1,0) [0|1] "" IHU
 SG_ EngFltIndcn22 : 321|1@0+ (1,0) [0|1] "" IHU
 SG_ EngFltIndcn23 : 320|1@0+ (1,0) [0|1] "" IHU
 SG_ EngFltIndcn24 : 335|1@0+ (1,0) [0|1] "" IHU
 SG_ EngFltIndcn25 : 334|1@0+ (1,0) [0|1] "" IHU
 SG_ EngFltIndcn26 : 333|1@0+ (1,0) [0|1] "" IHU
 SG_ EngFltIndcn27 : 332|1@0+ (1,0) [0|1] "" IHU
 SG_ EngFltIndcn3 : 331|1@0+ (1,0) [0|1] "" IHU
 SG_ EngFltIndcn4 : 330|1@0+ (1,0) [0|1] "" IHU
 SG_ EngFltIndcn5 : 329|1@0+ (1,0) [0|1] "" IHU
 SG_ EngFltIndcn6 : 328|1@0+ (1,0) [0|1] "" IHU
 SG_ EngFltIndcn7 : 343|1@0+ (1,0) [0|1] "" IHU
 SG_ EngFltIndcn8 : 342|1@0+ (1,0) [0|1] "" IHU
 SG_ EngFltIndcn9 : 341|1@0+ (1,0) [0|1] "" IHU
 SG_ EngOilLvl : 255|8@0+ (0.5,0.0) [0.0|120.0] "%" IHU
 SG_ EngOilLvl_UB : 474|1@0+ (1,0) [0|1] "" IHU
 SG_ EngOilLvlSts : 194|3@0+ (1,0) [0|7] "" IHU
 SG_ EngOilLvlSts_UB : 410|1@0+ (1,0) [0|1] "" IHU
 SG_ EngOilPWarn : 400|1@0+ (1,0) [0|1] "" IHU
 SG_ EngOilPWarn_UB : 415|1@0+ (1,0) [0|1] "" IHU
 SG_ ExtLiShwDwnldSts : 122|2@0+ (1,0) [0|3] "" IHU
 SG_ ExtLiShwDwnldSts_UB : 120|1@0+ (1,0) [0|1] "" IHU
 SG_ ExtrLiShowActvnSts_UB : 340|1@0+ (1,0) [0|1] "" IHU
 SG_ ExtrLiShowActvnStsExtrLiShowActvnFrntLeFb : 339|2@0+ (1,0) [0|3] "" IHU
 SG_ ExtrLiShowActvnStsExtrLiShowActvnFrntRiFb : 337|2@0+ (1,0) [0|3] "" IHU
 SG_ ExtrLiShowActvnStsExtrLiShowActvnReLe2Fb : 351|2@0+ (1,0) [0|3] "" IHU
 SG_ ExtrLiShowActvnStsExtrLiShowActvnReLeFb : 349|2@0+ (1,0) [0|3] "" IHU
 SG_ ExtrLiShowActvnStsExtrLiShowActvnReRi2Fb : 347|2@0+ (1,0) [0|3] "" IHU
 SG_ ExtrLiShowActvnStsExtrLiShowActvnReRiFb : 345|2@0+ (1,0) [0|3] "" IHU
 SG_ FrntWiprLvrCmd2_UB : 264|1@0+ (1,0) [0|1] "" IHU
 SG_ FrntWiprLvrCmd2FrntWiprLvrCmd1 : 271|3@0+ (1,0) [0|7] "" IHU
 SG_ FrntWiprLvrCmd2FrntWiprLvrCntr : 268|2@0+ (1.0,0.0) [0.0|3.0] "Unitless" IHU
 SG_ FrntWiprLvrCmd2FrntWiprLvrCrc : 263|8@0+ (1.0,0.0) [0.0|255.0] "Unitless" IHU
 SG_ FrntWiprLvrCmd2FrntWiprLvrQf : 266|2@0+ (1,0) [0|3] "" IHU
 SG_ HmiEngHybSts : 55|3@0+ (1,0) [0|7] "" IHU
 SG_ HmiEngHybSts_UB : 40|1@0+ (1,0) [0|1] "" IHU
 SG_ HmiFuLidNotClsd : 52|1@0+ (1,0) [0|1] "" IHU
 SG_ HmiFuLidNotClsd_UB : 354|1@0+ (1,0) [0|1] "" IHU
 SG_ HmiFuLidOpenSts : 51|1@0+ (1,0) [0|1] "" IHU
 SG_ HmiFuLidOpenSts_UB : 50|1@0+ (1,0) [0|1] "" IHU
 SG_ HmiFuTankRdy : 49|2@0+ (1,0) [0|3] "" IHU
 SG_ HmiFuTankRdy_UB : 63|1@0+ (1,0) [0|1] "" IHU
 SG_ HmiVehStopForRefu : 62|1@0+ (1,0) [0|1] "" IHU
 SG_ HmiVehStopForRefu_UB : 61|1@0+ (1,0) [0|1] "" IHU
 SG_ HpBattVlvPosRec : 207|10@0+ (0.1,0.0) [0.0|100.0] "%" IHU,ZCUP
 SG_ HpBattVlvPosRec_UB : 213|1@0+ (1,0) [0|1] "" IHU,ZCUP
 SG_ HudSnsrErr_UB : 104|1@0+ (1,0) [0|1] "" IHU
 SG_ HudSnsrErrParChk : 106|1@0+ (1,0) [0|1] "" IHU
 SG_ HudSnsrErrSnsrErr : 105|1@0+ (1,0) [0|1] "" IHU
 SG_ HvBattSoc : 239|11@0+ (0.05,0.0) [0.0|100.0] "%" Vector__XXX
 SG_ HvBattSoc_UB : 392|1@0+ (1,0) [0|1] "" Vector__XXX
 SG_ HvClimaCmd : 405|2@0+ (1,0) [0|3] "" IHU,ZCUP
 SG_ HvClimaCmd_UB : 403|1@0+ (1,0) [0|1] "" IHU,ZCUP
 SG_ IntrBriSts : 507|4@0+ (1.0,0.0) [0.0|15.0] "Unitless" Vector__XXX
 SG_ IntrBriSts_UB : 508|1@0+ (1,0) [0|1] "" Vector__XXX
 SG_ IsgInvrT : 231|8@0+ (1.0,-50.0) [-50.0|200.0] "degC" IHU
 SG_ IsgInvrT_UB : 477|1@0+ (1,0) [0|1] "" IHU
 SG_ IsgMotT : 447|8@0+ (1.0,-50.0) [-50.0|200.0] "degC" IHU,ZCUP
 SG_ IsgMotT_UB : 432|1@0+ (1,0) [0|1] "" IHU,ZCUP
 SG_ LockgPrsnlSts : 402|1@0+ (1,0) [0|1] "" IHU
 SG_ LockgPrsnlSts_UB : 401|1@0+ (1,0) [0|1] "" IHU
 SG_ LVPwrSplyErrSts : 244|4@0+ (1,0) [0|15] "" IHU,ZCUP
 SG_ LVPwrSplyErrSts_UB : 240|1@0+ (1,0) [0|1] "" IHU,ZCUP
 SG_ ObdAccrPedRat : 223|8@0+ (0.3921568628,0.0) [0.0|100.00000001400001] "%" IHU
 SG_ ObdAccrPedRat_UB : 356|1@0+ (1,0) [0|1] "" IHU
 SG_ OilMntnAlrmSt : 455|4@0+ (1,0) [0|15] "" IHU
 SG_ OilMntnAlrmSt_UB : 451|1@0+ (1,0) [0|1] "" IHU
 SG_ RecOfImpct_UB : 393|1@0+ (1,0) [0|1] "" IHU
 SG_ RecOfImpctCrashFrnt : 367|1@0+ (1,0) [0|1] "" IHU
 SG_ RecOfImpctCrashOffroadA : 366|1@0+ (1,0) [0|1] "" IHU
 SG_ RecOfImpctCrashOffroadD : 365|1@0+ (1,0) [0|1] "" IHU
 SG_ RecOfImpctCrashOffroadRT : 364|1@0+ (1,0) [0|1] "" IHU
 SG_ RecOfImpctCrashOffroadRTsevere : 363|1@0+ (1,0) [0|1] "" IHU
 SG_ RecOfImpctCrashPed : 362|1@0+ (1,0) [0|1] "" IHU
 SG_ RecOfImpctCrashRe : 361|1@0+ (1,0) [0|1] "" IHU
 SG_ RecOfImpctCrashRollovr : 360|1@0+ (1,0) [0|1] "" IHU
 SG_ RecOfImpctCrashSideLe : 375|1@0+ (1,0) [0|1] "" IHU
 SG_ RecOfImpctCrashSideRi : 399|1@0+ (1,0) [0|1] "" IHU
 SG_ RecOfImpctCrashState : 398|2@0+ (1,0) [0|3] "" IHU
 SG_ RecOfImpctImpctDvx : 383|8@0+ (1.0,0.0) [0.0|255.0] "Km/h" IHU
 SG_ RecOfImpctImpctDvy : 391|8@0+ (1.0,0.0) [0.0|255.0] "Km/h" IHU
 SG_ RecOfImpctImpctRollAg : 374|7@0+ (15.0,0.0) [0.0|1905.0] "Deg" IHU
 SG_ RecOfImpctVehOri : 396|3@0+ (1,0) [0|7] "" IHU
 SG_ RlyPwrDistbnCmd1WdBattSaveCmd : 510|1@0+ (1,0) [0|1] "" ZCUP
 SG_ RlyPwrDistbnCmd1WdBattSaveCmd_UB : 509|1@0+ (1,0) [0|1] "" ZCUP
 SG_ SolarSnsrLeValue : 303|8@0+ (5.0,0.0) [0.0|1275.0] "W/m2" IHU
 SG_ SolarSnsrLeValue_UB : 414|1@0+ (1,0) [0|1] "" IHU
 SG_ SolarSnsrRiValue : 311|8@0+ (5.0,0.0) [0.0|1275.0] "W/m2" IHU
 SG_ SolarSnsrRiValue_UB : 413|1@0+ (1,0) [0|1] "" IHU
 SG_ SteerLockWarnIndcn : 475|1@0+ (1,0) [0|1] "" IHU
 SG_ SteerLockWarnIndcn_UB : 476|1@0+ (1,0) [0|1] "" IHU
 SG_ SteerWhlHeatgLvlSts : 501|2@0+ (1,0) [0|3] "" IHU
 SG_ SteerWhlHeatgLvlSts_UB : 499|1@0+ (1,0) [0|1] "" IHU
 SG_ StopStrtStbIndcn : 60|3@0+ (1,0) [0|7] "" IHU
 SG_ StopStrtStbIndcn_UB : 77|1@0+ (1,0) [0|1] "" IHU
 SG_ StrtColdIndcnMsg : 57|2@0+ (1,0) [0|3] "" IHU
 SG_ StrtColdIndcnMsg_UB : 76|1@0+ (1,0) [0|1] "" IHU
 SG_ StrtMsgToModMngt : 71|3@0+ (1,0) [0|7] "" IHU
 SG_ StrtMsgToModMngt_UB : 68|1@0+ (1,0) [0|1] "" IHU
 SG_ SunCurtImpctDetnSts2 : 436|3@0+ (1,0) [0|7] "" IHU
 SG_ SunCurtImpctDetnSts2_UB : 433|1@0+ (1,0) [0|1] "" IHU
 SG_ TCSTmrOverSts : 279|5@0+ (1.0,0.0) [0.0|31.0] "hours" IHU
 SG_ TCSTmrOverSts_UB : 274|1@0+ (1,0) [0|1] "" IHU
 SG_ TCSTmrStrtSts : 273|2@0+ (1,0) [0|3] "" IHU
 SG_ TCSTmrStrtSts_UB : 123|1@0+ (1,0) [0|1] "" IHU
 SG_ TelltlPwrLoss : 108|1@0+ (1,0) [0|1] "" IHU
 SG_ TelltlPwrLoss_UB : 107|1@0+ (1,0) [0|1] "" IHU
 SG_ TrlrLiTurnIndcrActvt : 407|2@0+ (1,0) [0|3] "" IHU
 SG_ TrlrLiTurnIndcrActvt_UB : 412|1@0+ (1,0) [0|1] "" IHU
 SG_ WiprInPosnForSrv : 450|1@0+ (1,0) [0|1] "" IHU
 SG_ WiprInPosnForSrv_UB : 449|1@0+ (1,0) [0|1] "" IHU
 SG_ WiprReInPosnForSrv : 448|1@0+ (1,0) [0|1] "" IHU
 SG_ WiprReInPosnForSrv_UB : 463|1@0+ (1,0) [0|1] "" IHU

BO_ 288 ZCUDZCUCANFD2Fr08 : 64 ZCUD
 SG_ AirPtcHVPwrActl : 7|8@0+ (20.0,0.0) [0.0|5100.0] "W" IHU,ZCUP
 SG_ AirPtcHVPwrActl_UB : 58|1@0+ (1,0) [0|1] "" IHU,ZCUP
 SG_ AlcoLockMgrWarnlndcn : 15|5@0+ (1,0) [0|31] "" IHU
 SG_ AlcoLockMgrWarnlndcn_UB : 57|1@0+ (1,0) [0|1] "" IHU
 SG_ BattFltStsPrim_UB : 276|1@0+ (1,0) [0|1] "" IHU,ZCUP
 SG_ BattFltStsPrimBattFltStsPrm : 311|4@0+ (1,0) [0|15] "" IHU,ZCUP
 SG_ BattFltStsPrimChks : 319|8@0+ (1.0,0.0) [0.0|255.0] "Unitless" IHU,ZCUP
 SG_ BattFltStsPrimCntr : 307|4@0+ (1.0,0.0) [0.0|15.0] "Unitless" IHU,ZCUP
 SG_ BookTrvlChrgnFb : 23|2@0+ (1,0) [0|3] "" IHU
 SG_ BookTrvlChrgnFb_UB : 76|1@0+ (1,0) [0|1] "" IHU
 SG_ BookTrvlChrgnSts : 9|1@0+ (1,0) [0|1] "" IHU
 SG_ BookTrvlChrgnSts_UB : 10|1@0+ (1,0) [0|1] "" IHU
 SG_ CarLoctrHornLiSetActv : 21|2@0+ (1,0) [0|3] "" IHU
 SG_ CarLoctrHornLiSetActv_UB : 74|1@0+ (1,0) [0|1] "" IHU
 SG_ CmptmtFrntWindT : 26|11@0+ (0.1,-40.0) [-40.0|164.70000000000002] "degC" IHU,ZCUP
 SG_ CmptmtFrntWindT_UB : 98|1@0+ (1,0) [0|1] "" IHU,ZCUP
 SG_ CmptmtRelHum : 47|8@0+ (0.5,0.0) [0.0|100.0] "%" IHU,ZCUP
 SG_ CmptmtRelHum_UB : 97|1@0+ (1,0) [0|1] "" IHU,ZCUP
 SG_ DefrstSts_UB : 96|1@0+ (1,0) [0|1] "" IHU,ZCUP
 SG_ DefrstStsMirrDefrst : 55|3@0+ (1,0) [0|7] "" IHU,ZCUP
 SG_ DefrstStsWinDefrstFrnt : 52|3@0+ (1,0) [0|7] "" IHU,ZCUP
 SG_ DefrstStsWinDefrstRe : 63|3@0+ (1,0) [0|7] "" IHU,ZCUP
 SG_ DispOfPrpsnModForEv : 71|4@0+ (1,0) [0|15] "" IHU
 SG_ DispOfPrpsnModForEv_UB : 130|1@0+ (1,0) [0|1] "" IHU
 SG_ DrvrSeatAutMovmtSts : 279|2@0+ (1,0) [0|3] "" IHU
 SG_ DrvrSeatAutMovmtSts_UB : 277|1@0+ (1,0) [0|1] "" IHU
 SG_ EasyInOutPassReq : 261|2@0+ (1,0) [0|3] "" IHU,ZCUP
 SG_ EasyInOutPassReq_UB : 259|1@0+ (1,0) [0|1] "" IHU,ZCUP
 SG_ EPedlModSts : 139|3@0+ (1,0) [0|7] "" IHU
 SG_ EPedlModSts_UB : 136|1@0+ (1,0) [0|1] "" IHU
 SG_ FrntAirPtcHVPwrActl : 257|10@0+ (20.0,0.0) [0.0|20460.0] "W" IHU,ZCUP
 SG_ FrntAirPtcHVPwrActl_UB : 258|1@0+ (1,0) [0|1] "" IHU,ZCUP
 SG_ IgmGeneric_UB : 75|1@0+ (1,0) [0|1] "" IHU
 SG_ IgmGenericADAlrmSt : 247|2@0+ (1,0) [0|3] "" IHU
 SG_ IgmGenericDTCHig : 199|8@0+ (1.0,0.0) [0.0|255.0] "Unitless" IHU
 SG_ IgmGenericDTCLow : 207|8@0+ (1.0,0.0) [0.0|255.0] "Unitless" IHU
 SG_ IgmGenericDTCMid : 215|8@0+ (1.0,0.0) [0.0|255.0] "Unitless" IHU
 SG_ IgmGenericDTCSts : 223|8@0+ (1.0,0.0) [0.0|255.0] "Unitless" IHU
 SG_ IgmGenericEMQnty : 231|4@0+ (1.0,0.0) [0.0|15.0] "Unitless" IHU
 SG_ IgmGenericEMSeqNr : 227|4@0+ (1.0,0.0) [0.0|15.0] "Unitless" IHU
 SG_ IgmGenericFltAlrmSt : 245|2@0+ (1,0) [0|3] "" IHU
 SG_ IgmGenericIacAlrmSt : 243|2@0+ (1,0) [0|3] "" IHU
 SG_ IgmGenericInvrtTAlrmSt : 241|2@0+ (1,0) [0|3] "" IHU
 SG_ IgmGenericModStatusRms : 239|4@0+ (1,0) [0|15] "" IHU
 SG_ IgmGenericMotTAlrmSt : 255|2@0+ (1,0) [0|3] "" IHU
 SG_ IgmGenericRslAlrmSt : 253|2@0+ (1,0) [0|3] "" IHU
 SG_ IgmGenericSpdAlrmSt : 251|2@0+ (1,0) [0|3] "" IHU
 SG_ IgmGenericTypeInfo : 235|4@0+ (1.0,0.0) [0.0|15.0] "Unitless" IHU
 SG_ IgmGenericUDcAlrmSt : 249|2@0+ (1,0) [0|3] "" IHU
 SG_ LockgCenStsForUsrFb : 79|3@0+ (1,0) [0|7] "" IHU
 SG_ LockgCenStsForUsrFb_UB : 132|1@0+ (1,0) [0|1] "" IHU
 SG_ PrpsnMaxEVModBlk : 122|1@0+ (1,0) [0|1] "" IHU
 SG_ PrpsnMaxEVModBlk_UB : 121|1@0+ (1,0) [0|1] "" IHU
 SG_ PrpsnModElecDrvBlkd : 19|3@0+ (1,0) [0|7] "" IHU
 SG_ PrpsnModElecDrvBlkd_UB : 16|1@0+ (1,0) [0|1] "" IHU
 SG_ PrpsnModOffroadBlkd : 31|3@0+ (1,0) [0|7] "" IHU
 SG_ PrpsnModOffroadBlkd_UB : 28|1@0+ (1,0) [0|1] "" IHU
 SG_ PrpsnModOfTracBlkd : 67|3@0+ (1,0) [0|7] "" IHU
 SG_ PrpsnModOfTracBlkd_UB : 64|1@0+ (1,0) [0|1] "" IHU
 SG_ PrpsnModSptBlkd : 187|3@0+ (1,0) [0|7] "" IHU
 SG_ PrpsnModSptBlkd_UB : 184|1@0+ (1,0) [0|1] "" IHU
 SG_ PtModBlkd : 73|2@0+ (1,0) [0|3] "" IHU
 SG_ PtModBlkd_UB : 56|1@0+ (1,0) [0|1] "" IHU
 SG_ RelHumSnsrQf : 127|1@0+ (1,0) [0|1] "" IHU,ZCUP
 SG_ RelHumSnsrQf_UB : 126|1@0+ (1,0) [0|1] "" IHU,ZCUP
 SG_ RemnMilgOfDrvChrg : 274|11@0+ (1.0,0.0) [0.0|2047.0] "KiloMtr" Vector__XXX
 SG_ RemnMilgOfDrvChrg_UB : 275|1@0+ (1,0) [0|1] "" Vector__XXX
 SG_ RemnTiOfDrvChrg : 295|15@0+ (0.1,0.0) [0.0|3076.7000000000003] "Mins" Vector__XXX
 SG_ RemnTiOfDrvChrg_UB : 296|1@0+ (1,0) [0|1] "" Vector__XXX
 SG_ RhahFltIndcnReq : 8|1@0+ (1,0) [0|1] "" ZCUP
 SG_ RhahFltIndcnReq_UB : 27|1@0+ (1,0) [0|1] "" ZCUP
 SG_ SeatOccptAtRowSecDrSide2 : 60|2@0+ (1,0) [0|3] "" IHU,ZCUP
 SG_ SeatOccptAtRowSecDrSide2_UB : 263|1@0+ (1,0) [0|1] "" IHU,ZCUP
 SG_ SeatOccptAtRowSecDrSideSnsSts2 : 141|2@0+ (1,0) [0|3] "" IHU,ZCUP
 SG_ SeatOccptAtRowSecDrSideSnsSts2_UB : 262|1@0+ (1,0) [0|1] "" IHU,ZCUP
 SG_ SteerWhlHeatgDesPwr : 111|8@0+ (1.0,0.0) [0.0|255.0] "Unitless" IHU,ZCUP
 SG_ SteerWhlHeatgDesPwr_UB : 120|1@0+ (1,0) [0|1] "" IHU,ZCUP
 SG_ SteerWhlHeatgPwrAct : 119|8@0+ (1.0,0.0) [0.0|255.0] "Unitless" IHU,ZCUP
 SG_ SteerWhlHeatgPwrAct_UB : 135|1@0+ (1,0) [0|1] "" IHU,ZCUP
 SG_ TrsmN_UB : 131|1@0+ (1,0) [0|1] "" IHU
 SG_ TrsmNChks : 151|8@0+ (1.0,0.0) [0.0|255.0] "Unitless" IHU
 SG_ TrsmNCntr : 191|4@0+ (1.0,0.0) [0.0|15.0] "Unitless" IHU
 SG_ TrsmNInp : 159|15@0+ (0.5,0.0) [0.0|16383.5] "rpm" IHU
 SG_ TrsmNInpOk : 160|1@0+ (1,0) [0|1] "" IHU
 SG_ TrsmNOutp : 175|15@0+ (0.5,0.0) [0.0|16383.5] "rpm" IHU
 SG_ TrsmNOutpOk : 176|1@0+ (1,0) [0|1] "" IHU
 SG_ VehNotParkInfoWarn : 125|2@0+ (1,0) [0|3] "" IHU
 SG_ VehNotParkInfoWarn_UB : 123|1@0+ (1,0) [0|1] "" IHU
 SG_ WinFailrStsAtDrvr : 129|1@0+ (1,0) [0|1] "" IHU
 SG_ WinFailrStsAtDrvr_UB : 128|1@0+ (1,0) [0|1] "" IHU
 SG_ WinFailrStsAtReLe : 143|1@0+ (1,0) [0|1] "" IHU
 SG_ WinFailrStsAtReLe_UB : 142|1@0+ (1,0) [0|1] "" IHU

BO_ 279 ZCUDZCUCANFD2Fr09 : 64 ZCUD
 SG_ ActvnOfTechLiInfoDisp : 2|2@0+ (1,0) [0|3] "" IHU
 SG_ ActvnOfTechLiInfoDisp_UB : 0|1@0+ (1,0) [0|1] "" IHU
 SG_ AdjSpdLimnWarn : 5|2@0+ (1,0) [0|3] "" IHU
 SG_ AdjSpdLimnWarn_UB : 3|1@0+ (1,0) [0|1] "" IHU
 SG_ AutEgyRgnLvlAct : 111|3@0+ (1,0) [0|7] "" IHU
 SG_ AutEgyRgnLvlAct_UB : 97|1@0+ (1,0) [0|1] "" IHU
 SG_ CenLockMacKeyReq : 335|2@0+ (1,0) [0|3] "" IHU
 SG_ CenLockMacKeyReq_UB : 333|1@0+ (1,0) [0|1] "" IHU
 SG_ DoorDrvr2Swt1DplyHndl : 327|1@0+ (1,0) [0|1] "" IHU
 SG_ DoorDrvr2Swt1DplyHndl_UB : 326|1@0+ (1,0) [0|1] "" IHU
 SG_ DoorDrvr2Swt2DplyHndl : 325|1@0+ (1,0) [0|1] "" IHU
 SG_ DoorDrvr2Swt2DplyHndl_UB : 324|1@0+ (1,0) [0|1] "" IHU
 SG_ DoorDrvrLatPosn : 331|2@0+ (1,0) [0|3] "" IHU
 SG_ DoorDrvrLatPosn_UB : 332|1@0+ (1,0) [0|1] "" IHU
 SG_ DoorDrvrRe2Swt1DplyHndl : 323|1@0+ (1,0) [0|1] "" IHU
 SG_ DoorDrvrRe2Swt1DplyHndl_UB : 322|1@0+ (1,0) [0|1] "" IHU
 SG_ DoorDrvrRe2Swt2DplyHndl : 321|1@0+ (1,0) [0|1] "" IHU
 SG_ DoorDrvrRe2Swt2DplyHndl_UB : 320|1@0+ (1,0) [0|1] "" IHU
 SG_ DrvPfmncRedn : 107|4@0+ (1,0) [0|15] "" IHU
 SG_ DrvPfmncRedn_UB : 108|1@0+ (1,0) [0|1] "" IHU
 SG_ DrvrSeatInAutMovmt : 215|1@0+ (1,0) [0|1] "" IHU
 SG_ DrvrSeatInAutMovmt_UB : 214|1@0+ (1,0) [0|1] "" IHU
 SG_ ElecMot2PwrLimMax : 495|10@0+ (0.5,0.0) [0.0|511.0] "kW" IHU
 SG_ ElecMot2PwrLimMax_UB : 501|1@0+ (1,0) [0|1] "" IHU
 SG_ ElecMot2PwrLimMin : 497|10@0+ (0.5,-511.0) [-511.0|0.0] "kW" IHU
 SG_ ElecMot2PwrLimMin_UB : 498|1@0+ (1,0) [0|1] "" IHU
 SG_ EngFuCns : 199|8@0+ (200.0,0.0) [0.0|51000.0] "MicroL" IHU
 SG_ EngFuCns_UB : 210|1@0+ (1,0) [0|1] "" IHU
 SG_ EngFuCnsFild : 207|8@0+ (200.0,0.0) [0.0|51000.0] "MicroL" IHU
 SG_ EngFuCnsFild_UB : 208|1@0+ (1,0) [0|1] "" IHU
 SG_ EpbDrvrDispSec : 243|4@0+ (1,0) [0|15] "" IHU
 SG_ EpbDrvrDispSec_UB : 211|1@0+ (1,0) [0|1] "" IHU
 SG_ FbOfMusicShow : 15|2@0+ (1,0) [0|3] "" IHU
 SG_ FbOfMusicShow_UB : 13|1@0+ (1,0) [0|1] "" IHU
 SG_ FltEgyRstECUReq : 35|1@0+ (1,0) [0|1] "" IHU
 SG_ FltEgyRstECUReq_UB : 34|1@0+ (1,0) [0|1] "" IHU
 SG_ FltEgyRstRecReq : 33|1@0+ (1,0) [0|1] "" IHU
 SG_ FltEgyRstRecReq_UB : 32|1@0+ (1,0) [0|1] "" IHU
 SG_ FrntSunCurtMvngSts : 295|1@0+ (1,0) [0|1] "" IHU
 SG_ FrntSunCurtMvngSts_UB : 294|1@0+ (1,0) [0|1] "" IHU
 SG_ FrntSunCurtPosnSts : 292|5@0+ (1,0) [0|31] "" IHU
 SG_ FrntSunCurtPosnSts_UB : 293|1@0+ (1,0) [0|1] "" IHU
 SG_ HvBattLimnIndcn : 279|16@0+ (1.0,0.0) [0.0|65535.0] "Unitless" ZCUP
 SG_ HvBattLimnIndcn_UB : 270|1@0+ (1,0) [0|1] "" ZCUP
 SG_ IceBreakDoorDrvrActv : 329|1@0+ (1,0) [0|1] "" IHU
 SG_ IceBreakDoorDrvrActv_UB : 328|1@0+ (1,0) [0|1] "" IHU
 SG_ IceBreakDoorLeReActv : 260|1@0+ (1,0) [0|1] "" IHU,ZCUP
 SG_ IceBreakDoorLeReActv_UB : 259|1@0+ (1,0) [0|1] "" IHU,ZCUP
 SG_ IsgTqAct_UB : 209|1@0+ (1,0) [0|1] "" IHU
 SG_ IsgTqActChks : 239|8@0+ (1.0,0.0) [0.0|255.0] "Unitless" IHU
 SG_ IsgTqActCntr : 247|4@0+ (1.0,0.0) [0.0|15.0] "Unitless" IHU
 SG_ IsgTqActIsgTqAct : 223|14@0+ (1.0,-8188.0) [-8188.0|8192.0] "NewtonMeter" IHU
 SG_ IsgTqActQualityFactor : 225|2@0+ (1,0) [0|3] "" IHU
 SG_ LnchModSts : 115|3@0+ (1,0) [0|7] "" IHU
 SG_ LnchModSts_UB : 112|1@0+ (1,0) [0|1] "" IHU
 SG_ LowrTailgSts : 269|2@0+ (1,0) [0|3] "" IHU
 SG_ LowrTailgSts_UB : 312|1@0+ (1,0) [0|1] "" IHU
 SG_ MirrAtDrvrInMovmt : 213|1@0+ (1,0) [0|1] "" IHU
 SG_ MirrAtDrvrInMovmt_UB : 212|1@0+ (1,0) [0|1] "" IHU
 SG_ MirrBtnPsdAtDrvr : 70|1@0+ (1,0) [0|1] "" IHU
 SG_ MirrBtnPsdAtDrvr_UB : 69|1@0+ (1,0) [0|1] "" IHU
 SG_ MirrCmdAtPass_UB : 79|1@0+ (1,0) [0|1] "" IHU,ZCUP
 SG_ MirrCmdAtPassMirrDwnCmd : 78|2@0+ (1,0) [0|3] "" IHU,ZCUP
 SG_ MirrCmdAtPassMirrFoldCmd : 76|2@0+ (1,0) [0|3] "" IHU,ZCUP
 SG_ MirrCmdAtPassMirrPosAdjCmd : 74|3@0+ (1,0) [0|7] "" IHU,ZCUP
 SG_ MirrPosnToSetTarPosnAtDrvr_UB : 454|1@0+ (1,0) [0|1] "" IHU
 SG_ MirrPosnToSetTarPosnAtDrvrMirrAdjLeRi : 453|14@0+ (1.0,0.0) [0.0|10000.0] "Unitless" IHU
 SG_ MirrPosnToSetTarPosnAtDrvrMirrAdjUpDown : 471|14@0+ (1.0,0.0) [0.0|10000.0] "Unitless" IHU
 SG_ OpenDrvrReSwt : 258|1@0+ (1,0) [0|1] "" IHU,ZCUP
 SG_ OpenDrvrReSwt_UB : 257|1@0+ (1,0) [0|1] "" IHU,ZCUP
 SG_ OpenDrvrSwt : 256|1@0+ (1,0) [0|1] "" IHU,ZCUP
 SG_ OpenDrvrSwt_UB : 271|1@0+ (1,0) [0|1] "" IHU,ZCUP
 SG_ PassAirbLampReq_UB : 38|1@0+ (1,0) [0|1] "" IHU
 SG_ PassAirbLampReqChgOfPassAirbSts : 39|1@0+ (1,0) [0|1] "" IHU
 SG_ PassAirbLampReqChks : 23|8@0+ (1.0,0.0) [0.0|255.0] "Unitless" IHU
 SG_ PassAirbLampReqCntr : 31|4@0+ (1.0,0.0) [0.0|15.0] "Unitless" IHU
 SG_ PassAirbLampReqPassAirbLampDiReq : 27|2@0+ (1,0) [0|3] "" IHU
 SG_ PassAirbLampReqPassAirbLampEnaReq : 25|2@0+ (1,0) [0|3] "" IHU
 SG_ PtGearAct : 119|4@0+ (1,0) [0|15] "" IHU
 SG_ PtGearAct_UB : 96|1@0+ (1,0) [0|1] "" IHU
 SG_ PtTqAtWhlReAct_UB : 176|1@0+ (1,0) [0|1] "" IHU
 SG_ PtTqAtWhlReActChks : 175|8@0+ (1.0,0.0) [0.0|255.0] "Unitless" IHU
 SG_ PtTqAtWhlReActCntr : 183|4@0+ (1.0,0.0) [0.0|15.0] "Unitless" IHU
 SG_ PtTqAtWhlReActPtTqAtAxleReAct : 127|16@0- (1.0,0.0) [-20000.0|20000.0] "NewtonMeter" IHU
 SG_ PtTqAtWhlReActPtTqAtWhlReLeAct : 143|16@0- (1.0,0.0) [-20000.0|20000.0] "NewtonMeter" IHU
 SG_ PtTqAtWhlReActPtTqAtWhlReRiAct : 159|16@0- (1.0,0.0) [-20000.0|20000.0] "NewtonMeter" IHU
 SG_ PtTqAtWhlReActPtTqAtWhlsReQly : 179|3@0+ (1,0) [0|7] "" IHU
 SG_ ReSunCurtMvngSts : 303|1@0+ (1,0) [0|1] "" IHU
 SG_ ReSunCurtMvngSts_UB : 302|1@0+ (1,0) [0|1] "" IHU
 SG_ ReSunCurtPosnSts : 300|5@0+ (1,0) [0|31] "" IHU
 SG_ ReSunCurtPosnSts_UB : 301|1@0+ (1,0) [0|1] "" IHU
 SG_ RowSecLeSeatAdjmtCllsnWarn : 423|1@0+ (1,0) [0|1] "" IHU
 SG_ RowSecLeSeatAdjmtCllsnWarn_UB : 422|1@0+ (1,0) [0|1] "" IHU
 SG_ RowSecLeSeatAdjmtLimnWarn : 421|1@0+ (1,0) [0|1] "" IHU
 SG_ RowSecLeSeatAdjmtLimnWarn_UB : 420|1@0+ (1,0) [0|1] "" IHU
 SG_ RowSecLeSeatRotAvlSts : 419|1@0+ (1,0) [0|1] "" IHU
 SG_ RowSecLeSeatRotAvlSts_UB : 418|1@0+ (1,0) [0|1] "" IHU
 SG_ RowSecLeSeatRotFailFb : 416|9@0+ (1.0,0.0) [0.0|511.0] "Unitless" IHU
 SG_ RowSecLeSeatRotFailFb_UB : 417|1@0+ (1,0) [0|1] "" IHU
 SG_ RowSecRiSeatAdjmtCllsnWarn : 439|1@0+ (1,0) [0|1] "" IHU
 SG_ RowSecRiSeatAdjmtCllsnWarn_UB : 438|1@0+ (1,0) [0|1] "" IHU
 SG_ RowSecRiSeatAdjmtLimnWarn : 437|1@0+ (1,0) [0|1] "" IHU
 SG_ RowSecRiSeatAdjmtLimnWarn_UB : 436|1@0+ (1,0) [0|1] "" IHU
 SG_ RowSecRiSeatRotAvlSts : 435|1@0+ (1,0) [0|1] "" IHU
 SG_ RowSecRiSeatRotAvlSts_UB : 434|1@0+ (1,0) [0|1] "" IHU
 SG_ RowSecRiSeatRotFailFb : 432|9@0+ (1.0,0.0) [0.0|511.0] "Unitless" IHU
 SG_ RowSecRiSeatRotFailFb_UB : 433|1@0+ (1,0) [0|1] "" IHU
 SG_ RowSecRiSeatZeroGrvyRmn : 9|1@0+ (1,0) [0|1] "" IHU
 SG_ RowSecRiSeatZeroGrvyRmn_UB : 8|1@0+ (1,0) [0|1] "" IHU
 SG_ SeatCtrlFromSecSeatRi : 11|2@0+ (1,0) [0|3] "" ZCUP
 SG_ SeatCtrlFromSecSeatRi_UB : 12|1@0+ (1,0) [0|1] "" ZCUP
 SG_ SeatFoldRaiseAllwdRowThrdLe : 7|1@0+ (1,0) [0|1] "" IHU
 SG_ SeatFoldRaiseAllwdRowThrdLe_UB : 6|1@0+ (1,0) [0|1] "" IHU
 SG_ SeatFoldRaiseAllwdRowThrdRi : 37|1@0+ (1,0) [0|1] "" IHU
 SG_ SeatFoldRaiseAllwdRowThrdRi_UB : 36|1@0+ (1,0) [0|1] "" IHU
 SG_ SeatMatrsAirPmpDeflaSts : 473|2@0+ (1,0) [0|3] "" IHU
 SG_ SeatMatrsAirPmpDeflaSts_UB : 408|1@0+ (1,0) [0|1] "" IHU
 SG_ SeatMatrsAirPmpInflaSts : 483|2@0+ (1,0) [0|3] "" IHU
 SG_ SeatMatrsAirPmpInflaSts_UB : 500|1@0+ (1,0) [0|1] "" IHU
 SG_ SeatMatrsAirPmpPrepSts : 481|2@0+ (1,0) [0|3] "" IHU
 SG_ SeatMatrsAirPmpPrepSts_UB : 499|1@0+ (1,0) [0|1] "" IHU
 SG_ SeatOccptAtRowThrdLe2 : 255|2@0+ (1,0) [0|3] "" IHU,ZCUP
 SG_ SeatOccptAtRowThrdLe2_UB : 253|1@0+ (1,0) [0|1] "" IHU,ZCUP
 SG_ SeatOccptAtRowThrdLeSnsSts2 : 252|2@0+ (1,0) [0|3] "" IHU,ZCUP
 SG_ SeatOccptAtRowThrdLeSnsSts2_UB : 250|1@0+ (1,0) [0|1] "" IHU,ZCUP
 SG_ SeatOccptAtRowThrdRi2 : 249|2@0+ (1,0) [0|3] "" IHU,ZCUP
 SG_ SeatOccptAtRowThrdRi2_UB : 184|1@0+ (1,0) [0|1] "" IHU,ZCUP
 SG_ SeatOccptAtRowThrdRiSnsSts2 : 263|2@0+ (1,0) [0|3] "" IHU,ZCUP
 SG_ SeatOccptAtRowThrdRiSnsSts2_UB : 261|1@0+ (1,0) [0|1] "" IHU,ZCUP
 SG_ SeatRowThrdLeFoldRaiseWarn : 191|1@0+ (1,0) [0|1] "" IHU
 SG_ SeatRowThrdLeFoldRaiseWarn_UB : 190|1@0+ (1,0) [0|1] "" IHU
 SG_ SeatRowThrdLeFoldSts_UB : 185|1@0+ (1,0) [0|1] "" IHU
 SG_ SeatRowThrdLeFoldStsSeatFoldRaiseFlt : 189|1@0+ (1,0) [0|1] "" IHU
 SG_ SeatRowThrdLeFoldStsSeatFoldRaiseMovmt : 188|3@0+ (1,0) [0|7] "" IHU
 SG_ SteerActReGroup_UB : 343|1@0+ (1,0) [0|1] "" IHU
 SG_ SteerActReGroupAgAct : 342|15@0- (0.001,0.0) [-16.384|16.383] "Deg" IHU
 SG_ SteerActReGroupAgActQf : 395|2@0+ (1,0) [0|3] "" IHU
 SG_ SteerActReGroupAgGrdtMaxAvlFromSteerActrRe : 375|13@0+ (0.01,-40.96) [-40.96|40.949999999999996] "DegPerSec" IHU
 SG_ SteerActReGroupAgMaxAvlFromSteerActrRe : 359|15@0- (0.001,0.0) [-16.384|16.383] "Deg" IHU
 SG_ SteerActReGroupChks : 391|8@0+ (1.0,0.0) [0.0|255.0] "Unitless" IHU
 SG_ SteerActReGroupCntr : 399|4@0+ (1.0,0.0) [0.0|15.0] "Unitless" IHU
 SG_ SteerActReGroupSteerActrReSts : 378|3@0+ (1,0) [0|7] "" IHU
 SG_ SteerErrReq : 47|3@0+ (1,0) [0|7] "" IHU
 SG_ SteerErrReq_UB : 41|1@0+ (1,0) [0|1] "" IHU
 SG_ SteerStsToParkAssi : 266|3@0+ (1,0) [0|7] "" Vector__XXX
 SG_ SteerStsToParkAssi_UB : 267|1@0+ (1,0) [0|1] "" Vector__XXX
 SG_ SUMDrvModPrsnlAdjmt_UB : 415|1@0+ (1,0) [0|1] "" IHU
 SG_ SUMDrvModPrsnlAdjmtDamprCmftSts : 393|1@0+ (1,0) [0|1] "" IHU
 SG_ SUMDrvModPrsnlAdjmtDamprHardSts : 392|1@0+ (1,0) [0|1] "" IHU
 SG_ SUMDrvModPrsnlAdjmtDamprMedSts : 407|1@0+ (1,0) [0|1] "" IHU
 SG_ SUMDrvModPrsnlAdjmtDamprSts_Resv1 : 406|1@0+ (1,0) [0|1] "" IHU
 SG_ SUMDrvModPrsnlAdjmtDamprSts_Resv2 : 405|1@0+ (1,0) [0|1] "" IHU
 SG_ SUMDrvModPrsnlAdjmtSuspLvlHL1Sts : 404|1@0+ (1,0) [0|1] "" IHU
 SG_ SUMDrvModPrsnlAdjmtSuspLvlHL2Sts : 403|1@0+ (1,0) [0|1] "" IHU
 SG_ SUMDrvModPrsnlAdjmtSuspLvlLL1Sts : 402|1@0+ (1,0) [0|1] "" IHU
 SG_ SUMDrvModPrsnlAdjmtSuspLvlLL2Sts : 401|1@0+ (1,0) [0|1] "" IHU
 SG_ SUMDrvModPrsnlAdjmtSuspLvlNRHSts : 400|1@0+ (1,0) [0|1] "" IHU
 SG_ SunRoofMvngSts : 55|1@0+ (1,0) [0|1] "" IHU
 SG_ SunRoofMvngSts_UB : 54|1@0+ (1,0) [0|1] "" IHU
 SG_ SwtExtrLi2_UB : 71|1@0+ (1,0) [0|1] "" IHU
 SG_ SwtExtrLi2LiExtFctCntr : 53|2@0+ (1.0,0.0) [0.0|3.0] "Unitless" IHU
 SG_ SwtExtrLi2LiExtFctCrc : 63|8@0+ (1.0,0.0) [0.0|255.0] "Unitless" IHU
 SG_ SwtExtrLi2LiExtFctQf : 51|2@0+ (1,0) [0|3] "" IHU
 SG_ SwtExtrLi2LiExtFctReq1 : 49|2@0+ (1,0) [0|3] "" IHU
 SG_ ThrdRowLeVentnAutoSts : 414|2@0+ (1,0) [0|3] "" IHU
 SG_ ThrdRowLeVentnAutoSts_UB : 412|1@0+ (1,0) [0|1] "" IHU
 SG_ ThrdRowRiVentnAutoSts : 410|2@0+ (1,0) [0|3] "" IHU
 SG_ ThrdRowRiVentnAutoSts_UB : 411|1@0+ (1,0) [0|1] "" IHU
 SG_ TwbrWarnSts_UB : 313|1@0+ (1,0) [0|1] "" IHU
 SG_ TwbrWarnStsChks : 311|8@0+ (1.0,0.0) [0.0|255.0] "Unitless" IHU
 SG_ TwbrWarnStsCntr : 319|4@0+ (1.0,0.0) [0.0|15.0] "Unitless" IHU
 SG_ TwbrWarnStsYesNo : 315|2@0+ (1,0) [0|3] "" IHU
 SG_ WinDsblDrvrReSts : 68|1@0+ (1,0) [0|1] "" IHU,ZCUP
 SG_ WinDsblDrvrReSts_UB : 67|1@0+ (1,0) [0|1] "" IHU,ZCUP
 SG_ WinDsblLeftCmd : 66|1@0+ (1,0) [0|1] "" IHU,ZCUP
 SG_ WinDsblLeftCmd_UB : 65|1@0+ (1,0) [0|1] "" IHU,ZCUP
 SG_ WinDsblRightCmd : 87|1@0+ (1,0) [0|1] "" IHU,ZCUP
 SG_ WinDsblRightCmd_UB : 64|1@0+ (1,0) [0|1] "" IHU,ZCUP
 SG_ WinFailrStsAtDrvrRe : 86|1@0+ (1,0) [0|1] "" IHU,ZCUP
 SG_ WinFailrStsAtDrvrRe_UB : 85|1@0+ (1,0) [0|1] "" IHU,ZCUP
 SG_ WinGlbCmd : 44|3@0+ (1,0) [0|7] "" IHU,ZCUP
 SG_ WinGlbCmd_UB : 40|1@0+ (1,0) [0|1] "" IHU,ZCUP
 SG_ WinPosnStsAtDrvrRe : 84|5@0+ (1,0) [0|31] "" IHU,ZCUP
 SG_ WinPosnStsAtDrvrRe_UB : 95|1@0+ (1,0) [0|1] "" IHU,ZCUP

CM_ SG_ 336 ActvnOfHzrd "CEM internal signal. PWM signal to control Hazard button symbol illumination.";
CM_ SG_ 336 BookChrgnTarValFb "Feedback the corresponding signal when receives BookChrgnTarVal from TCAM";
CM_ SG_ 336 ChrgLidRearLockCmd "ChrgLidRearLockCmd - Rear Charge Lid Lock Command

Locking command for tank flap lock actuator.

LockActvnOff - Idle Command
LockActvnUnlck - Unlock tank flap
LockActvnLock - Lock tank flap
LockActvnSafe - No command
LockActvnUnlckByCrash - No command";
CM_ SG_ 336 ChrgnOrDisChrgnStsFb "Propulsion subsystem feedback charging and discharging status";
CM_ SG_ 336 CrashUnlckPosHldng "Flag signal for crash unlock position holding";
CM_ SG_ 336 DispOfPrpsnMod "Description: Actual powertrain propulsion mode of the hybrid propulsion system. Usage: For hybrid power flow status display in HMI.";
CM_ SG_ 336 DoorSldngLeReCinFailCinchFlt1 "Cinch fault";
CM_ SG_ 336 DoorSldngLeReCinFailCinchRestFlt "Cinch reset fault";
CM_ SG_ 336 DoorSldngLeRePreConNotFulfil "Power sliding left  door  preconditions are not fulfilled ";
CM_ SG_ 336 DoorSldngLeReStsDoorOpenSts "Left rear power sliding door current status";
CM_ SG_ 336 DoorSldngLeReStsFrstTmLveAbnd "Power Sliding door first oepartion after getting out of abandoned mode";
CM_ SG_ 336 DoorSldngRiReCinFailCinchFlt1 "Cinch fault";
CM_ SG_ 336 DoorSldngRiReCinFailCinchRestFlt "Cinch reset fault";
CM_ SG_ 336 DoorSldngRiReOpenEnaSts "Right sliding door open enable status according to  Lid status";
CM_ SG_ 336 DoorSldngRiRePreConNotFulfil "Power sliding right door  preconditions are not fulfilled";
CM_ SG_ 336 DoorSldngRiReStsDoorOpenSts "Rigth rear power sliding door current status";
CM_ SG_ 336 DoorSldngRiReStsFrstTmLveAbnd "Power Sliding door first oepartion after getting out of abandoned mode";
CM_ SG_ 336 DstEstimdToEmptyForDrvgElec "Estimated remaining driving range in electric only driving for current HV battery energy content.";
CM_ SG_ 336 DstFromDestinationFb "Feedback the corresponding signal when receives DstFromDestination from HMI subsystem";
CM_ SG_ 336 DstToEmptyIndcdDstToEmpty1 "Indicated distance to Empty (D.T.E.) with indicated unit Distance To Empty";
CM_ SG_ 336 DstToEmptyIndcdDstToEmpty2 "Indicated standard distance to Empty.(SDTE)

This value is equal to the amount of fuel left in the tank divided by the declared fuel consumption";
CM_ SG_ 336 ElecMot2SpdActSgn "Actual auxiliary motor speed with sign to indicate forward or backward direction";
CM_ SG_ 336 ElecMot2SpdReq "Generator motor speed request";
CM_ SG_ 336 ElecMot2TqActChks "Checksum";
CM_ SG_ 336 ElecMot2TqActCntr "Counter";
CM_ SG_ 336 ElecMot2TqActIsgTqAct "Actual torque";
CM_ SG_ 336 ElecMot2TqActQualityFactor "Quality factor";
CM_ SG_ 336 ElecMot2TqAllwdChks "Checksum for ElecMot2TqAllwd";
CM_ SG_ 336 ElecMot2TqAllwdCntr "Counter for ElecMot2TqAllwd";
CM_ SG_ 336 ElecMot2TqAllwdIsgTqAllwd "Indication if generator ISG is allowed to apply propulsive or regenerative torque on wheels. Coding: 0x0: Propulsive and regeneration torque not allowed; 0x1: Propulsive torque allowed; 0x2: Regenerative torque allowed; 0x3: Propulsive and regeneration torque allowed";
CM_ SG_ 336 ElecMot2TqAvlIsgTqAvlMax "Max available torque";
CM_ SG_ 336 ElecMot2TqAvlIsgTqAvlMin "Min available torque";
CM_ SG_ 336 ElecMot2TqReq "Generator motor torque request";
CM_ SG_ 336 FrntSeatEEInhbRowSecLe "Front Seat Easy Entry inhibition command from Second Row Left Seat";
CM_ SG_ 336 FrntSeatEEInhbRowSecRi "Front Seat Easy Entry inhibition command from Second Row Right Seat";
CM_ SG_ 336 IndirectLifeDetnAndCareDiWarn "to describe IndirectLifeDetnAndCareLvl1Warn is warning or not warning";
CM_ SG_ 336 IndirectLifeDetnAndCareLvl1Warn "to describe IndirectLifeDetnAndCareLvl1Warn warning or not warning";
CM_ SG_ 336 KeyLostWarnIndcn "Key lost warning indication for DIM to show a message and for IHU to play a sound.";
CM_ SG_ 336 KeyRmnIndcn "Key reminder indication for IHU to play a sound.";
CM_ SG_ 336 LiLvrSwt1 "Signal used to represent push button switch at end of stalk(TRIP) switch.
0-Not pressed and 1-Pressed";
CM_ SG_ 336 LockgFbAudioReq "Locking feedback to Audio ";
CM_ SG_ 336 LockgFbAudioWarn "LockgFbAudioWarn - Locking Feedback Audio Warning";
CM_ SG_ 336 MemBtnPsdMemBtn1 "Driver Memory Button 2";
CM_ SG_ 336 MemBtnPsdMemBtn2 "Driver Memory Button 2";
CM_ SG_ 336 MemBtnPsdMemBtn3 "Driver Memory Button 3";
CM_ SG_ 336 MemBtnPsdMemButM "Driver Memory Button";
CM_ SG_ 336 PassElecRunngBdSts "right electric running board status";
CM_ SG_ 336 RoofDispCtrlReqFromSecLe "Request roof display to fold or move";
CM_ SG_ 336 RoofDispCtrlReqFromSecRi "Request roof display to fold or move";
CM_ SG_ 336 RowFrstPassDivePosPercSeatPosPerc "passenger seat dive position";
CM_ SG_ 336 RowFrstPassDivePosPercSeatPosQf "passenger seat dive position quality factor";
CM_ SG_ 336 RowSecLeSeatAutMovmtSts "Second Row Left Seat Automatic Movement Status Feedback";
CM_ SG_ 336 RowSecLeSeatInAutMovmt "Row Second Left Seat In Automatic Movement";
CM_ SG_ 336 RowSecLeSeatRotSts "Second Row Left Seat Rotation Status";
CM_ SG_ 336 RowSecRiSeatAutMovmtSts "Second Row Right Seat Automatic Movement Status Feedback";
CM_ SG_ 336 RowSecRiSeatInAutMovmt "Row Second Right Seat In Automatic Movement";
CM_ SG_ 336 RowSecRiSeatRotSts "Second Row Right Seat Rotation Status";
CM_ SG_ 336 RowThrdLeSeatAutMovmtSts "Third Row Left Seat Automatic Movement Status Feedback";
CM_ SG_ 336 RowThrdRiSeatAutMovmtSts "Third Row Right Seat Automatic Movement Status Feedback";
CM_ SG_ 336 SecRowSeatHeatgActlPwrCnsLe "Actual power consumption for second row left seat heating.";
CM_ SG_ 336 SecRowSeatHeatgActlPwrCnsRi "Actual power consumption for second row right seat heating.";
CM_ SG_ 336 SecRowSeatHeatgDesPwrCnsLe "Desired power consumption for second row left seat heating.";
CM_ SG_ 336 SecRowSeatHeatgDesPwrCnsRi "Desired power consumption for second row right seat heating.";
CM_ SG_ 336 SecRowSeatVentnActlPwrCnsLe "Second row left seat ventilation actual power consumption.";
CM_ SG_ 336 SecRowSeatVentnActlPwrCnsRi "Second row right seat ventilation actual power consumption.";
CM_ SG_ 336 SecRowSeatVentnDesPwrCnsLe "Second row left ventilation desired power consumption.";
CM_ SG_ 336 SecRowSeatVentnDesPwrCnsRi "Second row right ventilation desired power consumption.";
CM_ SG_ 336 ShortDropWinDrvrReSts "Short drop a status sent back to locking to secure window is down and door is ready to be released. ";
CM_ SG_ 336 TailgCllsnRiskSts "Signal of collision risk status between upper and lower tailgate.";
CM_ SG_ 336 ThrdRowSeatHeatgActlPwrCnsLe "Actual power consumption for third row left seat heating.";
CM_ SG_ 336 ThrdRowSeatHeatgActlPwrCnsRi "Actual power consumption for third row right seat heating.";
CM_ SG_ 336 ThrdRowSeatHeatgDesPwrCnsLe "Desired power consumption for third row left seat heating.";
CM_ SG_ 336 ThrdRowSeatHeatgDesPwrCnsRi "Desired power consumption for third row right seat heating.";
CM_ SG_ 336 ThrdRowSeatVentnActlPwrCnsLe "Third row left seat ventilation actual power consumption.";
CM_ SG_ 336 ThrdRowSeatVentnActlPwrCnsRi "Third row right seat ventilation actual power consumption.";
CM_ SG_ 336 ThrdRowSeatVentnDesPwrCnsLe "Third row left ventilation desired power consumption.";
CM_ SG_ 336 ThrdRowSeatVentnDesPwrCnsRi "Third row right ventilation desired power consumption.";
CM_ SG_ 336 WadeProtnIndcn "Wade Protection Indication";
CM_ SG_ 53 ActnOfDynChrgnInEITL "charging light activation signal";
CM_ SG_ 53 ActvnOfIndcrIndcrOut "Direction indicator command";
CM_ SG_ 53 ActvnOfIndcrIndcrOutChks "CheckSum";
CM_ SG_ 53 ActvnOfIndcrIndcrOutCntr "Coounter";
CM_ SG_ 53 ActvnOfMusicShowforEITL "music show activation signal";
CM_ SG_ 53 ActvnOfParkShowforEITL "Activate Parking show Technology light";
CM_ SG_ 53 ActvnOfVSTDInEITL "VSTD technology light show";
CM_ SG_ 53 BLEKeySearchReqKeyLocn "the zone of key search";
CM_ SG_ 53 BLEKeySearchReqTirgger "which triggered key search";
CM_ SG_ 53 ChdLockDrvrReSts "Child protection Driver rear door, child lock status.";
CM_ SG_ 53 ChdLockLeftCmd "Signal sent from the Driver door module to the locking and window functionality in the left rear door module. The signal contains information whether the power window disable function and the electric child lock function shall be enabled or disabled.";
CM_ SG_ 53 ChdLockRightCmd "Signal sent from the Driver door module to the locking and window functionality in the right rear door module. The signal contains information whether the power window disable function and the electric child lock function shall be enabled or disabled.";
CM_ SG_ 53 CrashStsSafeChks "Checksum for E2E";
CM_ SG_ 53 CrashStsSafeCntr "Counter for E2E";
CM_ SG_ 53 CrashStsSafeSts "Information if a crash has been detected by SRS.";
CM_ SG_ 53 DoorDrvrHndlSts "To inform about driver door handle status, i.e. unknown, opened, closed according to
DoorDrvrHndlSts
- Ukwn
- FullRtrctd
- MovgOut
- StopDurgDply
- FullDplyd
- MovgIn
- StopDurgRtrct
- Flt";
CM_ SG_ 53 DoorDrvrReCinhIntFailInfCinchFlt1 "Cinch fault";
CM_ SG_ 53 DoorDrvrReCinhIntFailInfCinchRestFlt "Cinch reset fault";
CM_ SG_ 53 DoorDrvrReHndlSts "To inform about driver rear door handle status,";
CM_ SG_ 53 DoorDrvrReLatPosn "Driver rear door Cinch position. x01 equal fully open, x02 equal secondary position, x03 equal fully closed.";
CM_ SG_ 53 DoorDrvrReLockSts "DoorDrvrReLockSts - Driver Rear Door Lock Status";
CM_ SG_ 53 DoorDrvrReOpenLowReqOutdSwt1 "Driver Rear Door Open Request from Outside Switch 1 - Traditional door";
CM_ SG_ 53 DoorDrvrReOpenReqInsdSwt1 "Driver Rear Door Open Request from Inside Switch 1";
CM_ SG_ 53 DoorDrvrReRelsFailCinchOverTimed "Cinch processwas not successfull. It is overtimed.";
CM_ SG_ 53 DoorDrvrReRelsFailFailure1 "Issue described by requiremnt according to specific project";
CM_ SG_ 53 DoorDrvrReRelsFailMechRels "Door Mechanical release (No Power operated)";
CM_ SG_ 53 DoorLeReHndlSts "To inform about left rear door handle status, i.e. unknown, opened, closed according to
DoorLeReHndlSts
- Ukwn
- FullRtrctd
- MovgOut
- StopDurgDply
- FullDplyd
- MovgIn
- StopDurgRtrct
- Flt";
CM_ SG_ 53 DoorLeReLatPosn "Left rear door Cinch position. x01 equal fully open, x02 equal secondary position, x03 equal fully closed.";
CM_ SG_ 53 DoorLeReLockCmd "DoorLeReLockCmd - Left Rear Door Lock Command
Locking Command signal to left rear door
LockActvnOff - Idle Command
LockActvnUnlck - Unlock door
LockActvnLock - Lock door
LockActvnSafe - Double lock door
LockActvnUnlckByCrash - Crash Unlock door";
CM_ SG_ 53 DoorLeReRelsReq "DoorLeReRelsReq - Left Rear Door Release Request
Request to release the left rear door.
On - Release request
Off - No release request
Invalid1and2 - No release request";
CM_ SG_ 53 DoorPassLockCmd "DoorPassLockCmd - Passenger Door Lock Command
Locking Command signal to passenger door
LockActvnOff - Idle Command
LockActvnUnlck - Unlock door
LockActvnLock - Lock door
LockActvnSafe - Double lock door
LockActvnUnlckByCrash - Crash Unlock door";
CM_ SG_ 53 DoorPassRelsReq "DoorPassRelsReq - Passenger Door Release Request
Request to release the passenger door.
On - Release request
Off - No release request
Invalid1and2 - No release request";
CM_ SG_ 53 DoorRiReLockCmd "DoorRiReLockCmd - Right Rear Door Lock Command
Locking Command signal to right rear door
LockActvnOff - Idle Command
LockActvnUnlck - Unlock door
LockActvnLock - Lock door
LockActvnSafe - Double lock door
LockActvnUnlckByCrash - Crash Unlock door";
CM_ SG_ 53 DoorRiReRelsReq "DoorRiReRelsReq - Right Rear Door Release Request
Request to release the right rear door.
On - Release request
Off - No release request
Invalid1and2 - No release request";
CM_ SG_ 53 EpbLampReqSecChks "Checksum.";
CM_ SG_ 53 EpbLampReqSecCntr "Rolling counter.";
CM_ SG_ 53 EpbLampReqSecEpbLampReq "E2E secured Epb request to display Red EPB tell tale.
Record has checksum and counter Epb lamp request";
CM_ SG_ 53 ExtrLiRlySafe "Controls exterior light headlamp relay status when stopping engine during driving.";
CM_ SG_ 53 IceBreakDoorDrvrReActv "Boolean signal to indicate if Driver Rear door ice break function is activated";
CM_ SG_ 53 IsgIDc "DC current measured by the front inverter";
CM_ SG_ 53 IsgSpdActSgn "Actual ISG speed with sign to indicate forward or backward direction";
CM_ SG_ 53 IsgTqReq "Requested ISG motor torque on the crankshaft. The torque is positive in the forward rotation direction. ";
CM_ SG_ 53 OverBoostSts "0:OverBoost not active 1:OverBoost active";
CM_ SG_ 53 PanicAlrmSts "Notification panic alarm state to telematics";
CM_ SG_ 53 PawlDrvrReSwt "Driver rear door pawl switch status";
CM_ SG_ 53 PawlDrvrSwt "driver door pawl switch status";
CM_ SG_ 53 PrpsnHvBattUsgModAct "Actual Mode for Propulsion HV Battery usage mode, including Hold, Smart Hold and Charge.";
CM_ SG_ 53 PrpsnHvBattUsgOfDispSoc "State-of-charge Request level of the propulsion HV Battery Usage FUnction for display in driver information display.";
CM_ SG_ 53 PtModAct "Powertrain mode Act";
CM_ SG_ 53 PtTqAtWhlFrntActChks "checksum";
CM_ SG_ 53 PtTqAtWhlFrntActCntr "counter";
CM_ SG_ 53 PtTqAtWhlFrntActPtTqAtAxleFrntAct "Actual torque delivered by the powertrain to the front axle";
CM_ SG_ 53 PtTqAtWhlFrntActPtTqAtWhlFrntLeAct "Actual torque delivered by the powertrain to the front left wheel.";
CM_ SG_ 53 PtTqAtWhlFrntActPtTqAtWhlFrntRiAct "Actual torque delivered by the powertrain to the front right wheel.";
CM_ SG_ 53 PtTqAtWhlFrntActPtTqAtWhlsFrntQly "quality factor";
CM_ SG_ 53 RecOfImpct2ImpctDvxSigned "Crash information , changed velocity in x direction , data with sign";
CM_ SG_ 53 RecOfImpct2ImpctDvySigned "Crash information , changed velocity in y direction, data with sign";
CM_ SG_ 53 RowSecLeBtnPsd "the switch is pressed";
CM_ SG_ 53 RowSecLeInclPosAngle "Backrest angle of the Second Row Left Seat";
CM_ SG_ 53 RowSecLeLegRstHeiPosPercSeatPosPerc "Seat Leg Rest Height Position Percentage";
CM_ SG_ 53 RowSecLeLegRstHeiPosPercSeatPosQf "Seat Leg Rest Height Position Quality Factor";
CM_ SG_ 53 RowSecLeLegRstLenPosPercSeatPosPerc "Seat Leg Rest Length Position Percentage";
CM_ SG_ 53 RowSecLeLegRstLenPosPercSeatPosQf "Seat Leg Rest Length Position Quality Factor";
CM_ SG_ 53 RowSecLeSeatRotPosPerc "Percentage of Second Row Left Seat Rotation position";
CM_ SG_ 53 RowSecLeSldPosPercSeatPosPerc "Seat Slide Position Percentage";
CM_ SG_ 53 RowSecLeSldPosPercSeatPosQf "Seat Slide Position Quality Factor";
CM_ SG_ 53 RowSecRiBtnPsd "the switch is pressed";
CM_ SG_ 53 RowSecRiInclPosAngle "Backrest angle of the Second Row Right Seat";
CM_ SG_ 53 RowSecRiLegRstHeiPosPercSeatPosPerc "Seat Leg Rest Height Position Percentage";
CM_ SG_ 53 RowSecRiLegRstHeiPosPercSeatPosQf "Seat Leg Rest Height Position Quality Factor";
CM_ SG_ 53 RowSecRiLegRstLenPosPercSeatPosPerc "Seat Leg Rest Length Position Percentage";
CM_ SG_ 53 RowSecRiLegRstLenPosPercSeatPosQf "Seat Leg Rest Length Position Quality Factor";
CM_ SG_ 53 RowSecRiSeatRotPosPerc "Percentage of Second Row Right Seat Rotation position";
CM_ SG_ 53 RowSecRiSldPosPercSeatPosPerc "Seat Slide Position Percentage";
CM_ SG_ 53 RowSecRiSldPosPercSeatPosQf "Seat Slide Position Quality Factor";
CM_ SG_ 53 SteerWhlBtnPsd "it detect user button is pressed";
CM_ SG_ 53 SteerWhlInMovmt "indicate if the ECU is in movment";
CM_ SG_ 53 SteerWhlSnsrAg "Actual steering wheel angle from the actual centre position of the steering wheel. ";
CM_ SG_ 53 SteerWhlSnsrAgSpd "Actual steering wheel angle from the actual centre position of the steering wheel. Steering angle speed with steering wheel rotation direction.  ";
CM_ SG_ 53 SteerWhlSnsrChks "Checksum for steering wheel sensor data.";
CM_ SG_ 53 SteerWhlSnsrCntr "Counter value for steering wheel sensor data.";
CM_ SG_ 53 SteerWhlSnsrQf "Qf for steering wheel sensor information";
CM_ SG_ 53 TrRelsFailtoHMI "Used to communicate if there is an error in Tailgate/bootlid latch power operation";
CM_ SG_ 53 WadeProtnSts "Wade Protection Stauts";
CM_ SG_ 53 WhlFailrSts "Detect if there is any error with adc and what kind of error";
CM_ SG_ 53 WinSwtReqChks "Checksum";
CM_ SG_ 53 WinSwtReqCntr "Counter";
CM_ SG_ 53 WinSwtReqFrntLe "Signal from the Driver door switchpack to the Door modules containing the state of the window switches. Front left. ";
CM_ SG_ 53 WinSwtReqFrntRi "Signal from the Driver door switchpack to the Door modules containing the state of the window switches. Front right. ";
CM_ SG_ 53 WinSwtReqReLe "Signal from the Driver door switchpack to the Door modules containing the state of the window switches. Rear left. ";
CM_ SG_ 53 WinSwtReqReRi "Signal from the Driver door switchpack to the Door modules containing the state of the window switches.  Rear right. ";
CM_ SG_ 312 ActvnOfPasSideDoorIllmn "PWM signal to control Passenger side Inner door/door pocket light illumination.";
CM_ SG_ 312 ActvnOfPasSideStepIllmn "PWM signal to control Passenger side step light illumination.";
CM_ SG_ 312 ActvnOfRePasDoorIllmn "PWM signal to control Passenger side Rear Inner door/door pocket light illumination.";
CM_ SG_ 312 ActvnOfRePasSideStepIllmn "PWM signal to control Passenger Rear side step light illumination.";
CM_ SG_ 312 ActvnOfSwtIllmnSply "CEM internal signal. PWM signal to control illumination connected to the output SwitchIlluminationSupply.";
CM_ SG_ 312 AntithftActvnNotif "Request to telematics module to send a theft notification.";
CM_ SG_ 312 BattCooltIndcnReq "Battery coolant level indication request";
CM_ SG_ 312 BattSocRaw "Battery State of charge from BMS";
CM_ SG_ 312 BattURaw "Battery Voltage From BMS";
CM_ SG_ 312 BrkBoostErrIndcnReq "BBM";
CM_ SG_ 312 ChrgnByEngStsDurgDcha "Status of charging by engine during discharging";
CM_ SG_ 312 ChrgnWarn "ECM send the warning message to TCAM aim to indicate driver to charging";
CM_ SG_ 312 DispElecPwrAbs "absolutely motor power for display";
CM_ SG_ 312 DispElecPwrSts "status of motor charing o regen.";
CM_ SG_ 312 DispOfBrkPwrPercRgnMin "Maximum available regen for display of max regen capacity in Electrical Propulsion Driver Support (PHEV powermeter). ";
CM_ SG_ 312 DispOfPrpsnPwrPercElecMax "Maximum Electrical Propulsion Power threshold at which the engine is started/stopped for display in Electrical Propulsion Driver Support (PHEV powermeter). ";
CM_ SG_ 312 DoorDrvrCinhIntFailInfCinchFlt1 "Cinch fault";
CM_ SG_ 312 DoorDrvrCinhIntFailInfCinchRestFlt "Cinch reset fault";
CM_ SG_ 312 DoorDrvrRelsFailCinchOverTimed "Cinch processwas not successfull. It is overtimed.";
CM_ SG_ 312 DoorDrvrRelsFailFailure1 "Issue described by requiremnt according to specific project";
CM_ SG_ 312 DoorDrvrRelsFailMechRels "Door Mechanical release (No Power operated)";
CM_ SG_ 312 DoorLeReCinhIntFailInfCinchFlt1 "Cinch fault";
CM_ SG_ 312 DoorLeReCinhIntFailInfCinchRestFlt "Cinch reset fault";
CM_ SG_ 312 DoorLeReRelsFailCinchOverTimed "Cinch processwas not successfull. It is overtimed.";
CM_ SG_ 312 DoorLeReRelsFailFailure1 "Issue described by requiremnt according to specific project";
CM_ SG_ 312 DoorLeReRelsFailMechRels "Door Mechanical release (No Power operated)";
CM_ SG_ 312 DrvrSeatActvSpplFct "Selected Multifunction";
CM_ SG_ 312 DrvrSeatBtnPsd "The signal DrvrSeatBtnPsd shall be sent when any button connected to the PSM is activated. ";
CM_ SG_ 312 DrvrSeatExtAdjAllowd "External Adjustment of the Driver seat is allowed or not (from for example HMI)";
CM_ SG_ 312 DrvrSeatHeatgLvlSts "Seat heating level for first row driver seat.";
CM_ SG_ 312 DrvrSeatSwtStsDrvrSeatSwtAdjmtOfSpplFctHozlSts "Horizontal Multifunction";
CM_ SG_ 312 DrvrSeatSwtStsDrvrSeatSwtAdjmtOfSpplFctVertSts "Vertical Multifunction";
CM_ SG_ 312 DrvrSeatSwtStsDrvrSeatSwtHdrstHozlSts "Headrest Horizontal Status";
CM_ SG_ 312 DrvrSeatSwtStsDrvrSeatSwtHdrstVertSts "Headrest Vertical Status";
CM_ SG_ 312 DrvrSeatSwtStsDrvrSeatSwtHeiFrntSts "Front Height Stauts";
CM_ SG_ 312 DrvrSeatSwtStsDrvrSeatSwtHeiSts "Height Stauts";
CM_ SG_ 312 DrvrSeatSwtStsDrvrSeatSwtInclSts "Inclination Stauts";
CM_ SG_ 312 DrvrSeatSwtStsDrvrSeatSwtSelnOfSpplFctSts "Selector Multifunction";
CM_ SG_ 312 DrvrSeatSwtStsDrvrSeatSwtSldSts "Slide Stauts";
CM_ SG_ 312 DrvrSeatVentAvlSts "Seat ventilation on, off, error and limitation status for driver seat.";
CM_ SG_ 312 DstEstimdToEmptyForTarSoc1 "Predicted distance till empty in economic driving behavior from the target SOC 20";
CM_ SG_ 312 DstEstimdToEmptyForTarSoc2 "Predicted distance till empty in economic driving behavior from the target SOC 100";
CM_ SG_ 312 DstTrvldFromBodyBkp "backup distance from CEM.";
CM_ SG_ 312 DstTrvldVldFromBodyBkp "Indication if the transmitted backupvalue is valid or not";
CM_ SG_ 312 EgyRegenEgyAct "Regeneration energy accumulated in signal driving cycle";
CM_ SG_ 312 EngCooltIndcnReq "Request to display warning or info message to customer in DIM regarding engine cooling system in traditional car or hybrid car. ";
CM_ SG_ 312 EngCooltTPercForDisp "Engine coolant temperature percent for displaying in traditional car or hybird car.";
CM_ SG_ 312 EngFltIndcn1 "engine fault indication";
CM_ SG_ 312 EngFltIndcn10 "engine fault indication";
CM_ SG_ 312 EngFltIndcn11 "engine fault indication";
CM_ SG_ 312 EngFltIndcn12 "engine fault indication";
CM_ SG_ 312 EngFltIndcn13 "engine fault indication";
CM_ SG_ 312 EngFltIndcn14 "engine fault indication";
CM_ SG_ 312 EngFltIndcn15 "engine fault indication";
CM_ SG_ 312 EngFltIndcn16 "engine fault indication";
CM_ SG_ 312 EngFltIndcn17 "engine fault indication";
CM_ SG_ 312 EngFltIndcn18 "engine fault indication";
CM_ SG_ 312 EngFltIndcn19 "engine fault indication";
CM_ SG_ 312 EngFltIndcn2 "engine fault indication";
CM_ SG_ 312 EngFltIndcn20 "engine fault indication";
CM_ SG_ 312 EngFltIndcn21 "engine fault indication";
CM_ SG_ 312 EngFltIndcn22 "engine fault indication";
CM_ SG_ 312 EngFltIndcn23 "engine fault indication";
CM_ SG_ 312 EngFltIndcn24 "engine fault indication";
CM_ SG_ 312 EngFltIndcn25 "engine fault indication";
CM_ SG_ 312 EngFltIndcn26 "engine fault indication";
CM_ SG_ 312 EngFltIndcn27 "engine fault indication";
CM_ SG_ 312 EngFltIndcn3 "engine fault indication";
CM_ SG_ 312 EngFltIndcn4 "engine fault indication";
CM_ SG_ 312 EngFltIndcn5 "engine fault indication";
CM_ SG_ 312 EngFltIndcn6 "engine fault indication";
CM_ SG_ 312 EngFltIndcn7 "engine fault indication";
CM_ SG_ 312 EngFltIndcn8 "engine fault indication";
CM_ SG_ 312 EngFltIndcn9 "engine fault indication";
CM_ SG_ 312 EngOilLvl "Engine oil level, Range 0-120 %";
CM_ SG_ 312 EngOilLvlSts "Engine oil level status information.If no status currently can be derived [Not available] will be shown.";
CM_ SG_ 312 EngOilPWarn "Request to set low engine oil pressure warning to driver";
CM_ SG_ 312 ExtLiShwDwnldSts "Exterior Light Show Download Status";
CM_ SG_ 312 ExtrLiShowActvnStsExtrLiShowActvnFrntLeFb "Exterior Light Show Activation Front Left Feedback";
CM_ SG_ 312 ExtrLiShowActvnStsExtrLiShowActvnFrntRiFb "Exterior Light Show Activation Front Right Feedback";
CM_ SG_ 312 ExtrLiShowActvnStsExtrLiShowActvnReLe2Fb "Exterior Light Show Activation Rear Left 2 Feedback";
CM_ SG_ 312 ExtrLiShowActvnStsExtrLiShowActvnReLeFb "Exterior Light Show Activation Rear Left Feedback";
CM_ SG_ 312 ExtrLiShowActvnStsExtrLiShowActvnReRi2Fb "Exterior Light Show Activation Rear Right 2 Feedback";
CM_ SG_ 312 ExtrLiShowActvnStsExtrLiShowActvnReRiFb "Exterior Light Show Activation Rear Right Feedback";
CM_ SG_ 312 FrntWiprLvrCmd2FrntWiprLvrCmd1 "Wiper Data";
CM_ SG_ 312 FrntWiprLvrCmd2FrntWiprLvrCntr "Counter";
CM_ SG_ 312 FrntWiprLvrCmd2FrntWiprLvrCrc "J1850 CRC";
CM_ SG_ 312 FrntWiprLvrCmd2FrntWiprLvrQf "Quality Factor";
CM_ SG_ 312 HmiEngHybSts "Hmi Engine hybrid status operates when ECM determines that fuel is to old and informs driver. The bitcoding: Bit0 : Aged fuel, Fill up fuel tank. Bit1 : Aged fuel, Start petrol engine. Bit2 : Aged fuel, Engine will run to consume fuel. Bit3 : Aged fuel and low fuel level, Fill fuel. Bit4 : Spare";
CM_ SG_ 312 HmiFuLidNotClsd "HmiFuLidNotClsd: Hmi Fuel lid not closed is a warning and a message to the driver that the fuel lid is not closed. 0= No Warning. 1= Fuel Lid Not Closed Warning.";
CM_ SG_ 312 HmiFuLidOpenSts "HmiFuLidOpenSts: Hmi Fuel lid open status informs the driver with a DIM message that the system is venting the tank pressure and unlocking of the fuel tank lid is processing signal coding: 0 = unlocking not initiated, no status. 1= Please wait now opening";
CM_ SG_ 312 HmiFuTankRdy "HmiFuTankRdy: Hmi Fuel tank ready, informs the driver with a DIM message that the system is ready and it is possible to refuel. 0 = System is not ready. 1 = System is ready - Fuel can be filled. 2= Tank Lid can be open, but risk of splashing due to remaining pressure.";
CM_ SG_ 312 HmiVehStopForRefu "HmiVehStopForRefu: Fuel lid button pushed by mistake in vehiclespeed greater than 30km/h a message to the driver that the vehicle need to stop before preparing for refueling. 0= No Warning; 1= Please stop vehicle before refueling.";
CM_ SG_ 312 HpBattVlvPosRec "Battery three-way valve opening  position in percentage.";
CM_ SG_ 312 HudSnsrErrParChk " Signal indicates whether a fault has currently been detected in the forward facing HUD sensor of the RLSM or not. To ensure signal integrity, the signal also includes a parity bit ParChk. Odd parity is used. ";
CM_ SG_ 312 HudSnsrErrSnsrErr "Signal indicates whether a fault has currently been detected in the forward facing HUD sensor of the RLSM or not. ";
CM_ SG_ 312 HvBattSoc "Actual state of charge of the Hv Battery.";
CM_ SG_ 312 HvClimaCmd "Information for climate if climatisation is allowed";
CM_ SG_ 312 IntrBriSts "Rheostat setting. Set by user through rheostat wheel situated on MyCar Module.";
CM_ SG_ 312 IsgInvrT "Temperature of the inverter";
CM_ SG_ 312 IsgMotT "Temperature of the CISG";
CM_ SG_ 312 LockgPrsnlSts "LockgPrsnlSts - Private Locking Status
Current private locking status. To be used for user feedback.
On - Private locking is ON
Off - Private locking is OFF";
CM_ SG_ 312 LVPwrSplyErrSts "Low voltage power supply error status";
CM_ SG_ 312 ObdAccrPedRat "PID 49 acording to SAE 1979DA";
CM_ SG_ 312 OilMntnAlrmSt "Oil Maintenance Alarm State";
CM_ SG_ 312 RecOfImpctCrashFrnt "Crash information, if crash is frontal";
CM_ SG_ 312 RecOfImpctCrashOffroadA "Incident information, if driving off road and becoming airbourne has been detected.";
CM_ SG_ 312 RecOfImpctCrashOffroadD "Inicdent information, if driving into a ditch has been detected";
CM_ SG_ 312 RecOfImpctCrashOffroadRT "Incident information, if driving off the road and into rough terrain has been detected.";
CM_ SG_ 312 RecOfImpctCrashOffroadRTsevere "Incident information, if driving off road and into severe rough terrain has been detected.";
CM_ SG_ 312 RecOfImpctCrashPed "Incident information, if a pedestrian protection triggering has been made";
CM_ SG_ 312 RecOfImpctCrashRe "Crash information, if crash is rear";
CM_ SG_ 312 RecOfImpctCrashRollovr "Crash information, if crash is roll-over";
CM_ SG_ 312 RecOfImpctCrashSideLe "Crash information, if crash is left side";
CM_ SG_ 312 RecOfImpctCrashSideRi "Crash information, if crash is right side";
CM_ SG_ 312 RecOfImpctCrashState "Crash information, State of the crash";
CM_ SG_ 312 RecOfImpctImpctDvx "Crash information, change in velocity in x-direction";
CM_ SG_ 312 RecOfImpctImpctDvy "Crash information, change in velocity in y-direction";
CM_ SG_ 312 RecOfImpctImpctRollAg "Crash information, cumulative roll angle";
CM_ SG_ 312 RecOfImpctVehOri "Crash information, Vehicle orientation once crash subsides";
CM_ SG_ 312 RlyPwrDistbnCmd1WdBattSaveCmd "Status of the Battery saver relay";
CM_ SG_ 312 SolarSnsrLeValue "Left side sun sensor value.";
CM_ SG_ 312 SolarSnsrRiValue "Right side sun sensor value.";
CM_ SG_ 312 SteerLockWarnIndcn "SCL warning message to be shown in DIM";
CM_ SG_ 312 SteerWhlHeatgLvlSts "Steering Wheel heating level status.";
CM_ SG_ 312 StopStrtStbIndcn "Request to light Auto start in DIM";
CM_ SG_ 312 StrtColdIndcnMsg "when temperature is very low to -35 degrees Celsius and when engine can not be started, propulsion will send related messages to driver";
CM_ SG_ 312 StrtMsgToModMngt "Signaling that a requested start has been delayed or inhibited by the ECM SW";
CM_ SG_ 312 SunCurtImpctDetnSts2 "Interface reporting Status of Sun Curtain Impact Detection. ";
CM_ SG_ 312 TCSTmrOverSts "TCSTmrOverSts";
CM_ SG_ 312 TCSTmrStrtSts "TCSTmrStrtSts";
CM_ SG_ 312 TelltlPwrLoss "Power loss dection ,which is used to indicate the DIM(turtle indicator)";
CM_ SG_ 312 TrlrLiTurnIndcrActvt "Turn Indicators activation Trailer.";
CM_ SG_ 312 WiprInPosnForSrv "Information regarding when the windscreen wipers are in service position.";
CM_ SG_ 312 WiprReInPosnForSrv "Feedback about activation/deactivation of rear service position to HMI (CSD) ";
CM_ SG_ 288 AirPtcHVPwrActl "Air PTC actual high voltage power.";
CM_ SG_ 288 AlcoLockMgrWarnlndcn "Signal used for showing messages in IHU";
CM_ SG_ 288 BattFltStsPrimBattFltStsPrm "Battery fault status primary.";
CM_ SG_ 288 BattFltStsPrimChks "CheckSum";
CM_ SG_ 288 BattFltStsPrimCntr "Counter";
CM_ SG_ 288 BookTrvlChrgnFb "ECM shall feedback the status of charing";
CM_ SG_ 288 BookTrvlChrgnSts "ECM shall feedback the status of bookcharing";
CM_ SG_ 288 CarLoctrHornLiSetActv "Feedback from AlarmMgr to HMI with current sotre settings to activate CarLocator (CarFinder)";
CM_ SG_ 288 CmptmtFrntWindT "compartment front windscreen temperature value for climate control.";
CM_ SG_ 288 CmptmtRelHum "compartment relative humidity value for climate control.";
CM_ SG_ 288 DefrstStsMirrDefrst "Front windscreen, rear window and exterior rear view mirror electrical defroster status. Includes information regarding how they have been activated and their availability. ";
CM_ SG_ 288 DefrstStsWinDefrstFrnt "Front windscreen, rear window and exterior rear view mirror electrical defroster status. Includes information regarding how they have been activated and their availability. ";
CM_ SG_ 288 DefrstStsWinDefrstRe "Front windscreen, rear window and exterior rear view mirror electrical defroster status. Includes information regarding how they have been activated and their availability. ";
CM_ SG_ 288 DispOfPrpsnModForEv "Actual powertrain propulsion mode of the BEV propulsion system. Usage: For BEV power flow status display in HMI.";
CM_ SG_ 288 DrvrSeatAutMovmtSts "Driver Seat Automatic Movement Status Feedback";
CM_ SG_ 288 EasyInOutPassReq "Easy in out request for passenger side";
CM_ SG_ 288 EPedlModSts "e-Pedal mode activation status";
CM_ SG_ 288 FrntAirPtcHVPwrActl "Measured power consumption of the HVAH";
CM_ SG_ 288 IgmGenericADAlrmSt "Active Discharge fault alarm status";
CM_ SG_ 288 IgmGenericDTCHig "DTC high byte for non OBD or OBD";
CM_ SG_ 288 IgmGenericDTCLow "DTC low byte for non OBD";
CM_ SG_ 288 IgmGenericDTCMid "DTC middle byte for non OBD DTC low byte for OBD";
CM_ SG_ 288 IgmGenericDTCSts "DTC Status";
CM_ SG_ 288 IgmGenericEMQnty "Quantity of electric motor";
CM_ SG_ 288 IgmGenericEMSeqNr "Sequence number of electric motor";
CM_ SG_ 288 IgmGenericFltAlrmSt "Fault alarm status";
CM_ SG_ 288 IgmGenericIacAlrmSt "3 Phase current alarm status";
CM_ SG_ 288 IgmGenericInvrtTAlrmSt "Inverter temperature alarm status";
CM_ SG_ 288 IgmGenericModStatusRms "Motor status for RMS monitor";
CM_ SG_ 288 IgmGenericMotTAlrmSt "Motor temperature alarm status";
CM_ SG_ 288 IgmGenericRslAlrmSt "Resolver fault alarm status";
CM_ SG_ 288 IgmGenericSpdAlrmSt "Over speed alarm status";
CM_ SG_ 288 IgmGenericTypeInfo "Indicate different EDS suppliers. OEM defines this value.
0=not defined
1=PMA1 VseA, with ratio=10.134
2=PMA1 Nidec,with ratio=10.294
3=PMA1 VREMT,with ratio=11.56
4=SPAL Scheaffler,with ratio=9.071
5=SPA Simens, with ratio=10.008
6=PMA2 VREMT,with ratio=11.209
7=EPA ZF,with radio=9.187
8=EPA Polestar,with 2-gear ratio=7.155 and 13.645
9=PMA2 UAES,with ratio=11.067";
CM_ SG_ 288 IgmGenericUDcAlrmSt "High voltage alarm status";
CM_ SG_ 288 LockgCenStsForUsrFb "LockgCenStsForUsrFb - Central Locking Status for User Feedback
The signal is used to communicate central locking status to the user of the vehicle";
CM_ SG_ 288 PrpsnMaxEVModBlk "PrpsnMaxEVModBlk";
CM_ SG_ 288 PrpsnModElecDrvBlkd "Propulsion mode PURE ( i.e. Electric Drive) is not available.";
CM_ SG_ 288 PrpsnModOffroadBlkd "Propulsion mode XC ( i.e. Offroad) is not available. ";
CM_ SG_ 288 PrpsnModOfTracBlkd "Propulsion mode AWD (i.e. Traction) is not available.";
CM_ SG_ 288 PrpsnModSptBlkd "Propulsion mode POWER ( i.e. Sport) is not available.";
CM_ SG_ 288 PtModBlkd "Powertrain mode Blocked";
CM_ SG_ 288 RelHumSnsrQf "compartment relative humidity quality flag for climate control.";
CM_ SG_ 288 RemnMilgOfDrvChrg "The mileage required to reach the set SOC";
CM_ SG_ 288 RemnTiOfDrvChrg "The time required to reach the set SOC";
CM_ SG_ 288 RhahFltIndcnReq "RHAH high voltage fault indication request.";
CM_ SG_ 288 SeatOccptAtRowSecDrSide2 "Describes if an occupant is detected in the  seat.";
CM_ SG_ 288 SeatOccptAtRowSecDrSideSnsSts2 "Informs if there is a fault on the driver seat sensor is detected through electrical measurements, or plausibility judgement. NotOk means sensor is judged as faulty. Di means that the sensor is not configured.";
CM_ SG_ 288 SteerWhlHeatgDesPwr "Desired power consumption for steering wheel heating activation.";
CM_ SG_ 288 SteerWhlHeatgPwrAct "The calculated power draw of the heated steering wheel (averaged over the last 30 s)";
CM_ SG_ 288 TrsmNChks "Input shaft revolution speed of gearbox. Output shaft revolution speed of gearbox";
CM_ SG_ 288 TrsmNCntr "Input shaft revolution speed of gearbox. Output shaft revolution speed of gearbox";
CM_ SG_ 288 TrsmNInp "Input shaft revolution speed of gearbox. Output shaft revolution speed of gearbox";
CM_ SG_ 288 TrsmNInpOk "Input shaft revolution speed of gearbox. Output shaft revolution speed of gearbox";
CM_ SG_ 288 TrsmNOutp "Input shaft revolution speed of gearbox. Output shaft revolution speed of gearbox";
CM_ SG_ 288 TrsmNOutpOk "Input shaft revolution speed of gearbox. Output shaft revolution speed of gearbox";
CM_ SG_ 288 VehNotParkInfoWarn "Specifies text that should be displyed in DIM when Drvr attempts to leave car when gear is not in P";
CM_ SG_ 288 WinFailrStsAtDrvr "Report failure if Window motor is not possible to Run";
CM_ SG_ 288 WinFailrStsAtReLe "Report failure if Window motor is not possible to Run";
CM_ SG_ 279 ActvnOfTechLiInfoDisp "activate technology light information display";
CM_ SG_ 279 AdjSpdLimnWarn "The signal triggers visual and/or audial warnings to the driver if the Speed Limiter (ASL/AVSL) can not reach the desired set speed limit.";
CM_ SG_ 279 AutEgyRgnLvlAct "Actual enegy regen level specific for the vehicle with Auto or Off level of regeneration";
CM_ SG_ 279 CenLockMacKeyReq "Mechanical key central control lock lock request";
CM_ SG_ 279 DoorDrvr2Swt1DplyHndl "Door Driver 2 Switch solution deployable handle [Switch 1]
Psd - Pressed = 0
NotPsd - Not Pressed = 1";
CM_ SG_ 279 DoorDrvr2Swt2DplyHndl "Door Driver 2 Switch solution deployable handle [Switch 2]
Psd - Pressed = 0
NotPsd - Not Pressed = 1";
CM_ SG_ 279 DoorDrvrLatPosn "Driver door Cinch position. x01 equal fully open, x02 equal secondary position, x03 equal fully closed.";
CM_ SG_ 279 DoorDrvrRe2Swt1DplyHndl "Door Driver Rear 2 Switch solution deployable handle [Switch 1]
";
CM_ SG_ 279 DoorDrvrRe2Swt2DplyHndl "Door Driver Rear 2 Switch solution deployable handle [Switch 2]
";
CM_ SG_ 279 DrvPfmncRedn "Driver indication signal when there is faults occur reducing driving perfomance";
CM_ SG_ 279 DrvrSeatInAutMovmt "Driver Seat in Automatic Movement";
CM_ SG_ 279 ElecMot2PwrLimMax "Maximum generator motor drive system powerlimit on DC side. Positive power means power flowing into inverter.";
CM_ SG_ 279 ElecMot2PwrLimMin "Minimum generator motor drive system powerlimit on DC side. Positive power means power flowing into inverter.";
CM_ SG_ 279 EngFuCns "Engine fuel consumption";
CM_ SG_ 279 EngFuCnsFild "The econometer data signal for used for driver display have the following requirement for Econometer equalization: Deviations from normal data shall be taken care. Extra fuel consumption shall be stored locally in the ECM, to be transmitted as a distributed small added extra consumption data. ";
CM_ SG_ 279 EpbDrvrDispSec "Request to HMI to display predefined messages and symbols for EPB function.";
CM_ SG_ 279 FbOfMusicShow "feedback to DHU which the status of music light show";
CM_ SG_ 279 FltEgyRstECUReq "Request of ECUs Reset.";
CM_ SG_ 279 FltEgyRstRecReq "Request of Upload ECU Reset event.";
CM_ SG_ 279 FrntSunCurtMvngSts "Status signal to identify when front sun curtain is moving. TRUE equals movement.";
CM_ SG_ 279 FrntSunCurtPosnSts "Interface Reporting front Sun Curtain Position Status.";
CM_ SG_ 279 HvBattLimnIndcn "Propulsion related LOS (Limited Operation Strategy) information from Hv Battery. LOS";
CM_ SG_ 279 IceBreakDoorDrvrActv "Boolean signal to indicate if Driver door ice break function is activated";
CM_ SG_ 279 IceBreakDoorLeReActv "Boolean signal to indicate if Left Rear door ice break function is activated";
CM_ SG_ 279 IsgTqActChks "Checksum";
CM_ SG_ 279 IsgTqActCntr "Counter";
CM_ SG_ 279 IsgTqActIsgTqAct "Actual torque";
CM_ SG_ 279 IsgTqActQualityFactor "Quality factor";
CM_ SG_ 279 LnchModSts "Status of Launch mode";
CM_ SG_ 279 LowrTailgSts "Lower Tailgate/Bootlid Status";
CM_ SG_ 279 MirrAtDrvrInMovmt "Informs the Setting Management subsystem that the outer rear view mirrors are in movement. Driver side.";
CM_ SG_ 279 MirrBtnPsdAtDrvr "Tells if any mirror button has been pressed.";
CM_ SG_ 279 MirrCmdAtPassMirrDwnCmd "Mirror Down/Dip Command";
CM_ SG_ 279 MirrCmdAtPassMirrFoldCmd "Mirror Fold Command";
CM_ SG_ 279 MirrCmdAtPassMirrPosAdjCmd "Mirror Position Adjust Command";
CM_ SG_ 279 MirrPosnToSetTarPosnAtDrvrMirrAdjLeRi "Horizontal position adjustment of mirror";
CM_ SG_ 279 MirrPosnToSetTarPosnAtDrvrMirrAdjUpDown "vertical position adjustment of mirror";
CM_ SG_ 279 OpenDrvrReSwt "Driver rear door open switch status";
CM_ SG_ 279 OpenDrvrSwt "driver door open switch status";
CM_ SG_ 279 PassAirbLampReqChgOfPassAirbSts "Indication request for passenger airbag lamp status. Reqest for indication of passenger airbag status in DIM";
CM_ SG_ 279 PassAirbLampReqChks "Indication request for passenger airbag lamp status. Checksum for validity check of PAD and PAE request messages";
CM_ SG_ 279 PassAirbLampReqCntr "Indication request for passenger airbag lamp status. Counter for validity check of PAD and PAE request messages";
CM_ SG_ 279 PassAirbLampReqPassAirbLampDiReq "Indication request for passenger airbag lamp status. Requested status for PAD lamp";
CM_ SG_ 279 PassAirbLampReqPassAirbLampEnaReq "Indication request for passenger airbag lamp status. Requested status for PAE Lamp";
CM_ SG_ 279 PtGearAct "Actual gear.";
CM_ SG_ 279 PtTqAtWhlReActChks "checksum";
CM_ SG_ 279 PtTqAtWhlReActCntr "counter";
CM_ SG_ 279 PtTqAtWhlReActPtTqAtAxleReAct "Actual torque delivered by the powertrain to the rear axle";
CM_ SG_ 279 PtTqAtWhlReActPtTqAtWhlReLeAct "Actual torque delivered by the powertrain to the rear left wheel.";
CM_ SG_ 279 PtTqAtWhlReActPtTqAtWhlReRiAct "Actual torque delivered by the powertrain to the rear right wheel.";
CM_ SG_ 279 PtTqAtWhlReActPtTqAtWhlsReQly "quality factor";
CM_ SG_ 279 ReSunCurtMvngSts "Status signal to identify when rear sun curtain is moving. TRUE equals movement.";
CM_ SG_ 279 ReSunCurtPosnSts "Interface Reporting rear Sun Curtain Position Status.";
CM_ SG_ 279 RowSecLeSeatAdjmtCllsnWarn "Warning Signal for Second Row Right Seat Adjustment Risk of Collision with Roof Display";
CM_ SG_ 279 RowSecLeSeatAdjmtLimnWarn "Warning Signal of Second Row Left Seat Adjustment Limitation depending on Seat Rotation status";
CM_ SG_ 279 RowSecLeSeatRotAvlSts "Second Row Left Seat Rotation Available Status";
CM_ SG_ 279 RowSecLeSeatRotFailFb "Second Row Left Seat Rotation fail reason feedback";
CM_ SG_ 279 RowSecRiSeatAdjmtCllsnWarn "Warning Signal for Second Row Right Seat Adjustment Risk of Collision with Roof Display";
CM_ SG_ 279 RowSecRiSeatAdjmtLimnWarn "Warning Signal of Second Row Right Seat Adjustment Limitation depending on Seat Rotation status";
CM_ SG_ 279 RowSecRiSeatRotAvlSts "Second Row Right Seat Rotation Available Status";
CM_ SG_ 279 RowSecRiSeatRotFailFb "Second Row Right Seat Rotation fail reason feedback";
CM_ SG_ 279 RowSecRiSeatZeroGrvyRmn "Second Row Right Seat Zero Gravity Reminder signal";
CM_ SG_ 279 SeatCtrlFromSecSeatRi "Request other seats move to the avoidance position and Return";
CM_ SG_ 279 SeatFoldRaiseAllwdRowThrdLe "Seat Fold or Raise Allowed or Not";
CM_ SG_ 279 SeatFoldRaiseAllwdRowThrdRi "Seat Fold or Raise Allowed or Not";
CM_ SG_ 279 SeatMatrsAirPmpDeflaSts "Seat Mattress Air Pump deflate status";
CM_ SG_ 279 SeatMatrsAirPmpInflaSts "Seat Mattress Air Pump inflate status";
CM_ SG_ 279 SeatMatrsAirPmpPrepSts "Seat Mattress Air Pump work prepare status";
CM_ SG_ 279 SeatOccptAtRowThrdLe2 "Describes if an occupant is detected in the  seat.";
CM_ SG_ 279 SeatOccptAtRowThrdLeSnsSts2 "Informs if there is a fault on the driver seat sensor is detected through electrical measurements, or plausibility judgement. NotOk means sensor is judged as faulty. Di means that the sensor is not configured.";
CM_ SG_ 279 SeatOccptAtRowThrdRi2 "Describes if an occupant is detected in the  seat.";
CM_ SG_ 279 SeatOccptAtRowThrdRiSnsSts2 "Informs if there is a fault on the driver seat sensor is detected through electrical measurements, or plausibility judgement. NotOk means sensor is judged as faulty. Di means that the sensor is not configured.";
CM_ SG_ 279 SeatRowThrdLeFoldRaiseWarn "Warning signal for the Third Row Left Seat Fold or Raise";
CM_ SG_ 279 SeatRowThrdLeFoldStsSeatFoldRaiseFlt "Fault Status for the Third Row Left Seat Fold or Raise movement";
CM_ SG_ 279 SeatRowThrdLeFoldStsSeatFoldRaiseMovmt "Status for the Third Row Left Seat Fold or Raise movement";
CM_ SG_ 279 SteerActReGroupAgAct "AgAct";
CM_ SG_ 279 SteerActReGroupAgActQf "Qualify bit for actural angle ";
CM_ SG_ 279 SteerActReGroupAgGrdtMaxAvlFromSteerActrRe "max. available angle gradient of RASM";
CM_ SG_ 279 SteerActReGroupAgMaxAvlFromSteerActrRe "max. available steering angel of RASM";
CM_ SG_ 279 SteerActReGroupChks "Checksum";
CM_ SG_ 279 SteerActReGroupCntr "Rolling counter";
CM_ SG_ 279 SteerActReGroupSteerActrReSts "actuator RASM working state";
CM_ SG_ 279 SteerErrReq "Sent from steering system to display to notify driver if no steering torque assist is available. Messages sent from Steering system to DIM";
CM_ SG_ 279 SteerStsToParkAssi "SteerStsToParkAssi contains PSCM status related to execution of SAP.";
CM_ SG_ 279 SUMDrvModPrsnlAdjmtDamprCmftSts "Can the current height be selected for personalized settings";
CM_ SG_ 279 SUMDrvModPrsnlAdjmtDamprHardSts "Can the current height be selected for personalized settings";
CM_ SG_ 279 SUMDrvModPrsnlAdjmtDamprMedSts "Can the current height be selected for personalized settings";
CM_ SG_ 279 SUMDrvModPrsnlAdjmtDamprSts_Resv1 "Can the current height be selected for personalized settings-Resv1";
CM_ SG_ 279 SUMDrvModPrsnlAdjmtDamprSts_Resv2 "Can the current height be selected for personalized settings-Resv2";
CM_ SG_ 279 SUMDrvModPrsnlAdjmtSuspLvlHL1Sts "Can the current height be selected for personalized settings";
CM_ SG_ 279 SUMDrvModPrsnlAdjmtSuspLvlHL2Sts "Can the current height be selected for personalized settings";
CM_ SG_ 279 SUMDrvModPrsnlAdjmtSuspLvlLL1Sts "Can the current height be selected for personalized settings";
CM_ SG_ 279 SUMDrvModPrsnlAdjmtSuspLvlLL2Sts "Can the current height be selected for personalized settings";
CM_ SG_ 279 SUMDrvModPrsnlAdjmtSuspLvlNRHSts "Can the current height be selected for personalized settings";
CM_ SG_ 279 SunRoofMvngSts "Interface indicating movement status of Sun Roof. Value TRUE equals movement";
CM_ SG_ 279 SwtExtrLi2LiExtFctCntr "Counter";
CM_ SG_ 279 SwtExtrLi2LiExtFctCrc "Checksum";
CM_ SG_ 279 SwtExtrLi2LiExtFctQf "Quality factor";
CM_ SG_ 279 SwtExtrLi2LiExtFctReq1 "Light switch signal";
CM_ SG_ 279 ThrdRowLeVentnAutoSts "Automatic status feedback signal for seats ventilation of third row left.";
CM_ SG_ 279 ThrdRowRiVentnAutoSts "Automatic status feedback signal for seats ventilation of third row right.";
CM_ SG_ 279 TwbrWarnStsChks "Checksum";
CM_ SG_ 279 TwbrWarnStsCntr "Counter";
CM_ SG_ 279 TwbrWarnStsYesNo "To inform the driver if electrical-towbar is released by accident during driving.";
CM_ SG_ 279 WinDsblDrvrReSts "Signal sent from the rear driver door module to the Driver door module that informs of the local status of the power window disable functionality.
";
CM_ SG_ 279 WinDsblLeftCmd "Turn local rear window switch ON/OFF";
CM_ SG_ 279 WinDsblRightCmd "Rear Right Window Switch Control";
CM_ SG_ 279 WinFailrStsAtDrvrRe "Report failure if Window motor is not possible to Run";
CM_ SG_ 279 WinGlbCmd "Global open/close command that tells when to perform a global open or close.";
CM_ SG_ 279 WinPosnStsAtDrvrRe "Signal sent to inform the rest of the car of the window position status for the rear driver side door. The value of the signal is either an approximated percentage of openness, of the window is moving or if the position is unkown.
";
BA_DEF_ BO_ "CANFD_BRS" ENUM "0","1";
BA_DEF_ BO_ "GenMsgCycleTime" INT 0 65536; // [ms]
BA_DEF_ BO_ "GenMsgDelayTime" INT 0 65536; // [ms]
BA_DEF_ BO_ "GenMsgSendType" ENUM "cyclic", "spontaneous", "not-used", "not-used", "not-used", "cyclicAndSpontaneous", "not-used", "cyclicIfActive", "NoMsgSendType"; // [us]
BA_DEF_ BO_ "GenMsgStartDelayTime" INT 0 65536; // [ms]
BA_DEF_ BO_ "VFrameFormat" ENUM "StandardCAN","ExtendedCAN","reserved","J1939PG","reserved","reserved","reserved","reserved","reserved","reserved","reserved","reserved","reserved","reserved","StandardCAN_FD","ExtendedCAN_FD";
BA_DEF_ SG_ "GenSigSendType" ENUM "Cyclic","OnWrite","OnWriteWithRepetition","OnChange","OnChangeWithRepetition","IfActive","IfActiveWithRepetition","NoSigSendType";
BA_DEF_ SG_ "GenSigStartValue" HEX 0 80000000;
BA_DEF_ BO_ "GenMsgILSupport" ENUM "No","Yes";
BA_DEF_ BO_ "NmAsrMessage" ENUM "No","Yes";
BA_DEF_ SG_ "GenSigFuncType" ENUM "NoFunction","n/a","n/a","n/a","n/a","n/a","n/a","n/a","n/a","n/a","n/a","n/a","n/a","n/a","n/a","CHK","CNTR","n/a","n/a","n/a","CNTR_AR_01","CRC_AR_01_BOTH","CRC_AR_01_ALT","CRC_AR_01_LOW","CRC_AR_01_NIBBLE","CNTR_AR_04","CRC_AR_04A","CNTR_AR_05","CRC_AR_05";
BA_DEF_ SG_ "GenSigDataID" STRING;
BA_DEF_DEF_ "CANFD_BRS" "1";
BA_DEF_DEF_ "GenSigStartValue" 0;
BA_DEF_DEF_ "VFrameFormat" "J1939PG";
BA_DEF_DEF_ "GenSigSendType" "NoSigSendType";
BA_DEF_DEF_ "GenMsgCycleTime" 0;
BA_DEF_DEF_ "GenMsgDelayTime" 0;
BA_DEF_DEF_ "GenMsgStartDelayTime" 0;
BA_DEF_DEF_ "GenMsgSendType" "NoMsgSendType";
BA_DEF_DEF_ "GenMsgILSupport" "Yes";
BA_DEF_DEF_ "NmAsrMessage" "No";
BA_DEF_DEF_ "GenSigFuncType" "NoFunction";
BA_DEF_DEF_ "GenSigDataID" "";
// Frame: ZCUDZCUCANFD2Fr05
BA_ "GenMsgCycleTime" BO_ 336 60.000;
BA_ "GenMsgSendType" BO_ 336 0;
BA_ "VFrameFormat" BO_ 336 14;
// Frame: ZCUDZCUCANFD2Fr06
BA_ "GenMsgCycleTime" BO_ 53 10.000;
BA_ "GenMsgSendType" BO_ 53 0;
BA_ "VFrameFormat" BO_ 53 14;
// Frame: ZCUDZCUCANFD2Fr07
BA_ "GenMsgCycleTime" BO_ 312 150.000;
BA_ "GenMsgSendType" BO_ 312 0;
BA_ "VFrameFormat" BO_ 312 14;
// Frame: ZCUDZCUCANFD2Fr08
BA_ "GenMsgCycleTime" BO_ 288 120.000;
BA_ "GenMsgSendType" BO_ 288 0;
BA_ "VFrameFormat" BO_ 288 14;
// Frame: ZCUDZCUCANFD2Fr09
BA_ "GenMsgCycleTime" BO_ 279 30.000;
BA_ "GenMsgSendType" BO_ 279 0;
BA_ "VFrameFormat" BO_ 279 14;
BA_ "GenSigSendType" SG_ 53 ActnOfDynChrgnInEITL 0;
BA_ "GenSigSendType" SG_ 336 ActvnOfHzrd 0;
BA_ "GenSigSendType" SG_ 53 ActvnOfIndcrIndcrOut 0;
BA_ "GenSigDataID" SG_ 53 ActvnOfIndcrIndcrOutChks "0x9E";
BA_ "GenSigFuncType" SG_ 53 ActvnOfIndcrIndcrOutChks 15;
BA_ "GenSigSendType" SG_ 53 ActvnOfIndcrIndcrOutChks 0;
BA_ "GenSigFuncType" SG_ 53 ActvnOfIndcrIndcrOutCntr 16;
BA_ "GenSigSendType" SG_ 53 ActvnOfIndcrIndcrOutCntr 0;
BA_ "GenSigSendType" SG_ 53 ActvnOfMusicShowforEITL 0;
BA_ "GenSigSendType" SG_ 53 ActvnOfParkShowforEITL 0;
BA_ "GenSigSendType" SG_ 312 ActvnOfPasSideDoorIllmn 0;
BA_ "GenSigSendType" SG_ 312 ActvnOfPasSideStepIllmn 0;
BA_ "GenSigSendType" SG_ 312 ActvnOfRePasDoorIllmn 0;
BA_ "GenSigSendType" SG_ 312 ActvnOfRePasSideStepIllmn 0;
BA_ "GenSigSendType" SG_ 312 ActvnOfSwtIllmnSply 0;
BA_ "GenSigSendType" SG_ 279 ActvnOfTechLiInfoDisp 0;
BA_ "GenSigSendType" SG_ 53 ActvnOfVSTDInEITL 0;
BA_ "GenSigSendType" SG_ 279 AdjSpdLimnWarn 0;
BA_ "GenSigSendType" SG_ 288 AlcoLockMgrWarnlndcn 0;
BA_ "GenSigSendType" SG_ 312 AntithftActvnNotif 0;
BA_ "GenSigSendType" SG_ 279 AutEgyRgnLvlAct 0;
BA_ "GenSigSendType" SG_ 53 BLEKeySearchReqKeyLocn 1;
BA_ "GenSigSendType" SG_ 53 BLEKeySearchReqTirgger 1;
BA_ "GenSigSendType" SG_ 312 BattCooltIndcnReq 0;
BA_ "GenSigSendType" SG_ 288 BattFltStsPrimBattFltStsPrm 0;
BA_ "GenSigSendType" SG_ 288 BattFltStsPrimChks 0;
BA_ "GenSigSendType" SG_ 288 BattFltStsPrimCntr 0;
BA_ "GenSigSendType" SG_ 312 BattSocRaw 0;
BA_ "GenSigSendType" SG_ 312 BattURaw 0;
BA_ "GenSigSendType" SG_ 336 BookChrgnTarValFb 0;
BA_ "GenSigStartValue" SG_ 336 BookChrgnTarValFb 1000;
BA_ "GenSigSendType" SG_ 312 BrkBoostErrIndcnReq 0;
BA_ "GenSigSendType" SG_ 288 CarLoctrHornLiSetActv 0;
BA_ "GenSigSendType" SG_ 279 CenLockMacKeyReq 0;
BA_ "GenSigSendType" SG_ 53 ChdLockDrvrReSts 0;
BA_ "GenSigSendType" SG_ 53 ChdLockLeftCmd 0;
BA_ "GenSigSendType" SG_ 53 ChdLockRightCmd 0;
BA_ "GenSigSendType" SG_ 336 ChrgLidRearLockCmd 0;
BA_ "GenSigSendType" SG_ 312 ChrgnByEngStsDurgDcha 0;
BA_ "GenSigSendType" SG_ 336 ChrgnOrDisChrgnStsFb 0;
BA_ "GenSigSendType" SG_ 312 ChrgnWarn 0;
BA_ "GenSigSendType" SG_ 288 CmptmtFrntWindT 0;
BA_ "GenSigStartValue" SG_ 288 CmptmtFrntWindT 650;
BA_ "GenSigSendType" SG_ 288 CmptmtRelHum 0;
BA_ "GenSigStartValue" SG_ 288 CmptmtRelHum 80;
BA_ "GenSigDataID" SG_ 53 CrashStsSafeChks "0x40B";
BA_ "GenSigFuncType" SG_ 53 CrashStsSafeChks 15;
BA_ "GenSigSendType" SG_ 53 CrashStsSafeChks 1;
BA_ "GenSigStartValue" SG_ 53 CrashStsSafeChks 255;
BA_ "GenSigFuncType" SG_ 53 CrashStsSafeCntr 16;
BA_ "GenSigSendType" SG_ 53 CrashStsSafeCntr 1;
BA_ "GenSigSendType" SG_ 53 CrashStsSafeSts 1;
BA_ "GenSigSendType" SG_ 336 CrashUnlckPosHldng 0;
BA_ "GenSigSendType" SG_ 288 DefrstStsMirrDefrst 0;
BA_ "GenSigSendType" SG_ 288 DefrstStsWinDefrstFrnt 0;
BA_ "GenSigSendType" SG_ 288 DefrstStsWinDefrstRe 0;
BA_ "GenSigSendType" SG_ 312 DispElecPwrAbs 0;
BA_ "GenSigSendType" SG_ 312 DispElecPwrSts 0;
BA_ "GenSigSendType" SG_ 312 DispOfBrkPwrPercRgnMin 0;
BA_ "GenSigStartValue" SG_ 312 DispOfBrkPwrPercRgnMin 500;
BA_ "GenSigSendType" SG_ 336 DispOfPrpsnMod 0;
BA_ "GenSigSendType" SG_ 312 DispOfPrpsnPwrPercElecMax 0;
BA_ "GenSigSendType" SG_ 279 DoorDrvr2Swt1DplyHndl 0;
BA_ "GenSigStartValue" SG_ 279 DoorDrvr2Swt1DplyHndl 1;
BA_ "GenSigSendType" SG_ 279 DoorDrvr2Swt2DplyHndl 0;
BA_ "GenSigSendType" SG_ 312 DoorDrvrCinhIntFailInfCinchFlt1 0;
BA_ "GenSigSendType" SG_ 312 DoorDrvrCinhIntFailInfCinchRestFlt 0;
BA_ "GenSigSendType" SG_ 53 DoorDrvrHndlSts 0;
BA_ "GenSigSendType" SG_ 279 DoorDrvrLatPosn 0;
BA_ "GenSigSendType" SG_ 279 DoorDrvrRe2Swt1DplyHndl 0;
BA_ "GenSigStartValue" SG_ 279 DoorDrvrRe2Swt1DplyHndl 1;
BA_ "GenSigSendType" SG_ 279 DoorDrvrRe2Swt2DplyHndl 0;
BA_ "GenSigSendType" SG_ 53 DoorDrvrReCinhIntFailInfCinchFlt1 0;
BA_ "GenSigSendType" SG_ 53 DoorDrvrReCinhIntFailInfCinchRestFlt 0;
BA_ "GenSigSendType" SG_ 53 DoorDrvrReHndlSts 0;
BA_ "GenSigSendType" SG_ 53 DoorDrvrReLatPosn 0;
BA_ "GenSigSendType" SG_ 53 DoorDrvrReLockSts 0;
BA_ "GenSigSendType" SG_ 53 DoorDrvrReOpenLowReqOutdSwt1 0;
BA_ "GenSigStartValue" SG_ 53 DoorDrvrReOpenLowReqOutdSwt1 2;
BA_ "GenSigSendType" SG_ 53 DoorDrvrReOpenReqInsdSwt1 0;
BA_ "GenSigStartValue" SG_ 53 DoorDrvrReOpenReqInsdSwt1 2;
BA_ "GenSigSendType" SG_ 53 DoorDrvrReRelsFailCinchOverTimed 0;
BA_ "GenSigSendType" SG_ 53 DoorDrvrReRelsFailFailure1 0;
BA_ "GenSigSendType" SG_ 53 DoorDrvrReRelsFailMechRels 0;
BA_ "GenSigSendType" SG_ 312 DoorDrvrRelsFailCinchOverTimed 0;
BA_ "GenSigSendType" SG_ 312 DoorDrvrRelsFailFailure1 0;
BA_ "GenSigSendType" SG_ 312 DoorDrvrRelsFailMechRels 0;
BA_ "GenSigSendType" SG_ 312 DoorLeReCinhIntFailInfCinchFlt1 0;
BA_ "GenSigSendType" SG_ 312 DoorLeReCinhIntFailInfCinchRestFlt 0;
BA_ "GenSigSendType" SG_ 53 DoorLeReHndlSts 0;
BA_ "GenSigSendType" SG_ 53 DoorLeReLatPosn 0;
BA_ "GenSigSendType" SG_ 53 DoorLeReLockCmd 0;
BA_ "GenSigSendType" SG_ 312 DoorLeReRelsFailCinchOverTimed 0;
BA_ "GenSigSendType" SG_ 312 DoorLeReRelsFailFailure1 0;
BA_ "GenSigSendType" SG_ 312 DoorLeReRelsFailMechRels 0;
BA_ "GenSigSendType" SG_ 53 DoorLeReRelsReq 0;
BA_ "GenSigSendType" SG_ 53 DoorPassLockCmd 0;
BA_ "GenSigSendType" SG_ 53 DoorPassRelsReq 0;
BA_ "GenSigSendType" SG_ 53 DoorRiReLockCmd 0;
BA_ "GenSigSendType" SG_ 53 DoorRiReRelsReq 0;
BA_ "GenSigSendType" SG_ 336 DoorSldngLeRePreConNotFulfil 0;
BA_ "GenSigSendType" SG_ 336 DoorSldngRiReOpenEnaSts 0;
BA_ "GenSigSendType" SG_ 336 DoorSldngRiRePreConNotFulfil 0;
BA_ "GenSigSendType" SG_ 279 DrvPfmncRedn 0;
BA_ "GenSigSendType" SG_ 312 DrvrSeatActvSpplFct 0;
BA_ "GenSigSendType" SG_ 288 DrvrSeatAutMovmtSts 0;
BA_ "GenSigSendType" SG_ 312 DrvrSeatBtnPsd 0;
BA_ "GenSigSendType" SG_ 312 DrvrSeatExtAdjAllowd 0;
BA_ "GenSigSendType" SG_ 312 DrvrSeatHeatgLvlSts 0;
BA_ "GenSigSendType" SG_ 279 DrvrSeatInAutMovmt 0;
BA_ "GenSigSendType" SG_ 312 DrvrSeatSwtStsDrvrSeatSwtAdjmtOfSpplFctHozlSts 0;
BA_ "GenSigSendType" SG_ 312 DrvrSeatSwtStsDrvrSeatSwtAdjmtOfSpplFctVertSts 0;
BA_ "GenSigSendType" SG_ 312 DrvrSeatSwtStsDrvrSeatSwtHdrstHozlSts 0;
BA_ "GenSigSendType" SG_ 312 DrvrSeatSwtStsDrvrSeatSwtHdrstVertSts 0;
BA_ "GenSigSendType" SG_ 312 DrvrSeatSwtStsDrvrSeatSwtHeiFrntSts 0;
BA_ "GenSigSendType" SG_ 312 DrvrSeatSwtStsDrvrSeatSwtHeiSts 0;
BA_ "GenSigSendType" SG_ 312 DrvrSeatSwtStsDrvrSeatSwtInclSts 0;
BA_ "GenSigSendType" SG_ 312 DrvrSeatSwtStsDrvrSeatSwtSelnOfSpplFctSts 0;
BA_ "GenSigSendType" SG_ 312 DrvrSeatSwtStsDrvrSeatSwtSldSts 0;
BA_ "GenSigSendType" SG_ 312 DrvrSeatVentAvlSts 0;
BA_ "GenSigSendType" SG_ 336 DstEstimdToEmptyForDrvgElec 0;
BA_ "GenSigSendType" SG_ 312 DstEstimdToEmptyForTarSoc1 0;
BA_ "GenSigSendType" SG_ 312 DstEstimdToEmptyForTarSoc2 0;
BA_ "GenSigSendType" SG_ 336 DstToEmptyIndcdDstToEmpty1 0;
BA_ "GenSigSendType" SG_ 336 DstToEmptyIndcdDstToEmpty2 0;
BA_ "GenSigSendType" SG_ 312 DstTrvldFromBodyBkp 0;
BA_ "GenSigSendType" SG_ 312 DstTrvldVldFromBodyBkp 0;
BA_ "GenSigStartValue" SG_ 288 EPedlModSts 1;
BA_ "GenSigSendType" SG_ 288 EasyInOutPassReq 0;
BA_ "GenSigSendType" SG_ 312 EgyRegenEgyAct 0;
BA_ "GenSigSendType" SG_ 279 ElecMot2PwrLimMax 0;
BA_ "GenSigSendType" SG_ 279 ElecMot2PwrLimMin 0;
BA_ "GenSigStartValue" SG_ 279 ElecMot2PwrLimMin 1022;
BA_ "GenSigSendType" SG_ 336 ElecMot2SpdActSgn 0;
BA_ "GenSigSendType" SG_ 336 ElecMot2SpdReq 0;
BA_ "GenSigDataID" SG_ 336 ElecMot2TqActChks "0x467";
BA_ "GenSigFuncType" SG_ 336 ElecMot2TqActChks 15;
BA_ "GenSigSendType" SG_ 336 ElecMot2TqActChks 0;
BA_ "GenSigFuncType" SG_ 336 ElecMot2TqActCntr 16;
BA_ "GenSigSendType" SG_ 336 ElecMot2TqActCntr 0;
BA_ "GenSigSendType" SG_ 336 ElecMot2TqActIsgTqAct 0;
BA_ "GenSigStartValue" SG_ 336 ElecMot2TqActIsgTqAct 8188;
BA_ "GenSigSendType" SG_ 336 ElecMot2TqActQualityFactor 0;
BA_ "GenSigStartValue" SG_ 336 ElecMot2TqActQualityFactor 1;
BA_ "GenSigDataID" SG_ 336 ElecMot2TqAllwdChks "0x5B";
BA_ "GenSigFuncType" SG_ 336 ElecMot2TqAllwdChks 15;
BA_ "GenSigSendType" SG_ 336 ElecMot2TqAllwdChks 0;
BA_ "GenSigFuncType" SG_ 336 ElecMot2TqAllwdCntr 16;
BA_ "GenSigSendType" SG_ 336 ElecMot2TqAllwdCntr 0;
BA_ "GenSigSendType" SG_ 336 ElecMot2TqAllwdIsgTqAllwd 0;
BA_ "GenSigSendType" SG_ 336 ElecMot2TqAvlIsgTqAvlMax 0;
BA_ "GenSigStartValue" SG_ 336 ElecMot2TqAvlIsgTqAvlMax 8188;
BA_ "GenSigSendType" SG_ 336 ElecMot2TqAvlIsgTqAvlMin 0;
BA_ "GenSigStartValue" SG_ 336 ElecMot2TqAvlIsgTqAvlMin 8188;
BA_ "GenSigSendType" SG_ 336 ElecMot2TqReq 0;
BA_ "GenSigStartValue" SG_ 336 ElecMot2TqReq 8188;
BA_ "GenSigSendType" SG_ 312 EngCooltIndcnReq 0;
BA_ "GenSigSendType" SG_ 312 EngCooltTPercForDisp 0;
BA_ "GenSigSendType" SG_ 312 EngFltIndcn1 0;
BA_ "GenSigSendType" SG_ 312 EngFltIndcn10 0;
BA_ "GenSigSendType" SG_ 312 EngFltIndcn11 0;
BA_ "GenSigSendType" SG_ 312 EngFltIndcn12 0;
BA_ "GenSigSendType" SG_ 312 EngFltIndcn13 0;
BA_ "GenSigSendType" SG_ 312 EngFltIndcn14 0;
BA_ "GenSigSendType" SG_ 312 EngFltIndcn15 0;
BA_ "GenSigSendType" SG_ 312 EngFltIndcn16 0;
BA_ "GenSigSendType" SG_ 312 EngFltIndcn17 0;
BA_ "GenSigSendType" SG_ 312 EngFltIndcn18 0;
BA_ "GenSigSendType" SG_ 312 EngFltIndcn19 0;
BA_ "GenSigSendType" SG_ 312 EngFltIndcn2 0;
BA_ "GenSigSendType" SG_ 312 EngFltIndcn20 0;
BA_ "GenSigSendType" SG_ 312 EngFltIndcn21 0;
BA_ "GenSigSendType" SG_ 312 EngFltIndcn22 0;
BA_ "GenSigSendType" SG_ 312 EngFltIndcn23 0;
BA_ "GenSigSendType" SG_ 312 EngFltIndcn24 0;
BA_ "GenSigSendType" SG_ 312 EngFltIndcn25 0;
BA_ "GenSigSendType" SG_ 312 EngFltIndcn26 0;
BA_ "GenSigSendType" SG_ 312 EngFltIndcn27 0;
BA_ "GenSigSendType" SG_ 312 EngFltIndcn3 0;
BA_ "GenSigSendType" SG_ 312 EngFltIndcn4 0;
BA_ "GenSigSendType" SG_ 312 EngFltIndcn5 0;
BA_ "GenSigSendType" SG_ 312 EngFltIndcn6 0;
BA_ "GenSigSendType" SG_ 312 EngFltIndcn7 0;
BA_ "GenSigSendType" SG_ 312 EngFltIndcn8 0;
BA_ "GenSigSendType" SG_ 312 EngFltIndcn9 0;
BA_ "GenSigSendType" SG_ 279 EngFuCns 0;
BA_ "GenSigSendType" SG_ 279 EngFuCnsFild 0;
BA_ "GenSigSendType" SG_ 312 EngOilLvl 0;
BA_ "GenSigSendType" SG_ 312 EngOilLvlSts 0;
BA_ "GenSigSendType" SG_ 312 EngOilPWarn 0;
BA_ "GenSigSendType" SG_ 279 EpbDrvrDispSec 0;
BA_ "GenSigDataID" SG_ 53 EpbLampReqSecChks "0x45D";
BA_ "GenSigFuncType" SG_ 53 EpbLampReqSecChks 15;
BA_ "GenSigSendType" SG_ 53 EpbLampReqSecChks 0;
BA_ "GenSigFuncType" SG_ 53 EpbLampReqSecCntr 16;
BA_ "GenSigSendType" SG_ 53 EpbLampReqSecCntr 0;
BA_ "GenSigSendType" SG_ 53 EpbLampReqSecEpbLampReq 0;
BA_ "GenSigSendType" SG_ 312 ExtLiShwDwnldSts 0;
BA_ "GenSigSendType" SG_ 53 ExtrLiRlySafe 0;
BA_ "GenSigSendType" SG_ 312 ExtrLiShowActvnStsExtrLiShowActvnFrntLeFb 0;
BA_ "GenSigSendType" SG_ 312 ExtrLiShowActvnStsExtrLiShowActvnFrntRiFb 0;
BA_ "GenSigSendType" SG_ 312 ExtrLiShowActvnStsExtrLiShowActvnReLe2Fb 0;
BA_ "GenSigSendType" SG_ 312 ExtrLiShowActvnStsExtrLiShowActvnReLeFb 0;
BA_ "GenSigSendType" SG_ 312 ExtrLiShowActvnStsExtrLiShowActvnReRi2Fb 0;
BA_ "GenSigSendType" SG_ 312 ExtrLiShowActvnStsExtrLiShowActvnReRiFb 0;
BA_ "GenSigSendType" SG_ 279 FbOfMusicShow 0;
BA_ "GenSigSendType" SG_ 279 FltEgyRstECUReq 0;
BA_ "GenSigSendType" SG_ 279 FltEgyRstRecReq 0;
BA_ "GenSigSendType" SG_ 288 FrntAirPtcHVPwrActl 0;
BA_ "GenSigSendType" SG_ 336 FrntSeatEEInhbRowSecLe 0;
BA_ "GenSigSendType" SG_ 336 FrntSeatEEInhbRowSecRi 0;
BA_ "GenSigSendType" SG_ 279 FrntSunCurtMvngSts 0;
BA_ "GenSigSendType" SG_ 279 FrntSunCurtPosnSts 0;
BA_ "GenSigSendType" SG_ 312 FrntWiprLvrCmd2FrntWiprLvrCmd1 0;
BA_ "GenSigSendType" SG_ 312 FrntWiprLvrCmd2FrntWiprLvrCntr 0;
BA_ "GenSigSendType" SG_ 312 FrntWiprLvrCmd2FrntWiprLvrCrc 0;
BA_ "GenSigSendType" SG_ 312 FrntWiprLvrCmd2FrntWiprLvrQf 0;
BA_ "GenSigStartValue" SG_ 312 FrntWiprLvrCmd2FrntWiprLvrQf 1;
BA_ "GenSigSendType" SG_ 312 HmiEngHybSts 0;
BA_ "GenSigSendType" SG_ 312 HmiFuLidNotClsd 0;
BA_ "GenSigSendType" SG_ 312 HmiFuLidOpenSts 0;
BA_ "GenSigSendType" SG_ 312 HmiFuTankRdy 0;
BA_ "GenSigSendType" SG_ 312 HmiVehStopForRefu 0;
BA_ "GenSigSendType" SG_ 312 HpBattVlvPosRec 0;
BA_ "GenSigSendType" SG_ 312 HudSnsrErrParChk 0;
BA_ "GenSigSendType" SG_ 312 HudSnsrErrSnsrErr 0;
BA_ "GenSigSendType" SG_ 279 HvBattLimnIndcn 0;
BA_ "GenSigSendType" SG_ 312 HvBattSoc 0;
BA_ "GenSigSendType" SG_ 312 HvClimaCmd 0;
BA_ "GenSigStartValue" SG_ 312 HvClimaCmd 1;
BA_ "GenSigSendType" SG_ 279 IceBreakDoorDrvrActv 0;
BA_ "GenSigSendType" SG_ 53 IceBreakDoorDrvrReActv 0;
BA_ "GenSigSendType" SG_ 279 IceBreakDoorLeReActv 0;
BA_ "GenSigSendType" SG_ 288 IgmGenericADAlrmSt 0;
BA_ "GenSigSendType" SG_ 288 IgmGenericDTCHig 0;
BA_ "GenSigSendType" SG_ 288 IgmGenericDTCLow 0;
BA_ "GenSigSendType" SG_ 288 IgmGenericDTCMid 0;
BA_ "GenSigSendType" SG_ 288 IgmGenericDTCSts 0;
BA_ "GenSigSendType" SG_ 288 IgmGenericEMQnty 0;
BA_ "GenSigSendType" SG_ 288 IgmGenericEMSeqNr 0;
BA_ "GenSigSendType" SG_ 288 IgmGenericFltAlrmSt 0;
BA_ "GenSigSendType" SG_ 288 IgmGenericIacAlrmSt 0;
BA_ "GenSigSendType" SG_ 288 IgmGenericInvrtTAlrmSt 0;
BA_ "GenSigSendType" SG_ 288 IgmGenericModStatusRms 0;
BA_ "GenSigStartValue" SG_ 288 IgmGenericModStatusRms 3;
BA_ "GenSigSendType" SG_ 288 IgmGenericMotTAlrmSt 0;
BA_ "GenSigSendType" SG_ 288 IgmGenericRslAlrmSt 0;
BA_ "GenSigSendType" SG_ 288 IgmGenericSpdAlrmSt 0;
BA_ "GenSigSendType" SG_ 288 IgmGenericTypeInfo 0;
BA_ "GenSigSendType" SG_ 288 IgmGenericUDcAlrmSt 0;
BA_ "GenSigSendType" SG_ 336 IndirectLifeDetnAndCareDiWarn 0;
BA_ "GenSigSendType" SG_ 336 IndirectLifeDetnAndCareLvl1Warn 0;
BA_ "GenSigSendType" SG_ 312 IntrBriSts 0;
BA_ "GenSigSendType" SG_ 53 IsgIDc 0;
BA_ "GenSigStartValue" SG_ 53 IsgIDc 8188;
BA_ "GenSigSendType" SG_ 312 IsgInvrT 0;
BA_ "GenSigStartValue" SG_ 312 IsgInvrT 50;
BA_ "GenSigSendType" SG_ 312 IsgMotT 0;
BA_ "GenSigStartValue" SG_ 312 IsgMotT 50;
BA_ "GenSigSendType" SG_ 53 IsgSpdActSgn 0;
BA_ "GenSigStartValue" SG_ 53 IsgSpdActSgn 20000;
BA_ "GenSigDataID" SG_ 279 IsgTqActChks "0x46";
BA_ "GenSigFuncType" SG_ 279 IsgTqActChks 15;
BA_ "GenSigSendType" SG_ 279 IsgTqActChks 0;
BA_ "GenSigFuncType" SG_ 279 IsgTqActCntr 16;
BA_ "GenSigSendType" SG_ 279 IsgTqActCntr 0;
BA_ "GenSigSendType" SG_ 279 IsgTqActIsgTqAct 0;
BA_ "GenSigStartValue" SG_ 279 IsgTqActIsgTqAct 8188;
BA_ "GenSigSendType" SG_ 279 IsgTqActQualityFactor 0;
BA_ "GenSigStartValue" SG_ 279 IsgTqActQualityFactor 1;
BA_ "GenSigSendType" SG_ 53 IsgTqReq 0;
BA_ "GenSigStartValue" SG_ 53 IsgTqReq 8188;
BA_ "GenSigSendType" SG_ 336 KeyLostWarnIndcn 0;
BA_ "GenSigSendType" SG_ 336 KeyRmnIndcn 0;
BA_ "GenSigSendType" SG_ 312 LVPwrSplyErrSts 0;
BA_ "GenSigSendType" SG_ 288 LockgCenStsForUsrFb 0;
BA_ "GenSigSendType" SG_ 336 LockgFbAudioReq 0;
BA_ "GenSigSendType" SG_ 336 LockgFbAudioWarn 0;
BA_ "GenSigSendType" SG_ 312 LockgPrsnlSts 0;
BA_ "GenSigSendType" SG_ 279 LowrTailgSts 0;
BA_ "GenSigSendType" SG_ 336 MemBtnPsdMemBtn1 1;
BA_ "GenSigSendType" SG_ 336 MemBtnPsdMemBtn2 1;
BA_ "GenSigSendType" SG_ 336 MemBtnPsdMemBtn3 1;
BA_ "GenSigSendType" SG_ 336 MemBtnPsdMemButM 1;
BA_ "GenSigSendType" SG_ 279 MirrAtDrvrInMovmt 0;
BA_ "GenSigSendType" SG_ 279 MirrBtnPsdAtDrvr 0;
BA_ "GenSigSendType" SG_ 279 MirrCmdAtPassMirrDwnCmd 0;
BA_ "GenSigSendType" SG_ 279 MirrCmdAtPassMirrFoldCmd 0;
BA_ "GenSigSendType" SG_ 279 MirrCmdAtPassMirrPosAdjCmd 0;
BA_ "GenSigSendType" SG_ 279 MirrPosnToSetTarPosnAtDrvrMirrAdjLeRi 0;
BA_ "GenSigStartValue" SG_ 279 MirrPosnToSetTarPosnAtDrvrMirrAdjLeRi 5000;
BA_ "GenSigSendType" SG_ 279 MirrPosnToSetTarPosnAtDrvrMirrAdjUpDown 0;
BA_ "GenSigStartValue" SG_ 279 MirrPosnToSetTarPosnAtDrvrMirrAdjUpDown 5000;
BA_ "GenSigSendType" SG_ 312 ObdAccrPedRat 0;
BA_ "GenSigSendType" SG_ 312 OilMntnAlrmSt 0;
BA_ "GenSigSendType" SG_ 279 OpenDrvrReSwt 0;
BA_ "GenSigSendType" SG_ 279 OpenDrvrSwt 0;
BA_ "GenSigSendType" SG_ 53 OverBoostSts 0;
BA_ "GenSigSendType" SG_ 53 PanicAlrmSts 0;
BA_ "GenSigSendType" SG_ 279 PassAirbLampReqChgOfPassAirbSts 0;
BA_ "GenSigDataID" SG_ 279 PassAirbLampReqChks "0x475";
BA_ "GenSigFuncType" SG_ 279 PassAirbLampReqChks 15;
BA_ "GenSigSendType" SG_ 279 PassAirbLampReqChks 0;
BA_ "GenSigStartValue" SG_ 279 PassAirbLampReqChks 255;
BA_ "GenSigFuncType" SG_ 279 PassAirbLampReqCntr 16;
BA_ "GenSigSendType" SG_ 279 PassAirbLampReqCntr 0;
BA_ "GenSigSendType" SG_ 279 PassAirbLampReqPassAirbLampDiReq 0;
BA_ "GenSigStartValue" SG_ 279 PassAirbLampReqPassAirbLampDiReq 2;
BA_ "GenSigSendType" SG_ 279 PassAirbLampReqPassAirbLampEnaReq 0;
BA_ "GenSigStartValue" SG_ 279 PassAirbLampReqPassAirbLampEnaReq 2;
BA_ "GenSigSendType" SG_ 336 PassElecRunngBdSts 0;
BA_ "GenSigSendType" SG_ 53 PawlDrvrReSwt 0;
BA_ "GenSigSendType" SG_ 53 PawlDrvrSwt 0;
BA_ "GenSigSendType" SG_ 53 PrpsnHvBattUsgModAct 0;
BA_ "GenSigStartValue" SG_ 53 PrpsnHvBattUsgModAct 1;
BA_ "GenSigSendType" SG_ 53 PrpsnHvBattUsgOfDispSoc 0;
BA_ "GenSigSendType" SG_ 288 PrpsnMaxEVModBlk 0;
BA_ "GenSigSendType" SG_ 288 PrpsnModElecDrvBlkd 0;
BA_ "GenSigSendType" SG_ 288 PrpsnModOfTracBlkd 0;
BA_ "GenSigSendType" SG_ 288 PrpsnModOffroadBlkd 0;
BA_ "GenSigSendType" SG_ 288 PrpsnModSptBlkd 0;
BA_ "GenSigSendType" SG_ 279 PtGearAct 0;
BA_ "GenSigSendType" SG_ 53 PtModAct 0;
BA_ "GenSigSendType" SG_ 288 PtModBlkd 0;
BA_ "GenSigDataID" SG_ 53 PtTqAtWhlFrntActChks "0x4E";
BA_ "GenSigFuncType" SG_ 53 PtTqAtWhlFrntActChks 15;
BA_ "GenSigSendType" SG_ 53 PtTqAtWhlFrntActChks 0;
BA_ "GenSigFuncType" SG_ 53 PtTqAtWhlFrntActCntr 16;
BA_ "GenSigSendType" SG_ 53 PtTqAtWhlFrntActCntr 0;
BA_ "GenSigSendType" SG_ 53 PtTqAtWhlFrntActPtTqAtAxleFrntAct 0;
BA_ "GenSigSendType" SG_ 53 PtTqAtWhlFrntActPtTqAtWhlFrntLeAct 0;
BA_ "GenSigSendType" SG_ 53 PtTqAtWhlFrntActPtTqAtWhlFrntRiAct 0;
BA_ "GenSigSendType" SG_ 53 PtTqAtWhlFrntActPtTqAtWhlsFrntQly 0;
BA_ "GenSigDataID" SG_ 279 PtTqAtWhlReActChks "0x59";
BA_ "GenSigFuncType" SG_ 279 PtTqAtWhlReActChks 15;
BA_ "GenSigSendType" SG_ 279 PtTqAtWhlReActChks 0;
BA_ "GenSigFuncType" SG_ 279 PtTqAtWhlReActCntr 16;
BA_ "GenSigSendType" SG_ 279 PtTqAtWhlReActCntr 0;
BA_ "GenSigSendType" SG_ 279 PtTqAtWhlReActPtTqAtAxleReAct 0;
BA_ "GenSigSendType" SG_ 279 PtTqAtWhlReActPtTqAtWhlReLeAct 0;
BA_ "GenSigSendType" SG_ 279 PtTqAtWhlReActPtTqAtWhlReRiAct 0;
BA_ "GenSigSendType" SG_ 279 PtTqAtWhlReActPtTqAtWhlsReQly 0;
BA_ "GenSigSendType" SG_ 279 ReSunCurtMvngSts 0;
BA_ "GenSigSendType" SG_ 279 ReSunCurtPosnSts 0;
BA_ "GenSigSendType" SG_ 53 RecOfImpct2ImpctDvxSigned 0;
BA_ "GenSigStartValue" SG_ 53 RecOfImpct2ImpctDvxSigned 255;
BA_ "GenSigSendType" SG_ 53 RecOfImpct2ImpctDvySigned 0;
BA_ "GenSigStartValue" SG_ 53 RecOfImpct2ImpctDvySigned 255;
BA_ "GenSigSendType" SG_ 312 RecOfImpctCrashFrnt 0;
BA_ "GenSigSendType" SG_ 312 RecOfImpctCrashOffroadA 0;
BA_ "GenSigSendType" SG_ 312 RecOfImpctCrashOffroadD 0;
BA_ "GenSigSendType" SG_ 312 RecOfImpctCrashOffroadRT 0;
BA_ "GenSigSendType" SG_ 312 RecOfImpctCrashOffroadRTsevere 0;
BA_ "GenSigSendType" SG_ 312 RecOfImpctCrashPed 0;
BA_ "GenSigSendType" SG_ 312 RecOfImpctCrashRe 0;
BA_ "GenSigSendType" SG_ 312 RecOfImpctCrashRollovr 0;
BA_ "GenSigSendType" SG_ 312 RecOfImpctCrashSideLe 0;
BA_ "GenSigSendType" SG_ 312 RecOfImpctCrashSideRi 0;
BA_ "GenSigSendType" SG_ 312 RecOfImpctCrashState 0;
BA_ "GenSigSendType" SG_ 312 RecOfImpctImpctDvx 0;
BA_ "GenSigSendType" SG_ 312 RecOfImpctImpctDvy 0;
BA_ "GenSigSendType" SG_ 312 RecOfImpctImpctRollAg 0;
BA_ "GenSigSendType" SG_ 312 RecOfImpctVehOri 0;
BA_ "GenSigStartValue" SG_ 312 RecOfImpctVehOri 4;
BA_ "GenSigSendType" SG_ 288 RelHumSnsrQf 0;
BA_ "GenSigStartValue" SG_ 288 RelHumSnsrQf 1;
BA_ "GenSigSendType" SG_ 288 RemnMilgOfDrvChrg 0;
BA_ "GenSigSendType" SG_ 288 RemnTiOfDrvChrg 0;
BA_ "GenSigSendType" SG_ 288 RhahFltIndcnReq 0;
BA_ "GenSigSendType" SG_ 312 RlyPwrDistbnCmd1WdBattSaveCmd 0;
BA_ "GenSigSendType" SG_ 336 RoofDispCtrlReqFromSecLe 0;
BA_ "GenSigSendType" SG_ 336 RoofDispCtrlReqFromSecRi 0;
BA_ "GenSigSendType" SG_ 336 RowFrstPassDivePosPercSeatPosPerc 0;
BA_ "GenSigSendType" SG_ 336 RowFrstPassDivePosPercSeatPosQf 0;
BA_ "GenSigSendType" SG_ 53 RowSecLeBtnPsd 0;
BA_ "GenSigSendType" SG_ 53 RowSecLeInclPosAngle 0;
BA_ "GenSigSendType" SG_ 53 RowSecLeLegRstHeiPosPercSeatPosPerc 0;
BA_ "GenSigStartValue" SG_ 53 RowSecLeLegRstHeiPosPercSeatPosPerc 1000;
BA_ "GenSigSendType" SG_ 53 RowSecLeLegRstHeiPosPercSeatPosQf 0;
BA_ "GenSigStartValue" SG_ 53 RowSecLeLegRstHeiPosPercSeatPosQf 1;
BA_ "GenSigSendType" SG_ 53 RowSecLeLegRstLenPosPercSeatPosPerc 0;
BA_ "GenSigStartValue" SG_ 53 RowSecLeLegRstLenPosPercSeatPosPerc 1000;
BA_ "GenSigSendType" SG_ 53 RowSecLeLegRstLenPosPercSeatPosQf 0;
BA_ "GenSigStartValue" SG_ 53 RowSecLeLegRstLenPosPercSeatPosQf 1;
BA_ "GenSigSendType" SG_ 279 RowSecLeSeatAdjmtCllsnWarn 0;
BA_ "GenSigSendType" SG_ 279 RowSecLeSeatAdjmtLimnWarn 0;
BA_ "GenSigSendType" SG_ 336 RowSecLeSeatAutMovmtSts 0;
BA_ "GenSigSendType" SG_ 336 RowSecLeSeatInAutMovmt 0;
BA_ "GenSigSendType" SG_ 279 RowSecLeSeatRotAvlSts 0;
BA_ "GenSigStartValue" SG_ 279 RowSecLeSeatRotAvlSts 1;
BA_ "GenSigSendType" SG_ 279 RowSecLeSeatRotFailFb 0;
BA_ "GenSigSendType" SG_ 53 RowSecLeSeatRotPosPerc 0;
BA_ "GenSigSendType" SG_ 336 RowSecLeSeatRotSts 0;
BA_ "GenSigSendType" SG_ 53 RowSecLeSldPosPercSeatPosPerc 0;
BA_ "GenSigStartValue" SG_ 53 RowSecLeSldPosPercSeatPosPerc 1000;
BA_ "GenSigSendType" SG_ 53 RowSecLeSldPosPercSeatPosQf 0;
BA_ "GenSigStartValue" SG_ 53 RowSecLeSldPosPercSeatPosQf 1;
BA_ "GenSigSendType" SG_ 53 RowSecRiBtnPsd 0;
BA_ "GenSigSendType" SG_ 53 RowSecRiInclPosAngle 0;
BA_ "GenSigSendType" SG_ 53 RowSecRiLegRstHeiPosPercSeatPosPerc 0;
BA_ "GenSigStartValue" SG_ 53 RowSecRiLegRstHeiPosPercSeatPosPerc 1000;
BA_ "GenSigSendType" SG_ 53 RowSecRiLegRstHeiPosPercSeatPosQf 0;
BA_ "GenSigStartValue" SG_ 53 RowSecRiLegRstHeiPosPercSeatPosQf 1;
BA_ "GenSigSendType" SG_ 53 RowSecRiLegRstLenPosPercSeatPosPerc 0;
BA_ "GenSigStartValue" SG_ 53 RowSecRiLegRstLenPosPercSeatPosPerc 1000;
BA_ "GenSigSendType" SG_ 53 RowSecRiLegRstLenPosPercSeatPosQf 0;
BA_ "GenSigStartValue" SG_ 53 RowSecRiLegRstLenPosPercSeatPosQf 1;
BA_ "GenSigSendType" SG_ 279 RowSecRiSeatAdjmtCllsnWarn 0;
BA_ "GenSigSendType" SG_ 279 RowSecRiSeatAdjmtLimnWarn 0;
BA_ "GenSigSendType" SG_ 336 RowSecRiSeatAutMovmtSts 0;
BA_ "GenSigSendType" SG_ 336 RowSecRiSeatInAutMovmt 0;
BA_ "GenSigSendType" SG_ 279 RowSecRiSeatRotAvlSts 0;
BA_ "GenSigStartValue" SG_ 279 RowSecRiSeatRotAvlSts 1;
BA_ "GenSigSendType" SG_ 279 RowSecRiSeatRotFailFb 0;
BA_ "GenSigSendType" SG_ 53 RowSecRiSeatRotPosPerc 0;
BA_ "GenSigSendType" SG_ 336 RowSecRiSeatRotSts 0;
BA_ "GenSigSendType" SG_ 279 RowSecRiSeatZeroGrvyRmn 0;
BA_ "GenSigSendType" SG_ 53 RowSecRiSldPosPercSeatPosPerc 0;
BA_ "GenSigStartValue" SG_ 53 RowSecRiSldPosPercSeatPosPerc 1000;
BA_ "GenSigSendType" SG_ 53 RowSecRiSldPosPercSeatPosQf 0;
BA_ "GenSigStartValue" SG_ 53 RowSecRiSldPosPercSeatPosQf 1;
BA_ "GenSigSendType" SG_ 336 RowThrdLeSeatAutMovmtSts 0;
BA_ "GenSigSendType" SG_ 336 RowThrdRiSeatAutMovmtSts 0;
BA_ "GenSigSendType" SG_ 279 SUMDrvModPrsnlAdjmtDamprCmftSts 0;
BA_ "GenSigSendType" SG_ 279 SUMDrvModPrsnlAdjmtDamprHardSts 0;
BA_ "GenSigSendType" SG_ 279 SUMDrvModPrsnlAdjmtDamprMedSts 0;
BA_ "GenSigSendType" SG_ 279 SUMDrvModPrsnlAdjmtDamprSts_Resv1 0;
BA_ "GenSigSendType" SG_ 279 SUMDrvModPrsnlAdjmtDamprSts_Resv2 0;
BA_ "GenSigSendType" SG_ 279 SUMDrvModPrsnlAdjmtSuspLvlHL1Sts 0;
BA_ "GenSigSendType" SG_ 279 SUMDrvModPrsnlAdjmtSuspLvlHL2Sts 0;
BA_ "GenSigSendType" SG_ 279 SUMDrvModPrsnlAdjmtSuspLvlLL1Sts 0;
BA_ "GenSigSendType" SG_ 279 SUMDrvModPrsnlAdjmtSuspLvlLL2Sts 0;
BA_ "GenSigSendType" SG_ 279 SUMDrvModPrsnlAdjmtSuspLvlNRHSts 0;
BA_ "GenSigSendType" SG_ 279 SeatCtrlFromSecSeatRi 0;
BA_ "GenSigSendType" SG_ 279 SeatFoldRaiseAllwdRowThrdLe 0;
BA_ "GenSigSendType" SG_ 279 SeatFoldRaiseAllwdRowThrdRi 0;
BA_ "GenSigSendType" SG_ 288 SeatOccptAtRowSecDrSide2 0;
BA_ "GenSigStartValue" SG_ 288 SeatOccptAtRowSecDrSide2 1;
BA_ "GenSigSendType" SG_ 288 SeatOccptAtRowSecDrSideSnsSts2 0;
BA_ "GenSigSendType" SG_ 279 SeatOccptAtRowThrdLe2 0;
BA_ "GenSigStartValue" SG_ 279 SeatOccptAtRowThrdLe2 1;
BA_ "GenSigSendType" SG_ 279 SeatOccptAtRowThrdLeSnsSts2 0;
BA_ "GenSigSendType" SG_ 279 SeatOccptAtRowThrdRi2 0;
BA_ "GenSigStartValue" SG_ 279 SeatOccptAtRowThrdRi2 1;
BA_ "GenSigSendType" SG_ 279 SeatOccptAtRowThrdRiSnsSts2 0;
BA_ "GenSigSendType" SG_ 279 SeatRowThrdLeFoldRaiseWarn 0;
BA_ "GenSigSendType" SG_ 279 SeatRowThrdLeFoldStsSeatFoldRaiseFlt 0;
BA_ "GenSigSendType" SG_ 279 SeatRowThrdLeFoldStsSeatFoldRaiseMovmt 0;
BA_ "GenSigSendType" SG_ 336 SecRowSeatHeatgActlPwrCnsLe 0;
BA_ "GenSigSendType" SG_ 336 SecRowSeatHeatgActlPwrCnsRi 0;
BA_ "GenSigSendType" SG_ 336 SecRowSeatHeatgDesPwrCnsLe 0;
BA_ "GenSigSendType" SG_ 336 SecRowSeatHeatgDesPwrCnsRi 0;
BA_ "GenSigSendType" SG_ 336 SecRowSeatVentnActlPwrCnsLe 0;
BA_ "GenSigSendType" SG_ 336 SecRowSeatVentnActlPwrCnsRi 0;
BA_ "GenSigSendType" SG_ 336 SecRowSeatVentnDesPwrCnsLe 0;
BA_ "GenSigSendType" SG_ 336 SecRowSeatVentnDesPwrCnsRi 0;
BA_ "GenSigSendType" SG_ 336 ShortDropWinDrvrReSts 0;
BA_ "GenSigSendType" SG_ 312 SolarSnsrLeValue 0;
BA_ "GenSigStartValue" SG_ 312 SolarSnsrLeValue 50.8;
BA_ "GenSigSendType" SG_ 312 SolarSnsrRiValue 0;
BA_ "GenSigStartValue" SG_ 312 SolarSnsrRiValue 50.8;
BA_ "GenSigSendType" SG_ 279 SteerActReGroupAgAct 0;
BA_ "GenSigSendType" SG_ 279 SteerActReGroupAgActQf 0;
BA_ "GenSigSendType" SG_ 279 SteerActReGroupAgGrdtMaxAvlFromSteerActrRe 0;
BA_ "GenSigStartValue" SG_ 279 SteerActReGroupAgGrdtMaxAvlFromSteerActrRe 4096;
BA_ "GenSigSendType" SG_ 279 SteerActReGroupAgMaxAvlFromSteerActrRe 0;
BA_ "GenSigDataID" SG_ 279 SteerActReGroupChks "0x19E2";
BA_ "GenSigFuncType" SG_ 279 SteerActReGroupChks 15;
BA_ "GenSigSendType" SG_ 279 SteerActReGroupChks 0;
BA_ "GenSigFuncType" SG_ 279 SteerActReGroupCntr 16;
BA_ "GenSigSendType" SG_ 279 SteerActReGroupCntr 0;
BA_ "GenSigSendType" SG_ 279 SteerActReGroupSteerActrReSts 0;
BA_ "GenSigSendType" SG_ 279 SteerErrReq 0;
BA_ "GenSigSendType" SG_ 279 SteerStsToParkAssi 0;
BA_ "GenSigSendType" SG_ 53 SteerWhlBtnPsd 0;
BA_ "GenSigSendType" SG_ 288 SteerWhlHeatgDesPwr 0;
BA_ "GenSigSendType" SG_ 312 SteerWhlHeatgLvlSts 0;
BA_ "GenSigSendType" SG_ 288 SteerWhlHeatgPwrAct 0;
BA_ "GenSigSendType" SG_ 53 SteerWhlInMovmt 0;
BA_ "GenSigSendType" SG_ 53 SteerWhlSnsrAg 0;
BA_ "GenSigSendType" SG_ 53 SteerWhlSnsrAgSpd 0;
BA_ "GenSigDataID" SG_ 53 SteerWhlSnsrChks "0x33";
BA_ "GenSigFuncType" SG_ 53 SteerWhlSnsrChks 15;
BA_ "GenSigSendType" SG_ 53 SteerWhlSnsrChks 0;
BA_ "GenSigFuncType" SG_ 53 SteerWhlSnsrCntr 16;
BA_ "GenSigSendType" SG_ 53 SteerWhlSnsrCntr 0;
BA_ "GenSigSendType" SG_ 53 SteerWhlSnsrQf 0;
BA_ "GenSigStartValue" SG_ 53 SteerWhlSnsrQf 1;
BA_ "GenSigSendType" SG_ 312 StopStrtStbIndcn 0;
BA_ "GenSigSendType" SG_ 312 StrtColdIndcnMsg 0;
BA_ "GenSigSendType" SG_ 312 StrtMsgToModMngt 0;
BA_ "GenSigSendType" SG_ 312 SunCurtImpctDetnSts2 0;
BA_ "GenSigSendType" SG_ 279 SunRoofMvngSts 0;
BA_ "GenSigSendType" SG_ 279 SwtExtrLi2LiExtFctCntr 0;
BA_ "GenSigSendType" SG_ 279 SwtExtrLi2LiExtFctCrc 0;
BA_ "GenSigSendType" SG_ 279 SwtExtrLi2LiExtFctQf 0;
BA_ "GenSigStartValue" SG_ 279 SwtExtrLi2LiExtFctQf 1;
BA_ "GenSigSendType" SG_ 279 SwtExtrLi2LiExtFctReq1 0;
BA_ "GenSigSendType" SG_ 312 TCSTmrOverSts 0;
BA_ "GenSigSendType" SG_ 312 TCSTmrStrtSts 0;
BA_ "GenSigSendType" SG_ 336 TailgCllsnRiskSts 0;
BA_ "GenSigSendType" SG_ 312 TelltlPwrLoss 0;
BA_ "GenSigSendType" SG_ 279 ThrdRowLeVentnAutoSts 0;
BA_ "GenSigSendType" SG_ 279 ThrdRowRiVentnAutoSts 0;
BA_ "GenSigSendType" SG_ 336 ThrdRowSeatHeatgActlPwrCnsLe 0;
BA_ "GenSigSendType" SG_ 336 ThrdRowSeatHeatgActlPwrCnsRi 0;
BA_ "GenSigSendType" SG_ 336 ThrdRowSeatHeatgDesPwrCnsLe 0;
BA_ "GenSigSendType" SG_ 336 ThrdRowSeatHeatgDesPwrCnsRi 0;
BA_ "GenSigSendType" SG_ 336 ThrdRowSeatVentnActlPwrCnsLe 0;
BA_ "GenSigSendType" SG_ 336 ThrdRowSeatVentnActlPwrCnsRi 0;
BA_ "GenSigSendType" SG_ 336 ThrdRowSeatVentnDesPwrCnsLe 0;
BA_ "GenSigSendType" SG_ 336 ThrdRowSeatVentnDesPwrCnsRi 0;
BA_ "GenSigSendType" SG_ 53 TrRelsFailtoHMI 0;
BA_ "GenSigSendType" SG_ 312 TrlrLiTurnIndcrActvt 0;
BA_ "GenSigDataID" SG_ 288 TrsmNChks "0x6D";
BA_ "GenSigFuncType" SG_ 288 TrsmNChks 15;
BA_ "GenSigSendType" SG_ 288 TrsmNChks 0;
BA_ "GenSigFuncType" SG_ 288 TrsmNCntr 16;
BA_ "GenSigSendType" SG_ 288 TrsmNCntr 0;
BA_ "GenSigSendType" SG_ 288 TrsmNInp 0;
BA_ "GenSigSendType" SG_ 288 TrsmNInpOk 0;
BA_ "GenSigSendType" SG_ 288 TrsmNOutp 0;
BA_ "GenSigSendType" SG_ 288 TrsmNOutpOk 0;
BA_ "GenSigDataID" SG_ 279 TwbrWarnStsChks "0x1F43";
BA_ "GenSigFuncType" SG_ 279 TwbrWarnStsChks 15;
BA_ "GenSigSendType" SG_ 279 TwbrWarnStsChks 0;
BA_ "GenSigFuncType" SG_ 279 TwbrWarnStsCntr 16;
BA_ "GenSigSendType" SG_ 279 TwbrWarnStsCntr 0;
BA_ "GenSigSendType" SG_ 279 TwbrWarnStsYesNo 0;
BA_ "GenSigStartValue" SG_ 279 TwbrWarnStsYesNo 2;
BA_ "GenSigSendType" SG_ 288 VehNotParkInfoWarn 0;
BA_ "GenSigSendType" SG_ 336 WadeProtnIndcn 0;
BA_ "GenSigSendType" SG_ 53 WadeProtnSts 0;
BA_ "GenSigSendType" SG_ 53 WhlFailrSts 0;
BA_ "GenSigSendType" SG_ 279 WinDsblDrvrReSts 0;
BA_ "GenSigSendType" SG_ 279 WinDsblLeftCmd 0;
BA_ "GenSigSendType" SG_ 279 WinDsblRightCmd 0;
BA_ "GenSigSendType" SG_ 288 WinFailrStsAtDrvr 0;
BA_ "GenSigSendType" SG_ 279 WinFailrStsAtDrvrRe 0;
BA_ "GenSigSendType" SG_ 288 WinFailrStsAtReLe 0;
BA_ "GenSigSendType" SG_ 279 WinGlbCmd 0;
BA_ "GenSigSendType" SG_ 279 WinPosnStsAtDrvrRe 0;
BA_ "GenSigDataID" SG_ 53 WinSwtReqChks "0x45E";
BA_ "GenSigFuncType" SG_ 53 WinSwtReqChks 15;
BA_ "GenSigSendType" SG_ 53 WinSwtReqChks 0;
BA_ "GenSigFuncType" SG_ 53 WinSwtReqCntr 16;
BA_ "GenSigSendType" SG_ 53 WinSwtReqCntr 0;
BA_ "GenSigSendType" SG_ 53 WinSwtReqFrntLe 0;
BA_ "GenSigSendType" SG_ 53 WinSwtReqFrntRi 0;
BA_ "GenSigSendType" SG_ 53 WinSwtReqReLe 0;
BA_ "GenSigSendType" SG_ 53 WinSwtReqReRi 0;
BA_ "GenSigSendType" SG_ 312 WiprInPosnForSrv 0;
BA_ "GenSigSendType" SG_ 312 WiprReInPosnForSrv 0;
VAL_ 336 ChrgLidRearLockCmd 0 "LockActvn2_LockActvnOff" 1 "LockActvn2_LockActvnUnlck" 2 "LockActvn2_LockActvnLock" 3 "LockActvn2_LockActvnSafe" 4 "LockActvn2_LockActvnUnlckByCrash";
VAL_ 336 ChrgnOrDisChrgnStsFb 0 "ChrgnSts2_Default" 1 "ChrgnSts2_NoCharging" 2 "ChrgnSts2_ACCharging" 3 "ChrgnSts2_ChargingEnd" 4 "ChrgnSts2_ChargingCmpl" 5 "ChrgnSts2_Heating" 6 "ChrgnSts2_Booking" 7 "ChrgnSts2_NoDischaring" 8 "ChrgnSts2_Discharging" 9 "ChrgnSts2_DischargingEnd" 10 "ChrgnSts2_DischargingCmpl" 11 "ChrgnSts2_Chargingfalut" 12 "ChrgnSts2_DischargingFalut" 14 "ChrgnSts2_ACChrgnFltChrgrSide" 15 "ChrgnSts2_DCCharging" 18 "ChrgnSts2_DCChrgnFltVehSide" 19 "ChrgnSts2_DCChrgnFltChrgrSideTempFlt" 20 "ChrgnSts2_DCChrgnFltChrgrSideConFlt" 21 "ChrgnSts2_DCChrgnFltChrgrSideHwFlt" 22 "ChrgnSts2_DCChrgnFltChrgrSideEmgyFlt" 23 "ChrgnSts2_DCChrgnFltChrgrSideComFlt" 24 "ChrgnSts2_SuperCharging" 25 "ChrgnSts2_ACChargingSuspend" 26 "ChrgnSts2_DCChargingEnd" 27 "ChrgnSts2_ACChrgnFltVehSide" 28 "ChrgnSts2_Boostcharging" 29 "ChrgnSts2_BoostchargingFlt" 30 "ChrgnSts2_WirelessCharging";
VAL_ 336 CrashUnlckPosHldng 0 "Boolean_FALSE" 1 "Boolean_TRUE";
VAL_ 336 DispOfPrpsnMod 0 "DispOfPrpsnMod4_NotRdy" 1 "DispOfPrpsnMod4_ChrgnWithOnBdChrgr" 2 "DispOfPrpsnMod4_PrpsnMotElecAndPrpsnEng" 3 "DispOfPrpsnMod4_PrpsnMotElecAndPrpsnEngAndChrgn" 4 "DispOfPrpsnMod4_OnlyEngPrpsn" 5 "DispOfPrpsnMod4_OnlyEngPrpsnAndChrgn" 6 "DispOfPrpsnMod4_OnlyPrpsnMotElec" 7 "DispOfPrpsnMod4_NoPrpsnMotElecAndEngOff" 8 "DispOfPrpsnMod4_NoPrpsnMotElecAndOnEng" 9 "DispOfPrpsnMod4_NoPrpsnMotElecAndOnEngAndChrgn" 10 "DispOfPrpsnMod4_BrkgRgnAndEngOff" 11 "DispOfPrpsnMod4_BrkgRgnAndOnEng" 12 "DispOfPrpsnMod4_BrkgRgnAndEngOnAndChrgn" 13 "DispOfPrpsnMod4_Abnormal" 14 "DispOfPrpsnMod4_PrpsnMotElecAndEngChrgn" 15 "DispOfPrpsnMod4_PrpsnMotElecAndEngOn";
VAL_ 336 DoorSldngLeReCinFailCinchFlt1 0 "Boolean_FALSE" 1 "Boolean_TRUE";
VAL_ 336 DoorSldngLeReCinFailCinchRestFlt 0 "Boolean_FALSE" 1 "Boolean_TRUE";
VAL_ 336 DoorSldngLeRePreConNotFulfil 0 "Boolean_FALSE" 1 "Boolean_TRUE";
VAL_ 336 DoorSldngLeReStsDoorOpenSts 0 "DoorOpenerSts_Ukwn" 1 "DoorOpenerSts_FullClsd" 2 "DoorOpenerSts_MovgOut" 3 "DoorOpenerSts_MovgOutBrkg" 4 "DoorOpenerSts_StopDurgOpen" 5 "DoorOpenerSts_FullOpend" 6 "DoorOpenerSts_MovgIn" 7 "DoorOpenerSts_MovgInBrkg" 8 "DoorOpenerSts_StopDurgCls" 9 "DoorOpenerSts_HalfClsd" 10 "DoorOpenerSts_StopMinPntForCls";
VAL_ 336 DoorSldngLeReStsFrstTmLveAbnd 0 "Boolean_FALSE" 1 "Boolean_TRUE";
VAL_ 336 DoorSldngRiReCinFailCinchFlt1 0 "Boolean_FALSE" 1 "Boolean_TRUE";
VAL_ 336 DoorSldngRiReCinFailCinchRestFlt 0 "Boolean_FALSE" 1 "Boolean_TRUE";
VAL_ 336 DoorSldngRiReOpenEnaSts 0 "EnableDisableCoding_Disabled" 1 "EnableDisableCoding_Enabled";
VAL_ 336 DoorSldngRiRePreConNotFulfil 0 "Boolean_FALSE" 1 "Boolean_TRUE";
VAL_ 336 DoorSldngRiReStsDoorOpenSts 0 "DoorOpenerSts_Ukwn" 1 "DoorOpenerSts_FullClsd" 2 "DoorOpenerSts_MovgOut" 3 "DoorOpenerSts_MovgOutBrkg" 4 "DoorOpenerSts_StopDurgOpen" 5 "DoorOpenerSts_FullOpend" 6 "DoorOpenerSts_MovgIn" 7 "DoorOpenerSts_MovgInBrkg" 8 "DoorOpenerSts_StopDurgCls" 9 "DoorOpenerSts_HalfClsd" 10 "DoorOpenerSts_StopMinPntForCls";
VAL_ 336 DoorSldngRiReStsFrstTmLveAbnd 0 "Boolean_FALSE" 1 "Boolean_TRUE";
VAL_ 336 DstFromDestinationFb 0 "DstFromDestinationResp_Default" 1 "DstFromDestinationResp_Success" 2 "DstFromDestinationResp_Fault" 3 "DstFromDestinationResp_EndOfDischarge" 4 "DstFromDestinationResp_Reserved0" 5 "DstFromDestinationResp_Reserved1" 6 "DstFromDestinationResp_Reserved2" 7 "DstFromDestinationResp_Reserved3";
VAL_ 336 ElecMot2TqActQualityFactor 0 "QualityFactor_QfUndefd" 1 "QualityFactor_QfInProgs" 2 "QualityFactor_QfNotSpc" 3 "QualityFactor_QfSnsrDataOk";
VAL_ 336 FrntSeatEEInhbRowSecLe 0 "Inhb1_NotInhb" 1 "Inhb1_Inhb";
VAL_ 336 FrntSeatEEInhbRowSecRi 0 "Inhb1_NotInhb" 1 "Inhb1_Inhb";
VAL_ 336 IndirectLifeDetnAndCareDiWarn 0 "Warn2_NoWarn" 1 "Warn2_Warn";
VAL_ 336 IndirectLifeDetnAndCareLvl1Warn 0 "Warn2_NoWarn" 1 "Warn2_Warn";
VAL_ 336 KeyLostWarnIndcn 0 "KeyLostWarnIndcn_KeyLostNoMsg" 1 "KeyLostWarnIndcn_KeyMsgAndSoundLost" 2 "KeyLostWarnIndcn_KeyMsgLost";
VAL_ 336 KeyRmnIndcn 0 "OnOff1_Off" 1 "OnOff1_On";
VAL_ 336 LiLvrSwt1 0 "SwtPush_NotPsd" 1 "SwtPush_Psd";
VAL_ 336 LockgFbAudioReq 0 "LockActvn2_LockActvnOff" 1 "LockActvn2_LockActvnUnlck" 2 "LockActvn2_LockActvnLock" 3 "LockActvn2_LockActvnSafe" 4 "LockActvn2_LockActvnUnlckByCrash";
VAL_ 336 LockgFbAudioWarn 0 "Boolean_FALSE" 1 "Boolean_TRUE";
VAL_ 336 MemBtnPsdMemBtn1 0 "Boolean_FALSE" 1 "Boolean_TRUE";
VAL_ 336 MemBtnPsdMemBtn2 0 "Boolean_FALSE" 1 "Boolean_TRUE";
VAL_ 336 MemBtnPsdMemBtn3 0 "Boolean_FALSE" 1 "Boolean_TRUE";
VAL_ 336 MemBtnPsdMemButM 0 "Boolean_FALSE" 1 "Boolean_TRUE";
VAL_ 336 PassElecRunngBdSts 0 "OnOff1_Off" 1 "OnOff1_On";
VAL_ 336 RoofDispCtrlReqFromSecLe 0 "Boolean_FALSE" 1 "Boolean_TRUE";
VAL_ 336 RoofDispCtrlReqFromSecRi 0 "Boolean_FALSE" 1 "Boolean_TRUE";
VAL_ 336 RowFrstPassDivePosPercSeatPosQf 0 "Qf1_DevOfDataUndefd" 1 "Qf1_DataTmpUndefdAndEvlnInProgs" 2 "Qf1_DevOfDataNotWithinRngAllwd" 3 "Qf1_DataCalcdWithDevDefd";
VAL_ 336 RowSecLeSeatAutMovmtSts 0 "Sts_Resd" 1 "Sts_Err" 2 "Sts_CmplOk" 3 "Sts_InProgs";
VAL_ 336 RowSecLeSeatInAutMovmt 0 "Boolean_FALSE" 1 "Boolean_TRUE";
VAL_ 336 RowSecLeSeatRotSts 0 "Boolean_FALSE" 1 "Boolean_TRUE";
VAL_ 336 RowSecRiSeatAutMovmtSts 0 "Sts_Resd" 1 "Sts_Err" 2 "Sts_CmplOk" 3 "Sts_InProgs";
VAL_ 336 RowSecRiSeatInAutMovmt 0 "Boolean_FALSE" 1 "Boolean_TRUE";
VAL_ 336 RowSecRiSeatRotSts 0 "Boolean_FALSE" 1 "Boolean_TRUE";
VAL_ 336 RowThrdLeSeatAutMovmtSts 0 "Sts_Resd" 1 "Sts_Err" 2 "Sts_CmplOk" 3 "Sts_InProgs";
VAL_ 336 RowThrdRiSeatAutMovmtSts 0 "Sts_Resd" 1 "Sts_Err" 2 "Sts_CmplOk" 3 "Sts_InProgs";
VAL_ 336 ShortDropWinDrvrReSts 0 "ShortDropSts_Idle" 1 "ShortDropSts_WindowDown" 2 "ShortDropSts_WindowClosed" 3 "ShortDropSts_NotUsed";
VAL_ 336 TailgCllsnRiskSts 0 "Boolean_FALSE" 1 "Boolean_TRUE";
VAL_ 336 WadeProtnIndcn 0 "WadeProtnIndcn_Default" 1 "WadeProtnIndcn_OFF" 2 "WadeProtnIndcn_ON" 3 "WadeProtnIndcn_CdnNotMet" 4 "WadeProtnIndcn_LowLvSoc" 5 "WadeProtnIndcn_EngStall" 6 "WadeProtnIndcn_LowHvBattSoc" 7 "WadeProtnIndcn_Reserved";
VAL_ 53 ActnOfDynChrgnInEITL 0 "OnOff1_Off" 1 "OnOff1_On";
VAL_ 53 ActvnOfIndcrIndcrOut 0 "IndcrSts1_Off" 1 "IndcrSts1_LeOn" 2 "IndcrSts1_RiOn" 3 "IndcrSts1_LeAndRiOn";
VAL_ 53 ActvnOfMusicShowforEITL 0 "OnOff1_Off" 1 "OnOff1_On";
VAL_ 53 ActvnOfParkShowforEITL 0 "OnOff1_Off" 1 "OnOff1_On";
VAL_ 53 ActvnOfVSTDInEITL 0 "AlrmSt_Disarmd" 1 "AlrmSt_Armd" 2 "AlrmSt_Actv";
VAL_ 53 BLEKeySearchReqKeyLocn 0 "KeyLocn1_KeyLocnIdle" 1 "KeyLocn1_KeyLocnAll" 2 "KeyLocn1_KeyLocnAllExt" 3 "KeyLocn1_KeyLocnDrvrExt" 4 "KeyLocn1_KeyLocnPassExt" 5 "KeyLocn1_KeyLocnTrExt" 6 "KeyLocn1_KeyLocnAllInt" 7 "KeyLocn1_KeyLocnDrvrInt" 8 "KeyLocn1_KeyLocnPassInt" 9 "KeyLocn1_KeyLocnResvInt" 10 "KeyLocn1_KeyLocnResvIntSimple";
VAL_ 53 BLEKeySearchReqTirgger 0 "Tirgger_Idle" 1 "Tirgger_VMM" 2 "Tirgger_Locking" 3 "Tirgger_KeyRmn" 4 "Tirgger_KeyWrn" 5 "Tirgger_ProfiMgr";
VAL_ 53 ChdLockDrvrReSts 0 "OnOffSafe1_OnOffSafeInvld1" 1 "OnOffSafe1_OnOffSafeOn" 2 "OnOffSafe1_OnOffSafeOff" 3 "OnOffSafe1_OnOffSafeInvld2";
VAL_ 53 ChdLockLeftCmd 0 "OnOffSafe1_OnOffSafeInvld1" 1 "OnOffSafe1_OnOffSafeOn" 2 "OnOffSafe1_OnOffSafeOff" 3 "OnOffSafe1_OnOffSafeInvld2";
VAL_ 53 ChdLockRightCmd 0 "OnOffSafe1_OnOffSafeInvld1" 1 "OnOffSafe1_OnOffSafeOn" 2 "OnOffSafe1_OnOffSafeOff" 3 "OnOffSafe1_OnOffSafeInvld2";
VAL_ 53 CrashStsSafeSts 0 "CrashSts2_NoCrash" 1 "CrashSts2_Crash";
VAL_ 53 DoorDrvrHndlSts 0 "DoorHndlSts_Ukwn" 1 "DoorHndlSts_FullRtrctd" 2 "DoorHndlSts_MovgOut" 3 "DoorHndlSts_StopDurgDply" 4 "DoorHndlSts_FullDplyd" 5 "DoorHndlSts_MovgIn" 6 "DoorHndlSts_StopDurgRtrct" 7 "DoorHndlSts_Flt";
VAL_ 53 DoorDrvrReCinhIntFailInfCinchFlt1 0 "Boolean_FALSE" 1 "Boolean_TRUE";
VAL_ 53 DoorDrvrReCinhIntFailInfCinchRestFlt 0 "Boolean_FALSE" 1 "Boolean_TRUE";
VAL_ 53 DoorDrvrReHndlSts 0 "DoorHndlSts_Ukwn" 1 "DoorHndlSts_FullRtrctd" 2 "DoorHndlSts_MovgOut" 3 "DoorHndlSts_StopDurgDply" 4 "DoorHndlSts_FullDplyd" 5 "DoorHndlSts_MovgIn" 6 "DoorHndlSts_StopDurgRtrct" 7 "DoorHndlSts_Flt";
VAL_ 53 DoorDrvrReLatPosn 0 "DoorPos_Undefined" 1 "DoorPos_FullyClosed" 2 "DoorPos_SecondaryPosition" 3 "DoorPos_FullyOpen";
VAL_ 53 DoorDrvrReLockSts 0 "LockSts2_LockStsUkwn" 1 "LockSts2_Unlckd" 2 "LockSts2_Lockd" 3 "LockSts2_SafeLockd";
VAL_ 53 DoorDrvrReOpenLowReqOutdSwt1 0 "PsdNotPsd3_NoInfo1" 1 "PsdNotPsd3_Psd" 2 "PsdNotPsd3_NotPsd" 3 "PsdNotPsd3_NoInfo2";
VAL_ 53 DoorDrvrReOpenReqInsdSwt1 0 "PsdNotPsd3_NoInfo1" 1 "PsdNotPsd3_Psd" 2 "PsdNotPsd3_NotPsd" 3 "PsdNotPsd3_NoInfo2";
VAL_ 53 DoorDrvrReRelsFailCinchOverTimed 0 "Boolean_FALSE" 1 "Boolean_TRUE";
VAL_ 53 DoorDrvrReRelsFailFailure1 0 "Boolean_FALSE" 1 "Boolean_TRUE";
VAL_ 53 DoorDrvrReRelsFailMechRels 0 "Boolean_FALSE" 1 "Boolean_TRUE";
VAL_ 53 DoorLeReHndlSts 0 "DoorHndlSts_Ukwn" 1 "DoorHndlSts_FullRtrctd" 2 "DoorHndlSts_MovgOut" 3 "DoorHndlSts_StopDurgDply" 4 "DoorHndlSts_FullDplyd" 5 "DoorHndlSts_MovgIn" 6 "DoorHndlSts_StopDurgRtrct" 7 "DoorHndlSts_Flt";
VAL_ 53 DoorLeReLatPosn 0 "DoorPos_Undefined" 1 "DoorPos_FullyClosed" 2 "DoorPos_SecondaryPosition" 3 "DoorPos_FullyOpen";
VAL_ 53 DoorLeReLockCmd 0 "LockActvnSafe1_LockActvnOff" 1 "LockActvnSafe1_LockActvnUnlck" 2 "LockActvnSafe1_LockActvnLock" 3 "LockActvnSafe1_LockActvnSafe" 4 "LockActvnSafe1_LockActvnUnlckByCrash1" 8 "LockActvnSafe1_LockActvnUnlckByCrash2" 12 "LockActvnSafe1_LockActvnUnlckByCrash0" 13 "LockActvnSafe1_LockActvnUnlckByCrash4" 14 "LockActvnSafe1_LockActvnUnlckByCrash3";
VAL_ 53 DoorLeReRelsReq 0 "OnOffSafe1_OnOffSafeInvld1" 1 "OnOffSafe1_OnOffSafeOn" 2 "OnOffSafe1_OnOffSafeOff" 3 "OnOffSafe1_OnOffSafeInvld2";
VAL_ 53 DoorPassLockCmd 0 "LockActvnSafe1_LockActvnOff" 1 "LockActvnSafe1_LockActvnUnlck" 2 "LockActvnSafe1_LockActvnLock" 3 "LockActvnSafe1_LockActvnSafe" 4 "LockActvnSafe1_LockActvnUnlckByCrash1" 8 "LockActvnSafe1_LockActvnUnlckByCrash2" 12 "LockActvnSafe1_LockActvnUnlckByCrash0" 13 "LockActvnSafe1_LockActvnUnlckByCrash4" 14 "LockActvnSafe1_LockActvnUnlckByCrash3";
VAL_ 53 DoorPassRelsReq 0 "OnOffSafe1_OnOffSafeInvld1" 1 "OnOffSafe1_OnOffSafeOn" 2 "OnOffSafe1_OnOffSafeOff" 3 "OnOffSafe1_OnOffSafeInvld2";
VAL_ 53 DoorRiReLockCmd 0 "LockActvnSafe1_LockActvnOff" 1 "LockActvnSafe1_LockActvnUnlck" 2 "LockActvnSafe1_LockActvnLock" 3 "LockActvnSafe1_LockActvnSafe" 4 "LockActvnSafe1_LockActvnUnlckByCrash1" 8 "LockActvnSafe1_LockActvnUnlckByCrash2" 12 "LockActvnSafe1_LockActvnUnlckByCrash0" 13 "LockActvnSafe1_LockActvnUnlckByCrash4" 14 "LockActvnSafe1_LockActvnUnlckByCrash3";
VAL_ 53 DoorRiReRelsReq 0 "OnOffSafe1_OnOffSafeInvld1" 1 "OnOffSafe1_OnOffSafeOn" 2 "OnOffSafe1_OnOffSafeOff" 3 "OnOffSafe1_OnOffSafeInvld2";
VAL_ 53 EpbLampReqSecEpbLampReq 0 "EpbLampReqType1_On" 1 "EpbLampReqType1_Off" 2 "EpbLampReqType1_Flash2" 3 "EpbLampReqType1_Flash3";
VAL_ 53 ExtrLiRlySafe 0 "Boolean_FALSE" 1 "Boolean_TRUE";
VAL_ 53 IceBreakDoorDrvrReActv 0 "Boolean_FALSE" 1 "Boolean_TRUE";
VAL_ 53 OverBoostSts 0 "NotActvActv1_NotActv" 1 "NotActvActv1_Actv";
VAL_ 53 PanicAlrmSts 0 "OnOff1_Off" 1 "OnOff1_On";
VAL_ 53 PawlDrvrReSwt 0 "PsdNotPsd1_NotPsd" 1 "PsdNotPsd1_Psd";
VAL_ 53 PawlDrvrSwt 0 "PsdNotPsd1_NotPsd" 1 "PsdNotPsd1_Psd";
VAL_ 53 PrpsnHvBattUsgModAct 0 "HvBattUsgType_NoReq" 1 "HvBattUsgType_Norm" 2 "HvBattUsgType_Hld" 3 "HvBattUsgType_HldSmt" 4 "HvBattUsgType_Chrg" 5 "HvBattUsgType_NotOfUse1" 6 "HvBattUsgType_NotOfUse2" 7 "HvBattUsgType_NotOfUse3";
VAL_ 53 PtModAct 0 "PtModReqEV_NoRequest" 1 "PtModReqEV_EVmode" 2 "PtModReqEV_HEVmode" 3 "PtModReqEV_EV_PlusMode";
VAL_ 53 PtTqAtWhlFrntActPtTqAtWhlsFrntQly 0 "Qly3_De0" 1 "Qly3_De1" 2 "Qly3_De2" 3 "Qly3_De3" 4 "Qly3_De4" 5 "Qly3_De5" 6 "Qly3_De6" 7 "Qly3_De7";
VAL_ 53 RowSecLeBtnPsd 0 "Boolean_FALSE" 1 "Boolean_TRUE";
VAL_ 53 RowSecLeLegRstHeiPosPercSeatPosQf 0 "Qf1_DevOfDataUndefd" 1 "Qf1_DataTmpUndefdAndEvlnInProgs" 2 "Qf1_DevOfDataNotWithinRngAllwd" 3 "Qf1_DataCalcdWithDevDefd";
VAL_ 53 RowSecLeLegRstLenPosPercSeatPosQf 0 "Qf1_DevOfDataUndefd" 1 "Qf1_DataTmpUndefdAndEvlnInProgs" 2 "Qf1_DevOfDataNotWithinRngAllwd" 3 "Qf1_DataCalcdWithDevDefd";
VAL_ 53 RowSecLeSldPosPercSeatPosQf 0 "Qf1_DevOfDataUndefd" 1 "Qf1_DataTmpUndefdAndEvlnInProgs" 2 "Qf1_DevOfDataNotWithinRngAllwd" 3 "Qf1_DataCalcdWithDevDefd";
VAL_ 53 RowSecRiBtnPsd 0 "Boolean_FALSE" 1 "Boolean_TRUE";
VAL_ 53 RowSecRiLegRstHeiPosPercSeatPosQf 0 "Qf1_DevOfDataUndefd" 1 "Qf1_DataTmpUndefdAndEvlnInProgs" 2 "Qf1_DevOfDataNotWithinRngAllwd" 3 "Qf1_DataCalcdWithDevDefd";
VAL_ 53 RowSecRiLegRstLenPosPercSeatPosQf 0 "Qf1_DevOfDataUndefd" 1 "Qf1_DataTmpUndefdAndEvlnInProgs" 2 "Qf1_DevOfDataNotWithinRngAllwd" 3 "Qf1_DataCalcdWithDevDefd";
VAL_ 53 RowSecRiSldPosPercSeatPosQf 0 "Qf1_DevOfDataUndefd" 1 "Qf1_DataTmpUndefdAndEvlnInProgs" 2 "Qf1_DevOfDataNotWithinRngAllwd" 3 "Qf1_DataCalcdWithDevDefd";
VAL_ 53 SteerWhlBtnPsd 0 "Boolean_FALSE" 1 "Boolean_TRUE";
VAL_ 53 SteerWhlInMovmt 0 "Boolean_FALSE" 1 "Boolean_TRUE";
VAL_ 53 SteerWhlSnsrQf 0 "GenQf1_UndefindDataAccur" 1 "GenQf1_TmpUndefdData" 2 "GenQf1_DataAccurNotWithinSpcn" 3 "GenQf1_AccurData";
VAL_ 53 TrRelsFailtoHMI 0 "Boolean_FALSE" 1 "Boolean_TRUE";
VAL_ 53 WadeProtnSts 0 "OnOff1_Off" 1 "OnOff1_On";
VAL_ 53 WinSwtReqFrntLe 0 "WinPosnReq_Idle" 1 "WinPosnReq_UpMan" 2 "WinPosnReq_UpAut" 3 "WinPosnReq_DwnMan" 4 "WinPosnReq_DwnAut" 5 "WinPosnReq_NotDefd";
VAL_ 53 WinSwtReqFrntRi 0 "WinPosnReq_Idle" 1 "WinPosnReq_UpMan" 2 "WinPosnReq_UpAut" 3 "WinPosnReq_DwnMan" 4 "WinPosnReq_DwnAut" 5 "WinPosnReq_NotDefd";
VAL_ 53 WinSwtReqReLe 0 "WinPosnReq_Idle" 1 "WinPosnReq_UpMan" 2 "WinPosnReq_UpAut" 3 "WinPosnReq_DwnMan" 4 "WinPosnReq_DwnAut" 5 "WinPosnReq_NotDefd";
VAL_ 53 WinSwtReqReRi 0 "WinPosnReq_Idle" 1 "WinPosnReq_UpMan" 2 "WinPosnReq_UpAut" 3 "WinPosnReq_DwnMan" 4 "WinPosnReq_DwnAut" 5 "WinPosnReq_NotDefd";
VAL_ 312 AntithftActvnNotif 0 "AntithftActvnNotif1_NotActvd" 1 "AntithftActvnNotif1_Actvd";
VAL_ 312 BattCooltIndcnReq 0 "Boolean_FALSE" 1 "Boolean_TRUE";
VAL_ 312 BrkBoostErrIndcnReq 0 "OnOff1_Off" 1 "OnOff1_On";
VAL_ 312 ChrgnByEngStsDurgDcha 0 "ChrgnByEngSts_NoReq" 1 "ChrgnByEngSts_Chrgn" 2 "ChrgnByEngSts_Flt" 3 "ChrgnByEngSts_Finished" 4 "ChrgnByEngSts_StopByFuelLow" 5 "ChrgnByEngSts_StopByTiOut" 6 "ChrgnByEngSts_Reserved1" 7 "ChrgnByEngSts_Reserved2";
VAL_ 312 ChrgnWarn 0 "Warn2_NoWarn" 1 "Warn2_Warn";
VAL_ 312 DispElecPwrSts 0 "OnOff1_Off" 1 "OnOff1_On";
VAL_ 312 DoorDrvrCinhIntFailInfCinchFlt1 0 "Boolean_FALSE" 1 "Boolean_TRUE";
VAL_ 312 DoorDrvrCinhIntFailInfCinchRestFlt 0 "Boolean_FALSE" 1 "Boolean_TRUE";
VAL_ 312 DoorDrvrRelsFailCinchOverTimed 0 "Boolean_FALSE" 1 "Boolean_TRUE";
VAL_ 312 DoorDrvrRelsFailFailure1 0 "Boolean_FALSE" 1 "Boolean_TRUE";
VAL_ 312 DoorDrvrRelsFailMechRels 0 "Boolean_FALSE" 1 "Boolean_TRUE";
VAL_ 312 DoorLeReCinhIntFailInfCinchFlt1 0 "Boolean_FALSE" 1 "Boolean_TRUE";
VAL_ 312 DoorLeReCinhIntFailInfCinchRestFlt 0 "Boolean_FALSE" 1 "Boolean_TRUE";
VAL_ 312 DoorLeReRelsFailCinchOverTimed 0 "Boolean_FALSE" 1 "Boolean_TRUE";
VAL_ 312 DoorLeReRelsFailFailure1 0 "Boolean_FALSE" 1 "Boolean_TRUE";
VAL_ 312 DoorLeReRelsFailMechRels 0 "Boolean_FALSE" 1 "Boolean_TRUE";
VAL_ 312 DrvrSeatActvSpplFct 0 "SeatActvSpplFct1_NotAvl" 1 "SeatActvSpplFct1_LumExtnAndLumHei" 2 "SeatActvSpplFct1_BackBlster" 3 "SeatActvSpplFct1_CushExtn" 4 "SeatActvSpplFct1_HdrestHeiAndHdrestTilt" 5 "SeatActvSpplFct1_MassgFct" 6 "SeatActvSpplFct1_ShoulderFct" 7 "SeatActvSpplFct1_LegrestFct";
VAL_ 312 DrvrSeatBtnPsd 0 "Boolean_FALSE" 1 "Boolean_TRUE";
VAL_ 312 DrvrSeatExtAdjAllowd 0 "Boolean_FALSE" 1 "Boolean_TRUE";
VAL_ 312 DrvrSeatHeatgLvlSts 0 "SeatClimaLvl_Off" 1 "SeatClimaLvl_Lvl1" 2 "SeatClimaLvl_Lvl2" 3 "SeatClimaLvl_Lvl3";
VAL_ 312 DrvrSeatSwtStsDrvrSeatSwtAdjmtOfSpplFctHozlSts 0 "SwtHozlSts1_Idle" 1 "SwtHozlSts1_Fwd" 2 "SwtHozlSts1_Backw";
VAL_ 312 DrvrSeatSwtStsDrvrSeatSwtAdjmtOfSpplFctVertSts 0 "SwtVertSts1_Idle" 1 "SwtVertSts1_Up" 2 "SwtVertSts1_Dwn";
VAL_ 312 DrvrSeatSwtStsDrvrSeatSwtHdrstHozlSts 0 "SwtHozlSts1_Idle" 1 "SwtHozlSts1_Fwd" 2 "SwtHozlSts1_Backw";
VAL_ 312 DrvrSeatSwtStsDrvrSeatSwtHdrstVertSts 0 "SwtVertSts1_Idle" 1 "SwtVertSts1_Up" 2 "SwtVertSts1_Dwn";
VAL_ 312 DrvrSeatSwtStsDrvrSeatSwtHeiFrntSts 0 "SwtVertSts1_Idle" 1 "SwtVertSts1_Up" 2 "SwtVertSts1_Dwn";
VAL_ 312 DrvrSeatSwtStsDrvrSeatSwtHeiSts 0 "SwtVertSts1_Idle" 1 "SwtVertSts1_Up" 2 "SwtVertSts1_Dwn";
VAL_ 312 DrvrSeatSwtStsDrvrSeatSwtInclSts 0 "SwtHozlSts1_Idle" 1 "SwtHozlSts1_Fwd" 2 "SwtHozlSts1_Backw";
VAL_ 312 DrvrSeatSwtStsDrvrSeatSwtSelnOfSpplFctSts 0 "SwtVertSts1_Idle" 1 "SwtVertSts1_Up" 2 "SwtVertSts1_Dwn";
VAL_ 312 DrvrSeatSwtStsDrvrSeatSwtSldSts 0 "SwtHozlSts1_Idle" 1 "SwtHozlSts1_Fwd" 2 "SwtHozlSts1_Backw";
VAL_ 312 DrvrSeatVentAvlSts 0 "StsFd_None" 1 "StsFd_On" 2 "StsFd_Off" 3 "StsFd_Error" 4 "StsFd_Functionallimit" 5 "StsFd_Energylimit" 6 "StsFd_Resvd1" 7 "StsFd_Resvd2";
VAL_ 312 DstTrvldVldFromBodyBkp 0 "InvldVld1_Invld" 1 "InvldVld1_Vld";
VAL_ 312 EngCooltIndcnReq 0 "EngCooltIndcn_MsgNoWarn" 1 "EngCooltIndcn_EngTHiToSpdRedn" 2 "EngCooltIndcn_EngTHiToStopSafe" 3 "EngCooltIndcn_EngTHiToEngStop" 4 "EngCooltIndcn_EngTHiToMan" 5 "EngCooltIndcn_CooltLvlLoToEngStop" 6 "EngCooltIndcn_CooltLvlLoToStopSafe" 7 "EngCooltIndcn_CooltLvlLoToMan" 8 "EngCooltIndcn_CooltLvlLoToLvlChk" 9 "EngCooltIndcn_MsgSrvRqrd";
VAL_ 312 EngFltIndcn1 0 "DevErrSts2_NoFlt" 1 "DevErrSts2_Flt";
VAL_ 312 EngFltIndcn10 0 "DevErrSts2_NoFlt" 1 "DevErrSts2_Flt";
VAL_ 312 EngFltIndcn11 0 "DevErrSts2_NoFlt" 1 "DevErrSts2_Flt";
VAL_ 312 EngFltIndcn12 0 "DevErrSts2_NoFlt" 1 "DevErrSts2_Flt";
VAL_ 312 EngFltIndcn13 0 "DevErrSts2_NoFlt" 1 "DevErrSts2_Flt";
VAL_ 312 EngFltIndcn14 0 "DevErrSts2_NoFlt" 1 "DevErrSts2_Flt";
VAL_ 312 EngFltIndcn15 0 "DevErrSts2_NoFlt" 1 "DevErrSts2_Flt";
VAL_ 312 EngFltIndcn16 0 "DevErrSts2_NoFlt" 1 "DevErrSts2_Flt";
VAL_ 312 EngFltIndcn17 0 "DevErrSts2_NoFlt" 1 "DevErrSts2_Flt";
VAL_ 312 EngFltIndcn18 0 "DevErrSts2_NoFlt" 1 "DevErrSts2_Flt";
VAL_ 312 EngFltIndcn19 0 "DevErrSts2_NoFlt" 1 "DevErrSts2_Flt";
VAL_ 312 EngFltIndcn2 0 "DevErrSts2_NoFlt" 1 "DevErrSts2_Flt";
VAL_ 312 EngFltIndcn20 0 "DevErrSts2_NoFlt" 1 "DevErrSts2_Flt";
VAL_ 312 EngFltIndcn21 0 "DevErrSts2_NoFlt" 1 "DevErrSts2_Flt";
VAL_ 312 EngFltIndcn22 0 "DevErrSts2_NoFlt" 1 "DevErrSts2_Flt";
VAL_ 312 EngFltIndcn23 0 "DevErrSts2_NoFlt" 1 "DevErrSts2_Flt";
VAL_ 312 EngFltIndcn24 0 "DevErrSts2_NoFlt" 1 "DevErrSts2_Flt";
VAL_ 312 EngFltIndcn25 0 "DevErrSts2_NoFlt" 1 "DevErrSts2_Flt";
VAL_ 312 EngFltIndcn26 0 "DevErrSts2_NoFlt" 1 "DevErrSts2_Flt";
VAL_ 312 EngFltIndcn27 0 "DevErrSts2_NoFlt" 1 "DevErrSts2_Flt";
VAL_ 312 EngFltIndcn3 0 "DevErrSts2_NoFlt" 1 "DevErrSts2_Flt";
VAL_ 312 EngFltIndcn4 0 "DevErrSts2_NoFlt" 1 "DevErrSts2_Flt";
VAL_ 312 EngFltIndcn5 0 "DevErrSts2_NoFlt" 1 "DevErrSts2_Flt";
VAL_ 312 EngFltIndcn6 0 "DevErrSts2_NoFlt" 1 "DevErrSts2_Flt";
VAL_ 312 EngFltIndcn7 0 "DevErrSts2_NoFlt" 1 "DevErrSts2_Flt";
VAL_ 312 EngFltIndcn8 0 "DevErrSts2_NoFlt" 1 "DevErrSts2_Flt";
VAL_ 312 EngFltIndcn9 0 "DevErrSts2_NoFlt" 1 "DevErrSts2_Flt";
VAL_ 312 EngOilLvlSts 0 "EngOilLvlSts1_OilLvlOk" 1 "EngOilLvlSts1_OilLvlLo1" 2 "EngOilLvlSts1_OilLvlLo2" 3 "EngOilLvlSts1_OilLvlHi" 4 "EngOilLvlSts1_OilLvlSrvRqrd" 5 "EngOilLvlSts1_Resd";
VAL_ 312 EngOilPWarn 0 "EngOilPWarn1_EngOilPOk" 1 "EngOilPWarn1_EngOilPNotOk";
VAL_ 312 ExtLiShwDwnldSts 0 "Sts_Resd" 1 "Sts_Err" 2 "Sts_CmplOk" 3 "Sts_InProgs";
VAL_ 312 ExtrLiShowActvnStsExtrLiShowActvnFrntLeFb 0 "Sts_Resd" 1 "Sts_Err" 2 "Sts_CmplOk" 3 "Sts_InProgs";
VAL_ 312 ExtrLiShowActvnStsExtrLiShowActvnFrntRiFb 0 "Sts_Resd" 1 "Sts_Err" 2 "Sts_CmplOk" 3 "Sts_InProgs";
VAL_ 312 ExtrLiShowActvnStsExtrLiShowActvnReLe2Fb 0 "Sts_Resd" 1 "Sts_Err" 2 "Sts_CmplOk" 3 "Sts_InProgs";
VAL_ 312 ExtrLiShowActvnStsExtrLiShowActvnReLeFb 0 "Sts_Resd" 1 "Sts_Err" 2 "Sts_CmplOk" 3 "Sts_InProgs";
VAL_ 312 ExtrLiShowActvnStsExtrLiShowActvnReRi2Fb 0 "Sts_Resd" 1 "Sts_Err" 2 "Sts_CmplOk" 3 "Sts_InProgs";
VAL_ 312 ExtrLiShowActvnStsExtrLiShowActvnReRiFb 0 "Sts_Resd" 1 "Sts_Err" 2 "Sts_CmplOk" 3 "Sts_InProgs";
VAL_ 312 FrntWiprLvrCmd2FrntWiprLvrCmd1 0 "FrntWiprLvrCmd1_FrntWiprOff" 1 "FrntWiprLvrCmd1_FrntWiprSngStk" 2 "FrntWiprLvrCmd1_FrntWiprIntm" 3 "FrntWiprLvrCmd1_FrntWiprContnsLoSpd" 4 "FrntWiprLvrCmd1_FrntWiprContnsHiSpd";
VAL_ 312 FrntWiprLvrCmd2FrntWiprLvrQf 0 "Qf1_DevOfDataUndefd" 1 "Qf1_DataTmpUndefdAndEvlnInProgs" 2 "Qf1_DevOfDataNotWithinRngAllwd" 3 "Qf1_DataCalcdWithDevDefd";
VAL_ 312 HmiEngHybSts 0 "EngHybSts1_FuOutOfDateRefu" 1 "EngHybSts1_FuOutOfDateStrtOfEngGsl" 2 "EngHybSts1_FuOutOfDateFStrtOfEngGslToCnse" 3 "EngHybSts1_EngMntn" 4 "EngHybSts1_Spare";
VAL_ 312 HmiFuLidNotClsd 0 "OnOff1_Off" 1 "OnOff1_On";
VAL_ 312 HmiFuLidOpenSts 0 "OnOff1_Off" 1 "OnOff1_On";
VAL_ 312 HmiFuTankRdy 0 "OnOffOpen_Off" 1 "OnOffOpen_On" 2 "OnOffOpen_Open";
VAL_ 312 HmiVehStopForRefu 0 "OnOff1_Off" 1 "OnOff1_On";
VAL_ 312 HudSnsrErrParChk 0 "ParChks1_Unevennrof1" 1 "ParChks1_Evennrof1";
VAL_ 312 HudSnsrErrSnsrErr 0 "FltStsSlaveBasc_FltStsTestPassd" 1 "FltStsSlaveBasc_FltStsTestFaild";
VAL_ 312 HvClimaCmd 0 "HVBattChargnCmd_OK" 1 "HVBattChargnCmd_NOK" 2 "HVBattChargnCmd_INIT" 3 "HVBattChargnCmd_HOLD";
VAL_ 312 LockgPrsnlSts 0 "OnOff1_Off" 1 "OnOff1_On";
VAL_ 312 LVPwrSplyErrSts 0 "PwrSplyErrSts_SysOk" 1 "PwrSplyErrSts_UhiDurgDrvg" 2 "PwrSplyErrSts_UloDurgdrvg" 3 "PwrSplyErrSts_BattRlyFlt" 4 "PwrSplyErrSts_BattSnsrComFlt" 5 "PwrSplyErrSts_BattSnsrHwFlt" 6 "PwrSplyErrSts_FltComDcDc" 7 "PwrSplyErrSts_FltElecDcDc" 8 "PwrSplyErrSts_FltDcDc" 9 "PwrSplyErrSts_SupCptrHwFlt" 10 "PwrSplyErrSts_AltFltMecl" 11 "PwrSplyErrSts_AltFltElec" 12 "PwrSplyErrSts_AltFltT" 13 "PwrSplyErrSts_AltFltCom" 14 "PwrSplyErrSts_SpprtBattFltChrgn" 15 "PwrSplyErrSts_Spare6";
VAL_ 312 OilMntnAlrmSt 0 "OilMntnAlrmSt_NoRequestForMntn" 1 "OilMntnAlrmSt_MntnAboutToExpire" 2 "OilMntnAlrmSt_MntnExpire" 3 "OilMntnAlrmSt_MntnOutOfDate";
VAL_ 312 RecOfImpctCrashFrnt 0 "Boolean_FALSE" 1 "Boolean_TRUE";
VAL_ 312 RecOfImpctCrashOffroadA 0 "Boolean_FALSE" 1 "Boolean_TRUE";
VAL_ 312 RecOfImpctCrashOffroadD 0 "Boolean_FALSE" 1 "Boolean_TRUE";
VAL_ 312 RecOfImpctCrashOffroadRT 0 "Boolean_FALSE" 1 "Boolean_TRUE";
VAL_ 312 RecOfImpctCrashOffroadRTsevere 0 "Boolean_FALSE" 1 "Boolean_TRUE";
VAL_ 312 RecOfImpctCrashPed 0 "Boolean_FALSE" 1 "Boolean_TRUE";
VAL_ 312 RecOfImpctCrashRe 0 "Boolean_FALSE" 1 "Boolean_TRUE";
VAL_ 312 RecOfImpctCrashRollovr 0 "Boolean_FALSE" 1 "Boolean_TRUE";
VAL_ 312 RecOfImpctCrashSideLe 0 "Boolean_FALSE" 1 "Boolean_TRUE";
VAL_ 312 RecOfImpctCrashSideRi 0 "Boolean_FALSE" 1 "Boolean_TRUE";
VAL_ 312 RecOfImpctCrashState 0 "CrashSt_NoCrash" 1 "CrashSt_CrashImminent" 2 "CrashSt_CrashInProgress" 3 "CrashSt_CrashEnding";
VAL_ 312 RecOfImpctVehOri 0 "Orntn_OnWheels" 1 "Orntn_LeftSide" 2 "Orntn_RightSide" 3 "Orntn_OnRoof" 4 "Orntn_Indeterminate" 5 "Orntn_Resd1" 6 "Orntn_Resd2" 7 "Orntn_Resd3";
VAL_ 312 RlyPwrDistbnCmd1WdBattSaveCmd 0 "OnOff1_Off" 1 "OnOff1_On";
VAL_ 312 SteerLockWarnIndcn 0 "SteerLockWarnIndcn_NoSftySteerLockWarnIndcnTyp" 1 "SteerLockWarnIndcn_SftySteerLockWarnIndcnTyp";
VAL_ 312 SteerWhlHeatgLvlSts 0 "SteerWhlHeatgOnCmdTyp_Off" 1 "SteerWhlHeatgOnCmdTyp_Lo" 2 "SteerWhlHeatgOnCmdTyp_Med" 3 "SteerWhlHeatgOnCmdTyp_Hi";
VAL_ 312 StopStrtStbIndcn 0 "StopStrtStbIndcn_Off" 1 "StopStrtStbIndcn_Avl" 2 "StopStrtStbIndcn_TmpNotAvl" 3 "StopStrtStbIndcn_NotAvl" 4 "StopStrtStbIndcn_Actv";
VAL_ 312 StrtColdIndcnMsg 0 "ColdStartIndMsg_Default" 1 "ColdStartIndMsg_EngineStartLater" 2 "ColdStartIndMsg_DonotStartEngine" 3 "ColdStartIndMsg_Reserved";
VAL_ 312 StrtMsgToModMngt 0 "StrtMsgToModMgnt1_NoInhb" 1 "StrtMsgToModMgnt1_PwrUpDly" 2 "StrtMsgToModMgnt1_AltvStrt" 3 "StrtMsgToModMgnt1_inhbremstrt" 4 "StrtMsgToModMgnt1_diremstrt" 5 "StrtMsgToModMgnt1_SelnOfParkOrNeut" 6 "StrtMsgToModMgnt1_Resd1" 7 "StrtMsgToModMgnt1_Resd2";
VAL_ 312 SunCurtImpctDetnSts2 0 "SunRoofAndCurtImpctDetnStsTyp_ImpctDetnDi" 1 "SunRoofAndCurtImpctDetnStsTyp_ImpctDetnEna" 2 "SunRoofAndCurtImpctDetnStsTyp_ClsPinch" 3 "SunRoofAndCurtImpctDetnStsTyp_ClsBlk" 4 "SunRoofAndCurtImpctDetnStsTyp_OpenPinch" 5 "SunRoofAndCurtImpctDetnStsTyp_OpenBlk";
VAL_ 312 TCSTmrStrtSts 0 "OnOffNoReq_NoReq" 1 "OnOffNoReq_On" 2 "OnOffNoReq_Off";
VAL_ 312 TelltlPwrLoss 0 "OnOff1_Off" 1 "OnOff1_On";
VAL_ 312 TrlrLiTurnIndcrActvt 0 "IndcrSts1_Off" 1 "IndcrSts1_LeOn" 2 "IndcrSts1_RiOn" 3 "IndcrSts1_LeAndRiOn";
VAL_ 312 WiprInPosnForSrv 0 "OnOff1_Off" 1 "OnOff1_On";
VAL_ 312 WiprReInPosnForSrv 0 "OnOff1_Off" 1 "OnOff1_On";
VAL_ 288 AlcoLockMgrWarnlndcn 0 "AlcoLockMgrWarnlndcn_NoWarning" 1 "AlcoLockMgrWarnlndcn_ServiceInformation" 2 "AlcoLockMgrWarnlndcn_TestRequired_InitialTest" 3 "AlcoLockMgrWarnlndcn_TestRequired2_Retest" 4 "AlcoLockMgrWarnlndcn_Analysing" 5 "AlcoLockMgrWarnlndcn_Result_Passed" 6 "AlcoLockMgrWarnlndcn_Result_Failed" 7 "AlcoLockMgrWarnlndcn_GeneralError" 8 "AlcoLockMgrWarnlndcn_BlewTooEarly" 9 "AlcoLockMgrWarnIndcn_BlewTooSoft" 10 "AlcoLockMgrWarnIndcn_BlewTooHard" 11 "AlcoLockMgrWarnIndcn_NonAccepted" 12 "AlcoLockMgrWarnIndcn_EndExpiration" 13 "AlcoLockMgrWarnIndcn_PermanentLockOut" 14 "AlcoLockMgrWarnIndcn_NonPermanentLockOut" 15 "AlcoLockMgrWarnIndcn_InternalError" 16 "AlcoLockMgrWarnIndcn_AlcoholInterlockService" 17 "AlcoLockMgrWarnIndcn_Warming_Up" 18 "AlcoLockMgrWarnIndcn_Spare1" 19 "AlcoLockMgrWarnIndcn_Spare2" 20 "AlcoLockMgrWarnIndcn_Spare3";
VAL_ 288 BattFltStsPrimBattFltStsPrm 0 "BattFltStsPrm_NoFlt_Default" 1 "BattFltStsPrm_QCFlt_QuiescCurrtanomaly" 2 "BattFltStsPrm_LSocFlt_LowSocfault" 3 "BattFltStsPrm_OvFlt_Overvoltagefault" 4 "BattFltStsPrm_UvFlt_Undervoltagefault" 5 "BattFltStsPrm_HiTFlt_Hightemperaturefault" 6 "BattFltStsPrm_OcFlt_Overcurrentfault" 7 "BattFltStsPrm_ScFlt_shortcircuitfault" 11 "BattFltStsPrm_ThermRunawayFlt" 13 "BattFltStsPrm_ResetActvFlg" 14 "BattFltStsPrm_WakeupActvFlg" 15 "BattFltStsPrm_RlyOpenSoonIndcn";
VAL_ 288 BookTrvlChrgnFb 0 "BookChrgnStsFb_Default" 1 "BookChrgnStsFb_Success" 2 "BookChrgnStsFb_Fail" 3 "BookChrgnStsFb_Finished";
VAL_ 288 BookTrvlChrgnSts 0 "Boolean_FALSE" 1 "Boolean_TRUE";
VAL_ 288 CarLoctrHornLiSetActv 0 "CarFindrHornLiSetActv_HornLiSetActv" 1 "CarFindrHornLiSetActv_HornSetActv" 2 "CarFindrHornLiSetActv_LiSetActv" 3 "CarFindrHornLiSetActv_Reserved";
VAL_ 288 DefrstStsMirrDefrst 0 "ActrDefrstSts_Off" 1 "ActrDefrstSts_On" 2 "ActrDefrstSts_Limited" 3 "ActrDefrstSts_NotAvailable" 4 "ActrDefrstSts_TmrOff" 5 "ActrDefrstSts_AutoCdn";
VAL_ 288 DefrstStsWinDefrstFrnt 0 "ActrDefrstSts_Off" 1 "ActrDefrstSts_On" 2 "ActrDefrstSts_Limited" 3 "ActrDefrstSts_NotAvailable" 4 "ActrDefrstSts_TmrOff" 5 "ActrDefrstSts_AutoCdn";
VAL_ 288 DefrstStsWinDefrstRe 0 "ActrDefrstSts_Off" 1 "ActrDefrstSts_On" 2 "ActrDefrstSts_Limited" 3 "ActrDefrstSts_NotAvailable" 4 "ActrDefrstSts_TmrOff" 5 "ActrDefrstSts_AutoCdn";
VAL_ 288 DispOfPrpsnModForEv 0 "DispOfPrpsnModForEv_NotReady" 1 "DispOfPrpsnModForEv_Charging" 2 "DispOfPrpsnModForEv_PureElecAWD" 3 "DispOfPrpsnModForEv_OnlyPrpsnMotElecFrnt" 4 "DispOfPrpsnModForEv_OnlyPrpsnMotElecRe" 5 "DispOfPrpsnModForEv_NoPrpsnMotElec" 6 "DispOfPrpsnModForEv_Rgn" 7 "DispOfPrpsnModForEv_Reserved1" 8 "DispOfPrpsnModForEv_Reserved2" 9 "DispOfPrpsnModForEv_Reserved3" 10 "DispOfPrpsnModForEv_Reserved4" 11 "DispOfPrpsnModForEv_Reserved5" 12 "DispOfPrpsnModForEv_Reserved6" 13 "DispOfPrpsnModForEv_Abnormal" 14 "DispOfPrpsnModForEv_Invalid" 15 "DispOfPrpsnModForEv_Reserved7";
VAL_ 288 DrvrSeatAutMovmtSts 0 "Sts_Resd" 1 "Sts_Err" 2 "Sts_CmplOk" 3 "Sts_InProgs";
VAL_ 288 EasyInOutPassReq 0 "EasyInOutDrvrReq_Idle" 1 "EasyInOutDrvrReq_Move" 2 "EasyInOutDrvrReq_Reset";
VAL_ 288 EPedlModSts 1 "CrsCtrlrSts1_Off" 2 "CrsCtrlrSts1_Stb" 3 "CrsCtrlrSts1_Actv";
VAL_ 288 IgmGenericADAlrmSt 0 "AlrmSt_Disarmd" 1 "AlrmSt_Armd" 2 "AlrmSt_Actv";
VAL_ 288 IgmGenericFltAlrmSt 0 "AlrmSt_Disarmd" 1 "AlrmSt_Armd" 2 "AlrmSt_Actv";
VAL_ 288 IgmGenericIacAlrmSt 0 "AlrmSt_Disarmd" 1 "AlrmSt_Armd" 2 "AlrmSt_Actv";
VAL_ 288 IgmGenericInvrtTAlrmSt 0 "AlrmSt_Disarmd" 1 "AlrmSt_Armd" 2 "AlrmSt_Actv";
VAL_ 288 IgmGenericModStatusRms 0 "ModStatusRms_Invalid" 1 "PModStatusRms_wrCns" 2 "ModStatusRms_PwrGen" 3 "ModStatusRms_OffSts" 4 "ModStatusRms_RdySts" 5 "ModStatusRms_Abnormal" 6 "ModStatusRms_Invalid1" 7 "ModStatusRms_Invalid2" 8 "ModStatusRms_Invalid3" 9 "ModStatusRms_Invalid4" 10 "ModStatusRms_Invalid5" 11 "ModStatusRms_Invalid6" 12 "ModStatusRms_Invalid7" 13 "ModStatusRms_Invalid8" 14 "ModStatusRms_Invalid9" 15 "ModStatusRms_Invalid10";
VAL_ 288 IgmGenericMotTAlrmSt 0 "AlrmSt_Disarmd" 1 "AlrmSt_Armd" 2 "AlrmSt_Actv";
VAL_ 288 IgmGenericRslAlrmSt 0 "AlrmSt_Disarmd" 1 "AlrmSt_Armd" 2 "AlrmSt_Actv";
VAL_ 288 IgmGenericSpdAlrmSt 0 "AlrmSt_Disarmd" 1 "AlrmSt_Armd" 2 "AlrmSt_Actv";
VAL_ 288 IgmGenericUDcAlrmSt 0 "AlrmSt_Disarmd" 1 "AlrmSt_Armd" 2 "AlrmSt_Actv";
VAL_ 288 LockgCenStsForUsrFb 0 "LockSt2_Undefd" 1 "LockSt2_Opend" 2 "LockSt2_Clsd" 3 "LockSt2_Lockd" 4 "LockSt2_Safe";
VAL_ 288 PrpsnMaxEVModBlk 0 "OkNotOk1_Ok" 1 "OkNotOk1_NotOk";
VAL_ 288 PrpsnModElecDrvBlkd 0 "Typ1_Typ0" 1 "Typ1_Typ1" 2 "Typ1_Typ2" 3 "Typ1_Typ3" 4 "Typ1_Typ4" 5 "Typ1_Typ5" 6 "Typ1_Typ6" 7 "Typ1_Typ7";
VAL_ 288 PrpsnModOffroadBlkd 0 "Typ1_Typ0" 1 "Typ1_Typ1" 2 "Typ1_Typ2" 3 "Typ1_Typ3" 4 "Typ1_Typ4" 5 "Typ1_Typ5" 6 "Typ1_Typ6" 7 "Typ1_Typ7";
VAL_ 288 PrpsnModOfTracBlkd 0 "Typ1_Typ0" 1 "Typ1_Typ1" 2 "Typ1_Typ2" 3 "Typ1_Typ3" 4 "Typ1_Typ4" 5 "Typ1_Typ5" 6 "Typ1_Typ6" 7 "Typ1_Typ7";
VAL_ 288 PrpsnModSptBlkd 0 "Typ1_Typ0" 1 "Typ1_Typ1" 2 "Typ1_Typ2" 3 "Typ1_Typ3" 4 "Typ1_Typ4" 5 "Typ1_Typ5" 6 "Typ1_Typ6" 7 "Typ1_Typ7";
VAL_ 288 PtModBlkd 0 "PtModBlkd_NotBlocked" 1 "PtModBlkd_EVblocked" 2 "PtModBlkd_HEVblocked" 3 "PtModBlkd_EVPlus_blocked";
VAL_ 288 RelHumSnsrQf 0 "DataQf_NotOk" 1 "DataQf_Ok";
VAL_ 288 RhahFltIndcnReq 0 "Flg1_Rst" 1 "Flg1_Set";
VAL_ 288 SeatOccptAtRowSecDrSide2 0 "OccptPresSt1_Undefd1" 1 "OccptPresSt1_OccptNotPrsnt" 2 "OccptPresSt1_OccptPrsnt" 3 "OccptPresSt1_Undefd2";
VAL_ 288 SeatOccptAtRowSecDrSideSnsSts2 0 "OkNokDi_Ok" 1 "OkNokDi_NotOk" 2 "OkNokDi_Disabled" 3 "OkNokDi_Reserved";
VAL_ 288 TrsmNInpOk 0 "NoYes1_No" 1 "NoYes1_Yes";
VAL_ 288 TrsmNOutpOk 0 "NoYes1_No" 1 "NoYes1_Yes";
VAL_ 288 VehNotParkInfoWarn 0 "VehNotParkInfoWarn_NoTxt" 1 "VehNotParkInfoWarn_ShifttoP" 2 "VehNotParkInfoWarn_OutofP";
VAL_ 288 WinFailrStsAtDrvr 0 "Flt_NoFault" 1 "Flt_Fault";
VAL_ 288 WinFailrStsAtReLe 0 "Flt_NoFault" 1 "Flt_Fault";
VAL_ 279 ActvnOfTechLiInfoDisp 0 "ActvSts_Invalid" 1 "ActvSts_Inactive" 2 "ActvSts_Active" 3 "ActvSts_Reserved";
VAL_ 279 AdjSpdLimnWarn 0 "AdjSpdLimnWarnCoding_NoWarn" 1 "AdjSpdLimnWarnCoding_SoundWarn" 2 "AdjSpdLimnWarnCoding_VisWarn" 3 "AdjSpdLimnWarnCoding_SoundAndVisWarn";
VAL_ 279 AutEgyRgnLvlAct 0 "EgyRgnLvlAct_Low" 1 "EgyRgnLvlAct_Mid" 2 "EgyRgnLvlAct_High" 3 "EgyRgnLvlAct_Reserved1" 4 "EgyRgnLvlAct_Reserved2" 5 "EgyRgnLvlAct_Auto" 6 "EgyRgnLvlAct_Off" 7 "EgyRgnLvlAct_NoReq";
VAL_ 279 CenLockMacKeyReq 0 "LockgCenReq2_Idle" 1 "LockgCenReq2_Unlck" 2 "LockgCenReq2_Lock";
VAL_ 279 DoorDrvr2Swt1DplyHndl 0 "PsdNotPsd1_NotPsd" 1 "PsdNotPsd1_Psd";
VAL_ 279 DoorDrvr2Swt2DplyHndl 0 "PsdNotPsd1_NotPsd" 1 "PsdNotPsd1_Psd";
VAL_ 279 DoorDrvrLatPosn 0 "DoorPos_Undefined" 1 "DoorPos_FullyClosed" 2 "DoorPos_SecondaryPosition" 3 "DoorPos_FullyOpen";
VAL_ 279 DoorDrvrRe2Swt1DplyHndl 0 "PsdNotPsd1_NotPsd" 1 "PsdNotPsd1_Psd";
VAL_ 279 DoorDrvrRe2Swt2DplyHndl 0 "PsdNotPsd1_NotPsd" 1 "PsdNotPsd1_Psd";
VAL_ 279 DrvPfmncRedn 0 "NoIndcn" 1 "FltIndcn1" 2 "FltIndcn2" 3 "FltIndcn3" 4 "FltIndcn4" 5 "FltIndcn5" 6 "FltIndcn6" 7 "FltIndcn7" 8 "FltIndcn8" 9 "FltIndcn9" 10 "FltIndcn10" 11 "FltIndcn11" 12 "FltIndcn12" 13 "FltIndcn13" 14 "FltIndcn14" 15 "FltIndcn15";
VAL_ 279 DrvrSeatInAutMovmt 0 "Boolean_FALSE" 1 "Boolean_TRUE";
VAL_ 279 EpbDrvrDispSec 0 "EpbDrvrDisp_Msg0" 1 "EpbDrvrDisp_Resd1" 2 "EpbDrvrDisp_Resd2" 3 "EpbDrvrDisp_Msg3" 4 "EpbDrvrDisp_Msg4" 5 "EpbDrvrDisp_Msg5" 6 "EpbDrvrDisp_Msg6" 7 "EpbDrvrDisp_Resd7" 8 "EpbDrvrDisp_Msg8" 9 "EpbDrvrDisp_Resd9" 10 "EpbDrvrDisp_Msg10" 11 "EpbDrvrDisp_Msg11" 12 "EpbDrvrDisp_Msg12" 13 "EpbDrvrDisp_Msg13" 14 "EpbDrvrDisp_Msg14" 15 "EpbDrvrDisp_Msg15";
VAL_ 279 FbOfMusicShow 0 "DevSts4_Off" 1 "DevSts4_On" 2 "DevSts4_Err" 3 "DevSts4_Resd";
VAL_ 279 FltEgyRstECUReq 0 "OnOff1_Off" 1 "OnOff1_On";
VAL_ 279 FltEgyRstRecReq 0 "OnOff1_Off" 1 "OnOff1_On";
VAL_ 279 FrntSunCurtMvngSts 0 "Boolean_FALSE" 1 "Boolean_TRUE";
VAL_ 279 FrntSunCurtPosnSts 0 "WinAndRoofAndCurtPosnTyp_PosnUkwn" 1 "WinAndRoofAndCurtPosnTyp_ClsFull" 2 "WinAndRoofAndCurtPosnTyp_PercOpen4" 3 "WinAndRoofAndCurtPosnTyp_PercOpen8" 4 "WinAndRoofAndCurtPosnTyp_PercOpen12" 5 "WinAndRoofAndCurtPosnTyp_PercOpen16" 6 "WinAndRoofAndCurtPosnTyp_PercOpen20" 7 "WinAndRoofAndCurtPosnTyp_PercOpen24" 8 "WinAndRoofAndCurtPosnTyp_PercOpen28" 9 "WinAndRoofAndCurtPosnTyp_PercOpen32" 10 "WinAndRoofAndCurtPosnTyp_PercOpen36" 11 "WinAndRoofAndCurtPosnTyp_PercOpen40" 12 "WinAndRoofAndCurtPosnTyp_PercOpen44" 13 "WinAndRoofAndCurtPosnTyp_PercOpen48" 14 "WinAndRoofAndCurtPosnTyp_PercOpen52" 15 "WinAndRoofAndCurtPosnTyp_PercOpen56" 16 "WinAndRoofAndCurtPosnTyp_PercOpen60" 17 "WinAndRoofAndCurtPosnTyp_PercOpen64" 18 "WinAndRoofAndCurtPosnTyp_PercOpen68" 19 "WinAndRoofAndCurtPosnTyp_PercOpen72" 20 "WinAndRoofAndCurtPosnTyp_PercOpen76" 21 "WinAndRoofAndCurtPosnTyp_PercOpen80" 22 "WinAndRoofAndCurtPosnTyp_PercOpen84" 23 "WinAndRoofAndCurtPosnTyp_PercOpen88" 24 "WinAndRoofAndCurtPosnTyp_PercOpen92" 25 "WinAndRoofAndCurtPosnTyp_PercOpen96" 26 "WinAndRoofAndCurtPosnTyp_OpenFull" 27 "WinAndRoofAndCurtPosnTyp_Resd1" 28 "WinAndRoofAndCurtPosnTyp_Resd2" 29 "WinAndRoofAndCurtPosnTyp_Resd3" 30 "WinAndRoofAndCurtPosnTyp_Resd4" 31 "WinAndRoofAndCurtPosnTyp_Movg";
VAL_ 279 IceBreakDoorDrvrActv 0 "Boolean_FALSE" 1 "Boolean_TRUE";
VAL_ 279 IceBreakDoorLeReActv 0 "Boolean_FALSE" 1 "Boolean_TRUE";
VAL_ 279 IsgTqActQualityFactor 0 "QualityFactor_QfUndefd" 1 "QualityFactor_QfInProgs" 2 "QualityFactor_QfNotSpc" 3 "QualityFactor_QfSnsrDataOk";
VAL_ 279 LnchModSts 0 "LaunchModeSts_Disable" 1 "LaunchModeSts_Initial" 2 "LaunchModeSts_Standby" 3 "LaunchModeSts_Ready" 4 "LaunchModeSts_Active" 5 "LaunchModeSts_Failed" 6 "LaunchModeSts_Reserved1" 7 "LaunchModeSts_Reserved2";
VAL_ 279 LowrTailgSts 0 "DoorSts2_Ukwn" 1 "DoorSts2_Opend" 2 "DoorSts2_Clsd";
VAL_ 279 MirrAtDrvrInMovmt 0 "Boolean_FALSE" 1 "Boolean_TRUE";
VAL_ 279 MirrBtnPsdAtDrvr 0 "Boolean_FALSE" 1 "Boolean_TRUE";
VAL_ 279 MirrCmdAtPassMirrDwnCmd 0 "MirrDwnCmdTyp_Idle" 1 "MirrDwnCmdTyp_MirrUp" 2 "MirrDwnCmdTyp_MirrDwn";
VAL_ 279 MirrCmdAtPassMirrFoldCmd 0 "MirrFoldCmdTyp_Idle" 1 "MirrFoldCmdTyp_FoldIn" 2 "MirrFoldCmdTyp_FoldOut";
VAL_ 279 MirrCmdAtPassMirrPosAdjCmd 0 "MirrAdjCmdTyp_Idle" 1 "MirrAdjCmdTyp_Up" 2 "MirrAdjCmdTyp_Dwn" 3 "MirrAdjCmdTyp_Le" 4 "MirrAdjCmdTyp_Ri";
VAL_ 279 OpenDrvrReSwt 0 "PsdNotPsd1_NotPsd" 1 "PsdNotPsd1_Psd";
VAL_ 279 OpenDrvrSwt 0 "PsdNotPsd1_NotPsd" 1 "PsdNotPsd1_Psd";
VAL_ 279 PassAirbLampReqChgOfPassAirbSts 0 "ReqForDisp_Idle" 1 "ReqForDisp_IndcnReqd";
VAL_ 279 PassAirbLampReqPassAirbLampDiReq 0 "PassAirbLampReq_LampNotCfgd" 1 "PassAirbLampReq_LampOn" 2 "PassAirbLampReq_LampOff" 3 "PassAirbLampReq_Resd";
VAL_ 279 PassAirbLampReqPassAirbLampEnaReq 0 "PassAirbLampReq_LampNotCfgd" 1 "PassAirbLampReq_LampOn" 2 "PassAirbLampReq_LampOff" 3 "PassAirbLampReq_Resd";
VAL_ 279 PtGearAct 0 "PtGearAct1_Neut" 1 "PtGearAct1_Gear1" 2 "PtGearAct1_Gear2" 3 "PtGearAct1_Gear3" 4 "PtGearAct1_Gear4" 5 "PtGearAct1_Gear5" 6 "PtGearAct1_Gear6" 7 "PtGearAct1_Gear7" 8 "PtGearAct1_Gear8" 9 "PtGearAct1_Gear9" 10 "PtGearAct1_Gear10" 11 "PtGearAct1_Gear11" 12 "PtGearAct1_Gear12" 13 "PtGearAct1_Drv" 14 "PtGearAct1_Ukwn" 15 "PtGearAct1_Rvs";
VAL_ 279 PtTqAtWhlReActPtTqAtWhlsReQly 0 "Qly3_De0" 1 "Qly3_De1" 2 "Qly3_De2" 3 "Qly3_De3" 4 "Qly3_De4" 5 "Qly3_De5" 6 "Qly3_De6" 7 "Qly3_De7";
VAL_ 279 ReSunCurtMvngSts 0 "Boolean_FALSE" 1 "Boolean_TRUE";
VAL_ 279 ReSunCurtPosnSts 0 "WinAndRoofAndCurtPosnTyp_PosnUkwn" 1 "WinAndRoofAndCurtPosnTyp_ClsFull" 2 "WinAndRoofAndCurtPosnTyp_PercOpen4" 3 "WinAndRoofAndCurtPosnTyp_PercOpen8" 4 "WinAndRoofAndCurtPosnTyp_PercOpen12" 5 "WinAndRoofAndCurtPosnTyp_PercOpen16" 6 "WinAndRoofAndCurtPosnTyp_PercOpen20" 7 "WinAndRoofAndCurtPosnTyp_PercOpen24" 8 "WinAndRoofAndCurtPosnTyp_PercOpen28" 9 "WinAndRoofAndCurtPosnTyp_PercOpen32" 10 "WinAndRoofAndCurtPosnTyp_PercOpen36" 11 "WinAndRoofAndCurtPosnTyp_PercOpen40" 12 "WinAndRoofAndCurtPosnTyp_PercOpen44" 13 "WinAndRoofAndCurtPosnTyp_PercOpen48" 14 "WinAndRoofAndCurtPosnTyp_PercOpen52" 15 "WinAndRoofAndCurtPosnTyp_PercOpen56" 16 "WinAndRoofAndCurtPosnTyp_PercOpen60" 17 "WinAndRoofAndCurtPosnTyp_PercOpen64" 18 "WinAndRoofAndCurtPosnTyp_PercOpen68" 19 "WinAndRoofAndCurtPosnTyp_PercOpen72" 20 "WinAndRoofAndCurtPosnTyp_PercOpen76" 21 "WinAndRoofAndCurtPosnTyp_PercOpen80" 22 "WinAndRoofAndCurtPosnTyp_PercOpen84" 23 "WinAndRoofAndCurtPosnTyp_PercOpen88" 24 "WinAndRoofAndCurtPosnTyp_PercOpen92" 25 "WinAndRoofAndCurtPosnTyp_PercOpen96" 26 "WinAndRoofAndCurtPosnTyp_OpenFull" 27 "WinAndRoofAndCurtPosnTyp_Resd1" 28 "WinAndRoofAndCurtPosnTyp_Resd2" 29 "WinAndRoofAndCurtPosnTyp_Resd3" 30 "WinAndRoofAndCurtPosnTyp_Resd4" 31 "WinAndRoofAndCurtPosnTyp_Movg";
VAL_ 279 RowSecLeSeatAdjmtCllsnWarn 0 "Boolean_FALSE" 1 "Boolean_TRUE";
VAL_ 279 RowSecLeSeatAdjmtLimnWarn 0 "Boolean_FALSE" 1 "Boolean_TRUE";
VAL_ 279 RowSecLeSeatRotAvlSts 0 "AvlSts2_NotAvl" 1 "AvlSts2_Avl";
VAL_ 279 RowSecRiSeatAdjmtCllsnWarn 0 "Boolean_FALSE" 1 "Boolean_TRUE";
VAL_ 279 RowSecRiSeatAdjmtLimnWarn 0 "Boolean_FALSE" 1 "Boolean_TRUE";
VAL_ 279 RowSecRiSeatRotAvlSts 0 "AvlSts2_NotAvl" 1 "AvlSts2_Avl";
VAL_ 279 RowSecRiSeatZeroGrvyRmn 0 "Boolean_FALSE" 1 "Boolean_TRUE";
VAL_ 279 SeatCtrlFromSecSeatRi 0 "SeatCtrlReq_Idle" 1 "SeatCtrlReq_Move" 2 "SeatCtrlReq_Return" 3 "SeatCtrlReq_Stop";
VAL_ 279 SeatFoldRaiseAllwdRowThrdLe 0 "Boolean_FALSE" 1 "Boolean_TRUE";
VAL_ 279 SeatFoldRaiseAllwdRowThrdRi 0 "Boolean_FALSE" 1 "Boolean_TRUE";
VAL_ 279 SeatMatrsAirPmpDeflaSts 0 "Sts_Resd" 1 "Sts_Err" 2 "Sts_CmplOk" 3 "Sts_InProgs";
VAL_ 279 SeatMatrsAirPmpInflaSts 0 "Sts_Resd" 1 "Sts_Err" 2 "Sts_CmplOk" 3 "Sts_InProgs";
VAL_ 279 SeatMatrsAirPmpPrepSts 0 "OkNotOkCrit_NotVld1" 1 "OkNotOkCrit_Ok" 2 "OkNotOkCrit_NotOk" 3 "OkNotOkCrit_NotVld2";
VAL_ 279 SeatOccptAtRowThrdLe2 0 "OccptPresSt1_Undefd1" 1 "OccptPresSt1_OccptNotPrsnt" 2 "OccptPresSt1_OccptPrsnt" 3 "OccptPresSt1_Undefd2";
VAL_ 279 SeatOccptAtRowThrdLeSnsSts2 0 "OkNokDi_Ok" 1 "OkNokDi_NotOk" 2 "OkNokDi_Disabled" 3 "OkNokDi_Reserved";
VAL_ 279 SeatOccptAtRowThrdRi2 0 "OccptPresSt1_Undefd1" 1 "OccptPresSt1_OccptNotPrsnt" 2 "OccptPresSt1_OccptPrsnt" 3 "OccptPresSt1_Undefd2";
VAL_ 279 SeatOccptAtRowThrdRiSnsSts2 0 "OkNokDi_Ok" 1 "OkNokDi_NotOk" 2 "OkNokDi_Disabled" 3 "OkNokDi_Reserved";
VAL_ 279 SeatRowThrdLeFoldRaiseWarn 0 "Boolean_FALSE" 1 "Boolean_TRUE";
VAL_ 279 SeatRowThrdLeFoldStsSeatFoldRaiseFlt 0 "Flt_NoFault" 1 "Flt_Fault";
VAL_ 279 SeatRowThrdLeFoldStsSeatFoldRaiseMovmt 0 "FoldRaiseMovmt_Uknwn" 1 "FoldRaiseMovmt_Fld" 2 "FoldRaiseMovmt_Rsd" 3 "FoldRaiseMovmt_MovmtToFld" 4 "FoldRaiseMovmt_MovmtToRsd" 5 "FoldRaiseMovmt_BtwnFldAndRsd";
VAL_ 279 SteerActReGroupAgActQf 0 "GenQf1_UndefindDataAccur" 1 "GenQf1_TmpUndefdData" 2 "GenQf1_DataAccurNotWithinSpcn" 3 "GenQf1_AccurData";
VAL_ 279 SteerActReGroupSteerActrReSts 0 "ActrSts_Initialisation" 1 "ActrSts_Pending" 2 "ActrSts_Normal" 3 "ActrSts_Red" 4 "ActrSts_Yellow" 5 "ActrSts_Ramping" 6 "ActrSts_Inactive" 7 "ActrSts_Derating";
VAL_ 279 SteerErrReq 0 "SteerErrReq3_NoReq" 1 "SteerErrReq3_SteerAssiSrvRqrd" 2 "SteerErrReq3_SteerErrStopSfty" 3 "SteerErrReq3_SteerAssiUrgentSrvRqrd" 4 "SteerErrReq3_SteerAssiTmpRedn" 5 "SteerErrReq3_Spare01" 6 "SteerErrReq3_Spare02" 7 "SteerErrReq3_Spare03";
VAL_ 279 SteerStsToParkAssi 0 "SteerStsToParkAssi_NormOper" 1 "SteerStsToParkAssi_SteerAbortBySpdHi" 2 "SteerStsToParkAssi_CtrlDifHi" 3 "SteerStsToParkAssi_SteerCtrlIntErr" 4 "SteerStsToParkAssi_SteerAbortByDrvrIntv" 5 "SteerStsToParkAssi_SteerTqHi" 6 "SteerStsToParkAssi_Spare1" 7 "SteerStsToParkAssi_Spare2";
VAL_ 279 SUMDrvModPrsnlAdjmtDamprCmftSts 0 "YesNo2_No" 1 "YesNo2_Yes";
VAL_ 279 SUMDrvModPrsnlAdjmtDamprHardSts 0 "YesNo2_No" 1 "YesNo2_Yes";
VAL_ 279 SUMDrvModPrsnlAdjmtDamprMedSts 0 "YesNo2_No" 1 "YesNo2_Yes";
VAL_ 279 SUMDrvModPrsnlAdjmtDamprSts_Resv1 0 "YesNo2_No" 1 "YesNo2_Yes";
VAL_ 279 SUMDrvModPrsnlAdjmtDamprSts_Resv2 0 "YesNo2_No" 1 "YesNo2_Yes";
VAL_ 279 SUMDrvModPrsnlAdjmtSuspLvlHL1Sts 0 "YesNo2_No" 1 "YesNo2_Yes";
VAL_ 279 SUMDrvModPrsnlAdjmtSuspLvlHL2Sts 0 "YesNo2_No" 1 "YesNo2_Yes";
VAL_ 279 SUMDrvModPrsnlAdjmtSuspLvlLL1Sts 0 "YesNo2_No" 1 "YesNo2_Yes";
VAL_ 279 SUMDrvModPrsnlAdjmtSuspLvlLL2Sts 0 "YesNo2_No" 1 "YesNo2_Yes";
VAL_ 279 SUMDrvModPrsnlAdjmtSuspLvlNRHSts 0 "YesNo2_No" 1 "YesNo2_Yes";
VAL_ 279 SunRoofMvngSts 0 "Boolean_FALSE" 1 "Boolean_TRUE";
VAL_ 279 SwtExtrLi2LiExtFctQf 0 "Qf1_DevOfDataUndefd" 1 "Qf1_DataTmpUndefdAndEvlnInProgs" 2 "Qf1_DevOfDataNotWithinRngAllwd" 3 "Qf1_DataCalcdWithDevDefd";
VAL_ 279 SwtExtrLi2LiExtFctReq1 0 "LiExtFctReq1_Off" 1 "LiExtFctReq1_Pos" 2 "LiExtFctReq1_Lo" 3 "LiExtFctReq1_AutLi";
VAL_ 279 ThrdRowLeVentnAutoSts 0 "OffOnErrInvalid_Off" 1 "OffOnErrInvalid_On" 2 "OffOnErrInvalid_Err" 3 "OffOnErrInvalid_Invalid";
VAL_ 279 ThrdRowRiVentnAutoSts 0 "OffOnErrInvalid_Off" 1 "OffOnErrInvalid_On" 2 "OffOnErrInvalid_Err" 3 "OffOnErrInvalid_Invalid";
VAL_ 279 TwbrWarnStsYesNo 0 "YesNoRes_Resd1" 1 "YesNoRes_Yes" 2 "YesNoRes_No" 3 "YesNoRes_Resd2";
VAL_ 279 WinDsblDrvrReSts 0 "OnOff1_Off" 1 "OnOff1_On";
VAL_ 279 WinDsblLeftCmd 0 "Boolean_FALSE" 1 "Boolean_TRUE";
VAL_ 279 WinDsblRightCmd 0 "OnOff1_Off" 1 "OnOff1_On";
VAL_ 279 WinFailrStsAtDrvrRe 0 "Flt_NoFault" 1 "Flt_Fault";
VAL_ 279 WinGlbCmd 0 "OpenClsGlbCmd_Idle" 1 "OpenClsGlbCmd_GlobalOpenWindow" 2 "OpenClsGlbCmd_GlobalCloseWindowAndSunroof" 3 "OpenClsGlbCmd_GlobalCloseWindow" 4 "OpenClsGlbCmd_GlobalStop" 5 "OpenClsGlbCmd_Resd1" 6 "OpenClsGlbCmd_Resd2" 7 "OpenClsGlbCmd_Resd3";
VAL_ 279 WinPosnStsAtDrvrRe 0 "WinAndRoofAndCurtPosnTyp_PosnUkwn" 1 "WinAndRoofAndCurtPosnTyp_ClsFull" 2 "WinAndRoofAndCurtPosnTyp_PercOpen4" 3 "WinAndRoofAndCurtPosnTyp_PercOpen8" 4 "WinAndRoofAndCurtPosnTyp_PercOpen12" 5 "WinAndRoofAndCurtPosnTyp_PercOpen16" 6 "WinAndRoofAndCurtPosnTyp_PercOpen20" 7 "WinAndRoofAndCurtPosnTyp_PercOpen24" 8 "WinAndRoofAndCurtPosnTyp_PercOpen28" 9 "WinAndRoofAndCurtPosnTyp_PercOpen32" 10 "WinAndRoofAndCurtPosnTyp_PercOpen36" 11 "WinAndRoofAndCurtPosnTyp_PercOpen40" 12 "WinAndRoofAndCurtPosnTyp_PercOpen44" 13 "WinAndRoofAndCurtPosnTyp_PercOpen48" 14 "WinAndRoofAndCurtPosnTyp_PercOpen52" 15 "WinAndRoofAndCurtPosnTyp_PercOpen56" 16 "WinAndRoofAndCurtPosnTyp_PercOpen60" 17 "WinAndRoofAndCurtPosnTyp_PercOpen64" 18 "WinAndRoofAndCurtPosnTyp_PercOpen68" 19 "WinAndRoofAndCurtPosnTyp_PercOpen72" 20 "WinAndRoofAndCurtPosnTyp_PercOpen76" 21 "WinAndRoofAndCurtPosnTyp_PercOpen80" 22 "WinAndRoofAndCurtPosnTyp_PercOpen84" 23 "WinAndRoofAndCurtPosnTyp_PercOpen88" 24 "WinAndRoofAndCurtPosnTyp_PercOpen92" 25 "WinAndRoofAndCurtPosnTyp_PercOpen96" 26 "WinAndRoofAndCurtPosnTyp_OpenFull" 27 "WinAndRoofAndCurtPosnTyp_Resd1" 28 "WinAndRoofAndCurtPosnTyp_Resd2" 29 "WinAndRoofAndCurtPosnTyp_Resd3" 30 "WinAndRoofAndCurtPosnTyp_Resd4" 31 "WinAndRoofAndCurtPosnTyp_Movg";
SIG_GROUP_ 53 ActvnOfIndcr 1 : ActvnOfIndcrIndcrOut ActvnOfIndcrIndcrOutChks ActvnOfIndcrIndcrOutCntr;
SIG_GROUP_ 288 BattFltStsPrim 1 : BattFltStsPrimBattFltStsPrm BattFltStsPrimChks BattFltStsPrimCntr;
SIG_GROUP_ 53 BLEKeySearchReq 1 : BLEKeySearchReqKeyLocn BLEKeySearchReqTirgger;
SIG_GROUP_ 53 CrashStsSafe 1 : CrashStsSafeChks CrashStsSafeCntr CrashStsSafeSts;
SIG_GROUP_ 288 DefrstSts 1 : DefrstStsMirrDefrst DefrstStsWinDefrstFrnt DefrstStsWinDefrstRe;
SIG_GROUP_ 312 DispElecPwr 1 : DispElecPwrAbs DispElecPwrSts;
SIG_GROUP_ 312 DoorDrvrCinhIntFailInf 1 : DoorDrvrCinhIntFailInfCinchFlt1 DoorDrvrCinhIntFailInfCinchRestFlt;
SIG_GROUP_ 53 DoorDrvrReCinhIntFailInf 1 : DoorDrvrReCinhIntFailInfCinchFlt1 DoorDrvrReCinhIntFailInfCinchRestFlt;
SIG_GROUP_ 312 DoorDrvrRelsFail 1 : DoorDrvrRelsFailCinchOverTimed DoorDrvrRelsFailFailure1 DoorDrvrRelsFailMechRels;
SIG_GROUP_ 53 DoorDrvrReRelsFail 1 : DoorDrvrReRelsFailCinchOverTimed DoorDrvrReRelsFailFailure1 DoorDrvrReRelsFailMechRels;
SIG_GROUP_ 312 DoorLeReCinhIntFailInf 1 : DoorLeReCinhIntFailInfCinchFlt1 DoorLeReCinhIntFailInfCinchRestFlt;
SIG_GROUP_ 312 DoorLeReRelsFail 1 : DoorLeReRelsFailCinchOverTimed DoorLeReRelsFailFailure1 DoorLeReRelsFailMechRels;
SIG_GROUP_ 336 DoorSldngLeReCinFail 1 : DoorSldngLeReCinFailCinchFlt1 DoorSldngLeReCinFailCinchRestFlt;
SIG_GROUP_ 336 DoorSldngLeReSts 1 : DoorSldngLeReStsDoorOpenSts DoorSldngLeReStsFrstTmLveAbnd;
SIG_GROUP_ 336 DoorSldngRiReCinFail 1 : DoorSldngRiReCinFailCinchFlt1 DoorSldngRiReCinFailCinchRestFlt;
SIG_GROUP_ 336 DoorSldngRiReSts 1 : DoorSldngRiReStsDoorOpenSts DoorSldngRiReStsFrstTmLveAbnd;
SIG_GROUP_ 312 DrvrSeatSwtSts 1 : DrvrSeatSwtStsDrvrSeatSwtAdjmtOfSpplFctHozlSts DrvrSeatSwtStsDrvrSeatSwtAdjmtOfSpplFctVertSts DrvrSeatSwtStsDrvrSeatSwtHdrstHozlSts DrvrSeatSwtStsDrvrSeatSwtHdrstVertSts DrvrSeatSwtStsDrvrSeatSwtHeiFrntSts DrvrSeatSwtStsDrvrSeatSwtHeiSts DrvrSeatSwtStsDrvrSeatSwtInclSts DrvrSeatSwtStsDrvrSeatSwtSelnOfSpplFctSts DrvrSeatSwtStsDrvrSeatSwtSldSts;
SIG_GROUP_ 336 ElecMot2TqAct 1 : ElecMot2TqActChks ElecMot2TqActCntr ElecMot2TqActIsgTqAct ElecMot2TqActQualityFactor;
SIG_GROUP_ 336 ElecMot2TqAllwd 1 : ElecMot2TqAllwdChks ElecMot2TqAllwdCntr ElecMot2TqAllwdIsgTqAllwd;
SIG_GROUP_ 336 ElecMot2TqAvl 1 : ElecMot2TqAvlIsgTqAvlMax ElecMot2TqAvlIsgTqAvlMin;
SIG_GROUP_ 312 EngFltIndcn 1 : EngFltIndcn1 EngFltIndcn10 EngFltIndcn11 EngFltIndcn12 EngFltIndcn13 EngFltIndcn14 EngFltIndcn15 EngFltIndcn16 EngFltIndcn17 EngFltIndcn18 EngFltIndcn19 EngFltIndcn2 EngFltIndcn20 EngFltIndcn21 EngFltIndcn22 EngFltIndcn23 EngFltIndcn24 EngFltIndcn25 EngFltIndcn26 EngFltIndcn27 EngFltIndcn3 EngFltIndcn4 EngFltIndcn5 EngFltIndcn6 EngFltIndcn7 EngFltIndcn8 EngFltIndcn9;
SIG_GROUP_ 53 EpbLampReqSec 1 : EpbLampReqSecChks EpbLampReqSecCntr EpbLampReqSecEpbLampReq;
SIG_GROUP_ 312 ExtrLiShowActvnSts 1 : ExtrLiShowActvnStsExtrLiShowActvnFrntLeFb ExtrLiShowActvnStsExtrLiShowActvnFrntRiFb ExtrLiShowActvnStsExtrLiShowActvnReLe2Fb ExtrLiShowActvnStsExtrLiShowActvnReLeFb ExtrLiShowActvnStsExtrLiShowActvnReRi2Fb ExtrLiShowActvnStsExtrLiShowActvnReRiFb;
SIG_GROUP_ 312 FrntWiprLvrCmd2 1 : FrntWiprLvrCmd2FrntWiprLvrCmd1 FrntWiprLvrCmd2FrntWiprLvrCntr FrntWiprLvrCmd2FrntWiprLvrCrc FrntWiprLvrCmd2FrntWiprLvrQf;
SIG_GROUP_ 312 HudSnsrErr 1 : HudSnsrErrParChk HudSnsrErrSnsrErr;
SIG_GROUP_ 288 IgmGeneric 1 : IgmGenericADAlrmSt IgmGenericDTCHig IgmGenericDTCLow IgmGenericDTCMid IgmGenericDTCSts IgmGenericEMQnty IgmGenericEMSeqNr IgmGenericFltAlrmSt IgmGenericIacAlrmSt IgmGenericInvrtTAlrmSt IgmGenericModStatusRms IgmGenericMotTAlrmSt IgmGenericRslAlrmSt IgmGenericSpdAlrmSt IgmGenericTypeInfo IgmGenericUDcAlrmSt;
SIG_GROUP_ 279 IsgTqAct 1 : IsgTqActChks IsgTqActCntr IsgTqActIsgTqAct IsgTqActQualityFactor;
SIG_GROUP_ 336 MemBtnPsd 1 : MemBtnPsdMemBtn1 MemBtnPsdMemBtn2 MemBtnPsdMemBtn3 MemBtnPsdMemButM;
SIG_GROUP_ 279 MirrCmdAtPass 1 : MirrCmdAtPassMirrDwnCmd MirrCmdAtPassMirrFoldCmd MirrCmdAtPassMirrPosAdjCmd;
SIG_GROUP_ 279 MirrPosnToSetTarPosnAtDrvr 1 : MirrPosnToSetTarPosnAtDrvrMirrAdjLeRi MirrPosnToSetTarPosnAtDrvrMirrAdjUpDown;
SIG_GROUP_ 279 PassAirbLampReq 1 : PassAirbLampReqChgOfPassAirbSts PassAirbLampReqChks PassAirbLampReqCntr PassAirbLampReqPassAirbLampDiReq PassAirbLampReqPassAirbLampEnaReq;
SIG_GROUP_ 53 PtTqAtWhlFrntAct 1 : PtTqAtWhlFrntActChks PtTqAtWhlFrntActCntr PtTqAtWhlFrntActPtTqAtAxleFrntAct PtTqAtWhlFrntActPtTqAtWhlFrntLeAct PtTqAtWhlFrntActPtTqAtWhlFrntRiAct PtTqAtWhlFrntActPtTqAtWhlsFrntQly;
SIG_GROUP_ 279 PtTqAtWhlReAct 1 : PtTqAtWhlReActChks PtTqAtWhlReActCntr PtTqAtWhlReActPtTqAtAxleReAct PtTqAtWhlReActPtTqAtWhlReLeAct PtTqAtWhlReActPtTqAtWhlReRiAct PtTqAtWhlReActPtTqAtWhlsReQly;
SIG_GROUP_ 312 RecOfImpct 1 : RecOfImpctCrashFrnt RecOfImpctCrashOffroadA RecOfImpctCrashOffroadD RecOfImpctCrashOffroadRT RecOfImpctCrashOffroadRTsevere RecOfImpctCrashPed RecOfImpctCrashRe RecOfImpctCrashRollovr RecOfImpctCrashSideLe RecOfImpctCrashSideRi RecOfImpctCrashState RecOfImpctImpctDvx RecOfImpctImpctDvy RecOfImpctImpctRollAg RecOfImpctVehOri;
SIG_GROUP_ 53 RecOfImpct2 1 : RecOfImpct2ImpctDvxSigned RecOfImpct2ImpctDvySigned;
SIG_GROUP_ 336 RowFrstPassDivePosPerc 1 : RowFrstPassDivePosPercSeatPosPerc RowFrstPassDivePosPercSeatPosQf;
SIG_GROUP_ 53 RowSecLeLegRstHeiPosPerc 1 : RowSecLeLegRstHeiPosPercSeatPosPerc RowSecLeLegRstHeiPosPercSeatPosQf;
SIG_GROUP_ 53 RowSecLeLegRstLenPosPerc 1 : RowSecLeLegRstLenPosPercSeatPosPerc RowSecLeLegRstLenPosPercSeatPosQf;
SIG_GROUP_ 53 RowSecLeSldPosPerc 1 : RowSecLeSldPosPercSeatPosPerc RowSecLeSldPosPercSeatPosQf;
SIG_GROUP_ 53 RowSecRiLegRstHeiPosPerc 1 : RowSecRiLegRstHeiPosPercSeatPosPerc RowSecRiLegRstHeiPosPercSeatPosQf;
SIG_GROUP_ 53 RowSecRiLegRstLenPosPerc 1 : RowSecRiLegRstLenPosPercSeatPosPerc RowSecRiLegRstLenPosPercSeatPosQf;
SIG_GROUP_ 53 RowSecRiSldPosPerc 1 : RowSecRiSldPosPercSeatPosPerc RowSecRiSldPosPercSeatPosQf;
SIG_GROUP_ 279 SeatRowThrdLeFoldSts 1 : SeatRowThrdLeFoldStsSeatFoldRaiseFlt SeatRowThrdLeFoldStsSeatFoldRaiseMovmt;
SIG_GROUP_ 279 SteerActReGroup 1 : SteerActReGroupAgAct SteerActReGroupAgActQf SteerActReGroupAgGrdtMaxAvlFromSteerActrRe SteerActReGroupAgMaxAvlFromSteerActrRe SteerActReGroupChks SteerActReGroupCntr SteerActReGroupSteerActrReSts;
SIG_GROUP_ 53 SteerWhlSnsr 1 : SteerWhlSnsrAg SteerWhlSnsrAgSpd SteerWhlSnsrChks SteerWhlSnsrCntr SteerWhlSnsrQf;
SIG_GROUP_ 279 SUMDrvModPrsnlAdjmt 1 : SUMDrvModPrsnlAdjmtDamprCmftSts SUMDrvModPrsnlAdjmtDamprHardSts SUMDrvModPrsnlAdjmtDamprMedSts SUMDrvModPrsnlAdjmtDamprSts_Resv1 SUMDrvModPrsnlAdjmtDamprSts_Resv2 SUMDrvModPrsnlAdjmtSuspLvlHL1Sts SUMDrvModPrsnlAdjmtSuspLvlHL2Sts SUMDrvModPrsnlAdjmtSuspLvlLL1Sts SUMDrvModPrsnlAdjmtSuspLvlLL2Sts SUMDrvModPrsnlAdjmtSuspLvlNRHSts;
SIG_GROUP_ 279 SwtExtrLi2 1 : SwtExtrLi2LiExtFctCntr SwtExtrLi2LiExtFctCrc SwtExtrLi2LiExtFctQf SwtExtrLi2LiExtFctReq1;
SIG_GROUP_ 288 TrsmN 1 : TrsmNChks TrsmNCntr TrsmNInp TrsmNInpOk TrsmNOutp TrsmNOutpOk;
SIG_GROUP_ 279 TwbrWarnSts 1 : TwbrWarnStsChks TwbrWarnStsCntr TwbrWarnStsYesNo;
SIG_GROUP_ 53 WinSwtReq 1 : WinSwtReqChks WinSwtReqCntr WinSwtReqFrntLe WinSwtReqFrntRi WinSwtReqReLe WinSwtReqReRi;
