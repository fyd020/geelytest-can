// *************************************************************************** *
// *                                                                           *
// * Description:         CANDB File                                           *
// * Generated at:        2025-01-24 14:38                                     *
// * System:              SDB22436                                             *
// * Variant:             L946_ADCU9_ZCUD                                      *
// * Network:             ZCU_CANFD2                                           *
// *                                                                           *
// *************************************************************************** *
VERSION "ZCU_CANFD2"

NS_ :

BS_ :

BU_ :  ETC IHU ZCUD ZCUP

BO_ 371 DimZCUCANFD2Fr01 : 64 IHU
 SG_ AmbTIndcdWithUnit_UB : 0|1@0+ (1,0) [0|1] "" ZCUD
 SG_ AmbTIndcdWithUnitAmbTIndcd : 31|12@0+ (0.1,-100.0) [-100.0|309.5] "Unitless" ZCUD
 SG_ AmbTIndcdWithUnitAmbTIndcdUnit : 35|2@0+ (1,0) [0|3] "" ZCUD
 SG_ AmbTIndcdWithUnitQF : 33|2@0+ (1,0) [0|3] "" ZCUD
 SG_ BltRmnTelltl : 7|1@0+ (1,0) [0|1] "" ZCUD
 SG_ BltRmnTelltl_UB : 6|1@0+ (1,0) [0|1] "" ZCUD
 SG_ DrvrCrsCtrlFctDeactvnReq : 80|1@0+ (1,0) [0|1] "" ZCUD
 SG_ DrvrCrsCtrlFctDeactvnReq_UB : 95|1@0+ (1,0) [0|1] "" ZCUD
 SG_ DrvrCrsCtrlFctReActvReq : 94|1@0+ (1,0) [0|1] "" ZCUD
 SG_ DrvrCrsCtrlFctReActvReq_UB : 93|1@0+ (1,0) [0|1] "" ZCUD
 SG_ DrvrCrsCtrlFctSeld : 92|3@0+ (1,0) [0|7] "" ZCUD
 SG_ DrvrCrsCtrlFctSeld_UB : 89|1@0+ (1,0) [0|1] "" ZCUD
 SG_ FuFillgDetnForUseInt : 107|1@0+ (1,0) [0|1] "" ZCUD
 SG_ FuFillgDetnForUseInt_UB : 106|1@0+ (1,0) [0|1] "" ZCUD
 SG_ FuLvlRawActvSide_UB : 88|1@0+ (1,0) [0|1] "" ZCUD
 SG_ FuLvlRawActvSideFuLvlValFromFuTbl : 103|10@0+ (0.2,0.0) [0.0|204.60000000000002] "Litre" ZCUD
 SG_ FuLvlRawActvSideGenQF : 109|2@0+ (1,0) [0|3] "" ZCUD
 SG_ FuLvlRawPasSide_UB : 42|1@0+ (1,0) [0|1] "" ZCUD
 SG_ FuLvlRawPasSideFuLvlValFromFuTbl : 55|10@0+ (0.2,0.0) [0.0|204.60000000000002] "Litre" ZCUD
 SG_ FuLvlRawPasSideGenQF : 61|2@0+ (1,0) [0|3] "" ZCUD
 SG_ PwrCnsAvgIndcd_UB : 40|1@0+ (1,0) [0|1] "" ZCUD
 SG_ PwrCnsAvgIndcdEcoDrvInfo1 : 76|11@0+ (0.1,-102.3) [-102.3|102.30000000000003] "Unitless" ZCUD
 SG_ PwrCnsAvgIndcdPwrCnsUnit : 81|1@0+ (1,0) [0|1] "" ZCUD
 SG_ RstTrip1 : 71|4@0+ (1,0) [0|15] "" ZCUD
 SG_ RstTrip1_UB : 67|1@0+ (1,0) [0|1] "" ZCUD
 SG_ RstTrip2 : 66|3@0+ (1,0) [0|7] "" ZCUD
 SG_ RstTrip2_UB : 41|1@0+ (1,0) [0|1] "" ZCUD

BO_ 721 DimZCUCANFD2Fr02 : 64 IHU
 SG_ AmbTUnitForUseInt : 37|2@0+ (1,0) [0|3] "" Vector__XXX
 SG_ AmbTUnitForUseInt_UB : 35|1@0+ (1,0) [0|1] "" Vector__XXX
 SG_ CarModDynoCnfrm : 52|4@0+ (1,0) [0|15] "" ZCUD
 SG_ CarModDynoCnfrm_UB : 48|1@0+ (1,0) [0|1] "" ZCUD
 SG_ FuLvlLoIndcn : 276|1@0+ (1,0) [0|1] "" ZCUD
 SG_ FuLvlLoIndcn_UB : 275|1@0+ (1,0) [0|1] "" ZCUD
 SG_ FuLvlLoWarn : 126|1@0+ (1,0) [0|1] "" ZCUP
 SG_ FuLvlLoWarn_UB : 125|1@0+ (1,0) [0|1] "" ZCUP
 SG_ KeyLostWarnIndcnAckd : 297|1@0+ (1,0) [0|1] "" ZCUD
 SG_ KeyLostWarnIndcnAckd_UB : 296|1@0+ (1,0) [0|1] "" ZCUD
 SG_ ReqForPassAirbIndcnAckd : 89|1@0+ (1,0) [0|1] "" ZCUD
 SG_ ReqForPassAirbIndcnAckd_UB : 88|1@0+ (1,0) [0|1] "" ZCUD
 SG_ SrvRst : 274|1@0+ (1,0) [0|1] "" ZCUD
 SG_ SrvRst_UB : 273|1@0+ (1,0) [0|1] "" ZCUD
 SG_ TotDstToEmpty_UB : 195|1@0+ (1,0) [0|1] "" ZCUD
 SG_ TotDstToEmptyDstToEmpty : 343|13@0+ (1.0,0.0) [0.0|8190.0] "Unitless" ZCUD
 SG_ TotDstToEmptyDstUnit : 346|1@0+ (1,0) [0|1] "" ZCUD
 SG_ TrlrLampChkReqFromHmi : 122|2@0+ (1,0) [0|3] "" ZCUD
 SG_ TrlrLampChkReqFromHmi_UB : 120|1@0+ (1,0) [0|1] "" ZCUD

BO_ 558 DimZCUCANFD2Fr03 : 64 IHU
 SG_ AudWarnActv : 49|2@0+ (1,0) [0|3] "" ZCUD
 SG_ AudWarnActv_UB : 57|1@0+ (1,0) [0|1] "" ZCUD

BO_ 63 DimZCUCANFD2Fr04 : 64 IHU
 SG_ ActvnOfDefdLiShow : 173|1@0+ (1,0) [0|1] "" ZCUD
 SG_ ActvnOfDefdLiShow_UB : 172|1@0+ (1,0) [0|1] "" ZCUD
 SG_ MusicShowPlaySts : 171|1@0+ (1,0) [0|1] "" ZCUD
 SG_ MusicShowPlaySts_UB : 170|1@0+ (1,0) [0|1] "" ZCUD
 SG_ StreamingMirrBriAdjmt : 183|4@0+ (1.0,0.0) [0.0|15.0] "Unitless" ZCUD
 SG_ StreamingMirrBriAdjmt_UB : 169|1@0+ (1,0) [0|1] "" ZCUD
 SG_ StreamingMirrBriAutoAdjmt : 184|1@0+ (1,0) [0|1] "" ZCUD
 SG_ StreamingMirrBriAutoAdjmt_UB : 199|1@0+ (1,0) [0|1] "" ZCUD
 SG_ StreamingMirrImgAdjmt : 179|4@0+ (1.0,0.0) [0.0|15.0] "Unitless" ZCUD
 SG_ StreamingMirrImgAdjmt_UB : 168|1@0+ (1,0) [0|1] "" ZCUD
 SG_ StreamingMirrPosnAdjmt : 191|4@0+ (1.0,0.0) [0.0|15.0] "Unitless" ZCUD
 SG_ StreamingMirrPosnAdjmt_UB : 187|1@0+ (1,0) [0|1] "" ZCUD
 SG_ StreamingMirrSwt : 186|1@0+ (1,0) [0|1] "" ZCUD
 SG_ StreamingMirrSwt_UB : 185|1@0+ (1,0) [0|1] "" ZCUD
 SG_ TotDstTrvld : 135|25@0+ (0.1,0.0) [0.0|2000000.0] "km" ZCUD
 SG_ TotDstTrvld_UB : 158|1@0+ (1,0) [0|1] "" ZCUD

BO_ 1412 EtctoZcudXCPFr01 : 64 ETC

BO_ 1416 EtctoZcupXCPFr01 : 64 ETC

BO_ 1377 ETCZCUCANFD2DEVFr01 : 64 ETC
 SG_ ZCUDMdevelpsignalgroupReq_UB : 504|1@0+ (1,0) [0|1] "" ZCUD
 SG_ ZCUDMdevelpsignalgroupReqFunctiondevpsignalgroup1 : 7|8@0+ (1.0,0.0) [0.0|255.0] "Unitless" ZCUD
 SG_ ZCUDMdevelpsignalgroupReqFunctiondevpsignalgroup2 : 15|8@0+ (1.0,0.0) [0.0|255.0] "Unitless" ZCUD
 SG_ ZCUDMdevelpsignalgroupReqFunctiondevpsignalgroup3 : 23|8@0+ (1.0,0.0) [0.0|255.0] "Unitless" ZCUD
 SG_ ZCUDMdevelpsignalgroupReqFunctiondevpsignalgroup4 : 31|8@0+ (1.0,0.0) [0.0|255.0] "Unitless" ZCUD
 SG_ ZCUDMdevelpsignalgroupReqFunctiondevpsignalgroup5 : 39|8@0+ (1.0,0.0) [0.0|255.0] "Unitless" ZCUD
 SG_ ZCUDMdevelpsignalgroupReqFunctiondevpsignalgroup6 : 47|8@0+ (1.0,0.0) [0.0|255.0] "Unitless" ZCUD
 SG_ ZCUDMdevelpsignalgroupReqFunctiondevpsignalgroup7 : 55|8@0+ (1.0,0.0) [0.0|255.0] "Unitless" ZCUD
 SG_ ZCUDMdevelpsignalgroupReqFunctiondevpsignalgroup8 : 63|8@0+ (1.0,0.0) [0.0|255.0] "Unitless" ZCUD
 SG_ ZCUPdevelpsignalgroupReq_UB : 505|1@0+ (1,0) [0|1] "" ZCUP
 SG_ ZCUPdevelpsignalgroupReqFunctiondevpsignalgroup1 : 71|8@0+ (1.0,0.0) [0.0|255.0] "Unitless" ZCUP
 SG_ ZCUPdevelpsignalgroupReqFunctiondevpsignalgroup2 : 79|8@0+ (1.0,0.0) [0.0|255.0] "Unitless" ZCUP
 SG_ ZCUPdevelpsignalgroupReqFunctiondevpsignalgroup3 : 87|8@0+ (1.0,0.0) [0.0|255.0] "Unitless" ZCUP
 SG_ ZCUPdevelpsignalgroupReqFunctiondevpsignalgroup4 : 95|8@0+ (1.0,0.0) [0.0|255.0] "Unitless" ZCUP
 SG_ ZCUPdevelpsignalgroupReqFunctiondevpsignalgroup5 : 103|8@0+ (1.0,0.0) [0.0|255.0] "Unitless" ZCUP
 SG_ ZCUPdevelpsignalgroupReqFunctiondevpsignalgroup6 : 111|8@0+ (1.0,0.0) [0.0|255.0] "Unitless" ZCUP
 SG_ ZCUPdevelpsignalgroupReqFunctiondevpsignalgroup7 : 119|8@0+ (1.0,0.0) [0.0|255.0] "Unitless" ZCUP
 SG_ ZCUPdevelpsignalgroupReqFunctiondevpsignalgroup8 : 127|8@0+ (1.0,0.0) [0.0|255.0] "Unitless" ZCUP

BO_ 461 IHUZCUCANFD2Fr02 : 64 IHU
 SG_ CushExtnFirstDrvr : 82|2@0+ (1,0) [0|3] "" ZCUD
 SG_ CushExtnFirstDrvr_UB : 80|1@0+ (1,0) [0|1] "" ZCUD
 SG_ ExtrLtgZoneSet : 133|4@0+ (1.0,0.0) [0.0|15.0] "Unitless" ZCUD
 SG_ ExtrLtgZoneSet_UB : 129|1@0+ (1,0) [0|1] "" ZCUD
 SG_ FirstRowSeatInhbByMod : 143|2@0+ (1,0) [0|3] "" ZCUP
 SG_ FirstRowSeatInhbByMod_UB : 128|1@0+ (1,0) [0|1] "" ZCUP
 SG_ IntrMirrAntiGlareLvl : 167|4@0+ (1.0,0.0) [0.0|15.0] "Unitless" ZCUD
 SG_ IntrMirrAntiGlareLvl_UB : 163|1@0+ (1,0) [0|1] "" ZCUD
 SG_ IntrMirrAntiGlarePerc : 175|8@0+ (1.0,0.0) [0.0|255.0] "Unitless" ZCUD
 SG_ IntrMirrAntiGlarePerc_UB : 162|1@0+ (1,0) [0|1] "" ZCUD
 SG_ MagicCarpetSuspSet : 95|1@0+ (1,0) [0|1] "" ZCUD
 SG_ MagicCarpetSuspSet_UB : 94|1@0+ (1,0) [0|1] "" ZCUD
 SG_ PwrOutlOffSet : 93|3@0+ (1,0) [0|7] "" ZCUD
 SG_ PwrOutlOffSet_UB : 90|1@0+ (1,0) [0|1] "" ZCUD
 SG_ PwrSldgDoorAutClsEnaHmiReq : 161|1@0+ (1,0) [0|1] "" ZCUD
 SG_ PwrSldgDoorAutClsEnaHmiReq_UB : 160|1@0+ (1,0) [0|1] "" ZCUD
 SG_ RuranACModeSet : 183|3@0+ (1,0) [0|7] "" ZCUP
 SG_ RuranACModeSet_UB : 180|1@0+ (1,0) [0|1] "" ZCUP
 SG_ SldngDoorLeReAutoManReq : 179|2@0+ (1,0) [0|3] "" ZCUD
 SG_ SldngDoorLeReAutoManReq_UB : 177|1@0+ (1,0) [0|1] "" ZCUD
 SG_ SldngDoorRiReAutoManReq : 191|2@0+ (1,0) [0|3] "" ZCUD
 SG_ SldngDoorRiReAutoManReq_UB : 176|1@0+ (1,0) [0|1] "" ZCUD

BO_ 447 IHUZCUCANFD2Fr03 : 64 IHU
 SG_ DrvrSeatDispSwtFctMod : 271|2@0+ (1,0) [0|3] "" ZCUD
 SG_ DrvrSeatDispSwtFctMod_UB : 256|1@0+ (1,0) [0|1] "" ZCUD
 SG_ PassSeatDispSwtFctMod : 269|2@0+ (1,0) [0|3] "" ZCUP
 SG_ PassSeatDispSwtFctMod_UB : 267|1@0+ (1,0) [0|1] "" ZCUP
 SG_ SbwSteerBackToCenterSetg_UB : 238|1@0+ (1,0) [0|1] "" ZCUD
 SG_ SbwSteerBackToCenterSetgChks : 231|8@0+ (1.0,0.0) [0.0|255.0] "Unitless" ZCUD
 SG_ SbwSteerBackToCenterSetgCntr : 219|4@0+ (1.0,0.0) [0.0|15.0] "Unitless" ZCUD
 SG_ SbwSteerBackToCenterSetgSetg : 239|1@0+ (1,0) [0|1] "" ZCUD
 SG_ SbwSteerRatiosFolwSpdSetg_UB : 237|1@0+ (1,0) [0|1] "" ZCUD
 SG_ SbwSteerRatiosFolwSpdSetgChks : 247|8@0+ (1.0,0.0) [0.0|255.0] "Unitless" ZCUD
 SG_ SbwSteerRatiosFolwSpdSetgCntr : 235|4@0+ (1.0,0.0) [0.0|15.0] "Unitless" ZCUD
 SG_ SbwSteerRatiosFolwSpdSetgSetg : 236|1@0+ (1,0) [0|1] "" ZCUD
 SG_ SbwSteerRatiosLvlSetg_UB : 257|1@0+ (1,0) [0|1] "" ZCUD
 SG_ SbwSteerRatiosLvlSetgChks : 215|8@0+ (1.0,0.0) [0.0|255.0] "Unitless" ZCUD
 SG_ SbwSteerRatiosLvlSetgCntr : 223|4@0+ (1.0,0.0) [0.0|15.0] "Unitless" ZCUD
 SG_ SbwSteerRatiosLvlSetgSetg : 202|3@0+ (1,0) [0|7] "" ZCUD
 SG_ SbwSteerRatiosSetg_UB : 203|1@0+ (1,0) [0|1] "" ZCUD
 SG_ SbwSteerRatiosSetgChks : 199|8@0+ (1.0,0.0) [0.0|255.0] "Unitless" ZCUD
 SG_ SbwSteerRatiosSetgCntr : 207|4@0+ (1.0,0.0) [0.0|15.0] "Unitless" ZCUD
 SG_ SbwSteerRatiosSetgSetg : 177|10@0+ (0.1,0.0) [0.0|102.30000000000001] "Unitless" ZCUD
 SG_ SbwSteerRemainsStatySetg_UB : 258|1@0+ (1,0) [0|1] "" ZCUD
 SG_ SbwSteerRemainsStatySetgChks : 255|8@0+ (1.0,0.0) [0.0|255.0] "Unitless" ZCUD
 SG_ SbwSteerRemainsStatySetgCntr : 263|4@0+ (1.0,0.0) [0.0|15.0] "Unitless" ZCUD
 SG_ SbwSteerRemainsStatySetgSetg : 259|1@0+ (1,0) [0|1] "" ZCUD
 SG_ VoiceCtrlLocking : 49|1@0+ (1,0) [0|1] "" ZCUD
 SG_ VoiceCtrlLocking_UB : 48|1@0+ (1,0) [0|1] "" ZCUD

BO_ 356 IHUZCUCANFD2Fr07 : 64 IHU
 SG_ AudWarnOfSnsrParkAssiRe1 : 404|4@0+ (1,0) [0|15] "" ZCUP
 SG_ AudWarnOfSnsrParkAssiRe1_UB : 400|1@0+ (1,0) [0|1] "" ZCUP
 SG_ BlutoothPhoneWorkingSts : 282|3@0+ (1,0) [0|7] "" ZCUP
 SG_ BlutoothPhoneWorkingSts_UB : 272|1@0+ (1,0) [0|1] "" ZCUP
 SG_ SphDvExtnLg : 511|3@0+ (1,0) [0|7] "" ZCUD
 SG_ SphDvExtnLg_UB : 496|1@0+ (1,0) [0|1] "" ZCUD

BO_ 1564 ZcudCmdToDhuZCUCANFD2DiagResFr : 64 ZCUD

BO_ 1565 ZcudCmpToDhuZCUCANFD2DiagResFr : 64 ZCUD

BO_ 1594 ZcudDlmToDhuZCUCANFD2DiagResFr : 64 ZCUD

BO_ 1713 ZcudDpod2ToDhuZCUCANFD2DiagResFr : 64 ZCUD

BO_ 1715 ZcudHcmlToDhuZCUCANFD2DiagResFr : 64 ZCUD

BO_ 1716 ZcudHcmrToDhuZCUCANFD2DiagResFr : 64 ZCUD

BO_ 1712 ZcudLpod2ToDhuZCUCANFD2DiagResFr : 64 ZCUD

BO_ 1557 ZcudPotToDhuZCUCANFD2DiagResFr : 64 ZCUD

BO_ 1724 ZcudPpod2ToDhuZCUCANFD2DiagResFr : 64 ZCUD

BO_ 1714 ZcudRcmToDhuZCUCANFD2DiagResFr : 64 ZCUD

BO_ 1552 ZcudRmlToDhuZCUCANFD2DiagResFr : 64 ZCUD

BO_ 1553 ZcudRmrToDhuZCUCANFD2DiagResFr : 64 ZCUD

BO_ 1723 ZcudRpod2ToDhuZCUCANFD2DiagResFr : 64 ZCUD

BO_ 1571 ZcudSdlToDhuZCUCANFD2DiagResFr : 64 ZCUD

BO_ 1572 ZcudSdrToDhuZCUCANFD2DiagResFr : 64 ZCUD

BO_ 1585 ZcudSmblToDhuZCUCANFD2DiagResFr : 64 ZCUD

BO_ 1586 ZcudSmbrToDhuZCUCANFD2DiagResFr : 64 ZCUD

BO_ 1577 ZcudSmbToDhuZCUCANFD2DiagResFr : 64 ZCUD

BO_ 1576 ZcudSmp2ToDhuZCUCANFD2DiagResFr : 64 ZCUD

BO_ 2041 ZcudSrsToDhuISO26021ZCUCanFD2ResFr : 8 ZCUD

BO_ 1593 ZcudSrsToDhuZCUCANFD2DiagResFr : 64 ZCUD

BO_ 1650 ZcudSwmToDhuZCUCANFD2DiagResFr : 64 ZCUD

BO_ 1578 ZcudTcmbToDhuZCUCANFD2DiagResFr : 64 ZCUD

BO_ 1537 ZcudToDhuZCUCANFD2DiagResFr : 64 ZCUD

BO_ 1559 ZcudTrmToDhuZCUCANFD2DiagResFr : 64 ZCUD

BO_ 1378 ZCUDZCUCANFD2DEVFr01 : 64 ZCUD
 SG_ ZCUDMdevelpsignalgroupResp_UB : 504|1@0+ (1,0) [0|1] "" ETC
 SG_ ZCUDMdevelpsignalgroupRespFunctiondevpsignalgroup1 : 7|8@0+ (1.0,0.0) [0.0|255.0] "Unitless" ETC
 SG_ ZCUDMdevelpsignalgroupRespFunctiondevpsignalgroup2 : 15|8@0+ (1.0,0.0) [0.0|255.0] "Unitless" ETC
 SG_ ZCUDMdevelpsignalgroupRespFunctiondevpsignalgroup3 : 23|8@0+ (1.0,0.0) [0.0|255.0] "Unitless" ETC
 SG_ ZCUDMdevelpsignalgroupRespFunctiondevpsignalgroup4 : 31|8@0+ (1.0,0.0) [0.0|255.0] "Unitless" ETC
 SG_ ZCUDMdevelpsignalgroupRespFunctiondevpsignalgroup5 : 39|8@0+ (1.0,0.0) [0.0|255.0] "Unitless" ETC
 SG_ ZCUDMdevelpsignalgroupRespFunctiondevpsignalgroup6 : 47|8@0+ (1.0,0.0) [0.0|255.0] "Unitless" ETC
 SG_ ZCUDMdevelpsignalgroupRespFunctiondevpsignalgroup7 : 55|8@0+ (1.0,0.0) [0.0|255.0] "Unitless" ETC
 SG_ ZCUDMdevelpsignalgroupRespFunctiondevpsignalgroup8 : 63|8@0+ (1.0,0.0) [0.0|255.0] "Unitless" ETC
 SG_ ZCUDMDevpFrameForDebug_UB : 505|1@0+ (1,0) [0|1] "" ETC
 SG_ ZCUDMDevpFrameForDebugFunctiondevpsignalgroup1 : 71|8@0+ (1.0,0.0) [0.0|255.0] "Unitless" ETC
 SG_ ZCUDMDevpFrameForDebugFunctiondevpsignalgroup2 : 79|8@0+ (1.0,0.0) [0.0|255.0] "Unitless" ETC
 SG_ ZCUDMDevpFrameForDebugFunctiondevpsignalgroup3 : 87|8@0+ (1.0,0.0) [0.0|255.0] "Unitless" ETC
 SG_ ZCUDMDevpFrameForDebugFunctiondevpsignalgroup4 : 95|8@0+ (1.0,0.0) [0.0|255.0] "Unitless" ETC
 SG_ ZCUDMDevpFrameForDebugFunctiondevpsignalgroup5 : 103|8@0+ (1.0,0.0) [0.0|255.0] "Unitless" ETC
 SG_ ZCUDMDevpFrameForDebugFunctiondevpsignalgroup6 : 111|8@0+ (1.0,0.0) [0.0|255.0] "Unitless" ETC
 SG_ ZCUDMDevpFrameForDebugFunctiondevpsignalgroup7 : 119|8@0+ (1.0,0.0) [0.0|255.0] "Unitless" ETC
 SG_ ZCUDMDevpFrameForDebugFunctiondevpsignalgroup8 : 127|8@0+ (1.0,0.0) [0.0|255.0] "Unitless" ETC

BO_ 1169 ZCUDZCUCANFD2Fr01 : 64 ZCUD
 SG_ AccmFltSts : 372|5@0+ (1,0) [0|31] "" IHU
 SG_ AccmFltSts_UB : 373|1@0+ (1,0) [0|1] "" IHU
 SG_ AccrpedlSts_UB : 13|1@0+ (1,0) [0|1] "" IHU
 SG_ AccrpedlStsChks : 23|8@0+ (1.0,0.0) [0.0|255.0] "Unitless" IHU
 SG_ AccrpedlStsCntr : 11|4@0+ (1.0,0.0) [0.0|15.0] "Unitless" IHU
 SG_ AccrpedlStsFltSts : 12|1@0+ (1,0) [0|1] "" IHU
 SG_ ActnOfAssistantLi : 377|1@0+ (1,0) [0|1] "" IHU
 SG_ ActnOfAssistantLi_UB : 376|1@0+ (1,0) [0|1] "" IHU
 SG_ ActnOfDynEDIForChrgn : 385|1@0+ (1,0) [0|1] "" IHU
 SG_ ActnOfDynEDIForChrgn_UB : 384|1@0+ (1,0) [0|1] "" IHU
 SG_ ActnOfLedHiBeam : 31|1@0+ (1,0) [0|1] "" IHU
 SG_ ActnOfLedHiBeam_UB : 30|1@0+ (1,0) [0|1] "" IHU
 SG_ ActnOfLedLoBeam_UB : 29|1@0+ (1,0) [0|1] "" IHU
 SG_ ActnOfLedLoBeamActnOfLedLoBeam : 28|1@0+ (1,0) [0|1] "" IHU
 SG_ ActnOfLedLoBeamChks : 39|8@0+ (1.0,0.0) [0.0|255.0] "Unitless" IHU
 SG_ ActnOfLedLoBeamCntr : 27|4@0+ (1.0,0.0) [0.0|15.0] "Unitless" IHU
 SG_ ActvnOfEIDForVSTD : 1|2@0+ (1,0) [0|3] "" IHU
 SG_ ActvnOfEIDForVSTD_UB : 15|1@0+ (1,0) [0|1] "" IHU
 SG_ ActvnOfShowModLi : 3|1@0+ (1,0) [0|1] "" IHU
 SG_ ActvnOfShowModLi_UB : 2|1@0+ (1,0) [0|1] "" IHU
 SG_ ActvnOfWiprRe : 63|1@0+ (1,0) [0|1] "" IHU
 SG_ ActvnOfWiprRe_UB : 62|1@0+ (1,0) [0|1] "" IHU
 SG_ AgmFltSts : 510|5@0+ (1,0) [0|31] "" IHU
 SG_ AgmFltSts_UB : 505|1@0+ (1,0) [0|1] "" IHU
 SG_ AsySftyStandStillReq : 61|1@0+ (1,0) [0|1] "" IHU
 SG_ AsySftyStandStillReq_UB : 60|1@0+ (1,0) [0|1] "" IHU
 SG_ BattChrgnBalDurgDrvgRaw : 47|16@0+ (0.005,-100.0) [-100.0|100.0] "Ah" IHU
 SG_ BattChrgnBalDurgDrvgRaw_UB : 14|1@0+ (1,0) [0|1] "" IHU
 SG_ BattCircOpenU : 71|5@0+ (0.25,6.0) [6.0|13.75] "Volt" IHU
 SG_ BattCircOpenU_UB : 66|1@0+ (1,0) [0|1] "" IHU
 SG_ BattCpEstimdAtTNomRaw : 79|7@0+ (1.0,0.0) [0.0|100.0] "Ah" IHU
 SG_ BattCpEstimdAtTNomRaw_UB : 72|1@0+ (1,0) [0|1] "" IHU
 SG_ BattCpRel : 87|8@0+ (0.01,0.0) [0.0|2.5] "Cn" IHU
 SG_ BattCpRel_UB : 65|1@0+ (1,0) [0|1] "" IHU
 SG_ BattCycChrgCntrRaw : 95|14@0+ (0.05,0.0) [0.0|800.0] "Cn" IHU
 SG_ BattCycChrgCntrRaw_UB : 504|1@0+ (1,0) [0|1] "" IHU
 SG_ BattCycDchaCntrDurgConvceRaw : 111|14@0+ (0.05,0.0) [0.0|800.0] "Cn" IHU
 SG_ BattCycDchaCntrDurgConvceRaw_UB : 113|1@0+ (1,0) [0|1] "" IHU
 SG_ BattCycDchaCntrDurgDrvgRaw : 135|14@0+ (0.05,0.0) [0.0|800.0] "Cn" IHU
 SG_ BattCycDchaCntrDurgDrvgRaw_UB : 137|1@0+ (1,0) [0|1] "" IHU
 SG_ BattCycDchaCntrDurgQuiscPhaRaw : 159|14@0+ (0.015625,0.0) [0.0|255.0] "Cn" IHU
 SG_ BattCycDchaCntrDurgQuiscPhaRaw_UB : 161|1@0+ (1,0) [0|1] "" IHU
 SG_ BattIQuiscAvgRaw : 112|9@0+ (5.0,-2555.0) [-2500.0|0.0] "mA" IHU
 SG_ BattIQuiscAvgRaw_UB : 64|1@0+ (1,0) [0|1] "" IHU
 SG_ BattIQuiscFildLongRaw : 136|9@0+ (1.0,-511.0) [-511.0|0.0] "mA" IHU
 SG_ BattIQuiscFildLongRaw_UB : 97|1@0+ (1,0) [0|1] "" IHU
 SG_ BattIQuiscFildShoRaw : 160|9@0+ (1.0,-511.0) [-511.0|0.0] "mA" IHU
 SG_ BattIQuiscFildShoRaw_UB : 96|1@0+ (1,0) [0|1] "" IHU
 SG_ BattIRaw : 183|16@0+ (0.015625,-512.0) [-512.0|511.984375] "A" IHU
 SG_ BattIRaw_UB : 199|1@0+ (1,0) [0|1] "" IHU
 SG_ BattRAtTNomRaw : 207|8@0+ (0.1,0.0) [0.0|25.0] "mOhm" IHU
 SG_ BattRAtTNomRaw_UB : 198|1@0+ (1,0) [0|1] "" IHU
 SG_ BattRRaw : 215|8@0+ (0.1,0.0) [0.0|25.0] "mOhm" IHU
 SG_ BattRRaw_UB : 197|1@0+ (1,0) [0|1] "" IHU
 SG_ BattSnsrCalcnNotVldRaw : 59|1@0+ (1,0) [0|1] "" IHU
 SG_ BattSnsrCalcnNotVldRaw_UB : 58|1@0+ (1,0) [0|1] "" IHU
 SG_ BattSnsrHwFltRaw : 57|1@0+ (1,0) [0|1] "" IHU
 SG_ BattSnsrHwFltRaw_UB : 56|1@0+ (1,0) [0|1] "" IHU
 SG_ BattTiInSrvRaw : 223|12@0+ (1.0,0.0) [0.0|4095.0] "Days" IHU
 SG_ BattTiInSrvRaw_UB : 227|1@0+ (1,0) [0|1] "" IHU
 SG_ BattTRaw : 224|9@0+ (0.5,-128.0) [-70.0|125.0] "degC" IHU
 SG_ BattTRaw_UB : 226|1@0+ (1,0) [0|1] "" IHU
 SG_ BattUMinAvgDurgCrkRaw : 247|6@0+ (0.2,0.0) [0.0|12.0] "Volt" IHU
 SG_ BattUMinAvgDurgCrkRaw_UB : 225|1@0+ (1,0) [0|1] "" IHU
 SG_ BcpfFltSts : 383|5@0+ (1,0) [0|31] "" IHU
 SG_ BcpfFltSts_UB : 378|1@0+ (1,0) [0|1] "" IHU
 SG_ BexvFltSts : 391|5@0+ (1,0) [0|31] "" IHU
 SG_ BexvFltSts_UB : 386|1@0+ (1,0) [0|1] "" IHU
 SG_ CarModDispdWdDispd : 196|4@0+ (1,0) [0|15] "" IHU
 SG_ CarModDispdWdDispd_UB : 192|1@0+ (1,0) [0|1] "" IHU
 SG_ CarModDynoReq : 255|3@0+ (1,0) [0|7] "" IHU
 SG_ CarModDynoReq_UB : 241|1@0+ (1,0) [0|1] "" IHU
 SG_ CcvFltSts : 399|5@0+ (1,0) [0|31] "" IHU
 SG_ CcvFltSts_UB : 394|1@0+ (1,0) [0|1] "" IHU
 SG_ CcvmFltSts : 407|5@0+ (1,0) [0|31] "" IHU
 SG_ CcvmFltSts_UB : 402|1@0+ (1,0) [0|1] "" IHU
 SG_ CEMdevelpsignalgroupVMM1_UB : 240|1@0+ (1,0) [0|1] "" ETC,IHU
 SG_ CEMdevelpsignalgroupVMM1Functiondevpsignalgroup1 : 263|8@0+ (1.0,0.0) [0.0|255.0] "Unitless" ETC,IHU
 SG_ CEMdevelpsignalgroupVMM1Functiondevpsignalgroup2 : 271|8@0+ (1.0,0.0) [0.0|255.0] "Unitless" ETC,IHU
 SG_ CEMdevelpsignalgroupVMM1Functiondevpsignalgroup3 : 279|8@0+ (1.0,0.0) [0.0|255.0] "Unitless" ETC,IHU
 SG_ CEMdevelpsignalgroupVMM1Functiondevpsignalgroup4 : 287|8@0+ (1.0,0.0) [0.0|255.0] "Unitless" ETC,IHU
 SG_ CEMdevelpsignalgroupVMM1Functiondevpsignalgroup5 : 295|8@0+ (1.0,0.0) [0.0|255.0] "Unitless" ETC,IHU
 SG_ CEMdevelpsignalgroupVMM1Functiondevpsignalgroup6 : 303|8@0+ (1.0,0.0) [0.0|255.0] "Unitless" ETC,IHU
 SG_ CEMdevelpsignalgroupVMM1Functiondevpsignalgroup7 : 311|8@0+ (1.0,0.0) [0.0|255.0] "Unitless" ETC,IHU
 SG_ CEMdevelpsignalgroupVMM1Functiondevpsignalgroup8 : 319|8@0+ (1.0,0.0) [0.0|255.0] "Unitless" ETC,IHU
 SG_ CmptFrntWindDewT : 327|11@0+ (0.1,-40.0) [-40.0|164.70000000000002] "degC" IHU
 SG_ CmptFrntWindDewT_UB : 332|1@0+ (1,0) [0|1] "" IHU
 SG_ CmptFrntWindT : 330|11@0+ (0.1,-40.0) [-40.0|164.70000000000002] "degC" IHU
 SG_ CmptFrntWindT_UB : 331|1@0+ (1,0) [0|1] "" IHU
 SG_ CnvnAllwd : 351|1@0+ (1,0) [0|1] "" IHU
 SG_ CnvnAllwd_UB : 350|1@0+ (1,0) [0|1] "" IHU
 SG_ CnvnReq : 252|3@0+ (1,0) [0|7] "" IHU
 SG_ CnvnReq_UB : 349|1@0+ (1,0) [0|1] "" IHU
 SG_ CooltFlowForTOC : 367|9@0+ (0.1,0.0) [0.0|51.1] "L / min" IHU
 SG_ CooltFlowForTOC_UB : 374|1@0+ (1,0) [0|1] "" IHU
 SG_ CooltTSigForTOC : 346|11@0+ (0.1,-40.0) [-40.0|140.0] "degC" IHU
 SG_ CooltTSigForTOC_UB : 347|1@0+ (1,0) [0|1] "" IHU
 SG_ DoorDrvrSwtIntrLockgReq : 249|2@0+ (1,0) [0|3] "" ETC,IHU
 SG_ DoorDrvrSwtIntrLockgReq_UB : 348|1@0+ (1,0) [0|1] "" ETC,IHU
 SG_ DrvrSteerWhlHldGroup_UB : 432|1@0+ (1,0) [0|1] "" IHU
 SG_ DrvrSteerWhlHldGroupDrvrSteerWhlHld : 435|2@0+ (1,0) [0|3] "" IHU
 SG_ DrvrSteerWhlHldGroupDrvrSteerWhlHldQly : 439|4@0+ (1.0,0.0) [0.0|15.0] "Unitless" IHU
 SG_ EdcpFltSts : 415|5@0+ (1,0) [0|31] "" IHU
 SG_ EdcpFltSts_UB : 410|1@0+ (1,0) [0|1] "" IHU
 SG_ EexvFltSts : 423|5@0+ (1,0) [0|31] "" IHU
 SG_ EexvFltSts_UB : 418|1@0+ (1,0) [0|1] "" IHU
 SG_ EgyLvlElecDrvInfo : 447|2@0+ (1.0,0.0) [0.0|3.0] "Unitless" IHU
 SG_ EgyLvlElecDrvInfo_UB : 445|1@0+ (1,0) [0|1] "" IHU
 SG_ EgyMeas : 444|13@0+ (0.01,0.0) [0.0|81.91] "Ah" IHU
 SG_ EgyMeas_UB : 503|1@0+ (1,0) [0|1] "" IHU
 SG_ EgyMeasIntl_UB : 502|1@0+ (1,0) [0|1] "" IHU
 SG_ EgyMeasIntlIntl1 : 463|8@0+ (1.0,0.0) [0.0|255.0] "Unitless" IHU
 SG_ EgyMeasIntlIntl2 : 471|8@0+ (1.0,0.0) [0.0|255.0] "Unitless" IHU
 SG_ EgyMeasIntlIntl3 : 479|8@0+ (1.0,0.0) [0.0|255.0] "Unitless" IHU
 SG_ EgyMeasIntlIntl4 : 487|8@0+ (1.0,0.0) [0.0|255.0] "Unitless" IHU
 SG_ EgyMeasSec : 495|8@0+ (0.5,0.0) [0.0|127.5] "Ah" IHU
 SG_ EgyMeasSec_UB : 501|1@0+ (1,0) [0|1] "" IHU
 SG_ ElecMot2ModReq : 499|4@0+ (1,0) [0|15] "" IHU
 SG_ ElecMot2ModReq_UB : 511|1@0+ (1,0) [0|1] "" IHU
 SG_ ElecStepDrvr : 417|2@0+ (1,0) [0|3] "" IHU
 SG_ ElecStepDrvr_UB : 500|1@0+ (1,0) [0|1] "" IHU
 SG_ ElecStepPass : 431|2@0+ (1,0) [0|3] "" IHU
 SG_ ElecStepPass_UB : 429|1@0+ (1,0) [0|1] "" IHU

BO_ 306 ZCUDZCUCANFD2Fr02 : 64 ZCUD
 SG_ ActnOfDaytiRunngLampPass : 7|1@0+ (1,0) [0|1] "" IHU,ZCUP
 SG_ ActnOfDaytiRunngLampPass_UB : 104|1@0+ (1,0) [0|1] "" IHU,ZCUP
 SG_ ActnOfDynRePos : 6|3@0+ (1.0,0.0) [0.0|7.0] "Unitless" IHU,ZCUP
 SG_ ActnOfDynRePos_UB : 105|1@0+ (1,0) [0|1] "" IHU,ZCUP
 SG_ ActnOfFrntFogLampPass : 3|1@0+ (1,0) [0|1] "" IHU,ZCUP
 SG_ ActnOfFrntFogLampPass_UB : 106|1@0+ (1,0) [0|1] "" IHU,ZCUP
 SG_ ActnOfFrntPosnLampPass : 2|1@0+ (1,0) [0|1] "" IHU,ZCUP
 SG_ ActnOfFrntPosnLampPass_UB : 107|1@0+ (1,0) [0|1] "" IHU,ZCUP
 SG_ ActnOfHiBeamPass : 1|1@0+ (1,0) [0|1] "" IHU,ZCUP
 SG_ ActnOfHiBeamPass_UB : 108|1@0+ (1,0) [0|1] "" IHU,ZCUP
 SG_ ActnOfLedLeLogoLampDyn : 309|1@0+ (1,0) [0|1] "" IHU,ZCUP
 SG_ ActnOfLedLeLogoLampDyn_UB : 308|1@0+ (1,0) [0|1] "" IHU,ZCUP
 SG_ ActnOfLoBeamPass_UB : 208|1@0+ (1,0) [0|1] "" IHU,ZCUP
 SG_ ActnOfLoBeamPassChks : 239|8@0+ (1.0,0.0) [0.0|255.0] "Unitless" IHU,ZCUP
 SG_ ActnOfLoBeamPassCntr : 247|4@0+ (1.0,0.0) [0.0|15.0] "Unitless" IHU,ZCUP
 SG_ ActnOfLoBeamPassOnOff : 243|1@0+ (1,0) [0|1] "" IHU,ZCUP
 SG_ ActnOfReFogLampDrv : 15|1@0+ (1,0) [0|1] "" IHU,ZCUP
 SG_ ActnOfReFogLampDrv_UB : 110|1@0+ (1,0) [0|1] "" IHU,ZCUP
 SG_ ActnOfRePosnLampPass : 14|1@0+ (1,0) [0|1] "" IHU,ZCUP
 SG_ ActnOfRePosnLampPass_UB : 111|1@0+ (1,0) [0|1] "" IHU,ZCUP
 SG_ ActnOfReRegPlateLamp : 13|1@0+ (1,0) [0|1] "" IHU,ZCUP
 SG_ ActnOfReRegPlateLamp_UB : 112|1@0+ (1,0) [0|1] "" IHU,ZCUP
 SG_ ActnOfRvsgLampPass : 12|1@0+ (1,0) [0|1] "" IHU,ZCUP
 SG_ ActnOfRvsgLampPass_UB : 113|1@0+ (1,0) [0|1] "" IHU,ZCUP
 SG_ ActvnOfApproach : 11|1@0+ (1,0) [0|1] "" IHU,ZCUP
 SG_ ActvnOfApproach_UB : 114|1@0+ (1,0) [0|1] "" IHU,ZCUP
 SG_ ActvnOfCarLoctr : 10|1@0+ (1,0) [0|1] "" IHU,ZCUP
 SG_ ActvnOfCarLoctr_UB : 115|1@0+ (1,0) [0|1] "" IHU,ZCUP
 SG_ ActvnOfGoodByeLi : 9|1@0+ (1,0) [0|1] "" IHU,ZCUP
 SG_ ActvnOfGoodByeLi_UB : 116|1@0+ (1,0) [0|1] "" IHU,ZCUP
 SG_ ActvnOfHndlDoorLi1_UB : 117|1@0+ (1,0) [0|1] "" IHU,ZCUP
 SG_ ActvnOfHndlDoorLi1HndlDoorLiDrvr : 103|2@0+ (1,0) [0|3] "" IHU,ZCUP
 SG_ ActvnOfHndlDoorLi1HndlDoorLiDrvrRe : 101|2@0+ (1,0) [0|3] "" IHU,ZCUP
 SG_ ActvnOfHndlDoorLi1HndlDoorLiPass : 99|2@0+ (1,0) [0|3] "" IHU,ZCUP
 SG_ ActvnOfHndlDoorLi1HndlDoorLiPassRe : 97|2@0+ (1,0) [0|3] "" IHU,ZCUP
 SG_ ActvnOfHomeSafe : 8|1@0+ (1,0) [0|1] "" IHU,ZCUP
 SG_ ActvnOfHomeSafe_UB : 118|1@0+ (1,0) [0|1] "" IHU,ZCUP
 SG_ ActvnOfLiForComity : 23|1@0+ (1,0) [0|1] "" IHU,ZCUP
 SG_ ActvnOfLiForComity_UB : 119|1@0+ (1,0) [0|1] "" IHU,ZCUP
 SG_ ActvnOfLiForSpkr : 22|1@0+ (1,0) [0|1] "" IHU,ZCUP
 SG_ ActvnOfLiForSpkr_UB : 120|1@0+ (1,0) [0|1] "" IHU,ZCUP
 SG_ ActvnOfLiForWait : 21|1@0+ (1,0) [0|1] "" IHU,ZCUP
 SG_ ActvnOfLiForWait_UB : 121|1@0+ (1,0) [0|1] "" IHU,ZCUP
 SG_ ActvnOfPudLi : 20|1@0+ (1,0) [0|1] "" IHU,ZCUP
 SG_ ActvnOfPudLi_UB : 122|1@0+ (1,0) [0|1] "" IHU,ZCUP
 SG_ ActvnOfSideLogo : 311|2@0+ (1,0) [0|3] "" ZCUP
 SG_ ActvnOfSideLogo_UB : 265|1@0+ (1,0) [0|1] "" ZCUP
 SG_ ActvnOfWaitMode : 19|1@0+ (1,0) [0|1] "" IHU,ZCUP
 SG_ ActvnOfWaitMode_UB : 123|1@0+ (1,0) [0|1] "" IHU,ZCUP
 SG_ CarCfgInfoToWPC : 31|4@0+ (1.0,0.0) [0.0|15.0] "Unitless" IHU
 SG_ CarCfgInfoToWPC_UB : 125|1@0+ (1,0) [0|1] "" IHU
 SG_ ChdLockLeftSts : 215|2@0+ (1,0) [0|3] "" IHU,ZCUP
 SG_ ChdLockLeftSts_UB : 213|1@0+ (1,0) [0|1] "" IHU,ZCUP
 SG_ ChdLockRightStsToHmi : 202|2@0+ (1,0) [0|3] "" IHU
 SG_ ChdLockRightStsToHmi_UB : 200|1@0+ (1,0) [0|1] "" IHU
 SG_ ChdPrtnLeftStsToHmi : 212|2@0+ (1,0) [0|3] "" IHU
 SG_ ChdPrtnLeftStsToHmi_UB : 210|1@0+ (1,0) [0|1] "" IHU
 SG_ ChrgLidCombLockCmd : 27|3@0+ (1,0) [0|7] "" IHU,ZCUP
 SG_ ChrgLidCombLockCmd_UB : 126|1@0+ (1,0) [0|1] "" IHU,ZCUP
 SG_ ChrgLidManvgDCorAcDcActPosn2 : 511|8@0+ (1.0,0.0) [0.0|255.0] "Unitless" IHU
 SG_ ChrgLidManvgDCorAcDcActPosn2_UB : 448|1@0+ (1,0) [0|1] "" IHU
 SG_ ChrgnLtgSts : 143|2@0+ (1,0) [0|3] "" IHU
 SG_ ChrgnLtgSts_UB : 141|1@0+ (1,0) [0|1] "" IHU
 SG_ CinhDrvrReSts : 396|1@0+ (1,0) [0|1] "" IHU,ZCUP
 SG_ CinhDrvrReSts_UB : 395|1@0+ (1,0) [0|1] "" IHU,ZCUP
 SG_ CinhDrvrReSwt : 394|1@0+ (1,0) [0|1] "" IHU,ZCUP
 SG_ CinhDrvrReSwt_UB : 393|1@0+ (1,0) [0|1] "" IHU,ZCUP
 SG_ CinhDrvrSts : 407|1@0+ (1,0) [0|1] "" IHU,ZCUP
 SG_ CinhDrvrSts_UB : 392|1@0+ (1,0) [0|1] "" IHU,ZCUP
 SG_ CinhDrvrSwt : 406|1@0+ (1,0) [0|1] "" IHU,ZCUP
 SG_ CinhDrvrSwt_UB : 405|1@0+ (1,0) [0|1] "" IHU,ZCUP
 SG_ DchaChrgnTarValFb : 39|10@0+ (0.1,0.0) [0.0|100.0] "%" IHU
 SG_ DchaChrgnTarValFb_UB : 127|1@0+ (1,0) [0|1] "" IHU
 SG_ DigKeyPasEntryDiSts : 17|1@0+ (1,0) [0|1] "" IHU
 SG_ DigKeyPasEntryDiSts_UB : 128|1@0+ (1,0) [0|1] "" IHU
 SG_ DlyClsActv : 140|1@0+ (1,0) [0|1] "" IHU
 SG_ DlyClsActv_UB : 151|1@0+ (1,0) [0|1] "" IHU
 SG_ DoorLeReHndlCmd : 150|2@0+ (1,0) [0|3] "" IHU,ZCUP
 SG_ DoorLeReHndlCmd_UB : 148|1@0+ (1,0) [0|1] "" IHU,ZCUP
 SG_ DrvrGearLvrInfoIndcn : 158|3@0+ (1,0) [0|7] "" IHU
 SG_ DrvrGearLvrInfoIndcn_UB : 155|1@0+ (1,0) [0|1] "" IHU
 SG_ DrvrGearLvrLockIndcn : 45|4@0+ (1,0) [0|15] "" IHU
 SG_ DrvrGearLvrLockIndcn_UB : 129|1@0+ (1,0) [0|1] "" IHU
 SG_ DstTrvldFromSftyBkp : 255|21@0+ (1.0,0.0) [0.0|2000000.0] "km" IHU
 SG_ DstTrvldFromSftyBkp_UB : 240|1@0+ (1,0) [0|1] "" IHU
 SG_ DstTrvldVldFromSftyBkp : 242|1@0+ (1,0) [0|1] "" IHU
 SG_ DstTrvldVldFromSftyBkp_UB : 241|1@0+ (1,0) [0|1] "" IHU
 SG_ EmgyBrkLiIndcrTurn : 154|2@0+ (1,0) [0|3] "" IHU,ZCUP
 SG_ EmgyBrkLiIndcrTurn_UB : 152|1@0+ (1,0) [0|1] "" IHU,ZCUP
 SG_ ErsStrtApplSts : 41|2@0+ (1,0) [0|3] "" IHU
 SG_ ErsStrtApplSts_UB : 130|1@0+ (1,0) [0|1] "" IHU
 SG_ ExtrLiShowStoreStsFrntLe : 16|1@0+ (1,0) [0|1] "" IHU
 SG_ ExtrLiShowStoreStsFrntLe_UB : 131|1@0+ (1,0) [0|1] "" IHU
 SG_ ExtrLiShowStoreStsFrntRi : 24|1@0+ (1,0) [0|1] "" IHU
 SG_ ExtrLiShowStoreStsFrntRi_UB : 132|1@0+ (1,0) [0|1] "" IHU
 SG_ ExtrLiShowStoreStsReLe1 : 401|1@0+ (1,0) [0|1] "" IHU
 SG_ ExtrLiShowStoreStsReLe1_UB : 400|1@0+ (1,0) [0|1] "" IHU
 SG_ ExtrLiShowStoreStsReRi1 : 431|1@0+ (1,0) [0|1] "" IHU
 SG_ ExtrLiShowStoreStsReRi1_UB : 430|1@0+ (1,0) [0|1] "" IHU
 SG_ GlvBoxRelsReq : 55|1@0+ (1,0) [0|1] "" IHU,ZCUP
 SG_ GlvBoxRelsReq_UB : 133|1@0+ (1,0) [0|1] "" IHU,ZCUP
 SG_ HvBattHeatgReq : 54|2@0+ (1,0) [0|3] "" ZCUP
 SG_ HvBattHeatgReq_UB : 134|1@0+ (1,0) [0|1] "" ZCUP
 SG_ HvCooltWtrHeatrWtrTInIntk : 63|8@0+ (1.0,-40.0) [-40.0|215.0] "degC" IHU,ZCUP
 SG_ HvCooltWtrHeatrWtrTInIntk_UB : 135|1@0+ (1,0) [0|1] "" IHU,ZCUP
 SG_ HvCooltWtrHeatrWtrTInOutl : 71|8@0+ (1.0,-40.0) [-40.0|215.0] "degC" IHU,ZCUP
 SG_ HvCooltWtrHeatrWtrTInOutl_UB : 136|1@0+ (1,0) [0|1] "" IHU,ZCUP
 SG_ IndcrNoSeq : 167|1@0+ (1,0) [0|1] "" IHU,ZCUP
 SG_ IndcrNoSeq_UB : 166|1@0+ (1,0) [0|1] "" IHU,ZCUP
 SG_ KeyEnaSts_UB : 266|1@0+ (1,0) [0|1] "" IHU
 SG_ KeyEnaStsKey0 : 279|2@0+ (1,0) [0|3] "" IHU
 SG_ KeyEnaStsKey1 : 277|2@0+ (1,0) [0|3] "" IHU
 SG_ KeyEnaStsKey10 : 291|2@0+ (1,0) [0|3] "" IHU
 SG_ KeyEnaStsKey11 : 289|2@0+ (1,0) [0|3] "" IHU
 SG_ KeyEnaStsKey2 : 275|2@0+ (1,0) [0|3] "" IHU
 SG_ KeyEnaStsKey3 : 273|2@0+ (1,0) [0|3] "" IHU
 SG_ KeyEnaStsKey4 : 287|2@0+ (1,0) [0|3] "" IHU
 SG_ KeyEnaStsKey5 : 285|2@0+ (1,0) [0|3] "" IHU
 SG_ KeyEnaStsKey6 : 283|2@0+ (1,0) [0|3] "" IHU
 SG_ KeyEnaStsKey7 : 281|2@0+ (1,0) [0|3] "" IHU
 SG_ KeyEnaStsKey8 : 295|2@0+ (1,0) [0|3] "" IHU
 SG_ KeyEnaStsKey9 : 293|2@0+ (1,0) [0|3] "" IHU
 SG_ KeyScanActv : 404|1@0+ (1,0) [0|1] "" IHU
 SG_ KeyScanActv_UB : 403|1@0+ (1,0) [0|1] "" IHU
 SG_ MirrDefrstAtPassCmd : 52|1@0+ (1,0) [0|1] "" IHU,ZCUP
 SG_ MirrDefrstAtPassCmd_UB : 137|1@0+ (1,0) [0|1] "" IHU,ZCUP
 SG_ MirrDwnStsAtDrvr : 51|3@0+ (1,0) [0|7] "" IHU
 SG_ MirrDwnStsAtDrvr_UB : 138|1@0+ (1,0) [0|1] "" IHU
 SG_ MirrPosnAdjFromSetTarPosnPass_UB : 449|1@0+ (1,0) [0|1] "" IHU,ZCUP
 SG_ MirrPosnAdjFromSetTarPosnPassMirrAdjLeRi : 429|14@0+ (1.0,0.0) [0.0|10000.0] "Unitless" IHU,ZCUP
 SG_ MirrPosnAdjFromSetTarPosnPassMirrAdjUpDown : 447|14@0+ (1.0,0.0) [0.0|10000.0] "Unitless" IHU,ZCUP
 SG_ PedProtnMsgReqForFlt : 79|2@0+ (1,0) [0|3] "" IHU
 SG_ PedProtnMsgReqForFlt_UB : 139|1@0+ (1,0) [0|1] "" IHU
 SG_ PedProtnMsgReqForImpct : 48|1@0+ (1,0) [0|1] "" IHU
 SG_ PedProtnMsgReqForImpct_UB : 88|1@0+ (1,0) [0|1] "" IHU
 SG_ PrpsnHvBattUsgOfChrgBlkd2 : 147|2@0+ (1,0) [0|3] "" IHU
 SG_ PrpsnHvBattUsgOfChrgBlkd2_UB : 145|1@0+ (1,0) [0|1] "" IHU
 SG_ PrpsnHvBattUsgOfHldBlkd2 : 353|2@0+ (1,0) [0|3] "" IHU
 SG_ PrpsnHvBattUsgOfHldBlkd2_UB : 354|1@0+ (1,0) [0|1] "" IHU
 SG_ RegenAutLvlNotAvlMsg : 77|1@0+ (1,0) [0|1] "" IHU
 SG_ RegenAutLvlNotAvlMsg_UB : 89|1@0+ (1,0) [0|1] "" IHU
 SG_ RestrntSysLampReq : 75|2@0+ (1,0) [0|3] "" IHU
 SG_ RestrntSysLampReq_UB : 90|1@0+ (1,0) [0|1] "" IHU
 SG_ RestrntSysMsgReq : 73|2@0+ (1,0) [0|3] "" IHU
 SG_ RestrntSysMsgReq_UB : 91|1@0+ (1,0) [0|1] "" IHU
 SG_ SeatHeatgLvlStsRowSecLe : 183|2@0+ (1,0) [0|3] "" IHU,ZCUP
 SG_ SeatHeatgLvlStsRowSecLe_UB : 191|1@0+ (1,0) [0|1] "" IHU,ZCUP
 SG_ SeatHeatgLvlStsRowSecRi : 181|2@0+ (1,0) [0|3] "" IHU,ZCUP
 SG_ SeatHeatgLvlStsRowSecRi_UB : 190|1@0+ (1,0) [0|1] "" IHU,ZCUP
 SG_ SeatHeatgLvlStsRowThrdLe : 367|2@0+ (1,0) [0|3] "" IHU,ZCUP
 SG_ SeatHeatgLvlStsRowThrdLe_UB : 375|1@0+ (1,0) [0|1] "" IHU,ZCUP
 SG_ SeatHeatgLvlStsRowThrdRi : 365|2@0+ (1,0) [0|3] "" IHU,ZCUP
 SG_ SeatHeatgLvlStsRowThrdRi_UB : 374|1@0+ (1,0) [0|1] "" IHU,ZCUP
 SG_ SeatRowSecLeSwtSts_UB : 264|1@0+ (1,0) [0|1] "" IHU
 SG_ SeatRowSecLeSwtStsPassSeatSwtAdjmtOfSpplFctHozlSts : 327|2@0+ (1,0) [0|3] "" IHU
 SG_ SeatRowSecLeSwtStsPassSeatSwtAdjmtOfSpplFctVerSts : 325|2@0+ (1,0) [0|3] "" IHU
 SG_ SeatRowSecLeSwtStsPassSeatSwtHdrstHozlSts : 323|2@0+ (1,0) [0|3] "" IHU
 SG_ SeatRowSecLeSwtStsPassSeatSwtHdrstVertSts : 321|2@0+ (1,0) [0|3] "" IHU
 SG_ SeatRowSecLeSwtStsPassSeatSwtHeiFrntSts : 335|2@0+ (1,0) [0|3] "" IHU
 SG_ SeatRowSecLeSwtStsPassSeatSwtHeiSts : 333|2@0+ (1,0) [0|3] "" IHU
 SG_ SeatRowSecLeSwtStsPassSeatSwtInclSts : 331|2@0+ (1,0) [0|3] "" IHU
 SG_ SeatRowSecLeSwtStsPassSeatSwtSelnOfSpplFctStsSts : 329|2@0+ (1,0) [0|3] "" IHU
 SG_ SeatRowSecLeSwtStsPassSeatSwtSldSts : 343|2@0+ (1,0) [0|3] "" IHU
 SG_ SeatRowSecRiSwtSts_UB : 355|1@0+ (1,0) [0|1] "" IHU
 SG_ SeatRowSecRiSwtStsPassSeatSwtAdjmtOfSpplFctHozlSts : 341|2@0+ (1,0) [0|3] "" IHU
 SG_ SeatRowSecRiSwtStsPassSeatSwtAdjmtOfSpplFctVerSts : 339|2@0+ (1,0) [0|3] "" IHU
 SG_ SeatRowSecRiSwtStsPassSeatSwtHdrstHozlSts : 337|2@0+ (1,0) [0|3] "" IHU
 SG_ SeatRowSecRiSwtStsPassSeatSwtHdrstVertSts : 351|2@0+ (1,0) [0|3] "" IHU
 SG_ SeatRowSecRiSwtStsPassSeatSwtHeiFrntSts : 349|2@0+ (1,0) [0|3] "" IHU
 SG_ SeatRowSecRiSwtStsPassSeatSwtHeiSts : 347|2@0+ (1,0) [0|3] "" IHU
 SG_ SeatRowSecRiSwtStsPassSeatSwtInclSts : 345|2@0+ (1,0) [0|3] "" IHU
 SG_ SeatRowSecRiSwtStsPassSeatSwtSelnOfSpplFctStsSts : 359|2@0+ (1,0) [0|3] "" IHU
 SG_ SeatRowSecRiSwtStsPassSeatSwtSldSts : 357|2@0+ (1,0) [0|3] "" IHU
 SG_ SeatRowThrdLeInclPosAngle : 463|8@0+ (1.0,0.0) [0.0|180.0] "Deg" IHU
 SG_ SeatRowThrdLeInclPosAngle_UB : 469|1@0+ (1,0) [0|1] "" IHU
 SG_ SeatRowThrdLeMassgRunng : 471|1@0+ (1,0) [0|1] "" IHU
 SG_ SeatRowThrdLeMassgRunng_UB : 470|1@0+ (1,0) [0|1] "" IHU
 SG_ SeatRowThrdLeSldPosPerc_UB : 468|1@0+ (1,0) [0|1] "" IHU
 SG_ SeatRowThrdLeSldPosPercSeatPosPerc : 465|10@0+ (0.1,0.0) [0.0|100.0] "%" IHU
 SG_ SeatRowThrdLeSldPosPercSeatPosQf : 467|2@0+ (1,0) [0|3] "" IHU
 SG_ SeatRowThrdRiFoldRaiseWarn : 18|1@0+ (1,0) [0|1] "" IHU
 SG_ SeatRowThrdRiFoldRaiseWarn_UB : 124|1@0+ (1,0) [0|1] "" IHU
 SG_ SeatRowThrdRiFoldSts_UB : 383|1@0+ (1,0) [0|1] "" IHU
 SG_ SeatRowThrdRiFoldStsSeatFoldRaiseFlt : 368|1@0+ (1,0) [0|1] "" IHU
 SG_ SeatRowThrdRiFoldStsSeatFoldRaiseMovmt : 371|3@0+ (1,0) [0|7] "" IHU
 SG_ SeatRowThrdRiInclPosAngle : 487|8@0+ (1.0,0.0) [0.0|180.0] "Deg" IHU
 SG_ SeatRowThrdRiInclPosAngle_UB : 495|1@0+ (1,0) [0|1] "" IHU
 SG_ SeatRowThrdRiMassgRunng : 494|1@0+ (1,0) [0|1] "" IHU
 SG_ SeatRowThrdRiMassgRunng_UB : 493|1@0+ (1,0) [0|1] "" IHU
 SG_ SeatRowThrdRiSldPosPerc_UB : 492|1@0+ (1,0) [0|1] "" IHU
 SG_ SeatRowThrdRiSldPosPercSeatPosPerc : 489|10@0+ (0.1,0.0) [0.0|100.0] "%" IHU
 SG_ SeatRowThrdRiSldPosPercSeatPosQf : 491|2@0+ (1,0) [0|3] "" IHU
 SG_ SeatVentnLvlStsRowSecLe : 179|2@0+ (1,0) [0|3] "" IHU,ZCUP
 SG_ SeatVentnLvlStsRowSecLe_UB : 189|1@0+ (1,0) [0|1] "" IHU,ZCUP
 SG_ SeatVentnLvlStsRowSecRi : 177|2@0+ (1,0) [0|3] "" IHU,ZCUP
 SG_ SeatVentnLvlStsRowSecRi_UB : 188|1@0+ (1,0) [0|1] "" IHU,ZCUP
 SG_ SeatVentnLvlStsRowThrdLe : 363|2@0+ (1,0) [0|3] "" IHU,ZCUP
 SG_ SeatVentnLvlStsRowThrdLe_UB : 373|1@0+ (1,0) [0|1] "" IHU,ZCUP
 SG_ SeatVentnLvlStsRowThrdRi : 361|2@0+ (1,0) [0|3] "" IHU,ZCUP
 SG_ SeatVentnLvlStsRowThrdRi_UB : 372|1@0+ (1,0) [0|1] "" IHU,ZCUP
 SG_ SecRowLeHeatgAutoSts : 382|2@0+ (1,0) [0|3] "" IHU
 SG_ SecRowLeHeatgAutoSts_UB : 380|1@0+ (1,0) [0|1] "" IHU
 SG_ SecRowLeVentnAutoSts : 389|2@0+ (1,0) [0|3] "" IHU
 SG_ SecRowLeVentnAutoSts_UB : 387|1@0+ (1,0) [0|1] "" IHU
 SG_ SecRowRiHeatgAutoSts : 391|2@0+ (1,0) [0|3] "" IHU
 SG_ SecRowRiHeatgAutoSts_UB : 376|1@0+ (1,0) [0|1] "" IHU
 SG_ SecRowRiVentnAutoSts : 379|2@0+ (1,0) [0|3] "" IHU
 SG_ SecRowRiVentnAutoSts_UB : 377|1@0+ (1,0) [0|1] "" IHU
 SG_ SnowFlg : 159|1@0+ (1,0) [0|1] "" IHU
 SG_ SnowFlg_UB : 144|1@0+ (1,0) [0|1] "" IHU
 SG_ SteerServoSts : 76|1@0+ (1,0) [0|1] "" IHU
 SG_ SteerServoSts_UB : 92|1@0+ (1,0) [0|1] "" IHU
 SG_ SuspTarHei : 307|3@0+ (1,0) [0|7] "" IHU
 SG_ SuspTarHei_UB : 304|1@0+ (1,0) [0|1] "" IHU
 SG_ TCSTNowSts : 175|8@0+ (1.0,-50.0) [-50.0|205.0] "degC" IHU
 SG_ TCSTNowSts_UB : 162|1@0+ (1,0) [0|1] "" IHU
 SG_ ThrdRowLeHeatgAutoSts : 386|2@0+ (1,0) [0|3] "" IHU
 SG_ ThrdRowLeHeatgAutoSts_UB : 384|1@0+ (1,0) [0|1] "" IHU
 SG_ ThrdRowRiHeatgAutoSts : 399|2@0+ (1,0) [0|3] "" IHU
 SG_ ThrdRowRiHeatgAutoSts_UB : 397|1@0+ (1,0) [0|1] "" IHU
 SG_ TopPosHmiFeedBack : 186|3@0+ (1,0) [0|7] "" IHU
 SG_ TopPosHmiFeedBack_UB : 187|1@0+ (1,0) [0|1] "" IHU
 SG_ TopPosHmiFeedBack2 : 199|7@0+ (1.0,0.0) [0.0|101.0] "%" IHU
 SG_ TopPosHmiFeedBack2_UB : 192|1@0+ (1,0) [0|1] "" IHU
 SG_ TrOpenerSts : 207|4@0+ (1,0) [0|15] "" IHU
 SG_ TrOpenerSts_UB : 203|1@0+ (1,0) [0|1] "" IHU
 SG_ TrOpenPosn : 87|7@0+ (1.0,0.0) [0.0|101.0] "%" IHU
 SG_ TrOpenPosn_UB : 80|1@0+ (1,0) [0|1] "" IHU
 SG_ VehActvMsgToDrvr : 95|2@0+ (1,0) [0|3] "" IHU
 SG_ VehActvMsgToDrvr_UB : 93|1@0+ (1,0) [0|1] "" IHU
 SG_ VehEgyCoornDataReq : 161|1@0+ (1,0) [0|1] "" IHU
 SG_ VehEgyCoornDataReq_UB : 160|1@0+ (1,0) [0|1] "" IHU

BO_ 369 ZCUDZCUCANFD2Fr03 : 64 ZCUD
 SG_ AcEgyDistbn : 7|10@0+ (20.0,0.0) [0.0|20460.0] "W" IHU
 SG_ AcEgyDistbn_UB : 323|1@0+ (1,0) [0|1] "" IHU
 SG_ AudWarn : 11|1@0+ (1,0) [0|1] "" IHU
 SG_ AudWarn_UB : 381|1@0+ (1,0) [0|1] "" IHU
 SG_ AutoShowModPrpsnEna : 31|1@0+ (1,0) [0|1] "" IHU
 SG_ AutoShowModPrpsnEna_UB : 380|1@0+ (1,0) [0|1] "" IHU
 SG_ BltLockStAtPassMid_UB : 52|1@0+ (1,0) [0|1] "" IHU
 SG_ BltLockStAtPassMidBltLockEquid : 55|1@0+ (1,0) [0|1] "" IHU
 SG_ BltLockStAtPassMidBltLockSt1 : 54|1@0+ (1,0) [0|1] "" IHU
 SG_ BltLockStAtPassMidBltLockSts : 53|1@0+ (1,0) [0|1] "" IHU
 SG_ BltLockStAtRowFrthLe_UB : 48|1@0+ (1,0) [0|1] "" IHU
 SG_ BltLockStAtRowFrthLeBltLockEquid : 51|1@0+ (1,0) [0|1] "" IHU
 SG_ BltLockStAtRowFrthLeBltLockSt1 : 50|1@0+ (1,0) [0|1] "" IHU
 SG_ BltLockStAtRowFrthLeBltLockSts : 49|1@0+ (1,0) [0|1] "" IHU
 SG_ BltLockStAtRowFrthMid_UB : 60|1@0+ (1,0) [0|1] "" IHU
 SG_ BltLockStAtRowFrthMidBltLockEquid : 63|1@0+ (1,0) [0|1] "" IHU
 SG_ BltLockStAtRowFrthMidBltLockSt1 : 62|1@0+ (1,0) [0|1] "" IHU
 SG_ BltLockStAtRowFrthMidBltLockSts : 61|1@0+ (1,0) [0|1] "" IHU
 SG_ BltLockStAtRowFrthRi_UB : 56|1@0+ (1,0) [0|1] "" IHU
 SG_ BltLockStAtRowFrthRiBltLockEquid : 59|1@0+ (1,0) [0|1] "" IHU
 SG_ BltLockStAtRowFrthRiBltLockSt1 : 58|1@0+ (1,0) [0|1] "" IHU
 SG_ BltLockStAtRowFrthRiBltLockSts : 57|1@0+ (1,0) [0|1] "" IHU
 SG_ BltLockStAtRowThrdMid_UB : 414|1@0+ (1,0) [0|1] "" IHU
 SG_ BltLockStAtRowThrdMidBltLockEquid : 407|1@0+ (1,0) [0|1] "" IHU
 SG_ BltLockStAtRowThrdMidBltLockSt1 : 406|1@0+ (1,0) [0|1] "" IHU
 SG_ BltLockStAtRowThrdMidBltLockSts : 405|1@0+ (1,0) [0|1] "" IHU
 SG_ BtnLockStsAndKeyId_UB : 115|1@0+ (1,0) [0|1] "" ETC,IHU
 SG_ BtnLockStsAndKeyIdBtnSts : 164|1@0+ (1,0) [0|1] "" ETC,IHU
 SG_ BtnLockStsAndKeyIdKeyId : 163|4@0+ (1,0) [0|15] "" ETC,IHU
 SG_ BtnUnlckStsAndKeyId_UB : 117|1@0+ (1,0) [0|1] "" ETC,IHU
 SG_ BtnUnlckStsAndKeyIdBtnSts : 446|1@0+ (1,0) [0|1] "" ETC,IHU
 SG_ BtnUnlckStsAndKeyIdKeyId : 445|4@0+ (1,0) [0|15] "" ETC,IHU
 SG_ CchForFuEco_UB : 379|1@0+ (1,0) [0|1] "" IHU
 SG_ CchForFuEcoBarForFuEco : 247|10@0+ (0.1,0.0) [0.0|102.30000000000001] "%" IHU
 SG_ CchForFuEcoGrdForFuEco : 249|10@0+ (0.1,0.0) [0.0|102.30000000000001] "Unitless" IHU
 SG_ CchForPwrEco_UB : 378|1@0+ (1,0) [0|1] "" IHU
 SG_ CchForPwrEcoBarForPwrEco : 271|10@0+ (0.1,0.0) [0.0|102.30000000000001] "%" IHU
 SG_ CchForPwrEcoGrdForPwrEco : 273|10@0+ (0.1,0.0) [0.0|102.30000000000001] "Unitless" IHU
 SG_ CDCModIndcn : 503|3@0+ (1,0) [0|7] "" IHU
 SG_ CDCModIndcn_UB : 489|1@0+ (1,0) [0|1] "" IHU
 SG_ CmptmtFrntWindDewT : 10|11@0+ (0.1,-40.0) [-40.0|164.70000000000002] "degC" IHU,ZCUP
 SG_ CmptmtFrntWindDewT_UB : 400|1@0+ (1,0) [0|1] "" IHU,ZCUP
 SG_ CoolgLoadGroup_UB : 166|1@0+ (1,0) [0|1] "" IHU,ZCUP
 SG_ CoolgLoadGroupCoolgLimd : 159|1@0+ (1,0) [0|1] "" IHU,ZCUP
 SG_ CoolgLoadGroupCoolgLoad2 : 158|7@0+ (1.0,0.0) [0.0|100.0] "%" IHU,ZCUP
 SG_ DigKeyApproachReq_UB : 322|1@0+ (1,0) [0|1] "" ETC,IHU
 SG_ DigKeyApproachReqDigKeyApproaReq : 239|4@0+ (1,0) [0|15] "" ETC,IHU
 SG_ DigKeyApproachReqKeyId3 : 235|4@0+ (1,0) [0|15] "" ETC,IHU
 SG_ DoorHandleSensorSts : 47|8@0+ (1.0,0.0) [0.0|255.0] "Unitless" IHU,ZCUP
 SG_ DoorHandleSensorSts_UB : 401|1@0+ (1,0) [0|1] "" IHU,ZCUP
 SG_ DoorLockUnlockCmdNFC_UB : 447|1@0+ (1,0) [0|1] "" ETC,IHU
 SG_ DoorLockUnlockCmdNFCKeyId3 : 439|4@0+ (1,0) [0|15] "" ETC,IHU
 SG_ DoorLockUnlockCmdNFCKeyPrsntSts1 : 426|2@0+ (1,0) [0|3] "" ETC,IHU
 SG_ DoorLockUnlockCmdNFCPsdNotPsd : 424|1@0+ (1,0) [0|1] "" ETC,IHU
 SG_ DoorPassHndlCmd : 30|2@0+ (1,0) [0|3] "" IHU,ZCUP
 SG_ DoorPassHndlCmd_UB : 408|1@0+ (1,0) [0|1] "" IHU,ZCUP
 SG_ DoorRiReHndlCmd : 28|2@0+ (1,0) [0|3] "" IHU,ZCUP
 SG_ DoorRiReHndlCmd_UB : 409|1@0+ (1,0) [0|1] "" IHU,ZCUP
 SG_ DrvrElecRunngBdSts : 191|1@0+ (1,0) [0|1] "" IHU
 SG_ DrvrElecRunngBdSts_UB : 190|1@0+ (1,0) [0|1] "" IHU
 SG_ DrvrSeatAdjmtLimnWarn : 177|1@0+ (1,0) [0|1] "" IHU
 SG_ DrvrSeatAdjmtLimnWarn_UB : 176|1@0+ (1,0) [0|1] "" IHU
 SG_ DrvrSeatPosPerc_UB : 410|1@0+ (1,0) [0|1] "" IHU,ZCUP
 SG_ DrvrSeatPosPercSeatPosFrntHeiPerc : 295|10@0+ (0.1,0.0) [0.0|100.0] "%" IHU,ZCUP
 SG_ DrvrSeatPosPercSeatPosFrntHeiQF : 301|2@0+ (1,0) [0|3] "" IHU,ZCUP
 SG_ DrvrSeatPosPercSeatPosHeiPerc : 297|10@0+ (0.1,0.0) [0.0|100.0] "%" IHU,ZCUP
 SG_ DrvrSeatPosPercSeatPosHeiQF : 299|2@0+ (1,0) [0|3] "" IHU,ZCUP
 SG_ DrvrSeatPosPercSeatPosSldPerc : 319|10@0+ (0.1,0.0) [0.0|100.0] "%" IHU,ZCUP
 SG_ DrvrSeatPosPercSeatPosSldQF : 325|2@0+ (1,0) [0|3] "" IHU,ZCUP
 SG_ EgyAvgCnsDstSg : 74|1@0+ (1,0) [0|1] "" IHU
 SG_ EgyAvgCnsDstSg_UB : 412|1@0+ (1,0) [0|1] "" IHU
 SG_ FuCnsAvgIndcdFuCnsIndcdVal1 : 71|13@0+ (0.1,0.0) [0.0|819.1] "LPer100kilometer_1" IHU
 SG_ FuCnsAvgIndcdFuCnsIndcdVal1_UB : 415|1@0+ (1,0) [0|1] "" IHU
 SG_ FuCnsAvgIndcdFuCnsIndcdVal2 : 95|13@0+ (0.1,0.0) [0.0|819.1] "LPer100kilometer_1" IHU
 SG_ FuCnsAvgIndcdFuCnsIndcdVal2_UB : 416|1@0+ (1,0) [0|1] "" IHU
 SG_ FuCnsAvgIndcdFuCnsIndcdVal3 : 140|13@0+ (0.1,0.0) [0.0|819.1] "LPer100kilometer_1" IHU
 SG_ FuCnsAvgIndcdFuCnsIndcdVal3_UB : 417|1@0+ (1,0) [0|1] "" IHU
 SG_ FuCnsIndcdVal1 : 471|13@0+ (0.1,0.0) [0.0|819.1] "LPer100kilometer_1" IHU
 SG_ FuCnsIndcdVal1_UB : 418|1@0+ (1,0) [0|1] "" IHU
 SG_ GearIndcnRec_UB : 419|1@0+ (1,0) [0|1] "" IHU
 SG_ GearIndcnRecGearIndcn : 335|4@0+ (1,0) [0|15] "" IHU
 SG_ GearIndcnRecGearShiftIndcn : 321|2@0+ (1,0) [0|3] "" IHU
 SG_ GearIndcnRecGearTarIndcn : 331|4@0+ (1,0) [0|15] "" IHU
 SG_ HvConvPwrAct : 73|10@0+ (20.0,0.0) [0.0|20460.0] "W" IHU
 SG_ HvConvPwrAct_UB : 420|1@0+ (1,0) [0|1] "" IHU
 SG_ ImobRemMgrChk_UB : 421|1@0+ (1,0) [0|1] "" IHU
 SG_ ImobRemMgrChkImobDataRemMgrChk0 : 343|8@0+ (1.0,0.0) [0.0|255.0] "Unitless" IHU
 SG_ ImobRemMgrChkImobDataRemMgrChk1 : 351|8@0+ (1.0,0.0) [0.0|255.0] "Unitless" IHU
 SG_ ImobRemMgrChkImobDataRemMgrChk2 : 359|8@0+ (1.0,0.0) [0.0|255.0] "Unitless" IHU
 SG_ ImobRemMgrChkImobDataRemMgrChk3 : 367|8@0+ (1.0,0.0) [0.0|255.0] "Unitless" IHU
 SG_ ImobRemMgrChkImobDataRemMgrChk4 : 375|8@0+ (1.0,0.0) [0.0|255.0] "Unitless" IHU
 SG_ ImobRemMgrChkSts : 383|2@0+ (1,0) [0|3] "" IHU
 SG_ ImobVehRemMgrSts1_UB : 422|1@0+ (1,0) [0|1] "" IHU
 SG_ ImobVehRemMgrSts1ImobVehRemMgrSts : 377|2@0+ (1,0) [0|3] "" IHU
 SG_ ImobVehRemMgrSts1SpdLimRemMgrSts : 391|8@0+ (1.0,0.0) [0.0|255.0] "Unitless" IHU
 SG_ LnchModIndcnMsg : 395|4@0+ (1,0) [0|15] "" IHU
 SG_ LnchModIndcnMsg_UB : 413|1@0+ (1,0) [0|1] "" IHU
 SG_ LockgFbAcoustReq : 474|3@0+ (1,0) [0|7] "" ETC,IHU
 SG_ LockgFbAcoustReq_UB : 456|1@0+ (1,0) [0|1] "" ETC,IHU
 SG_ LockgFbToExtLi : 404|3@0+ (1,0) [0|7] "" ETC,IHU
 SG_ LockgFbToExtLi_UB : 441|1@0+ (1,0) [0|1] "" ETC,IHU
 SG_ MobDevVentReq : 167|1@0+ (1,0) [0|1] "" IHU,ZCUP
 SG_ MobDevVentReq_UB : 423|1@0+ (1,0) [0|1] "" IHU,ZCUP
 SG_ OpenClsCmftReq_UB : 440|1@0+ (1,0) [0|1] "" ETC,IHU
 SG_ OpenClsCmftReqOpenClsCmftReq : 399|2@0+ (1,0) [0|3] "" ETC,IHU
 SG_ OpenClsCmftReqOpenClsCmftTrigSrc : 397|2@0+ (1,0) [0|3] "" ETC,IHU
 SG_ PassMidSeatSts : 459|2@0+ (1,0) [0|3] "" IHU
 SG_ PassMidSeatSts_UB : 457|1@0+ (1,0) [0|1] "" IHU
 SG_ PT2SensrP : 487|13@0+ (1.0,0.0) [0.0|5000.0] "KiloPa" IHU
 SG_ PT2SensrP_UB : 490|1@0+ (1,0) [0|1] "" IHU
 SG_ PwrCnsAvgIndcdPwrCns1 : 97|11@0+ (0.1,-102.3) [-102.3|102.30000000000003] "Unitless" IHU
 SG_ PwrCnsAvgIndcdPwrCns1_UB : 427|1@0+ (1,0) [0|1] "" IHU
 SG_ PwrCnsAvgIndcdPwrCns2 : 135|11@0+ (0.1,-102.3) [-102.3|102.30000000000003] "Unitless" IHU
 SG_ PwrCnsAvgIndcdPwrCns2_UB : 428|1@0+ (1,0) [0|1] "" IHU
 SG_ PwrCnsAvgIndcdPwrCns3 : 114|11@0+ (0.1,-102.3) [-102.3|102.30000000000003] "Unitless" IHU
 SG_ PwrCnsAvgIndcdPwrCns3_UB : 429|1@0+ (1,0) [0|1] "" IHU
 SG_ PwrCnsIndcdPwrCnsIn1 : 215|11@0+ (0.1,-100.0) [-100.0|100.0] "KwHper100Kilometer_1" IHU
 SG_ PwrCnsIndcdPwrCnsIn1_UB : 430|1@0+ (1,0) [0|1] "" IHU
 SG_ RainDetected : 98|1@0+ (1,0) [0|1] "" IHU,ZCUP
 SG_ RainDetected_UB : 431|1@0+ (1,0) [0|1] "" IHU,ZCUP
 SG_ RemAllowStrt : 118|1@0+ (1,0) [0|1] "" IHU
 SG_ RemAllowStrt_UB : 432|1@0+ (1,0) [0|1] "" IHU
 SG_ RemClimaHVReqFb : 189|2@0+ (1,0) [0|3] "" ZCUP
 SG_ RemClimaHVReqFb_UB : 187|1@0+ (1,0) [0|1] "" ZCUP
 SG_ RowSecRiSeatZeroGrvySts : 499|3@0+ (1,0) [0|7] "" IHU
 SG_ RowSecRiSeatZeroGrvySts_UB : 500|1@0+ (1,0) [0|1] "" IHU
 SG_ RowSecRiSeatZeroGrvyWarn : 488|1@0+ (1,0) [0|1] "" IHU
 SG_ RowSecRiSeatZeroGrvyWarn_UB : 496|1@0+ (1,0) [0|1] "" IHU
 SG_ SeatOccptAtRowFrthLe : 455|2@0+ (1,0) [0|3] "" IHU
 SG_ SeatOccptAtRowFrthLe_UB : 463|1@0+ (1,0) [0|1] "" IHU
 SG_ SeatOccptAtRowFrthMid : 453|2@0+ (1,0) [0|3] "" IHU
 SG_ SeatOccptAtRowFrthMid_UB : 462|1@0+ (1,0) [0|1] "" IHU
 SG_ SeatOccptAtRowFrthRi : 451|2@0+ (1,0) [0|3] "" IHU
 SG_ SeatOccptAtRowFrthRi_UB : 461|1@0+ (1,0) [0|1] "" IHU
 SG_ SeatOccptAtRowThrdMid : 449|2@0+ (1,0) [0|3] "" IHU
 SG_ SeatOccptAtRowThrdMid_UB : 460|1@0+ (1,0) [0|1] "" IHU
 SG_ ShortDropWinLeReDoor2 : 169|2@0+ (1,0) [0|3] "" IHU,ZCUP
 SG_ ShortDropWinLeReDoor2_UB : 116|1@0+ (1,0) [0|1] "" IHU,ZCUP
 SG_ ShortDropWinPassDoor2 : 183|2@0+ (1,0) [0|3] "" IHU,ZCUP
 SG_ ShortDropWinPassDoor2_UB : 181|1@0+ (1,0) [0|1] "" IHU,ZCUP
 SG_ ShortDropWinRiReDoor2 : 180|2@0+ (1,0) [0|3] "" IHU,ZCUP
 SG_ ShortDropWinRiReDoor2_UB : 178|1@0+ (1,0) [0|1] "" IHU,ZCUP
 SG_ SunCurtPosnSts : 175|5@0+ (1,0) [0|31] "" IHU,ZCUP
 SG_ SunCurtPosnSts_UB : 170|1@0+ (1,0) [0|1] "" IHU,ZCUP
 SG_ TankFlapLockgCmd : 220|3@0+ (1,0) [0|7] "" IHU,ZCUP
 SG_ TankFlapLockgCmd_UB : 433|1@0+ (1,0) [0|1] "" IHU,ZCUP
 SG_ ThmEgyDistbn : 217|10@0+ (20.0,0.0) [0.0|20460.0] "W" IHU
 SG_ ThmEgyDistbn_UB : 434|1@0+ (1,0) [0|1] "" IHU
 SG_ TotDrvPwrAct : 199|11@0+ (1.0,-1000.0) [-1000.0|1047.0] "kW" IHU
 SG_ TotDrvPwrAct_UB : 165|1@0+ (1,0) [0|1] "" IHU
 SG_ TrHndlOutdOpenSts : 13|1@0+ (1,0) [0|1] "" ETC,IHU
 SG_ TrHndlOutdOpenSts_UB : 12|1@0+ (1,0) [0|1] "" ETC,IHU
 SG_ TrsmFltIndcn : 204|5@0+ (1,0) [0|31] "" Vector__XXX
 SG_ TrsmFltIndcn_UB : 435|1@0+ (1,0) [0|1] "" Vector__XXX

BO_ 666 ZCUDZCUCANFD2Fr04 : 64 ZCUD
 SG_ AcChllrOutT : 408|9@0+ (0.5,-60.0) [-60.0|195.5] "Unitless" IHU
 SG_ AcChllrOutT_UB : 409|1@0+ (1,0) [0|1] "" IHU
 SG_ AcHiSideP : 7|13@0+ (1.0,0.0) [0.0|5000.0] "KiloPa" IHU
 SG_ AcHiSideP_UB : 488|1@0+ (1,0) [0|1] "" IHU
 SG_ ActvnOfWshrFrntSafe : 10|2@0+ (1,0) [0|3] "" IHU,ZCUP
 SG_ ActvnOfWshrFrntSafe_UB : 482|1@0+ (1,0) [0|1] "" IHU,ZCUP
 SG_ ActvOfHorn : 8|1@0+ (1,0) [0|1] "" IHU
 SG_ ActvOfHorn_UB : 487|1@0+ (1,0) [0|1] "" IHU
 SG_ AirPtcPCBTempActl : 23|8@0+ (1.0,-40.0) [-40.0|215.0] "degC" IHU
 SG_ AirPtcPCBTempActl_UB : 486|1@0+ (1,0) [0|1] "" IHU
 SG_ AirTFromHeatgEstimd : 31|13@0- (0.1,0.0) [-256.0|255.9] "degC" IHU,ZCUP
 SG_ AirTFromHeatgEstimd_UB : 485|1@0+ (1,0) [0|1] "" IHU,ZCUP
 SG_ AutoTrainModReq : 359|3@0+ (1,0) [0|7] "" IHU
 SG_ AutoTrainModReq_UB : 355|1@0+ (1,0) [0|1] "" IHU
 SG_ BattCpEstimdRaw : 47|7@0+ (1.0,0.0) [0.0|100.0] "Ah" IHU
 SG_ BattCpEstimdRaw_UB : 484|1@0+ (1,0) [0|1] "" IHU
 SG_ CmprReqCmprSpdReq : 391|8@0+ (50.0,0.0) [0.0|12700.0] "rpm" IHU
 SG_ CmprReqCmprSpdReq_UB : 393|1@0+ (1,0) [0|1] "" IHU
 SG_ CooltFlowInCmptmtCirc : 57|10@0+ (0.05,0.0) [0.0|51.150000000000006] "L / min" IHU,ZCUP
 SG_ CooltFlowInCmptmtCirc_UB : 473|1@0+ (1,0) [0|1] "" IHU,ZCUP
 SG_ CooltHeatrTIntk : 79|8@0+ (1.0,-40.0) [-40.0|210.0] "degC" IHU,ZCUP
 SG_ CooltHeatrTIntk_UB : 474|1@0+ (1,0) [0|1] "" IHU,ZCUP
 SG_ CooltHeatrTOutl : 87|8@0+ (1.0,-40.0) [-40.0|210.0] "degC" IHU,ZCUP
 SG_ CooltHeatrTOutl_UB : 475|1@0+ (1,0) [0|1] "" IHU,ZCUP
 SG_ DCDCConsDyvCyc : 95|32@0+ (0.1,0.0) [0.0|800000.0] "Kilojoule_1" IHU
 SG_ DCDCConsDyvCyc_UB : 476|1@0+ (1,0) [0|1] "" IHU
 SG_ DChrgStrtEngRes : 149|4@0+ (1,0) [0|15] "" IHU
 SG_ DChrgStrtEngRes_UB : 477|1@0+ (1,0) [0|1] "" IHU
 SG_ DispIdlChrgPwr : 143|10@0+ (0.5,0.0) [0.0|511.0] "kW" IHU
 SG_ DispIdlChrgPwr_UB : 480|1@0+ (1,0) [0|1] "" IHU
 SG_ EcmRoilgCntr : 455|8@0+ (1.0,0.0) [0.0|255.0] "Unitless" IHU,ZCUP
 SG_ EcmRoilgCntr_UB : 491|1@0+ (1,0) [0|1] "" IHU,ZCUP
 SG_ EldtPmpPwrCns : 407|12@0+ (1.0,0.0) [0.0|4095.0] "W" IHU
 SG_ EldtPmpPwrCns_UB : 472|1@0+ (1,0) [0|1] "" IHU
 SG_ ElecStepFlt_UB : 392|1@0+ (1,0) [0|1] "" IHU
 SG_ ElecStepFltActrFlt1 : 399|1@0+ (1,0) [0|1] "" IHU
 SG_ ElecStepFltActrFlt2 : 398|1@0+ (1,0) [0|1] "" IHU
 SG_ ElecStepFltActrFlt3 : 397|1@0+ (1,0) [0|1] "" IHU
 SG_ ElecStepFltActrFlt4 : 396|1@0+ (1,0) [0|1] "" IHU
 SG_ ElecStepFltActrFlt5 : 395|1@0+ (1,0) [0|1] "" IHU
 SG_ ElecStepFltTmrFlt : 394|1@0+ (1,0) [0|1] "" IHU
 SG_ EngCooltInhbFlow : 479|1@0+ (1,0) [0|1] "" IHU,ZCUP
 SG_ EngCooltInhbFlow_UB : 478|1@0+ (1,0) [0|1] "" IHU,ZCUP
 SG_ EngCooltLoFlowReq : 469|6@0+ (0.5,0.0) [0.0|20.0] "L / min" IHU,ZCUP
 SG_ EngCooltLoFlowReq_UB : 492|1@0+ (1,0) [0|1] "" IHU,ZCUP
 SG_ EngCooltPmpPwrCns : 127|11@0+ (1.0,0.0) [0.0|2047.0] "W" IHU
 SG_ EngCooltPmpPwrCns_UB : 381|1@0+ (1,0) [0|1] "" IHU
 SG_ FanPwrCns : 55|11@0+ (1.0,0.0) [0.0|2047.0] "W" IHU
 SG_ FanPwrCns_UB : 129|1@0+ (1,0) [0|1] "" IHU
 SG_ FuelConsDrvCyc : 145|10@0+ (0.1,0.0) [0.0|102.30000000000001] "Litre" IHU
 SG_ FuelConsDrvCyc_UB : 483|1@0+ (1,0) [0|1] "" IHU
 SG_ HvahFltIndcnReq : 505|1@0+ (1,0) [0|1] "" IHU,ZCUP
 SG_ HvahFltIndcnReq_UB : 504|1@0+ (1,0) [0|1] "" IHU,ZCUP
 SG_ HvEgyCnsAllwdForClima : 167|8@0+ (50.0,0.0) [0.0|12750.0] "Wh" IHU,ZCUP
 SG_ HvEgyCnsAllwdForClima_UB : 379|1@0+ (1,0) [0|1] "" IHU,ZCUP
 SG_ HvEgyLoadFctReq : 495|1@0+ (1,0) [0|1] "" IHU
 SG_ HvEgyLoadFctReq_UB : 494|1@0+ (1,0) [0|1] "" IHU
 SG_ HvPwrAvlForClimaEstimd : 375|10@0+ (20.0,0.0) [0.0|20460.0] "W" IHU,ZCUP
 SG_ HvPwrAvlForClimaEstimd_UB : 380|1@0+ (1,0) [0|1] "" IHU,ZCUP
 SG_ HvPwrEgyPrio : 60|3@0+ (1,0) [0|7] "" IHU,ZCUP
 SG_ HvPwrEgyPrio_UB : 40|1@0+ (1,0) [0|1] "" IHU,ZCUP
 SG_ HvWtrHeatrPwrCnsAllwd : 463|8@0+ (40.0,0.0) [0.0|10200.0] "W" IHU
 SG_ HvWtrHeatrPwrCnsAllwd_UB : 128|1@0+ (1,0) [0|1] "" IHU
 SG_ HwRowRearLeLegRstHeiMotCtrl : 207|2@0+ (1,0) [0|3] "" IHU
 SG_ HwRowRearLeLegRstHeiMotCtrl_UB : 215|1@0+ (1,0) [0|1] "" IHU
 SG_ HwRowRearLeLegRstLenMotCtrl : 205|2@0+ (1,0) [0|3] "" IHU
 SG_ HwRowRearLeLegRstLenMotCtrl_UB : 214|1@0+ (1,0) [0|1] "" IHU
 SG_ HwRowRearRiLegRstHeiMotCtrl : 203|2@0+ (1,0) [0|3] "" IHU
 SG_ HwRowRearRiLegRstHeiMotCtrl_UB : 213|1@0+ (1,0) [0|1] "" IHU
 SG_ HwRowRearRiLegRstLenMotCtrl : 201|2@0+ (1,0) [0|3] "" IHU
 SG_ HwRowRearRiLegRstLenMotCtrl_UB : 212|1@0+ (1,0) [0|1] "" IHU
 SG_ HwRowSecLeInclMotCtrl : 223|2@0+ (1,0) [0|3] "" IHU
 SG_ HwRowSecLeInclMotCtrl_UB : 211|1@0+ (1,0) [0|1] "" IHU
 SG_ HwRowSecLeSldMotCtrl : 221|2@0+ (1,0) [0|3] "" IHU
 SG_ HwRowSecLeSldMotCtrl_UB : 210|1@0+ (1,0) [0|1] "" IHU
 SG_ HwRowSecRiInclMotCtrl : 219|2@0+ (1,0) [0|3] "" IHU
 SG_ HwRowSecRiInclMotCtrl_UB : 209|1@0+ (1,0) [0|1] "" IHU
 SG_ HwRowSecRiSldMotCtrl : 217|2@0+ (1,0) [0|3] "" IHU
 SG_ HwRowSecRiSldMotCtrl_UB : 208|1@0+ (1,0) [0|1] "" IHU
 SG_ HwRowThrdLeInclMotCtrl : 231|2@0+ (1,0) [0|3] "" IHU
 SG_ HwRowThrdLeInclMotCtrl_UB : 229|1@0+ (1,0) [0|1] "" IHU
 SG_ HwRowThrdRiInclMotCtrl : 227|2@0+ (1,0) [0|3] "" IHU
 SG_ HwRowThrdRiInclMotCtrl_UB : 228|1@0+ (1,0) [0|1] "" IHU
 SG_ MirrActvBtn : 225|1@0+ (1,0) [0|1] "" IHU
 SG_ MirrActvBtn_UB : 224|1@0+ (1,0) [0|1] "" IHU
 SG_ MirrCmdAtDrvr_UB : 232|1@0+ (1,0) [0|1] "" IHU
 SG_ MirrCmdAtDrvrMirrDwnCmd : 239|2@0+ (1,0) [0|3] "" IHU
 SG_ MirrCmdAtDrvrMirrFoldCmd : 237|2@0+ (1,0) [0|3] "" IHU
 SG_ MirrCmdAtDrvrMirrPosAdjCmd : 235|3@0+ (1,0) [0|7] "" IHU
 SG_ MirrDefrstAtDrvSts : 377|1@0+ (1,0) [0|1] "" IHU
 SG_ MirrDefrstAtDrvSts_UB : 376|1@0+ (1,0) [0|1] "" IHU
 SG_ MirrDirReq : 259|3@0+ (1,0) [0|7] "" IHU
 SG_ MirrDirReq_UB : 256|1@0+ (1,0) [0|1] "" IHU
 SG_ MirrSelnReq : 261|2@0+ (1,0) [0|3] "" IHU
 SG_ MirrSelnReq_UB : 262|1@0+ (1,0) [0|1] "" IHU
 SG_ MotGenDrvCyc : 175|32@0+ (0.1,0.0) [0.0|800000.0] "Kilojoule_1" IHU
 SG_ MotGenDrvCyc_UB : 378|1@0+ (1,0) [0|1] "" IHU
 SG_ RngExtd : 503|14@0+ (0.1,0.0) [0.0|1638.3000000000002] "km" IHU
 SG_ RngExtd_UB : 489|1@0+ (1,0) [0|1] "" IHU
 SG_ RoadSlopeInst : 335|15@0+ (0.01,-100.0) [-100.0|100.0] "%" IHU
 SG_ RoadSlopeInst_UB : 336|1@0+ (1,0) [0|1] "" IHU
 SG_ SecPwrSrcUloWarn_UB : 263|1@0+ (1,0) [0|1] "" Vector__XXX
 SG_ SecPwrSrcUloWarnChks : 247|8@0+ (1.0,0.0) [0.0|255.0] "Unitless" Vector__XXX
 SG_ SecPwrSrcUloWarnCntr : 255|4@0+ (1.0,0.0) [0.0|15.0] "Unitless" Vector__XXX
 SG_ SecPwrSrcUloWarnULoWarn : 251|2@0+ (1,0) [0|3] "" Vector__XXX
 SG_ SldgActiveInteWarn : 34|3@0+ (1,0) [0|7] "" IHU
 SG_ SldgActiveInteWarn_UB : 132|1@0+ (1,0) [0|1] "" IHU
 SG_ TOCCooltFlowReq : 353|10@0+ (0.02,0.0) [0.0|20.46] "L / min" IHU
 SG_ TOCCooltFlowReq_UB : 356|1@0+ (1,0) [0|1] "" IHU
 SG_ TrlrModPrpsnSts : 471|2@0+ (1,0) [0|3] "" IHU
 SG_ TrlrModPrpsnSts_UB : 493|1@0+ (1,0) [0|1] "" IHU

CM_ SG_ 371 AmbTIndcdWithUnitAmbTIndcd "Indicated ambient temperature";
CM_ SG_ 371 AmbTIndcdWithUnitAmbTIndcdUnit "Unit of the indicated temperature";
CM_ SG_ 371 AmbTIndcdWithUnitQF "QF";
CM_ SG_ 371 BltRmnTelltl "Safety belt reminder telltale warning.";
CM_ SG_ 371 DrvrCrsCtrlFctDeactvnReq "request to deactivate cc";
CM_ SG_ 371 DrvrCrsCtrlFctReActvReq "request to activate cc";
CM_ SG_ 371 DrvrCrsCtrlFctSeld "select ACC function or CC function.";
CM_ SG_ 371 FuFillgDetnForUseInt "Detection of if fuel filling.";
CM_ SG_ 371 FuLvlRawActvSideFuLvlValFromFuTbl "raw value from sensor";
CM_ SG_ 371 FuLvlRawActvSideGenQF "QF";
CM_ SG_ 371 FuLvlRawPasSideFuLvlValFromFuTbl "RAW value from sensor";
CM_ SG_ 371 FuLvlRawPasSideGenQF "Quality Flag";
CM_ SG_ 371 PwrCnsAvgIndcdEcoDrvInfo1 "AEC value";
CM_ SG_ 371 PwrCnsAvgIndcdPwrCnsUnit "AEC unit";
CM_ SG_ 371 RstTrip1 "The reason of restting Trip1 information. ";
CM_ SG_ 371 RstTrip2 "The reason of restting Trip2 information. ";
CM_ SG_ 721 AmbTUnitForUseInt "Internal signal for Temp unit";
CM_ SG_ 721 CarModDynoCnfrm "Car Mode Dynamometer Confirm";
CM_ SG_ 721 FuLvlLoIndcn "Signal that indicated if the yellow low fuel tell tale is lit";
CM_ SG_ 721 FuLvlLoWarn "Signal that indicated if the RED low fuel warning LED is lit";
CM_ SG_ 721 KeyLostWarnIndcnAckd "Activation of key search function.";
CM_ SG_ 721 ReqForPassAirbIndcnAckd "info about the acknowledgement";
CM_ SG_ 721 SrvRst "This signal indicates (during about 10sec) when a reste of the service reminder is done in instrument cluster";
CM_ SG_ 721 TotDstToEmptyDstToEmpty "Total Distance to empty Indicated";
CM_ SG_ 721 TotDstToEmptyDstUnit "Total Distance to empty Indicated unit";
CM_ SG_ 721 TrlrLampChkReqFromHmi "Distribution of trailer lamp check activation from DIM";
CM_ SG_ 558 AudWarnActv "Signal to CEM that sound has been played for GearPositionWarning.";
CM_ SG_ 63 ActvnOfDefdLiShow "User-defined light show";
CM_ SG_ 63 MusicShowPlaySts "indicate music show playing status";
CM_ SG_ 63 StreamingMirrBriAdjmt "Manually adjust the brightness of the streaming media rearview mirror";
CM_ SG_ 63 StreamingMirrBriAutoAdjmt "IRMD brightness auto adjustment ";
CM_ SG_ 63 StreamingMirrImgAdjmt "Rearview mirror streaming image zoom.";
CM_ SG_ 63 StreamingMirrPosnAdjmt "Streaming media rearview mirror position adjustment";
CM_ SG_ 63 StreamingMirrSwt "Turn on or off the streaming media rearview mirror.";
CM_ SG_ 63 TotDstTrvld "Total driven distance (odometer), in km";
CM_ SG_ 1377 ZCUDMdevelpsignalgroupReqFunctiondevpsignalgroup1 "develop signal group";
CM_ SG_ 1377 ZCUDMdevelpsignalgroupReqFunctiondevpsignalgroup2 "develop signal group";
CM_ SG_ 1377 ZCUDMdevelpsignalgroupReqFunctiondevpsignalgroup3 "develop signal group";
CM_ SG_ 1377 ZCUDMdevelpsignalgroupReqFunctiondevpsignalgroup4 "develop signal group";
CM_ SG_ 1377 ZCUDMdevelpsignalgroupReqFunctiondevpsignalgroup5 "develop signal group";
CM_ SG_ 1377 ZCUDMdevelpsignalgroupReqFunctiondevpsignalgroup6 "develop signal group";
CM_ SG_ 1377 ZCUDMdevelpsignalgroupReqFunctiondevpsignalgroup7 "develop signal group";
CM_ SG_ 1377 ZCUDMdevelpsignalgroupReqFunctiondevpsignalgroup8 "develop signal group";
CM_ SG_ 1377 ZCUPdevelpsignalgroupReqFunctiondevpsignalgroup1 "develop signal group";
CM_ SG_ 1377 ZCUPdevelpsignalgroupReqFunctiondevpsignalgroup2 "develop signal group";
CM_ SG_ 1377 ZCUPdevelpsignalgroupReqFunctiondevpsignalgroup3 "develop signal group";
CM_ SG_ 1377 ZCUPdevelpsignalgroupReqFunctiondevpsignalgroup4 "develop signal group";
CM_ SG_ 1377 ZCUPdevelpsignalgroupReqFunctiondevpsignalgroup5 "develop signal group";
CM_ SG_ 1377 ZCUPdevelpsignalgroupReqFunctiondevpsignalgroup6 "develop signal group";
CM_ SG_ 1377 ZCUPdevelpsignalgroupReqFunctiondevpsignalgroup7 "develop signal group";
CM_ SG_ 1377 ZCUPdevelpsignalgroupReqFunctiondevpsignalgroup8 "develop signal group";
CM_ SG_ 461 CushExtnFirstDrvr "cush extend";
CM_ SG_ 461 ExtrLtgZoneSet "Zone setting status indicate of Exterior Zone Lighting function";
CM_ SG_ 461 FirstRowSeatInhbByMod "passenger seat Inhibit by seat mode";
CM_ SG_ 461 IntrMirrAntiGlareLvl "switch for interior mirror anti-glare level";
CM_ SG_ 461 IntrMirrAntiGlarePerc "switch for interior mirror anti-glare percentage";
CM_ SG_ 461 MagicCarpetSuspSet "Magic Carpet Suspension On Off";
CM_ SG_ 461 PwrOutlOffSet "Vehicle power Outlet delay off setting";
CM_ SG_ 461 PwrSldgDoorAutClsEnaHmiReq "Power sliding door automatic closes enable hmi request";
CM_ SG_ 461 RuranACModeSet "Ruran Airconditioner Mode Setting";
CM_ SG_ 461 SldngDoorLeReAutoManReq "Left rear slding door auto or manual type selection";
CM_ SG_ 461 SldngDoorRiReAutoManReq "Right rear slding door auto or manual type selection";
CM_ SG_ 447 DrvrSeatDispSwtFctMod "Driver Seat Active Integrated soft Switch Mode";
CM_ SG_ 447 PassSeatDispSwtFctMod "Passenger Seat Active Integrated soft Switch Mode";
CM_ SG_ 447 SbwSteerBackToCenterSetgChks "Checksum";
CM_ SG_ 447 SbwSteerBackToCenterSetgCntr "Counter";
CM_ SG_ 447 SbwSteerBackToCenterSetgSetg "Driver can choose whether to turn the steering wheel and front wheel to the center position before the vehicle is powered off";
CM_ SG_ 447 SbwSteerRatiosFolwSpdSetgChks "Checksum";
CM_ SG_ 447 SbwSteerRatiosFolwSpdSetgCntr "Counter";
CM_ SG_ 447 SbwSteerRatiosFolwSpdSetgSetg "The steering ratios follow speed setting";
CM_ SG_ 447 SbwSteerRatiosLvlSetgChks "Checksum";
CM_ SG_ 447 SbwSteerRatiosLvlSetgCntr "Counter";
CM_ SG_ 447 SbwSteerRatiosLvlSetgSetg "The steering ratio level setting ";
CM_ SG_ 447 SbwSteerRatiosSetgChks "Checksum";
CM_ SG_ 447 SbwSteerRatiosSetgCntr "Counter";
CM_ SG_ 447 SbwSteerRatiosSetgSetg "The steering ratio setting";
CM_ SG_ 447 SbwSteerRemainsStatySetgChks "Checksum";
CM_ SG_ 447 SbwSteerRemainsStatySetgCntr "Counter";
CM_ SG_ 447 SbwSteerRemainsStatySetgSetg "Steering wheel remains stationary setting";
CM_ SG_ 447 VoiceCtrlLocking "Suitable for voice lock function outside the vehicle";
CM_ SG_ 356 AudWarnOfSnsrParkAssiRe1 "Rear audio warning Req";
CM_ SG_ 356 BlutoothPhoneWorkingSts "BlutoothPhoneWorkingSts";
CM_ SG_ 356 SphDvExtnLg "Voice status linked to exterior lights";
CM_ SG_ 1378 ZCUDMdevelpsignalgroupRespFunctiondevpsignalgroup1 "develop signal group";
CM_ SG_ 1378 ZCUDMdevelpsignalgroupRespFunctiondevpsignalgroup2 "develop signal group";
CM_ SG_ 1378 ZCUDMdevelpsignalgroupRespFunctiondevpsignalgroup3 "develop signal group";
CM_ SG_ 1378 ZCUDMdevelpsignalgroupRespFunctiondevpsignalgroup4 "develop signal group";
CM_ SG_ 1378 ZCUDMdevelpsignalgroupRespFunctiondevpsignalgroup5 "develop signal group";
CM_ SG_ 1378 ZCUDMdevelpsignalgroupRespFunctiondevpsignalgroup6 "develop signal group";
CM_ SG_ 1378 ZCUDMdevelpsignalgroupRespFunctiondevpsignalgroup7 "develop signal group";
CM_ SG_ 1378 ZCUDMdevelpsignalgroupRespFunctiondevpsignalgroup8 "develop signal group";
CM_ SG_ 1378 ZCUDMDevpFrameForDebugFunctiondevpsignalgroup1 "develop signal group";
CM_ SG_ 1378 ZCUDMDevpFrameForDebugFunctiondevpsignalgroup2 "develop signal group";
CM_ SG_ 1378 ZCUDMDevpFrameForDebugFunctiondevpsignalgroup3 "develop signal group";
CM_ SG_ 1378 ZCUDMDevpFrameForDebugFunctiondevpsignalgroup4 "develop signal group";
CM_ SG_ 1378 ZCUDMDevpFrameForDebugFunctiondevpsignalgroup5 "develop signal group";
CM_ SG_ 1378 ZCUDMDevpFrameForDebugFunctiondevpsignalgroup6 "develop signal group";
CM_ SG_ 1378 ZCUDMDevpFrameForDebugFunctiondevpsignalgroup7 "develop signal group";
CM_ SG_ 1378 ZCUDMDevpFrameForDebugFunctiondevpsignalgroup8 "develop signal group";
CM_ SG_ 1169 AccmFltSts "Air compressor fault and status";
CM_ SG_ 1169 AccrpedlStsChks " It should provide acceleration pedal Status signal ( AccrpedlSts ) to predict whether the accelerator pedal  has fault or not.1-Fault; 0-NoFault";
CM_ SG_ 1169 AccrpedlStsCntr " It should provide acceleration pedal Status signal ( AccrpedlSts ) to predict whether the accelerator pedal  has fault or not.1-Fault; 0-NoFault";
CM_ SG_ 1169 AccrpedlStsFltSts " It should provide acceleration pedal Status signal ( AccrpedlSts ) to predict whether the accelerator pedal  has fault or not.1-Fault; 0-NoFault";
CM_ SG_ 1169 ActnOfAssistantLi "Activation signal of assistant light";
CM_ SG_ 1169 ActnOfDynEDIForChrgn "Activate charging dynamic light";
CM_ SG_ 1169 ActnOfLedHiBeam "Activate LED High Beam.";
CM_ SG_ 1169 ActnOfLedLoBeamActnOfLedLoBeam "Activation of Low Beam function to HCM";
CM_ SG_ 1169 ActnOfLedLoBeamChks "Low Beam Check Sum ASIL B";
CM_ SG_ 1169 ActnOfLedLoBeamCntr "Low Beam Counter ASIL B";
CM_ SG_ 1169 ActvnOfEIDForVSTD "Activate VSTD alert or alarm lighting";
CM_ SG_ 1169 ActvnOfShowModLi "Activate show mode light";
CM_ SG_ 1169 ActvnOfWiprRe "Activate rear wiper";
CM_ SG_ 1169 AgmFltSts "AGS fault and status";
CM_ SG_ 1169 AsySftyStandStillReq "Let the relative subsystem to know, the vehicle is stopped by AEB, and now the vehicle need to keep standstill.";
CM_ SG_ 1169 BattChrgnBalDurgDrvgRaw "Accumulated battery charging during driving";
CM_ SG_ 1169 BattCircOpenU "Battery open circuit voltage";
CM_ SG_ 1169 BattCpEstimdAtTNomRaw "Estimated Battery Capacity At Nominal Temperature";
CM_ SG_ 1169 BattCpRel "Relative battery capacity";
CM_ SG_ 1169 BattCycChrgCntrRaw "Cumulative Battery Charge When Engine Running Normalized to capacity at nominal temperature";
CM_ SG_ 1169 BattCycDchaCntrDurgConvceRaw "Cumulative Battery Discharge During Engine Off Normalized to capacity at nominal temperature";
CM_ SG_ 1169 BattCycDchaCntrDurgDrvgRaw "Cumulative Battery Discharge During Engine On Normalized to capacity at nominal temperature";
CM_ SG_ 1169 BattCycDchaCntrDurgQuiscPhaRaw "Cumulative Battery Discharge During Ignition Off Normalized to capacity at nominal temperature";
CM_ SG_ 1169 BattIQuiscAvgRaw "Presents the average level of quiescent current in BattSnsrSt";
CM_ SG_ 1169 BattIQuiscFildLongRaw "Average Quiescent Current During Sleep Quick Indication 10h";
CM_ SG_ 1169 BattIQuiscFildShoRaw "Average Quiescent Current During Sleep Quick Indication 20 Minuters";
CM_ SG_ 1169 BattIRaw "Battery Current From BMS";
CM_ SG_ 1169 BattRAtTNomRaw "Internal resistance of battery at Nominal Temperature";
CM_ SG_ 1169 BattRRaw "Internal resistance of battery with consideration to Present Temperature and SOC";
CM_ SG_ 1169 BattSnsrCalcnNotVldRaw "BMS consistency fault";
CM_ SG_ 1169 BattSnsrHwFltRaw "Battery sensor HW fault";
CM_ SG_ 1169 BattTiInSrvRaw "Battery time in service from BMS";
CM_ SG_ 1169 BattTRaw "Battery temperature from BMS";
CM_ SG_ 1169 BattUMinAvgDurgCrkRaw "Signal shall output the lowest average voltage during cranking at present Temperature.";
CM_ SG_ 1169 BcpfFltSts "battery water pump fault and status";
CM_ SG_ 1169 BexvFltSts "BEXV fault and status";
CM_ SG_ 1169 CarModDispdWdDispd "Enum that specifies what CarMode is to be displayed in DIM.";
CM_ SG_ 1169 CarModDynoReq "Initiates message display for entering CarMode Dyno";
CM_ SG_ 1169 CcvFltSts "CCV fault and status";
CM_ SG_ 1169 CcvmFltSts "CCVM fault and status";
CM_ SG_ 1169 CEMdevelpsignalgroupVMM1Functiondevpsignalgroup1 "VMM internal signal group1.";
CM_ SG_ 1169 CEMdevelpsignalgroupVMM1Functiondevpsignalgroup2 "VMM internal signal group2.";
CM_ SG_ 1169 CEMdevelpsignalgroupVMM1Functiondevpsignalgroup3 "VMM internal signal group3.";
CM_ SG_ 1169 CEMdevelpsignalgroupVMM1Functiondevpsignalgroup4 "VMM internal signal group4.";
CM_ SG_ 1169 CEMdevelpsignalgroupVMM1Functiondevpsignalgroup5 "VMM internal signal group5.";
CM_ SG_ 1169 CEMdevelpsignalgroupVMM1Functiondevpsignalgroup6 "VMM internal signal group6.";
CM_ SG_ 1169 CEMdevelpsignalgroupVMM1Functiondevpsignalgroup7 "VMM internal signal group7.";
CM_ SG_ 1169 CEMdevelpsignalgroupVMM1Functiondevpsignalgroup8 "VMM internal signal group8.";
CM_ SG_ 1169 CmptFrntWindDewT "compartment front windscreen dew temperature.";
CM_ SG_ 1169 CmptFrntWindT "compartment front windsreeen temperature signal.";
CM_ SG_ 1169 CnvnAllwd "Intelligent charging allow status. 0 = NOK Or 1 = OK";
CM_ SG_ 1169 CnvnReq "Intelligent charge request";
CM_ SG_ 1169 CooltFlowForTOC "estimated coolant flow of TOC circuit";
CM_ SG_ 1169 CooltTSigForTOC "coolant temperature of TOC circuit radiator outlet measured by sensor";
CM_ SG_ 1169 DoorDrvrSwtIntrLockgReq "DoorDrvrSwtIntrLockgReq - Driver Door Interior Locking Switch Request
Central locking-unlocking request from driver door interior central locking-unlocking switch
Idle - No Request
Unlck - Unlock request
Lock - Lock request";
CM_ SG_ 1169 DrvrSteerWhlHldGroupDrvrSteerWhlHld "Hands on steering wheel information. Signal indicating whether the driver has his hands on the steering wheel or not.";
CM_ SG_ 1169 DrvrSteerWhlHldGroupDrvrSteerWhlHldQly "Hands on steering wheel information. Confidence value for the DrvrSteerWhlHld estimation calculation, specifically indicating the confidence for the hands off state.";
CM_ SG_ 1169 EdcpFltSts "ED water pump fault and status";
CM_ SG_ 1169 EexvFltSts "EEXV fault and status";
CM_ SG_ 1169 EgyLvlElecDrvInfo "Trigger for displaying energy level related messages.";
CM_ SG_ 1169 EgyMeas "Accumulated battery energy";
CM_ SG_ 1169 EgyMeasIntlIntl1 "Intervals 0 to 50mA";
CM_ SG_ 1169 EgyMeasIntlIntl2 "Intervals 50 to 1500mA";
CM_ SG_ 1169 EgyMeasIntlIntl3 "Intervals 1500 to 4000mA";
CM_ SG_ 1169 EgyMeasIntlIntl4 "Intervals larger than 4000mA";
CM_ SG_ 1169 EgyMeasSec "Secondary accumulated battery energy";
CM_ SG_ 1169 ElecMot2ModReq "Generator motor operation mode request
1: standby
2: torque control
3: speed control
4: UDC control
5: Speed Control Dead Zone";
CM_ SG_ 1169 ElecStepDrvr "ElecStepReq1";
CM_ SG_ 1169 ElecStepPass "ElecStepReq2";
CM_ SG_ 306 ActnOfDaytiRunngLampPass "Activate DRL Lamp of passenger side";
CM_ SG_ 306 ActnOfDynRePos "different value for dynamic rear position";
CM_ SG_ 306 ActnOfFrntFogLampPass "Activate front fog Lamp of passenger side";
CM_ SG_ 306 ActnOfFrntPosnLampPass "Activate front position Lamp of passenger side";
CM_ SG_ 306 ActnOfHiBeamPass "Activate high beam of passenger side";
CM_ SG_ 306 ActnOfLedLeLogoLampDyn "Activation of Left Logo Lamp as part of Position Lights with dynamic pattern";
CM_ SG_ 306 ActnOfLoBeamPassChks "Low Beam Check Sum ASIL B";
CM_ SG_ 306 ActnOfLoBeamPassCntr "Low Beam Counter ASIL B";
CM_ SG_ 306 ActnOfLoBeamPassOnOff "Activation of Low Beam function";
CM_ SG_ 306 ActnOfReFogLampDrv "Activate rear fog Lamp of driver side";
CM_ SG_ 306 ActnOfRePosnLampPass "Activate rear position Lamp of passenger side";
CM_ SG_ 306 ActnOfReRegPlateLamp "Requests activation of registration plate light.";
CM_ SG_ 306 ActnOfRvsgLampPass "Activate reverse Lamp of passenger side";
CM_ SG_ 306 ActvnOfApproach "to indicate approach light function for dynmaic animation";
CM_ SG_ 306 ActvnOfCarLoctr "to indicate car locate function for dynmaic animation";
CM_ SG_ 306 ActvnOfGoodByeLi "Activation Request for Goodbye Light";
CM_ SG_ 306 ActvnOfHndlDoorLi1HndlDoorLiDrvr "ActvnOfHndlDoorLi1";
CM_ SG_ 306 ActvnOfHndlDoorLi1HndlDoorLiDrvrRe "ActvnOfHndlDoorLi1";
CM_ SG_ 306 ActvnOfHndlDoorLi1HndlDoorLiPass "ActvnOfHndlDoorLi1";
CM_ SG_ 306 ActvnOfHndlDoorLi1HndlDoorLiPassRe "ActvnOfHndlDoorLi1";
CM_ SG_ 306 ActvnOfHomeSafe "Activate home safe light function";
CM_ SG_ 306 ActvnOfLiForComity "signal send to actuator to activate dynamic light for comity function";
CM_ SG_ 306 ActvnOfLiForSpkr "signal send to actuator to activate dynamic light for showing speaker";
CM_ SG_ 306 ActvnOfLiForWait "signal send to actuator to activate dynamic light for wait function";
CM_ SG_ 306 ActvnOfPudLi "Activate Puddle light";
CM_ SG_ 306 ActvnOfSideLogo "Activate side logo lamp";
CM_ SG_ 306 ActvnOfWaitMode "Activate signal to actuator to implement wait mode animation";
CM_ SG_ 306 CarCfgInfoToWPC "inform WPC the car configuration informtion";
CM_ SG_ 306 ChdLockLeftSts "CdhLockgProtnStsAtLeRe - Child Lock Protection Status at Left Rear Door
Indicates child lock status for left rear door
On - Child lock is active
Off - Child lock is not active";
CM_ SG_ 306 ChdLockRightStsToHmi "Signal sent from the Driver door module to the Driver information module to inform if the electric child lock  is ative or not for right rear door";
CM_ SG_ 306 ChdPrtnLeftStsToHmi "Signal sent from the Driver door module to the Driver information module to inform if the electric child lock  is ative or not";
CM_ SG_ 306 ChrgLidCombLockCmd "Combo Charge Lid Lock Command";
CM_ SG_ 306 ChrgLidManvgDCorAcDcActPosn2 "Charge lid actual position";
CM_ SG_ 306 ChrgnLtgSts "AC/DC charging status";
CM_ SG_ 306 CinhDrvrReSts "Driver rear Door cinch Status";
CM_ SG_ 306 CinhDrvrReSwt "Driver rear door Cinch switch status";
CM_ SG_ 306 CinhDrvrSts "CinhDrvrSts - Driver Door cinch Status";
CM_ SG_ 306 CinhDrvrSwt "driver door Cinch switch status";
CM_ SG_ 306 DchaChrgnTarValFb "Feedback the corresponding signal when receivesDchaChrgnTarVal from TCAM";
CM_ SG_ 306 DigKeyPasEntryDiSts "Digital Key Passive entry disable status";
CM_ SG_ 306 DlyClsActv "Signal informing Remote Control that a Delay Close of the tailgate is active";
CM_ SG_ 306 DoorLeReHndlCmd "Shall send command to operate the deployable left rear door handle according to
DoorLeReHndlCmd
- Idle
- Deploy
- Retract";
CM_ SG_ 306 DrvrGearLvrInfoIndcn "Indicates to the driver why the gear lever information is change.";
CM_ SG_ 306 DrvrGearLvrLockIndcn "Indicates to the driver why the gear lever is locked. Valid for Shift By Wire systems. Does not include error information.";
CM_ SG_ 306 DstTrvldFromSftyBkp "Saved backupvalue";
CM_ SG_ 306 DstTrvldVldFromSftyBkp "Indication if the transmitted backupvalue is valid or not";
CM_ SG_ 306 EmgyBrkLiIndcrTurn "Activation of both rear direction indicators for EBL.";
CM_ SG_ 306 ErsStrtApplSts "The primary state of the ERS application";
CM_ SG_ 306 ExtrLiShowStoreStsFrntLe "ExtrLiShowStoreStsFrntLe";
CM_ SG_ 306 ExtrLiShowStoreStsFrntRi "ExtrLiShowStoreStsFrntRi";
CM_ SG_ 306 ExtrLiShowStoreStsReLe1 "ExtrLiShowStoreStsReLe1";
CM_ SG_ 306 ExtrLiShowStoreStsReRi1 "ExtrLiShowStoreStsReRi1";
CM_ SG_ 306 GlvBoxRelsReq "GlvBoxRelsReq - Glove Box Release Request

Request signal to release (open) glove box. Actuated by motor in glove box, hardwired to CEM.

On - Glove box release requested
Off - Glove box release not requested";
CM_ SG_ 306 HvBattHeatgReq "Hv Battery request level for heating.";
CM_ SG_ 306 HvCooltWtrHeatrWtrTInIntk "Coolant temperature in heater inlet.";
CM_ SG_ 306 HvCooltWtrHeatrWtrTInOutl "Coolant temperature in heater outlet.";
CM_ SG_ 306 IndcrNoSeq "to indicate if HWL or DI with sequence";
CM_ SG_ 306 KeyEnaStsKey0 "KeyEnaSts is a record with status for each of the possible keys (0-11)
Each key can be either: 
Idle (not connected to the vehicle)
Disabled (connected to vehicle but all functionality disabled)
Enabled (Connected and OK for all functionality)
Limited (Connected and OK but with restrictions - restricted/limited key)";
CM_ SG_ 306 KeyEnaStsKey1 "KeyEnaSts is a record with status for each of the possible keys (0-11)
Each key can be either: 
Idle (not connected to the vehicle)
Disabled (connected to vehicle but all functionality disabled)
Enabled (Connected and OK for all functionality)
Limited (Connected and OK but with restrictions - restricted/limited key)";
CM_ SG_ 306 KeyEnaStsKey10 "KeyEnaSts is a record with status for each of the possible keys (0-11)
Each key can be either: 
Idle (not connected to the vehicle)
Disabled (connected to vehicle but all functionality disabled)
Enabled (Connected and OK for all functionality)
Limited (Connected and OK but with restrictions - restricted/limited key)";
CM_ SG_ 306 KeyEnaStsKey11 "KeyEnaSts is a record with status for each of the possible keys (0-11)
Each key can be either: 
Idle (not connected to the vehicle)
Disabled (connected to vehicle but all functionality disabled)
Enabled (Connected and OK for all functionality)
Limited (Connected and OK but with restrictions - restricted/limited key)";
CM_ SG_ 306 KeyEnaStsKey2 "KeyEnaSts is a record with status for each of the possible keys (0-11)
Each key can be either: 
Idle (not connected to the vehicle)
Disabled (connected to vehicle but all functionality disabled)
Enabled (Connected and OK for all functionality)
Limited (Connected and OK but with restrictions - restricted/limited key)";
CM_ SG_ 306 KeyEnaStsKey3 "KeyEnaSts is a record with status for each of the possible keys (0-11)
Each key can be either: 
Idle (not connected to the vehicle)
Disabled (connected to vehicle but all functionality disabled)
Enabled (Connected and OK for all functionality)
Limited (Connected and OK but with restrictions - restricted/limited key)";
CM_ SG_ 306 KeyEnaStsKey4 "KeyEnaSts is a record with status for each of the possible keys (0-11)
Each key can be either: 
Idle (not connected to the vehicle)
Disabled (connected to vehicle but all functionality disabled)
Enabled (Connected and OK for all functionality)
Limited (Connected and OK but with restrictions - restricted/limited key)";
CM_ SG_ 306 KeyEnaStsKey5 "KeyEnaSts is a record with status for each of the possible keys (0-11)
Each key can be either: 
Idle (not connected to the vehicle)
Disabled (connected to vehicle but all functionality disabled)
Enabled (Connected and OK for all functionality)
Limited (Connected and OK but with restrictions - restricted/limited key)";
CM_ SG_ 306 KeyEnaStsKey6 "KeyEnaSts is a record with status for each of the possible keys (0-11)
Each key can be either: 
Idle (not connected to the vehicle)
Disabled (connected to vehicle but all functionality disabled)
Enabled (Connected and OK for all functionality)
Limited (Connected and OK but with restrictions - restricted/limited key)";
CM_ SG_ 306 KeyEnaStsKey7 "KeyEnaSts is a record with status for each of the possible keys (0-11)
Each key can be either: 
Idle (not connected to the vehicle)
Disabled (connected to vehicle but all functionality disabled)
Enabled (Connected and OK for all functionality)
Limited (Connected and OK but with restrictions - restricted/limited key)";
CM_ SG_ 306 KeyEnaStsKey8 "KeyEnaSts is a record with status for each of the possible keys (0-11)
Each key can be either: 
Idle (not connected to the vehicle)
Disabled (connected to vehicle but all functionality disabled)
Enabled (Connected and OK for all functionality)
Limited (Connected and OK but with restrictions - restricted/limited key)";
CM_ SG_ 306 KeyEnaStsKey9 "KeyEnaSts is a record with status for each of the possible keys (0-11)
Each key can be either: 
Idle (not connected to the vehicle)
Disabled (connected to vehicle but all functionality disabled)
Enabled (Connected and OK for all functionality)
Limited (Connected and OK but with restrictions - restricted/limited key)";
CM_ SG_ 306 KeyScanActv "Signal to inform about if a key search is in progress.
TRUE - Key search ongoing
FALSE - No key search";
CM_ SG_ 306 MirrDefrstAtPassCmd "Activation signal exterior rear view mirror electrical defroster passenger side.";
CM_ SG_ 306 MirrDwnStsAtDrvr "Reports the status of the mirror dipping mode. Driver side.";
CM_ SG_ 306 MirrPosnAdjFromSetTarPosnPassMirrAdjLeRi "Horizontal position adjustment of mirror";
CM_ SG_ 306 MirrPosnAdjFromSetTarPosnPassMirrAdjUpDown "vertical position adjustment of mirror";
CM_ SG_ 306 PedProtnMsgReqForFlt "Indication request for pedestrian protection faults.";
CM_ SG_ 306 PedProtnMsgReqForImpct "Text message request to inform about triggering of the pedestrian protection system.";
CM_ SG_ 306 PrpsnHvBattUsgOfChrgBlkd2 "Charge mode is blocked/unavailable";
CM_ SG_ 306 PrpsnHvBattUsgOfHldBlkd2 "Hold mode is blocked/unavailable";
CM_ SG_ 306 RegenAutLvlNotAvlMsg "Regeneration level Auto not avaliable indication";
CM_ SG_ 306 RestrntSysLampReq "Indication request for SRS faults.";
CM_ SG_ 306 RestrntSysMsgReq "Text message request for SRS faults.";
CM_ SG_ 306 SeatHeatgLvlStsRowSecLe "Seat heating level for second row left seat.";
CM_ SG_ 306 SeatHeatgLvlStsRowSecRi "Seat heating level for second row left seat.";
CM_ SG_ 306 SeatHeatgLvlStsRowThrdLe "Seat heating level for third row left seat.";
CM_ SG_ 306 SeatHeatgLvlStsRowThrdRi "Seat heating level for third row left seat.";
CM_ SG_ 306 SeatRowSecLeSwtStsPassSeatSwtAdjmtOfSpplFctHozlSts "Multifunction Horizontal Switch Status";
CM_ SG_ 306 SeatRowSecLeSwtStsPassSeatSwtAdjmtOfSpplFctVerSts "Multifunction Vertical Switch Status";
CM_ SG_ 306 SeatRowSecLeSwtStsPassSeatSwtHdrstHozlSts "Headrest Horizontal Switch Status";
CM_ SG_ 306 SeatRowSecLeSwtStsPassSeatSwtHdrstVertSts "Headrest Vertical Switch Status";
CM_ SG_ 306 SeatRowSecLeSwtStsPassSeatSwtHeiFrntSts "Tilt Switch Status";
CM_ SG_ 306 SeatRowSecLeSwtStsPassSeatSwtHeiSts "Height Switch Status";
CM_ SG_ 306 SeatRowSecLeSwtStsPassSeatSwtInclSts "Backrest Switch Status";
CM_ SG_ 306 SeatRowSecLeSwtStsPassSeatSwtSelnOfSpplFctStsSts "Multifunction Selector Switch Status";
CM_ SG_ 306 SeatRowSecLeSwtStsPassSeatSwtSldSts "Slide Switch Status";
CM_ SG_ 306 SeatRowSecRiSwtStsPassSeatSwtAdjmtOfSpplFctHozlSts "Multifunction Horizontal Switch Status";
CM_ SG_ 306 SeatRowSecRiSwtStsPassSeatSwtAdjmtOfSpplFctVerSts "Multifunction Vertical Switch Status";
CM_ SG_ 306 SeatRowSecRiSwtStsPassSeatSwtHdrstHozlSts "Headrest Horizontal Switch Status";
CM_ SG_ 306 SeatRowSecRiSwtStsPassSeatSwtHdrstVertSts "Headrest Vertical Switch Status";
CM_ SG_ 306 SeatRowSecRiSwtStsPassSeatSwtHeiFrntSts "Tilt Switch Status";
CM_ SG_ 306 SeatRowSecRiSwtStsPassSeatSwtHeiSts "Height Switch Status";
CM_ SG_ 306 SeatRowSecRiSwtStsPassSeatSwtInclSts "Backrest Switch Status";
CM_ SG_ 306 SeatRowSecRiSwtStsPassSeatSwtSelnOfSpplFctStsSts "Multifunction Selector Switch Status";
CM_ SG_ 306 SeatRowSecRiSwtStsPassSeatSwtSldSts "Slide Switch Status";
CM_ SG_ 306 SeatRowThrdLeInclPosAngle "Backrest angle of the Third Row Left Seat";
CM_ SG_ 306 SeatRowThrdLeMassgRunng "Signal to report third row left seat massage module running status";
CM_ SG_ 306 SeatRowThrdLeSldPosPercSeatPosPerc "Seat Slide Position Percentage";
CM_ SG_ 306 SeatRowThrdLeSldPosPercSeatPosQf "Seat Slide Position Quality Factor";
CM_ SG_ 306 SeatRowThrdRiFoldRaiseWarn "Warning signal for the Third Row Right Seat Fold or Raise";
CM_ SG_ 306 SeatRowThrdRiFoldStsSeatFoldRaiseFlt "Fault Status for the Third Row Right Seat Fold or Raise movement";
CM_ SG_ 306 SeatRowThrdRiFoldStsSeatFoldRaiseMovmt "Status for the Third Row Right Seat Fold or Raise movement";
CM_ SG_ 306 SeatRowThrdRiInclPosAngle "Backrest angle of the Third Row Right Seat";
CM_ SG_ 306 SeatRowThrdRiMassgRunng "Signal to report third row right seat massage module running status";
CM_ SG_ 306 SeatRowThrdRiSldPosPercSeatPosPerc "Seat Slide Position Percentage";
CM_ SG_ 306 SeatRowThrdRiSldPosPercSeatPosQf "Seat Slide Position Quality Factor";
CM_ SG_ 306 SeatVentnLvlStsRowSecLe "Seat ventilation level for second row left seat.";
CM_ SG_ 306 SeatVentnLvlStsRowSecRi "Seat ventilation level for second row right seat.";
CM_ SG_ 306 SeatVentnLvlStsRowThrdLe "Seat ventilation level for third row left seat.";
CM_ SG_ 306 SeatVentnLvlStsRowThrdRi "Seat ventilation level for third row right seat.";
CM_ SG_ 306 SecRowLeHeatgAutoSts "Automatic status feedback signal for seats heating of second row left.";
CM_ SG_ 306 SecRowLeVentnAutoSts "Automatic status feedback signal for seats ventilation of second row left.";
CM_ SG_ 306 SecRowRiHeatgAutoSts "Automatic status feedback signal for seats heating of second row right.";
CM_ SG_ 306 SecRowRiVentnAutoSts "Automatic status feedback signal for seats ventilation of second row right.";
CM_ SG_ 306 SnowFlg "0x0=off
0x1=on";
CM_ SG_ 306 SteerServoSts "Status of lateral control request";
CM_ SG_ 306 SuspTarHei "suspension target height";
CM_ SG_ 306 TCSTNowSts "TCSTNowSts";
CM_ SG_ 306 ThrdRowLeHeatgAutoSts "Automatic status feedback signal for seats heating of third row left.";
CM_ SG_ 306 ThrdRowRiHeatgAutoSts "Automatic status feedback signal for seats heating of third row right.";
CM_ SG_ 306 TopPosHmiFeedBack "The signal is uded to inform about the latest successful top position set according: 0(unknown), 1(fail), 2(0 to 20perc), 3(21 to 40 perc), 4(41 to 60perc), 5(61 to 80perc), 6(81 to 100perc)";
CM_ SG_ 306 TopPosHmiFeedBack2 " used to inform about the last successful top position set ";
CM_ SG_ 306 TrOpenerSts "To inform about POT status. moving, opened, closed...";
CM_ SG_ 306 TrOpenPosn "Indicates the actual open state of the tailgate:";
CM_ SG_ 306 VehActvMsgToDrvr "Containing messages to inform the driver that the vehicle is active.";
CM_ SG_ 306 VehEgyCoornDataReq "Req the ADAS Map to sent the horizon data";
CM_ SG_ 369 AcEgyDistbn "Actual AC energy distribution";
CM_ SG_ 369 AudWarn "specifies if there should audio warning when Driver attempts to leave the car when gear not in P";
CM_ SG_ 369 AutoShowModPrpsnEna "show car mode propultion enable conditon";
CM_ SG_ 369 BltLockStAtPassMidBltLockEquid "Belt lock state at 1st row middle passenger seat position. Signal gives out if the belt lock sensor is equipped or not.";
CM_ SG_ 369 BltLockStAtPassMidBltLockSt1 "Belt lock state at 1st row middle passenger seat position. Signal gives out if the belt lock is locked or unlocked. ";
CM_ SG_ 369 BltLockStAtPassMidBltLockSts "Belt lock state at 1st row middle passenger seat position. Signal gives out if the belt lock is faulty or not.";
CM_ SG_ 369 BltLockStAtRowFrthLeBltLockEquid "Signal gives out if belt lock detection sensor is equipped at the 4th row outer left seat.";
CM_ SG_ 369 BltLockStAtRowFrthLeBltLockSt1 "Belt lock state at 4th row outer left seat posiiton. Signal gives out if the belt lock is locked or unlocked. ";
CM_ SG_ 369 BltLockStAtRowFrthLeBltLockSts "Belt lock fault status at the 4th row outer left seat. Signal gives out if belt lock is faulty or not.";
CM_ SG_ 369 BltLockStAtRowFrthMidBltLockEquid "Signal gives out if belt lock detection sensor is equipped at the 4th row middle seat.";
CM_ SG_ 369 BltLockStAtRowFrthMidBltLockSt1 "Belt lock state at 4th row middle seat posiiton. Signal gives out if the belt lock is locked or unlocked.";
CM_ SG_ 369 BltLockStAtRowFrthMidBltLockSts "Belt lock fault status at the 4th row  middle seat. Signal gives out if belt lock is faulty or not.";
CM_ SG_ 369 BltLockStAtRowFrthRiBltLockEquid "Signal gives out if belt lock detection sensor is equipped at the 4th row outer right seat.";
CM_ SG_ 369 BltLockStAtRowFrthRiBltLockSt1 "Belt lock state at 4th row outer right seat posiiton. Signal gives out if the belt lock is locked or unlocked.";
CM_ SG_ 369 BltLockStAtRowFrthRiBltLockSts "Belt lock fault status at the 4th row outer right seat. Signal gives out if belt lock is faulty or not.";
CM_ SG_ 369 BltLockStAtRowThrdMidBltLockEquid "State of belt lock at seating position at middle third row If the belt lock is equipped";
CM_ SG_ 369 BltLockStAtRowThrdMidBltLockSt1 "State of belt lock at seating position at middle third row Belt lock state,  locked/unlocked";
CM_ SG_ 369 BltLockStAtRowThrdMidBltLockSts "State of belt lock at seating position at middle third row Belt lock status, OK/NOK";
CM_ SG_ 369 BtnLockStsAndKeyIdBtnSts "Lock button on the remote (pressed - not pressed) together with information about KeyID of the key used";
CM_ SG_ 369 BtnLockStsAndKeyIdKeyId "Lock button on the remote (pressed - not pressed) together with information about KeyID of the key used";
CM_ SG_ 369 BtnUnlckStsAndKeyIdBtnSts "Unlock button on the remote (pressed - not pressed) together with information about KeyID of the key used";
CM_ SG_ 369 BtnUnlckStsAndKeyIdKeyId "Unlock button on the remote (pressed - not pressed) together with information about KeyID of the key used";
CM_ SG_ 369 CchForFuEcoBarForFuEco "Eco Coach data, both calculated instantaneous and grade eco coach data.";
CM_ SG_ 369 CchForFuEcoGrdForFuEco "Eco Coach data, both calculated instantaneous and grade eco coach data.";
CM_ SG_ 369 CchForPwrEcoBarForPwrEco "Eco Coach data, both calculated instantaneous and grade eco coach data.";
CM_ SG_ 369 CchForPwrEcoGrdForPwrEco "Eco Coach data, both calculated instantaneous and grade eco coach data.";
CM_ SG_ 369 CDCModIndcn "CDC mode status";
CM_ SG_ 369 CmptmtFrntWindDewT "compartment front windsreen dew temperature value for climate control.";
CM_ SG_ 369 CoolgLoadGroupCoolgLimd "Reduced or limited capacity";
CM_ SG_ 369 CoolgLoadGroupCoolgLoad2 " Present cooling load";
CM_ SG_ 369 DigKeyApproachReqDigKeyApproaReq "approach request";
CM_ SG_ 369 DigKeyApproachReqKeyId3 "key id";
CM_ SG_ 369 DoorHandleSensorSts "Door handle sensor status";
CM_ SG_ 369 DoorLockUnlockCmdNFCKeyId3 "key id";
CM_ SG_ 369 DoorLockUnlockCmdNFCKeyPrsntSts1 "key present status";
CM_ SG_ 369 DoorLockUnlockCmdNFCPsdNotPsd "NFC status";
CM_ SG_ 369 DoorPassHndlCmd "Shall send command to operate the deployable passenger door handle according to
DoorPassHndlCmd
- Idle
- Deploy
- Retract";
CM_ SG_ 369 DoorRiReHndlCmd "Shall send command to operate the deployable right rear door handle according to
DoorRiReHndlCmd
- Idle
- Deploy
- Retract";
CM_ SG_ 369 DrvrElecRunngBdSts "left electric running board status";
CM_ SG_ 369 DrvrSeatAdjmtLimnWarn "Warning Signal of Driver Seat Adjustment Limitation depending on Roof Display status";
CM_ SG_ 369 DrvrSeatPosPercSeatPosFrntHeiPerc "Front Height Position Percentage";
CM_ SG_ 369 DrvrSeatPosPercSeatPosFrntHeiQF "Front Height Position Quality Factor";
CM_ SG_ 369 DrvrSeatPosPercSeatPosHeiPerc "Height Position Percentage";
CM_ SG_ 369 DrvrSeatPosPercSeatPosHeiQF "Height Position Quality Factor";
CM_ SG_ 369 DrvrSeatPosPercSeatPosSldPerc "Length Position Percentage";
CM_ SG_ 369 DrvrSeatPosPercSeatPosSldQF "Length Position Quality Factor";
CM_ SG_ 369 EgyAvgCnsDstSg "average energy consumption of distance single";
CM_ SG_ 369 FuCnsAvgIndcdFuCnsIndcdVal1 "Average Fuel Consumption signal1";
CM_ SG_ 369 FuCnsAvgIndcdFuCnsIndcdVal2 "Average Fuel Consumption signal2";
CM_ SG_ 369 FuCnsAvgIndcdFuCnsIndcdVal3 "Average Fuel Consumption signa for Trip Statistics";
CM_ SG_ 369 FuCnsIndcdVal1 "Instantaneous Fuel Consumption (IFC) with indicated unit IFC value";
CM_ SG_ 369 GearIndcnRecGearIndcn "Record contains two signals. 1. Actual gear displayed for the driver 2. Recommended shift up or down to obtain maximal fuel economy and driveability.";
CM_ SG_ 369 GearIndcnRecGearShiftIndcn "Record contains two signals. 1. Actual gear displayed for the driver 2. Recommended shift up or down to obtain maximal fuel economy and driveability.";
CM_ SG_ 369 GearIndcnRecGearTarIndcn "Record contains two signals. 1. Actual gear displayed for the driver 2. Recommended shift up or down to obtain maximal fuel economy and driveability.";
CM_ SG_ 369 HvConvPwrAct "Actual power consumption of the low-voltage system";
CM_ SG_ 369 ImobRemMgrChkImobDataRemMgrChk0 "Flag to TEM that RVI challenge is available and 5 bytes challenge Challenge byte 0";
CM_ SG_ 369 ImobRemMgrChkImobDataRemMgrChk1 "Flag to TEM that RVI challenge is available and 5 bytes challenge Challenge Byte 1";
CM_ SG_ 369 ImobRemMgrChkImobDataRemMgrChk2 "Flag to TEM that RVI challenge is available and 5 bytes challenge Challenge byte 2";
CM_ SG_ 369 ImobRemMgrChkImobDataRemMgrChk3 "Flag to TEM that RVI challenge is available and 5 bytes challenge Challenge byte 3";
CM_ SG_ 369 ImobRemMgrChkImobDataRemMgrChk4 "Flag to TEM that RVI challenge is available and 5 bytes challenge Challenge byte 4";
CM_ SG_ 369 ImobRemMgrChkSts "Flag to TEM that RVI challenge is available and 5 bytes challenge Challenge available";
CM_ SG_ 369 ImobVehRemMgrSts1ImobVehRemMgrSts "RVI status from CEM to TEM Status for RVI manager";
CM_ SG_ 369 ImobVehRemMgrSts1SpdLimRemMgrSts "RVI status from CEM to TEM Remote vehicle slow down";
CM_ SG_ 369 LnchModIndcnMsg "Indication message to HMI when there has some faults which inhibite active launch mode";
CM_ SG_ 369 LockgFbAcoustReq "LockgFbAcoustReq - Locking Feedback Acoustic Request.

Request from central locking to perform audible locking feedback.

LockActvnLock - Audible locking feedback request
Any other value - No request.";
CM_ SG_ 369 LockgFbToExtLi "LockgFbToExtLi - Lockging Feedback to Exterior Light

Request signal from central locking to exterior light, to perform flashing of turn indicators as locking or unlocking customer feedback.

LockActvnUnlck - Unlocking feedback request
LockActvnLock - Locking feedback request
Any other value - No request";
CM_ SG_ 369 MobDevVentReq "Ventilation Request by Mobile Device";
CM_ SG_ 369 OpenClsCmftReqOpenClsCmftReq "OpenClsCmftReqAndTrigSrc - Comfort Open Close Request and Trig Source.

Request from central locking to perform comfort open and close (and stop), i.e. opening and closing of side door windows and sun roof etc. Contains type of request and trig source:

Type of Request:
NoCmftReq - No Request
OpenCmft - Comfort Open request
ClsCmfg - Comfort Close request
StopCmft - Stop ongoing open/close.

Trig Source:
NoTrigSrc - No Trig Source
SwtInt - Interior central locking switches
KeyRem - Remote key
Keyls - Keyless (capacitive door handles)";
CM_ SG_ 369 OpenClsCmftReqOpenClsCmftTrigSrc "OpenClsCmftReqAndTrigSrc - Comfort Open Close Request and Trig Source.

Request from central locking to perform comfort open and close (and stop), i.e. opening and closing of side door windows and sun roof etc. Contains type of request and trig source:

Type of Request:
NoCmftReq - No Request
OpenCmft - Comfort Open request
ClsCmfg - Comfort Close request
StopCmft - Stop ongoing open/close.

Trig Source:
NoTrigSrc - No Trig Source
SwtInt - Interior central locking switches
KeyRem - Remote key
Keyls - Keyless (capacitive door handles)";
CM_ SG_ 369 PassMidSeatSts "Occupation status based on occupant detection sensor at front row middle seat. ";
CM_ SG_ 369 PT2SensrP "Pressure value measured by PT2 sensor.";
CM_ SG_ 369 PwrCnsAvgIndcdPwrCns1 "The average power consumption of Trip1";
CM_ SG_ 369 PwrCnsAvgIndcdPwrCns2 "The average power consumption of Trip2";
CM_ SG_ 369 PwrCnsAvgIndcdPwrCns3 "The average power consumption per unit distance on the energy consumption curve";
CM_ SG_ 369 PwrCnsIndcdPwrCnsIn1 "Instantaneous Electrical Consumption";
CM_ SG_ 369 RainDetected "Informs the system if rain is detected.";
CM_ SG_ 369 RemAllowStrt "Signal indicate validity of remote allow start";
CM_ SG_ 369 RemClimaHVReqFb "Remote climate request for hv system";
CM_ SG_ 369 RowSecRiSeatZeroGrvySts "Second row right seat zero gravity status";
CM_ SG_ 369 RowSecRiSeatZeroGrvyWarn "Indicating of Second Row Right Seat Zero Gravity Condition not fullfilled";
CM_ SG_ 369 SeatOccptAtRowFrthLe "Occupation status based on occupant detection sensor at the 4th row outer left seat. ";
CM_ SG_ 369 SeatOccptAtRowFrthMid "Occupation status based on occupant detection sensor at the 4th middle seat. ";
CM_ SG_ 369 SeatOccptAtRowFrthRi "Occupation status based on occupant detection sensor at the 4th row outer right seat. ";
CM_ SG_ 369 SeatOccptAtRowThrdMid "Occupant presence status at 3rd row ,  right position.";
CM_ SG_ 369 ShortDropWinLeReDoor2 "Left Rear window short drop2 request to open/close frameless doors";
CM_ SG_ 369 ShortDropWinPassDoor2 "Passenger window short drop request to open/close frameless doors";
CM_ SG_ 369 ShortDropWinRiReDoor2 "Right rear window short drop2 request to open/close frameless doors";
CM_ SG_ 369 SunCurtPosnSts "Interface Reporting Sun Curtain Position Status.";
CM_ SG_ 369 TankFlapLockgCmd "TankFlapLockgCmd - Tank Flap Lock Command

Locking command for tank flap lock actuator.

LockActvnOff - Idle Command
LockActvnUnlck - Unlock tank flap
LockActvnLock - Lock tank flap
LockActvnSafe - No command
LockActvnUnlckByCrash - No command";
CM_ SG_ 369 ThmEgyDistbn "Actual  thermal distribution";
CM_ SG_ 369 TotDrvPwrAct "Actual total driving power of power source";
CM_ SG_ 369 TrHndlOutdOpenSts "TrHndlOutOpenSts - Tailgate/Bootlid outer door handle open switch status

Status signal for the tailgate/bootlid outer door handle soft touch switch.

Psd - Pressed
NotPsd - Not Pressed";
CM_ SG_ 369 TrsmFltIndcn "TCM uses signal Transmission Fault Indication to request text message ilumination to driver. Signal is transmitted to both ECM and DIM.Signal consits of 32 slots. One slot is one unique text message. Default value is 0 (No request)";
CM_ SG_ 666 AcChllrOutT "Chiller outlet refrigerant temperature.";
CM_ SG_ 666 AcHiSideP "Ac pressure in high side measured by sensors.";
CM_ SG_ 666 ActvnOfWshrFrntSafe "Activate front washer";
CM_ SG_ 666 ActvOfHorn "Activate and deactive the Vehicle Horn";
CM_ SG_ 666 AirPtcPCBTempActl "Air PTC actual PCB temperature.";
CM_ SG_ 666 AirTFromHeatgEstimd "Estimated air temperature from heater.";
CM_ SG_ 666 AutoTrainModReq "Auto Terrain Mode Request";
CM_ SG_ 666 BattCpEstimdRaw "Estimated battery capacity";
CM_ SG_ 666 CmprReqCmprSpdReq "AC compressor rotational speed request.";
CM_ SG_ 666 CooltFlowInCmptmtCirc "Informs of coolant flow in the heat exchange. Created for the short coolant circuit in hybrid cars.";
CM_ SG_ 666 CooltHeatrTIntk "Coolant temperature at  intake of heater.";
CM_ SG_ 666 CooltHeatrTOutl "Coolant temperature at outlet of heater.";
CM_ SG_ 666 DCDCConsDyvCyc "Accumulated energy consumption of DCDC at the high voltage end during the driving cycle";
CM_ SG_ 666 DChrgStrtEngRes "Status of the Discharge Start of engine";
CM_ SG_ 666 DispIdlChrgPwr "Charging power idle charging";
CM_ SG_ 666 EcmRoilgCntr "Reserved roiling counter for ECM.";
CM_ SG_ 666 EldtPmpPwrCns "Coolant pump power consumption in ELDT cooling circuit.";
CM_ SG_ 666 ElecStepFltActrFlt1 "information anti-pinch state";
CM_ SG_ 666 ElecStepFltActrFlt2 "motor fault";
CM_ SG_ 666 ElecStepFltActrFlt3 "internal fault";
CM_ SG_ 666 ElecStepFltActrFlt4 "fault state";
CM_ SG_ 666 ElecStepFltActrFlt5 "fault state";
CM_ SG_ 666 ElecStepFltTmrFlt "reserved";
CM_ SG_ 666 EngCooltInhbFlow "Inhibitation of non-crucial coolant flow requests. Sent out to inform that the eninge is in heat up phase and that all additional coolant flow will postphone the time when the engine has reached normal operating temperature.";
CM_ SG_ 666 EngCooltLoFlowReq "Coolant flow request to the auxillary waterpump. (l/min)";
CM_ SG_ 666 EngCooltPmpPwrCns "Actual electrical power consumed by engine water pump.";
CM_ SG_ 666 FanPwrCns "Actual electrical power consumed by the engine cooling fan.";
CM_ SG_ 666 FuelConsDrvCyc "Cumulative fuel consumption during PEM activation";
CM_ SG_ 666 HvahFltIndcnReq "HVAH high voltage fault indication request.";
CM_ SG_ 666 HvEgyCnsAllwdForClima "How much available energy is available for compartment climatisation. Estimated available energy from wall socket or Hv battery.";
CM_ SG_ 666 HvEgyLoadFctReq "Information that Hv system is active. Usage mode state shall not be abandoned.";
CM_ SG_ 666 HvPwrAvlForClimaEstimd "An estimation of how much HV-power that is available for climatization.";
CM_ SG_ 666 HvPwrEgyPrio "Information about which session is prioritized (charging, cooling, climatization etc).";
CM_ SG_ 666 HvWtrHeatrPwrCnsAllwd "Power consumption allowed for HVCH";
CM_ SG_ 666 HwRowRearLeLegRstHeiMotCtrl "Signal to control rear row left leg rest height adjustment motor, in a system with only one rear row.";
CM_ SG_ 666 HwRowRearLeLegRstLenMotCtrl "Signal to control rear row left leg rest motor, in a system with only one rear row.";
CM_ SG_ 666 HwRowRearRiLegRstHeiMotCtrl "Signal to control rear row right leg rest heigth adjustment motor, in a system with only one rear row.";
CM_ SG_ 666 HwRowRearRiLegRstLenMotCtrl "Signal to control rear row right leg rest motor, in a system with only one rear row.";
CM_ SG_ 666 HwRowSecLeInclMotCtrl "control second row left inclination motor";
CM_ SG_ 666 HwRowSecLeSldMotCtrl "control second row left slide motor";
CM_ SG_ 666 HwRowSecRiInclMotCtrl "control second row right inclination motor";
CM_ SG_ 666 HwRowSecRiSldMotCtrl "control second row right slide motor";
CM_ SG_ 666 HwRowThrdLeInclMotCtrl "control third row left inclination motor";
CM_ SG_ 666 HwRowThrdRiInclMotCtrl "control third row right inclination motor";
CM_ SG_ 666 MirrActvBtn "The button to active mirror adjustment function on DIM";
CM_ SG_ 666 MirrCmdAtDrvrMirrDwnCmd "Mirror Down/Dip Command";
CM_ SG_ 666 MirrCmdAtDrvrMirrFoldCmd "Mirror Fold Command";
CM_ SG_ 666 MirrCmdAtDrvrMirrPosAdjCmd "Mirror Position Adjust Command";
CM_ SG_ 666 MirrDefrstAtDrvSts "Status signal exterior rear view mirror electrical defroster driver side.";
CM_ SG_ 666 MirrDirReq "Signal from the Driver door switchpack to the Driver Door module containing information of the position of the  mirror manoeuvring joystick
";
CM_ SG_ 666 MirrSelnReq "Signal indicating what wing mirror has been selected to be adjusted (none, left, right or both)";
CM_ SG_ 666 MotGenDrvCyc "Cumulative energy generation of all motors in this driving cycle";
CM_ SG_ 666 RngExtd "Extended range, km";
CM_ SG_ 666 RoadSlopeInst "Real-time road slope information";
CM_ SG_ 666 SecPwrSrcUloWarnChks "Checksum";
CM_ SG_ 666 SecPwrSrcUloWarnCntr "Counter";
CM_ SG_ 666 SecPwrSrcUloWarnULoWarn "Secondary ULoWarn for LVEEM";
CM_ SG_ 666 SldgActiveInteWarn "Description of why the power sliding doors opening and closing are interrupted";
CM_ SG_ 666 TOCCooltFlowReq "coolant flow requirement for TOC";
CM_ SG_ 666 TrlrModPrpsnSts "Trailer mode status signal TrlrModPrpsnSts.
";
BA_DEF_ BO_ "CANFD_BRS" ENUM "0","1";
BA_DEF_ BO_ "GenMsgCycleTime" INT 0 65536; // [ms]
BA_DEF_ BO_ "GenMsgDelayTime" INT 0 65536; // [ms]
BA_DEF_ BO_ "GenMsgSendType" ENUM "cyclic", "spontaneous", "not-used", "not-used", "not-used", "cyclicAndSpontaneous", "not-used", "cyclicIfActive", "NoMsgSendType"; // [us]
BA_DEF_ BO_ "GenMsgStartDelayTime" INT 0 65536; // [ms]
BA_DEF_ BO_ "VFrameFormat" ENUM "StandardCAN","ExtendedCAN","reserved","J1939PG","reserved","reserved","reserved","reserved","reserved","reserved","reserved","reserved","reserved","reserved","StandardCAN_FD","ExtendedCAN_FD";
BA_DEF_ SG_ "GenSigSendType" ENUM "Cyclic","OnWrite","OnWriteWithRepetition","OnChange","OnChangeWithRepetition","IfActive","IfActiveWithRepetition","NoSigSendType";
BA_DEF_ SG_ "GenSigStartValue" HEX 0 80000000;
BA_DEF_ BO_ "GenMsgILSupport" ENUM "No","Yes";
BA_DEF_ BO_ "NmAsrMessage" ENUM "No","Yes";
BA_DEF_ SG_ "GenSigFuncType" ENUM "NoFunction","n/a","n/a","n/a","n/a","n/a","n/a","n/a","n/a","n/a","n/a","n/a","n/a","n/a","n/a","CHK","CNTR","n/a","n/a","n/a","CNTR_AR_01","CRC_AR_01_BOTH","CRC_AR_01_ALT","CRC_AR_01_LOW","CRC_AR_01_NIBBLE","CNTR_AR_04","CRC_AR_04A","CNTR_AR_05","CRC_AR_05";
BA_DEF_ SG_ "GenSigDataID" STRING;
BA_DEF_DEF_ "CANFD_BRS" "1";
BA_DEF_DEF_ "GenSigStartValue" 0;
BA_DEF_DEF_ "VFrameFormat" "J1939PG";
BA_DEF_DEF_ "GenSigSendType" "NoSigSendType";
BA_DEF_DEF_ "GenMsgCycleTime" 0;
BA_DEF_DEF_ "GenMsgDelayTime" 0;
BA_DEF_DEF_ "GenMsgStartDelayTime" 0;
BA_DEF_DEF_ "GenMsgSendType" "NoMsgSendType";
BA_DEF_DEF_ "GenMsgILSupport" "Yes";
BA_DEF_DEF_ "NmAsrMessage" "No";
BA_DEF_DEF_ "GenSigFuncType" "NoFunction";
BA_DEF_DEF_ "GenSigDataID" "";
// Frame: DimZCUCANFD2Fr01
BA_ "GenMsgCycleTime" BO_ 371 30.000;
BA_ "GenMsgSendType" BO_ 371 0;
BA_ "VFrameFormat" BO_ 371 14;
// Frame: DimZCUCANFD2Fr02
BA_ "GenMsgCycleTime" BO_ 721 100.000;
BA_ "GenMsgSendType" BO_ 721 0;
BA_ "VFrameFormat" BO_ 721 14;
// Frame: DimZCUCANFD2Fr03
BA_ "GenMsgCycleTime" BO_ 558 250.000;
BA_ "GenMsgSendType" BO_ 558 0;
BA_ "VFrameFormat" BO_ 558 14;
// Frame: DimZCUCANFD2Fr04
BA_ "GenMsgCycleTime" BO_ 63 10.000;
BA_ "GenMsgSendType" BO_ 63 0;
BA_ "VFrameFormat" BO_ 63 14;
// Frame: ETCZCUCANFD2DEVFr01
BA_ "GenMsgDelayTime" BO_ 1377 90.000;
BA_ "GenMsgSendType" BO_ 1377 1;
BA_ "VFrameFormat" BO_ 1377 14;
// Frame: EtctoZcudXCPFr01
BA_ "GenMsgDelayTime" BO_ 1412 50.000;
BA_ "GenMsgSendType" BO_ 1412 1;
BA_ "VFrameFormat" BO_ 1412 14;
// Frame: EtctoZcupXCPFr01
BA_ "GenMsgDelayTime" BO_ 1416 50.000;
BA_ "GenMsgSendType" BO_ 1416 1;
BA_ "VFrameFormat" BO_ 1416 14;
// Frame: IHUZCUCANFD2Fr02
BA_ "GenMsgCycleTime" BO_ 461 150.000;
BA_ "GenMsgSendType" BO_ 461 0;
BA_ "VFrameFormat" BO_ 461 14;
// Frame: IHUZCUCANFD2Fr03
BA_ "GenMsgCycleTime" BO_ 447 100.000;
BA_ "GenMsgSendType" BO_ 447 0;
BA_ "VFrameFormat" BO_ 447 14;
// Frame: IHUZCUCANFD2Fr07
BA_ "GenMsgCycleTime" BO_ 356 40.000;
BA_ "GenMsgSendType" BO_ 356 0;
BA_ "VFrameFormat" BO_ 356 14;
// Frame: ZCUDZCUCANFD2DEVFr01
BA_ "GenMsgDelayTime" BO_ 1378 100.000;
BA_ "GenMsgSendType" BO_ 1378 1;
BA_ "VFrameFormat" BO_ 1378 14;
// Frame: ZCUDZCUCANFD2Fr01
BA_ "GenMsgCycleTime" BO_ 1169 1000.000;
BA_ "GenMsgSendType" BO_ 1169 0;
BA_ "VFrameFormat" BO_ 1169 14;
// Frame: ZCUDZCUCANFD2Fr02
BA_ "GenMsgCycleTime" BO_ 306 50.000;
BA_ "GenMsgDelayTime" BO_ 306 10.000;
BA_ "GenMsgSendType" BO_ 306 5;
BA_ "VFrameFormat" BO_ 306 14;
// Frame: ZCUDZCUCANFD2Fr03
BA_ "GenMsgCycleTime" BO_ 369 80.000;
BA_ "GenMsgSendType" BO_ 369 0;
BA_ "VFrameFormat" BO_ 369 14;
// Frame: ZCUDZCUCANFD2Fr04
BA_ "GenMsgCycleTime" BO_ 666 400.000;
BA_ "GenMsgSendType" BO_ 666 0;
BA_ "VFrameFormat" BO_ 666 14;
// Frame: ZcudCmdToDhuZCUCANFD2DiagResFr
BA_ "GenMsgDelayTime" BO_ 1564 5.000;
BA_ "GenMsgSendType" BO_ 1564 1;
BA_ "VFrameFormat" BO_ 1564 14;
// Frame: ZcudCmpToDhuZCUCANFD2DiagResFr
BA_ "GenMsgDelayTime" BO_ 1565 5.000;
BA_ "GenMsgSendType" BO_ 1565 1;
BA_ "VFrameFormat" BO_ 1565 14;
// Frame: ZcudDlmToDhuZCUCANFD2DiagResFr
BA_ "GenMsgDelayTime" BO_ 1594 5.000;
BA_ "GenMsgSendType" BO_ 1594 1;
BA_ "VFrameFormat" BO_ 1594 14;
// Frame: ZcudDpod2ToDhuZCUCANFD2DiagResFr
BA_ "GenMsgDelayTime" BO_ 1713 5.000;
BA_ "GenMsgSendType" BO_ 1713 1;
BA_ "VFrameFormat" BO_ 1713 14;
// Frame: ZcudHcmlToDhuZCUCANFD2DiagResFr
BA_ "GenMsgDelayTime" BO_ 1715 5.000;
BA_ "GenMsgSendType" BO_ 1715 1;
BA_ "VFrameFormat" BO_ 1715 14;
// Frame: ZcudHcmrToDhuZCUCANFD2DiagResFr
BA_ "GenMsgDelayTime" BO_ 1716 5.000;
BA_ "GenMsgSendType" BO_ 1716 1;
BA_ "VFrameFormat" BO_ 1716 14;
// Frame: ZcudLpod2ToDhuZCUCANFD2DiagResFr
BA_ "GenMsgDelayTime" BO_ 1712 5.000;
BA_ "GenMsgSendType" BO_ 1712 1;
BA_ "VFrameFormat" BO_ 1712 14;
// Frame: ZcudPotToDhuZCUCANFD2DiagResFr
BA_ "GenMsgDelayTime" BO_ 1557 5.000;
BA_ "GenMsgSendType" BO_ 1557 1;
BA_ "VFrameFormat" BO_ 1557 14;
// Frame: ZcudPpod2ToDhuZCUCANFD2DiagResFr
BA_ "GenMsgDelayTime" BO_ 1724 5.000;
BA_ "GenMsgSendType" BO_ 1724 1;
BA_ "VFrameFormat" BO_ 1724 14;
// Frame: ZcudRcmToDhuZCUCANFD2DiagResFr
BA_ "GenMsgDelayTime" BO_ 1714 5.000;
BA_ "GenMsgSendType" BO_ 1714 1;
BA_ "VFrameFormat" BO_ 1714 14;
// Frame: ZcudRmlToDhuZCUCANFD2DiagResFr
BA_ "GenMsgDelayTime" BO_ 1552 5.000;
BA_ "GenMsgSendType" BO_ 1552 1;
BA_ "VFrameFormat" BO_ 1552 14;
// Frame: ZcudRmrToDhuZCUCANFD2DiagResFr
BA_ "GenMsgDelayTime" BO_ 1553 5.000;
BA_ "GenMsgSendType" BO_ 1553 1;
BA_ "VFrameFormat" BO_ 1553 14;
// Frame: ZcudRpod2ToDhuZCUCANFD2DiagResFr
BA_ "GenMsgDelayTime" BO_ 1723 5.000;
BA_ "GenMsgSendType" BO_ 1723 1;
BA_ "VFrameFormat" BO_ 1723 14;
// Frame: ZcudSdlToDhuZCUCANFD2DiagResFr
BA_ "GenMsgDelayTime" BO_ 1571 5.000;
BA_ "GenMsgSendType" BO_ 1571 1;
BA_ "VFrameFormat" BO_ 1571 14;
// Frame: ZcudSdrToDhuZCUCANFD2DiagResFr
BA_ "GenMsgDelayTime" BO_ 1572 5.000;
BA_ "GenMsgSendType" BO_ 1572 1;
BA_ "VFrameFormat" BO_ 1572 14;
// Frame: ZcudSmbToDhuZCUCANFD2DiagResFr
BA_ "GenMsgDelayTime" BO_ 1577 5.000;
BA_ "GenMsgSendType" BO_ 1577 1;
BA_ "VFrameFormat" BO_ 1577 14;
// Frame: ZcudSmblToDhuZCUCANFD2DiagResFr
BA_ "GenMsgDelayTime" BO_ 1585 5.000;
BA_ "GenMsgSendType" BO_ 1585 1;
BA_ "VFrameFormat" BO_ 1585 14;
// Frame: ZcudSmbrToDhuZCUCANFD2DiagResFr
BA_ "GenMsgDelayTime" BO_ 1586 5.000;
BA_ "GenMsgSendType" BO_ 1586 1;
BA_ "VFrameFormat" BO_ 1586 14;
// Frame: ZcudSmp2ToDhuZCUCANFD2DiagResFr
BA_ "GenMsgDelayTime" BO_ 1576 5.000;
BA_ "GenMsgSendType" BO_ 1576 1;
BA_ "VFrameFormat" BO_ 1576 14;
// Frame: ZcudSrsToDhuISO26021ZCUCanFD2ResFr
BA_ "GenMsgDelayTime" BO_ 2041 5.000;
BA_ "GenMsgSendType" BO_ 2041 1;
BA_ "VFrameFormat" BO_ 2041 0;
// Frame: ZcudSrsToDhuZCUCANFD2DiagResFr
BA_ "GenMsgDelayTime" BO_ 1593 5.000;
BA_ "GenMsgSendType" BO_ 1593 1;
BA_ "VFrameFormat" BO_ 1593 14;
// Frame: ZcudSwmToDhuZCUCANFD2DiagResFr
BA_ "GenMsgDelayTime" BO_ 1650 5.000;
BA_ "GenMsgSendType" BO_ 1650 1;
BA_ "VFrameFormat" BO_ 1650 14;
// Frame: ZcudTcmbToDhuZCUCANFD2DiagResFr
BA_ "GenMsgDelayTime" BO_ 1578 5.000;
BA_ "GenMsgSendType" BO_ 1578 1;
BA_ "VFrameFormat" BO_ 1578 14;
// Frame: ZcudToDhuZCUCANFD2DiagResFr
BA_ "GenMsgDelayTime" BO_ 1537 5.000;
BA_ "GenMsgSendType" BO_ 1537 1;
BA_ "VFrameFormat" BO_ 1537 14;
// Frame: ZcudTrmToDhuZCUCANFD2DiagResFr
BA_ "GenMsgDelayTime" BO_ 1559 5.000;
BA_ "GenMsgSendType" BO_ 1559 1;
BA_ "VFrameFormat" BO_ 1559 14;
BA_ "GenSigStartValue" SG_ 666 AcChllrOutT 120;
BA_ "GenSigSendType" SG_ 369 AcEgyDistbn 0;
BA_ "GenSigSendType" SG_ 666 AcHiSideP 0;
BA_ "GenSigDataID" SG_ 1169 AccrpedlStsChks "0x1781";
BA_ "GenSigFuncType" SG_ 1169 AccrpedlStsChks 15;
BA_ "GenSigSendType" SG_ 1169 AccrpedlStsChks 0;
BA_ "GenSigFuncType" SG_ 1169 AccrpedlStsCntr 16;
BA_ "GenSigSendType" SG_ 1169 AccrpedlStsCntr 0;
BA_ "GenSigSendType" SG_ 1169 AccrpedlStsFltSts 0;
BA_ "GenSigSendType" SG_ 1169 ActnOfAssistantLi 0;
BA_ "GenSigSendType" SG_ 306 ActnOfDaytiRunngLampPass 0;
BA_ "GenSigSendType" SG_ 1169 ActnOfDynEDIForChrgn 0;
BA_ "GenSigSendType" SG_ 306 ActnOfDynRePos 0;
BA_ "GenSigSendType" SG_ 306 ActnOfFrntFogLampPass 0;
BA_ "GenSigSendType" SG_ 306 ActnOfFrntPosnLampPass 0;
BA_ "GenSigSendType" SG_ 306 ActnOfHiBeamPass 0;
BA_ "GenSigSendType" SG_ 1169 ActnOfLedHiBeam 0;
BA_ "GenSigSendType" SG_ 306 ActnOfLedLeLogoLampDyn 0;
BA_ "GenSigSendType" SG_ 1169 ActnOfLedLoBeamActnOfLedLoBeam 0;
BA_ "GenSigDataID" SG_ 1169 ActnOfLedLoBeamChks "0x441";
BA_ "GenSigFuncType" SG_ 1169 ActnOfLedLoBeamChks 15;
BA_ "GenSigSendType" SG_ 1169 ActnOfLedLoBeamChks 0;
BA_ "GenSigFuncType" SG_ 1169 ActnOfLedLoBeamCntr 16;
BA_ "GenSigSendType" SG_ 1169 ActnOfLedLoBeamCntr 0;
BA_ "GenSigDataID" SG_ 306 ActnOfLoBeamPassChks "0x1FA2";
BA_ "GenSigFuncType" SG_ 306 ActnOfLoBeamPassChks 15;
BA_ "GenSigSendType" SG_ 306 ActnOfLoBeamPassChks 0;
BA_ "GenSigFuncType" SG_ 306 ActnOfLoBeamPassCntr 16;
BA_ "GenSigSendType" SG_ 306 ActnOfLoBeamPassCntr 0;
BA_ "GenSigSendType" SG_ 306 ActnOfLoBeamPassOnOff 0;
BA_ "GenSigSendType" SG_ 306 ActnOfReFogLampDrv 0;
BA_ "GenSigSendType" SG_ 306 ActnOfRePosnLampPass 0;
BA_ "GenSigSendType" SG_ 306 ActnOfReRegPlateLamp 0;
BA_ "GenSigSendType" SG_ 306 ActnOfRvsgLampPass 0;
BA_ "GenSigSendType" SG_ 666 ActvOfHorn 0;
BA_ "GenSigSendType" SG_ 306 ActvnOfApproach 0;
BA_ "GenSigSendType" SG_ 306 ActvnOfCarLoctr 0;
BA_ "GenSigSendType" SG_ 63 ActvnOfDefdLiShow 0;
BA_ "GenSigSendType" SG_ 1169 ActvnOfEIDForVSTD 0;
BA_ "GenSigSendType" SG_ 306 ActvnOfGoodByeLi 0;
BA_ "GenSigSendType" SG_ 306 ActvnOfHndlDoorLi1HndlDoorLiDrvr 0;
BA_ "GenSigSendType" SG_ 306 ActvnOfHndlDoorLi1HndlDoorLiDrvrRe 0;
BA_ "GenSigSendType" SG_ 306 ActvnOfHndlDoorLi1HndlDoorLiPass 0;
BA_ "GenSigSendType" SG_ 306 ActvnOfHndlDoorLi1HndlDoorLiPassRe 0;
BA_ "GenSigSendType" SG_ 306 ActvnOfHomeSafe 0;
BA_ "GenSigSendType" SG_ 306 ActvnOfLiForComity 0;
BA_ "GenSigSendType" SG_ 306 ActvnOfLiForSpkr 0;
BA_ "GenSigSendType" SG_ 306 ActvnOfLiForWait 0;
BA_ "GenSigSendType" SG_ 306 ActvnOfPudLi 0;
BA_ "GenSigSendType" SG_ 1169 ActvnOfShowModLi 0;
BA_ "GenSigSendType" SG_ 306 ActvnOfSideLogo 0;
BA_ "GenSigSendType" SG_ 306 ActvnOfWaitMode 0;
BA_ "GenSigSendType" SG_ 1169 ActvnOfWiprRe 0;
BA_ "GenSigSendType" SG_ 666 ActvnOfWshrFrntSafe 0;
BA_ "GenSigStartValue" SG_ 666 AirPtcPCBTempActl 40;
BA_ "GenSigSendType" SG_ 666 AirTFromHeatgEstimd 0;
BA_ "GenSigSendType" SG_ 371 AmbTIndcdWithUnitAmbTIndcd 0;
BA_ "GenSigStartValue" SG_ 371 AmbTIndcdWithUnitAmbTIndcd 1000;
BA_ "GenSigSendType" SG_ 371 AmbTIndcdWithUnitAmbTIndcdUnit 0;
BA_ "GenSigSendType" SG_ 371 AmbTIndcdWithUnitQF 0;
BA_ "GenSigSendType" SG_ 721 AmbTUnitForUseInt 0;
BA_ "GenSigSendType" SG_ 1169 AsySftyStandStillReq 0;
BA_ "GenSigSendType" SG_ 369 AudWarn 0;
BA_ "GenSigSendType" SG_ 558 AudWarnActv 0;
BA_ "GenSigSendType" SG_ 369 AutoShowModPrpsnEna 0;
BA_ "GenSigSendType" SG_ 666 AutoTrainModReq 0;
BA_ "GenSigSendType" SG_ 1169 BattChrgnBalDurgDrvgRaw 0;
BA_ "GenSigStartValue" SG_ 1169 BattChrgnBalDurgDrvgRaw 20000;
BA_ "GenSigSendType" SG_ 1169 BattCircOpenU 0;
BA_ "GenSigSendType" SG_ 1169 BattCpEstimdAtTNomRaw 0;
BA_ "GenSigSendType" SG_ 666 BattCpEstimdRaw 0;
BA_ "GenSigStartValue" SG_ 666 BattCpEstimdRaw 80;
BA_ "GenSigSendType" SG_ 1169 BattCpRel 0;
BA_ "GenSigSendType" SG_ 1169 BattCycChrgCntrRaw 0;
BA_ "GenSigSendType" SG_ 1169 BattCycDchaCntrDurgConvceRaw 0;
BA_ "GenSigSendType" SG_ 1169 BattCycDchaCntrDurgDrvgRaw 0;
BA_ "GenSigSendType" SG_ 1169 BattCycDchaCntrDurgQuiscPhaRaw 0;
BA_ "GenSigSendType" SG_ 1169 BattIQuiscAvgRaw 0;
BA_ "GenSigStartValue" SG_ 1169 BattIQuiscAvgRaw 511;
BA_ "GenSigSendType" SG_ 1169 BattIQuiscFildLongRaw 0;
BA_ "GenSigStartValue" SG_ 1169 BattIQuiscFildLongRaw 511;
BA_ "GenSigSendType" SG_ 1169 BattIQuiscFildShoRaw 0;
BA_ "GenSigStartValue" SG_ 1169 BattIQuiscFildShoRaw 511;
BA_ "GenSigSendType" SG_ 1169 BattIRaw 0;
BA_ "GenSigStartValue" SG_ 1169 BattIRaw 32768;
BA_ "GenSigSendType" SG_ 1169 BattRAtTNomRaw 0;
BA_ "GenSigSendType" SG_ 1169 BattRRaw 0;
BA_ "GenSigSendType" SG_ 1169 BattSnsrCalcnNotVldRaw 0;
BA_ "GenSigSendType" SG_ 1169 BattSnsrHwFltRaw 0;
BA_ "GenSigSendType" SG_ 1169 BattTRaw 0;
BA_ "GenSigStartValue" SG_ 1169 BattTRaw 256;
BA_ "GenSigSendType" SG_ 1169 BattTiInSrvRaw 0;
BA_ "GenSigSendType" SG_ 369 BltLockStAtPassMidBltLockEquid 0;
BA_ "GenSigStartValue" SG_ 369 BltLockStAtPassMidBltLockEquid 1;
BA_ "GenSigSendType" SG_ 369 BltLockStAtPassMidBltLockSt1 0;
BA_ "GenSigSendType" SG_ 369 BltLockStAtPassMidBltLockSts 0;
BA_ "GenSigStartValue" SG_ 369 BltLockStAtPassMidBltLockSts 1;
BA_ "GenSigSendType" SG_ 369 BltLockStAtRowFrthLeBltLockEquid 0;
BA_ "GenSigStartValue" SG_ 369 BltLockStAtRowFrthLeBltLockEquid 1;
BA_ "GenSigSendType" SG_ 369 BltLockStAtRowFrthLeBltLockSt1 0;
BA_ "GenSigSendType" SG_ 369 BltLockStAtRowFrthLeBltLockSts 0;
BA_ "GenSigStartValue" SG_ 369 BltLockStAtRowFrthLeBltLockSts 1;
BA_ "GenSigSendType" SG_ 369 BltLockStAtRowFrthMidBltLockEquid 0;
BA_ "GenSigStartValue" SG_ 369 BltLockStAtRowFrthMidBltLockEquid 1;
BA_ "GenSigSendType" SG_ 369 BltLockStAtRowFrthMidBltLockSt1 0;
BA_ "GenSigSendType" SG_ 369 BltLockStAtRowFrthMidBltLockSts 0;
BA_ "GenSigStartValue" SG_ 369 BltLockStAtRowFrthMidBltLockSts 1;
BA_ "GenSigSendType" SG_ 369 BltLockStAtRowFrthRiBltLockEquid 0;
BA_ "GenSigStartValue" SG_ 369 BltLockStAtRowFrthRiBltLockEquid 1;
BA_ "GenSigSendType" SG_ 369 BltLockStAtRowFrthRiBltLockSt1 0;
BA_ "GenSigSendType" SG_ 369 BltLockStAtRowFrthRiBltLockSts 0;
BA_ "GenSigStartValue" SG_ 369 BltLockStAtRowFrthRiBltLockSts 1;
BA_ "GenSigSendType" SG_ 369 BltLockStAtRowThrdMidBltLockEquid 0;
BA_ "GenSigStartValue" SG_ 369 BltLockStAtRowThrdMidBltLockEquid 1;
BA_ "GenSigSendType" SG_ 369 BltLockStAtRowThrdMidBltLockSt1 0;
BA_ "GenSigSendType" SG_ 369 BltLockStAtRowThrdMidBltLockSts 0;
BA_ "GenSigStartValue" SG_ 369 BltLockStAtRowThrdMidBltLockSts 1;
BA_ "GenSigSendType" SG_ 371 BltRmnTelltl 0;
BA_ "GenSigSendType" SG_ 356 BlutoothPhoneWorkingSts 0;
BA_ "GenSigSendType" SG_ 369 BtnLockStsAndKeyIdBtnSts 0;
BA_ "GenSigSendType" SG_ 369 BtnLockStsAndKeyIdKeyId 0;
BA_ "GenSigSendType" SG_ 369 BtnUnlckStsAndKeyIdBtnSts 0;
BA_ "GenSigSendType" SG_ 369 BtnUnlckStsAndKeyIdKeyId 0;
BA_ "GenSigSendType" SG_ 369 CDCModIndcn 0;
BA_ "GenSigSendType" SG_ 1169 CEMdevelpsignalgroupVMM1Functiondevpsignalgroup1 0;
BA_ "GenSigSendType" SG_ 1169 CEMdevelpsignalgroupVMM1Functiondevpsignalgroup2 0;
BA_ "GenSigSendType" SG_ 1169 CEMdevelpsignalgroupVMM1Functiondevpsignalgroup3 0;
BA_ "GenSigSendType" SG_ 1169 CEMdevelpsignalgroupVMM1Functiondevpsignalgroup4 0;
BA_ "GenSigSendType" SG_ 1169 CEMdevelpsignalgroupVMM1Functiondevpsignalgroup5 0;
BA_ "GenSigSendType" SG_ 1169 CEMdevelpsignalgroupVMM1Functiondevpsignalgroup6 0;
BA_ "GenSigSendType" SG_ 1169 CEMdevelpsignalgroupVMM1Functiondevpsignalgroup7 0;
BA_ "GenSigSendType" SG_ 1169 CEMdevelpsignalgroupVMM1Functiondevpsignalgroup8 0;
BA_ "GenSigSendType" SG_ 306 CarCfgInfoToWPC 0;
BA_ "GenSigSendType" SG_ 1169 CarModDispdWdDispd 0;
BA_ "GenSigSendType" SG_ 721 CarModDynoCnfrm 0;
BA_ "GenSigSendType" SG_ 1169 CarModDynoReq 0;
BA_ "GenSigStartValue" SG_ 1169 CarModDynoReq 4;
BA_ "GenSigSendType" SG_ 369 CchForFuEcoBarForFuEco 0;
BA_ "GenSigSendType" SG_ 369 CchForFuEcoGrdForFuEco 0;
BA_ "GenSigSendType" SG_ 369 CchForPwrEcoBarForPwrEco 0;
BA_ "GenSigSendType" SG_ 369 CchForPwrEcoGrdForPwrEco 0;
BA_ "GenSigSendType" SG_ 306 ChdLockLeftSts 0;
BA_ "GenSigSendType" SG_ 306 ChdLockRightStsToHmi 0;
BA_ "GenSigSendType" SG_ 306 ChdPrtnLeftStsToHmi 0;
BA_ "GenSigSendType" SG_ 306 ChrgLidCombLockCmd 0;
BA_ "GenSigSendType" SG_ 306 ChrgLidManvgDCorAcDcActPosn2 0;
BA_ "GenSigStartValue" SG_ 306 ChrgLidManvgDCorAcDcActPosn2 126;
BA_ "GenSigSendType" SG_ 306 ChrgnLtgSts 0;
BA_ "GenSigSendType" SG_ 306 CinhDrvrReSts 0;
BA_ "GenSigSendType" SG_ 306 CinhDrvrReSwt 0;
BA_ "GenSigSendType" SG_ 306 CinhDrvrSts 0;
BA_ "GenSigSendType" SG_ 306 CinhDrvrSwt 0;
BA_ "GenSigSendType" SG_ 666 CmprReqCmprSpdReq 0;
BA_ "GenSigSendType" SG_ 1169 CmptFrntWindDewT 0;
BA_ "GenSigStartValue" SG_ 1169 CmptFrntWindDewT 600;
BA_ "GenSigSendType" SG_ 1169 CmptFrntWindT 0;
BA_ "GenSigStartValue" SG_ 1169 CmptFrntWindT 650;
BA_ "GenSigSendType" SG_ 369 CmptmtFrntWindDewT 0;
BA_ "GenSigStartValue" SG_ 369 CmptmtFrntWindDewT 600;
BA_ "GenSigSendType" SG_ 1169 CnvnAllwd 0;
BA_ "GenSigSendType" SG_ 1169 CnvnReq 0;
BA_ "GenSigSendType" SG_ 369 CoolgLoadGroupCoolgLimd 0;
BA_ "GenSigSendType" SG_ 369 CoolgLoadGroupCoolgLoad2 0;
BA_ "GenSigSendType" SG_ 1169 CooltFlowForTOC 0;
BA_ "GenSigSendType" SG_ 666 CooltFlowInCmptmtCirc 0;
BA_ "GenSigSendType" SG_ 666 CooltHeatrTIntk 0;
BA_ "GenSigStartValue" SG_ 666 CooltHeatrTIntk 40;
BA_ "GenSigSendType" SG_ 666 CooltHeatrTOutl 0;
BA_ "GenSigStartValue" SG_ 666 CooltHeatrTOutl 40;
BA_ "GenSigSendType" SG_ 1169 CooltTSigForTOC 0;
BA_ "GenSigStartValue" SG_ 1169 CooltTSigForTOC 400;
BA_ "GenSigSendType" SG_ 461 CushExtnFirstDrvr 0;
BA_ "GenSigSendType" SG_ 666 DCDCConsDyvCyc 0;
BA_ "GenSigSendType" SG_ 666 DChrgStrtEngRes 0;
BA_ "GenSigSendType" SG_ 306 DchaChrgnTarValFb 0;
BA_ "GenSigStartValue" SG_ 306 DchaChrgnTarValFb 200;
BA_ "GenSigSendType" SG_ 369 DigKeyApproachReqDigKeyApproaReq 0;
BA_ "GenSigSendType" SG_ 369 DigKeyApproachReqKeyId3 0;
BA_ "GenSigSendType" SG_ 306 DigKeyPasEntryDiSts 0;
BA_ "GenSigSendType" SG_ 666 DispIdlChrgPwr 0;
BA_ "GenSigSendType" SG_ 306 DlyClsActv 0;
BA_ "GenSigSendType" SG_ 1169 DoorDrvrSwtIntrLockgReq 0;
BA_ "GenSigSendType" SG_ 369 DoorHandleSensorSts 0;
BA_ "GenSigSendType" SG_ 306 DoorLeReHndlCmd 0;
BA_ "GenSigSendType" SG_ 369 DoorLockUnlockCmdNFCKeyId3 0;
BA_ "GenSigSendType" SG_ 369 DoorLockUnlockCmdNFCKeyPrsntSts1 0;
BA_ "GenSigSendType" SG_ 369 DoorLockUnlockCmdNFCPsdNotPsd 0;
BA_ "GenSigSendType" SG_ 369 DoorPassHndlCmd 0;
BA_ "GenSigSendType" SG_ 369 DoorRiReHndlCmd 0;
BA_ "GenSigSendType" SG_ 371 DrvrCrsCtrlFctDeactvnReq 0;
BA_ "GenSigSendType" SG_ 371 DrvrCrsCtrlFctReActvReq 0;
BA_ "GenSigSendType" SG_ 371 DrvrCrsCtrlFctSeld 0;
BA_ "GenSigSendType" SG_ 369 DrvrElecRunngBdSts 0;
BA_ "GenSigSendType" SG_ 306 DrvrGearLvrInfoIndcn 0;
BA_ "GenSigSendType" SG_ 306 DrvrGearLvrLockIndcn 0;
BA_ "GenSigSendType" SG_ 369 DrvrSeatAdjmtLimnWarn 0;
BA_ "GenSigSendType" SG_ 447 DrvrSeatDispSwtFctMod 0;
BA_ "GenSigSendType" SG_ 369 DrvrSeatPosPercSeatPosFrntHeiPerc 0;
BA_ "GenSigStartValue" SG_ 369 DrvrSeatPosPercSeatPosFrntHeiPerc 1000;
BA_ "GenSigSendType" SG_ 369 DrvrSeatPosPercSeatPosFrntHeiQF 0;
BA_ "GenSigStartValue" SG_ 369 DrvrSeatPosPercSeatPosFrntHeiQF 1;
BA_ "GenSigSendType" SG_ 369 DrvrSeatPosPercSeatPosHeiPerc 0;
BA_ "GenSigStartValue" SG_ 369 DrvrSeatPosPercSeatPosHeiPerc 1000;
BA_ "GenSigSendType" SG_ 369 DrvrSeatPosPercSeatPosHeiQF 0;
BA_ "GenSigStartValue" SG_ 369 DrvrSeatPosPercSeatPosHeiQF 1;
BA_ "GenSigSendType" SG_ 369 DrvrSeatPosPercSeatPosSldPerc 0;
BA_ "GenSigStartValue" SG_ 369 DrvrSeatPosPercSeatPosSldPerc 1000;
BA_ "GenSigSendType" SG_ 369 DrvrSeatPosPercSeatPosSldQF 0;
BA_ "GenSigStartValue" SG_ 369 DrvrSeatPosPercSeatPosSldQF 1;
BA_ "GenSigSendType" SG_ 1169 DrvrSteerWhlHldGroupDrvrSteerWhlHld 0;
BA_ "GenSigSendType" SG_ 1169 DrvrSteerWhlHldGroupDrvrSteerWhlHldQly 0;
BA_ "GenSigSendType" SG_ 306 DstTrvldFromSftyBkp 0;
BA_ "GenSigSendType" SG_ 306 DstTrvldVldFromSftyBkp 0;
BA_ "GenSigSendType" SG_ 369 EgyAvgCnsDstSg 0;
BA_ "GenSigSendType" SG_ 1169 EgyLvlElecDrvInfo 0;
BA_ "GenSigSendType" SG_ 1169 EgyMeas 0;
BA_ "GenSigSendType" SG_ 1169 EgyMeasIntlIntl1 0;
BA_ "GenSigSendType" SG_ 1169 EgyMeasIntlIntl2 0;
BA_ "GenSigSendType" SG_ 1169 EgyMeasIntlIntl3 0;
BA_ "GenSigSendType" SG_ 1169 EgyMeasIntlIntl4 0;
BA_ "GenSigSendType" SG_ 1169 EgyMeasSec 0;
BA_ "GenSigSendType" SG_ 666 EldtPmpPwrCns 0;
BA_ "GenSigSendType" SG_ 1169 ElecMot2ModReq 0;
BA_ "GenSigSendType" SG_ 1169 ElecStepDrvr 0;
BA_ "GenSigSendType" SG_ 666 ElecStepFltActrFlt1 0;
BA_ "GenSigSendType" SG_ 666 ElecStepFltActrFlt2 0;
BA_ "GenSigSendType" SG_ 666 ElecStepFltActrFlt3 0;
BA_ "GenSigSendType" SG_ 666 ElecStepFltActrFlt4 0;
BA_ "GenSigSendType" SG_ 666 ElecStepFltActrFlt5 0;
BA_ "GenSigSendType" SG_ 666 ElecStepFltTmrFlt 0;
BA_ "GenSigSendType" SG_ 1169 ElecStepPass 0;
BA_ "GenSigSendType" SG_ 306 EmgyBrkLiIndcrTurn 0;
BA_ "GenSigStartValue" SG_ 306 EmgyBrkLiIndcrTurn 1;
BA_ "GenSigSendType" SG_ 666 EngCooltInhbFlow 0;
BA_ "GenSigSendType" SG_ 666 EngCooltLoFlowReq 0;
BA_ "GenSigSendType" SG_ 666 EngCooltPmpPwrCns 0;
BA_ "GenSigSendType" SG_ 306 ErsStrtApplSts 0;
BA_ "GenSigSendType" SG_ 306 ExtrLiShowStoreStsFrntLe 0;
BA_ "GenSigSendType" SG_ 306 ExtrLiShowStoreStsFrntRi 0;
BA_ "GenSigSendType" SG_ 461 ExtrLtgZoneSet 0;
BA_ "GenSigStartValue" SG_ 461 ExtrLtgZoneSet 15;
BA_ "GenSigSendType" SG_ 666 FanPwrCns 0;
BA_ "GenSigSendType" SG_ 461 FirstRowSeatInhbByMod 0;
BA_ "GenSigSendType" SG_ 369 FuCnsAvgIndcdFuCnsIndcdVal1 0;
BA_ "GenSigSendType" SG_ 369 FuCnsAvgIndcdFuCnsIndcdVal2 0;
BA_ "GenSigSendType" SG_ 369 FuCnsAvgIndcdFuCnsIndcdVal3 0;
BA_ "GenSigSendType" SG_ 369 FuCnsIndcdVal1 0;
BA_ "GenSigSendType" SG_ 371 FuFillgDetnForUseInt 0;
BA_ "GenSigSendType" SG_ 721 FuLvlLoIndcn 0;
BA_ "GenSigSendType" SG_ 721 FuLvlLoWarn 0;
BA_ "GenSigSendType" SG_ 371 FuLvlRawActvSideFuLvlValFromFuTbl 0;
BA_ "GenSigSendType" SG_ 371 FuLvlRawActvSideGenQF 0;
BA_ "GenSigSendType" SG_ 371 FuLvlRawPasSideFuLvlValFromFuTbl 0;
BA_ "GenSigSendType" SG_ 371 FuLvlRawPasSideGenQF 0;
BA_ "GenSigSendType" SG_ 666 FuelConsDrvCyc 0;
BA_ "GenSigSendType" SG_ 369 GearIndcnRecGearIndcn 0;
BA_ "GenSigSendType" SG_ 369 GearIndcnRecGearShiftIndcn 0;
BA_ "GenSigSendType" SG_ 369 GearIndcnRecGearTarIndcn 0;
BA_ "GenSigSendType" SG_ 306 GlvBoxRelsReq 0;
BA_ "GenSigSendType" SG_ 306 HvBattHeatgReq 0;
BA_ "GenSigSendType" SG_ 369 HvConvPwrAct 0;
BA_ "GenSigSendType" SG_ 306 HvCooltWtrHeatrWtrTInIntk 0;
BA_ "GenSigStartValue" SG_ 306 HvCooltWtrHeatrWtrTInIntk 40;
BA_ "GenSigSendType" SG_ 306 HvCooltWtrHeatrWtrTInOutl 0;
BA_ "GenSigStartValue" SG_ 306 HvCooltWtrHeatrWtrTInOutl 40;
BA_ "GenSigSendType" SG_ 666 HvEgyCnsAllwdForClima 0;
BA_ "GenSigSendType" SG_ 666 HvEgyLoadFctReq 0;
BA_ "GenSigSendType" SG_ 666 HvPwrAvlForClimaEstimd 0;
BA_ "GenSigSendType" SG_ 666 HvPwrEgyPrio 0;
BA_ "GenSigSendType" SG_ 666 HvWtrHeatrPwrCnsAllwd 0;
BA_ "GenSigSendType" SG_ 666 HvahFltIndcnReq 0;
BA_ "GenSigSendType" SG_ 666 HwRowRearLeLegRstHeiMotCtrl 0;
BA_ "GenSigSendType" SG_ 666 HwRowRearLeLegRstLenMotCtrl 0;
BA_ "GenSigSendType" SG_ 666 HwRowRearRiLegRstHeiMotCtrl 0;
BA_ "GenSigSendType" SG_ 666 HwRowRearRiLegRstLenMotCtrl 0;
BA_ "GenSigSendType" SG_ 666 HwRowSecLeInclMotCtrl 0;
BA_ "GenSigSendType" SG_ 666 HwRowSecLeSldMotCtrl 0;
BA_ "GenSigSendType" SG_ 666 HwRowSecRiInclMotCtrl 0;
BA_ "GenSigSendType" SG_ 666 HwRowSecRiSldMotCtrl 0;
BA_ "GenSigSendType" SG_ 666 HwRowThrdLeInclMotCtrl 0;
BA_ "GenSigSendType" SG_ 666 HwRowThrdRiInclMotCtrl 0;
BA_ "GenSigSendType" SG_ 369 ImobRemMgrChkImobDataRemMgrChk0 0;
BA_ "GenSigSendType" SG_ 369 ImobRemMgrChkImobDataRemMgrChk1 0;
BA_ "GenSigSendType" SG_ 369 ImobRemMgrChkImobDataRemMgrChk2 0;
BA_ "GenSigSendType" SG_ 369 ImobRemMgrChkImobDataRemMgrChk3 0;
BA_ "GenSigSendType" SG_ 369 ImobRemMgrChkImobDataRemMgrChk4 0;
BA_ "GenSigSendType" SG_ 369 ImobRemMgrChkSts 0;
BA_ "GenSigSendType" SG_ 369 ImobVehRemMgrSts1ImobVehRemMgrSts 0;
BA_ "GenSigSendType" SG_ 369 ImobVehRemMgrSts1SpdLimRemMgrSts 0;
BA_ "GenSigSendType" SG_ 306 IndcrNoSeq 0;
BA_ "GenSigSendType" SG_ 461 IntrMirrAntiGlareLvl 0;
BA_ "GenSigSendType" SG_ 461 IntrMirrAntiGlarePerc 0;
BA_ "GenSigSendType" SG_ 306 KeyEnaStsKey0 0;
BA_ "GenSigSendType" SG_ 306 KeyEnaStsKey1 0;
BA_ "GenSigSendType" SG_ 306 KeyEnaStsKey10 0;
BA_ "GenSigSendType" SG_ 306 KeyEnaStsKey11 0;
BA_ "GenSigSendType" SG_ 306 KeyEnaStsKey2 0;
BA_ "GenSigSendType" SG_ 306 KeyEnaStsKey3 0;
BA_ "GenSigSendType" SG_ 306 KeyEnaStsKey4 0;
BA_ "GenSigSendType" SG_ 306 KeyEnaStsKey5 0;
BA_ "GenSigSendType" SG_ 306 KeyEnaStsKey6 0;
BA_ "GenSigSendType" SG_ 306 KeyEnaStsKey7 0;
BA_ "GenSigSendType" SG_ 306 KeyEnaStsKey8 0;
BA_ "GenSigSendType" SG_ 306 KeyEnaStsKey9 0;
BA_ "GenSigSendType" SG_ 721 KeyLostWarnIndcnAckd 0;
BA_ "GenSigSendType" SG_ 306 KeyScanActv 0;
BA_ "GenSigSendType" SG_ 369 LockgFbAcoustReq 0;
BA_ "GenSigSendType" SG_ 369 LockgFbToExtLi 0;
BA_ "GenSigSendType" SG_ 461 MagicCarpetSuspSet 0;
BA_ "GenSigSendType" SG_ 666 MirrActvBtn 0;
BA_ "GenSigSendType" SG_ 666 MirrCmdAtDrvrMirrDwnCmd 0;
BA_ "GenSigSendType" SG_ 666 MirrCmdAtDrvrMirrFoldCmd 0;
BA_ "GenSigSendType" SG_ 666 MirrCmdAtDrvrMirrPosAdjCmd 0;
BA_ "GenSigSendType" SG_ 666 MirrDefrstAtDrvSts 0;
BA_ "GenSigSendType" SG_ 306 MirrDefrstAtPassCmd 0;
BA_ "GenSigSendType" SG_ 666 MirrDirReq 0;
BA_ "GenSigSendType" SG_ 306 MirrDwnStsAtDrvr 0;
BA_ "GenSigSendType" SG_ 306 MirrPosnAdjFromSetTarPosnPassMirrAdjLeRi 0;
BA_ "GenSigStartValue" SG_ 306 MirrPosnAdjFromSetTarPosnPassMirrAdjLeRi 5000;
BA_ "GenSigSendType" SG_ 306 MirrPosnAdjFromSetTarPosnPassMirrAdjUpDown 0;
BA_ "GenSigStartValue" SG_ 306 MirrPosnAdjFromSetTarPosnPassMirrAdjUpDown 5000;
BA_ "GenSigSendType" SG_ 666 MirrSelnReq 0;
BA_ "GenSigSendType" SG_ 369 MobDevVentReq 0;
BA_ "GenSigSendType" SG_ 666 MotGenDrvCyc 0;
BA_ "GenSigSendType" SG_ 63 MusicShowPlaySts 0;
BA_ "GenSigSendType" SG_ 369 OpenClsCmftReqOpenClsCmftReq 0;
BA_ "GenSigSendType" SG_ 369 OpenClsCmftReqOpenClsCmftTrigSrc 0;
BA_ "GenSigSendType" SG_ 369 PassMidSeatSts 0;
BA_ "GenSigSendType" SG_ 447 PassSeatDispSwtFctMod 0;
BA_ "GenSigSendType" SG_ 306 PedProtnMsgReqForFlt 0;
BA_ "GenSigSendType" SG_ 306 PedProtnMsgReqForImpct 0;
BA_ "GenSigSendType" SG_ 306 PrpsnHvBattUsgOfChrgBlkd2 0;
BA_ "GenSigSendType" SG_ 306 PrpsnHvBattUsgOfHldBlkd2 0;
BA_ "GenSigSendType" SG_ 371 PwrCnsAvgIndcdEcoDrvInfo1 0;
BA_ "GenSigSendType" SG_ 369 PwrCnsAvgIndcdPwrCns1 0;
BA_ "GenSigStartValue" SG_ 369 PwrCnsAvgIndcdPwrCns1 1023;
BA_ "GenSigSendType" SG_ 369 PwrCnsAvgIndcdPwrCns2 0;
BA_ "GenSigStartValue" SG_ 369 PwrCnsAvgIndcdPwrCns2 1023;
BA_ "GenSigSendType" SG_ 369 PwrCnsAvgIndcdPwrCns3 0;
BA_ "GenSigStartValue" SG_ 369 PwrCnsAvgIndcdPwrCns3 1023;
BA_ "GenSigSendType" SG_ 371 PwrCnsAvgIndcdPwrCnsUnit 0;
BA_ "GenSigSendType" SG_ 369 PwrCnsIndcdPwrCnsIn1 0;
BA_ "GenSigStartValue" SG_ 369 PwrCnsIndcdPwrCnsIn1 1000;
BA_ "GenSigSendType" SG_ 461 PwrOutlOffSet 0;
BA_ "GenSigSendType" SG_ 461 PwrSldgDoorAutClsEnaHmiReq 0;
BA_ "GenSigSendType" SG_ 369 RainDetected 0;
BA_ "GenSigSendType" SG_ 306 RegenAutLvlNotAvlMsg 0;
BA_ "GenSigSendType" SG_ 369 RemAllowStrt 0;
BA_ "GenSigSendType" SG_ 369 RemClimaHVReqFb 0;
BA_ "GenSigSendType" SG_ 721 ReqForPassAirbIndcnAckd 0;
BA_ "GenSigSendType" SG_ 306 RestrntSysLampReq 0;
BA_ "GenSigSendType" SG_ 306 RestrntSysMsgReq 0;
BA_ "GenSigStartValue" SG_ 306 RestrntSysMsgReq 1;
BA_ "GenSigSendType" SG_ 666 RngExtd 0;
BA_ "GenSigSendType" SG_ 666 RoadSlopeInst 0;
BA_ "GenSigStartValue" SG_ 666 RoadSlopeInst 10000;
BA_ "GenSigSendType" SG_ 369 RowSecRiSeatZeroGrvySts 0;
BA_ "GenSigSendType" SG_ 369 RowSecRiSeatZeroGrvyWarn 0;
BA_ "GenSigSendType" SG_ 371 RstTrip1 0;
BA_ "GenSigSendType" SG_ 371 RstTrip2 0;
BA_ "GenSigSendType" SG_ 461 RuranACModeSet 0;
BA_ "GenSigDataID" SG_ 447 SbwSteerBackToCenterSetgChks "0x214D";
BA_ "GenSigFuncType" SG_ 447 SbwSteerBackToCenterSetgChks 15;
BA_ "GenSigSendType" SG_ 447 SbwSteerBackToCenterSetgChks 0;
BA_ "GenSigFuncType" SG_ 447 SbwSteerBackToCenterSetgCntr 16;
BA_ "GenSigSendType" SG_ 447 SbwSteerBackToCenterSetgCntr 0;
BA_ "GenSigSendType" SG_ 447 SbwSteerBackToCenterSetgSetg 0;
BA_ "GenSigStartValue" SG_ 447 SbwSteerBackToCenterSetgSetg 1;
BA_ "GenSigDataID" SG_ 447 SbwSteerRatiosFolwSpdSetgChks "0x214F";
BA_ "GenSigFuncType" SG_ 447 SbwSteerRatiosFolwSpdSetgChks 15;
BA_ "GenSigSendType" SG_ 447 SbwSteerRatiosFolwSpdSetgChks 0;
BA_ "GenSigFuncType" SG_ 447 SbwSteerRatiosFolwSpdSetgCntr 16;
BA_ "GenSigSendType" SG_ 447 SbwSteerRatiosFolwSpdSetgCntr 0;
BA_ "GenSigSendType" SG_ 447 SbwSteerRatiosFolwSpdSetgSetg 0;
BA_ "GenSigDataID" SG_ 447 SbwSteerRatiosLvlSetgChks "0x214C";
BA_ "GenSigFuncType" SG_ 447 SbwSteerRatiosLvlSetgChks 15;
BA_ "GenSigSendType" SG_ 447 SbwSteerRatiosLvlSetgChks 0;
BA_ "GenSigFuncType" SG_ 447 SbwSteerRatiosLvlSetgCntr 16;
BA_ "GenSigSendType" SG_ 447 SbwSteerRatiosLvlSetgCntr 0;
BA_ "GenSigSendType" SG_ 447 SbwSteerRatiosLvlSetgSetg 0;
BA_ "GenSigDataID" SG_ 447 SbwSteerRatiosSetgChks "0x214E";
BA_ "GenSigFuncType" SG_ 447 SbwSteerRatiosSetgChks 15;
BA_ "GenSigSendType" SG_ 447 SbwSteerRatiosSetgChks 0;
BA_ "GenSigFuncType" SG_ 447 SbwSteerRatiosSetgCntr 16;
BA_ "GenSigSendType" SG_ 447 SbwSteerRatiosSetgCntr 0;
BA_ "GenSigSendType" SG_ 447 SbwSteerRatiosSetgSetg 0;
BA_ "GenSigStartValue" SG_ 447 SbwSteerRatiosSetgSetg 100;
BA_ "GenSigDataID" SG_ 447 SbwSteerRemainsStatySetgChks "0x2150";
BA_ "GenSigFuncType" SG_ 447 SbwSteerRemainsStatySetgChks 15;
BA_ "GenSigSendType" SG_ 447 SbwSteerRemainsStatySetgChks 0;
BA_ "GenSigFuncType" SG_ 447 SbwSteerRemainsStatySetgCntr 16;
BA_ "GenSigSendType" SG_ 447 SbwSteerRemainsStatySetgCntr 0;
BA_ "GenSigSendType" SG_ 447 SbwSteerRemainsStatySetgSetg 0;
BA_ "GenSigSendType" SG_ 306 SeatHeatgLvlStsRowSecLe 0;
BA_ "GenSigSendType" SG_ 306 SeatHeatgLvlStsRowSecRi 0;
BA_ "GenSigSendType" SG_ 306 SeatHeatgLvlStsRowThrdLe 0;
BA_ "GenSigSendType" SG_ 306 SeatHeatgLvlStsRowThrdRi 0;
BA_ "GenSigSendType" SG_ 369 SeatOccptAtRowFrthLe 0;
BA_ "GenSigSendType" SG_ 369 SeatOccptAtRowFrthMid 0;
BA_ "GenSigSendType" SG_ 369 SeatOccptAtRowFrthRi 0;
BA_ "GenSigSendType" SG_ 369 SeatOccptAtRowThrdMid 0;
BA_ "GenSigSendType" SG_ 306 SeatRowSecLeSwtStsPassSeatSwtAdjmtOfSpplFctHozlSts 0;
BA_ "GenSigSendType" SG_ 306 SeatRowSecLeSwtStsPassSeatSwtAdjmtOfSpplFctVerSts 0;
BA_ "GenSigSendType" SG_ 306 SeatRowSecLeSwtStsPassSeatSwtHdrstHozlSts 0;
BA_ "GenSigSendType" SG_ 306 SeatRowSecLeSwtStsPassSeatSwtHdrstVertSts 0;
BA_ "GenSigSendType" SG_ 306 SeatRowSecLeSwtStsPassSeatSwtHeiFrntSts 0;
BA_ "GenSigSendType" SG_ 306 SeatRowSecLeSwtStsPassSeatSwtHeiSts 0;
BA_ "GenSigSendType" SG_ 306 SeatRowSecLeSwtStsPassSeatSwtInclSts 0;
BA_ "GenSigSendType" SG_ 306 SeatRowSecLeSwtStsPassSeatSwtSelnOfSpplFctStsSts 0;
BA_ "GenSigSendType" SG_ 306 SeatRowSecLeSwtStsPassSeatSwtSldSts 0;
BA_ "GenSigSendType" SG_ 306 SeatRowSecRiSwtStsPassSeatSwtAdjmtOfSpplFctHozlSts 0;
BA_ "GenSigSendType" SG_ 306 SeatRowSecRiSwtStsPassSeatSwtAdjmtOfSpplFctVerSts 0;
BA_ "GenSigSendType" SG_ 306 SeatRowSecRiSwtStsPassSeatSwtHdrstHozlSts 0;
BA_ "GenSigSendType" SG_ 306 SeatRowSecRiSwtStsPassSeatSwtHdrstVertSts 0;
BA_ "GenSigSendType" SG_ 306 SeatRowSecRiSwtStsPassSeatSwtHeiFrntSts 0;
BA_ "GenSigSendType" SG_ 306 SeatRowSecRiSwtStsPassSeatSwtHeiSts 0;
BA_ "GenSigSendType" SG_ 306 SeatRowSecRiSwtStsPassSeatSwtInclSts 0;
BA_ "GenSigSendType" SG_ 306 SeatRowSecRiSwtStsPassSeatSwtSelnOfSpplFctStsSts 0;
BA_ "GenSigSendType" SG_ 306 SeatRowSecRiSwtStsPassSeatSwtSldSts 0;
BA_ "GenSigSendType" SG_ 306 SeatRowThrdLeInclPosAngle 0;
BA_ "GenSigSendType" SG_ 306 SeatRowThrdLeMassgRunng 0;
BA_ "GenSigSendType" SG_ 306 SeatRowThrdLeSldPosPercSeatPosPerc 0;
BA_ "GenSigStartValue" SG_ 306 SeatRowThrdLeSldPosPercSeatPosPerc 1000;
BA_ "GenSigSendType" SG_ 306 SeatRowThrdLeSldPosPercSeatPosQf 0;
BA_ "GenSigStartValue" SG_ 306 SeatRowThrdLeSldPosPercSeatPosQf 1;
BA_ "GenSigSendType" SG_ 306 SeatRowThrdRiFoldRaiseWarn 0;
BA_ "GenSigSendType" SG_ 306 SeatRowThrdRiFoldStsSeatFoldRaiseFlt 0;
BA_ "GenSigSendType" SG_ 306 SeatRowThrdRiFoldStsSeatFoldRaiseMovmt 0;
BA_ "GenSigSendType" SG_ 306 SeatRowThrdRiInclPosAngle 0;
BA_ "GenSigSendType" SG_ 306 SeatRowThrdRiMassgRunng 0;
BA_ "GenSigSendType" SG_ 306 SeatRowThrdRiSldPosPercSeatPosPerc 0;
BA_ "GenSigStartValue" SG_ 306 SeatRowThrdRiSldPosPercSeatPosPerc 1000;
BA_ "GenSigSendType" SG_ 306 SeatRowThrdRiSldPosPercSeatPosQf 0;
BA_ "GenSigStartValue" SG_ 306 SeatRowThrdRiSldPosPercSeatPosQf 1;
BA_ "GenSigSendType" SG_ 306 SeatVentnLvlStsRowSecLe 0;
BA_ "GenSigSendType" SG_ 306 SeatVentnLvlStsRowSecRi 0;
BA_ "GenSigSendType" SG_ 306 SeatVentnLvlStsRowThrdLe 0;
BA_ "GenSigSendType" SG_ 306 SeatVentnLvlStsRowThrdRi 0;
BA_ "GenSigSendType" SG_ 666 SecPwrSrcUloWarnChks 0;
BA_ "GenSigSendType" SG_ 666 SecPwrSrcUloWarnCntr 0;
BA_ "GenSigSendType" SG_ 666 SecPwrSrcUloWarnULoWarn 0;
BA_ "GenSigSendType" SG_ 306 SecRowLeHeatgAutoSts 0;
BA_ "GenSigSendType" SG_ 306 SecRowLeVentnAutoSts 0;
BA_ "GenSigSendType" SG_ 306 SecRowRiHeatgAutoSts 0;
BA_ "GenSigSendType" SG_ 306 SecRowRiVentnAutoSts 0;
BA_ "GenSigSendType" SG_ 369 ShortDropWinLeReDoor2 0;
BA_ "GenSigSendType" SG_ 369 ShortDropWinPassDoor2 0;
BA_ "GenSigSendType" SG_ 369 ShortDropWinRiReDoor2 0;
BA_ "GenSigSendType" SG_ 666 SldgActiveInteWarn 0;
BA_ "GenSigSendType" SG_ 461 SldngDoorLeReAutoManReq 0;
BA_ "GenSigSendType" SG_ 461 SldngDoorRiReAutoManReq 0;
BA_ "GenSigSendType" SG_ 356 SphDvExtnLg 0;
BA_ "GenSigSendType" SG_ 721 SrvRst 0;
BA_ "GenSigSendType" SG_ 306 SteerServoSts 0;
BA_ "GenSigSendType" SG_ 63 StreamingMirrBriAdjmt 0;
BA_ "GenSigStartValue" SG_ 63 StreamingMirrBriAdjmt 10;
BA_ "GenSigSendType" SG_ 63 StreamingMirrBriAutoAdjmt 0;
BA_ "GenSigStartValue" SG_ 63 StreamingMirrBriAutoAdjmt 1;
BA_ "GenSigSendType" SG_ 63 StreamingMirrImgAdjmt 0;
BA_ "GenSigSendType" SG_ 63 StreamingMirrPosnAdjmt 0;
BA_ "GenSigStartValue" SG_ 63 StreamingMirrPosnAdjmt 3;
BA_ "GenSigSendType" SG_ 63 StreamingMirrSwt 0;
BA_ "GenSigSendType" SG_ 369 SunCurtPosnSts 0;
BA_ "GenSigSendType" SG_ 306 SuspTarHei 0;
BA_ "GenSigSendType" SG_ 306 TCSTNowSts 0;
BA_ "GenSigStartValue" SG_ 306 TCSTNowSts 255;
BA_ "GenSigSendType" SG_ 666 TOCCooltFlowReq 0;
BA_ "GenSigSendType" SG_ 369 TankFlapLockgCmd 0;
BA_ "GenSigSendType" SG_ 369 ThmEgyDistbn 0;
BA_ "GenSigSendType" SG_ 306 ThrdRowLeHeatgAutoSts 0;
BA_ "GenSigSendType" SG_ 306 ThrdRowRiHeatgAutoSts 0;
BA_ "GenSigSendType" SG_ 306 TopPosHmiFeedBack 0;
BA_ "GenSigSendType" SG_ 306 TopPosHmiFeedBack2 0;
BA_ "GenSigStartValue" SG_ 306 TopPosHmiFeedBack2 95;
BA_ "GenSigSendType" SG_ 369 TotDrvPwrAct 0;
BA_ "GenSigStartValue" SG_ 369 TotDrvPwrAct 1000;
BA_ "GenSigSendType" SG_ 721 TotDstToEmptyDstToEmpty 0;
BA_ "GenSigSendType" SG_ 721 TotDstToEmptyDstUnit 0;
BA_ "GenSigSendType" SG_ 63 TotDstTrvld 0;
BA_ "GenSigSendType" SG_ 369 TrHndlOutdOpenSts 0;
BA_ "GenSigSendType" SG_ 306 TrOpenPosn 0;
BA_ "GenSigStartValue" SG_ 306 TrOpenPosn 101;
BA_ "GenSigSendType" SG_ 306 TrOpenerSts 0;
BA_ "GenSigSendType" SG_ 721 TrlrLampChkReqFromHmi 0;
BA_ "GenSigSendType" SG_ 666 TrlrModPrpsnSts 0;
BA_ "GenSigSendType" SG_ 369 TrsmFltIndcn 0;
BA_ "GenSigSendType" SG_ 306 VehActvMsgToDrvr 0;
BA_ "GenSigSendType" SG_ 306 VehEgyCoornDataReq 1;
BA_ "GenSigSendType" SG_ 447 VoiceCtrlLocking 0;
BA_ "GenSigSendType" SG_ 1378 ZCUDMDevpFrameForDebugFunctiondevpsignalgroup1 1;
BA_ "GenSigSendType" SG_ 1378 ZCUDMDevpFrameForDebugFunctiondevpsignalgroup2 1;
BA_ "GenSigSendType" SG_ 1378 ZCUDMDevpFrameForDebugFunctiondevpsignalgroup3 1;
BA_ "GenSigSendType" SG_ 1378 ZCUDMDevpFrameForDebugFunctiondevpsignalgroup4 1;
BA_ "GenSigSendType" SG_ 1378 ZCUDMDevpFrameForDebugFunctiondevpsignalgroup5 1;
BA_ "GenSigSendType" SG_ 1378 ZCUDMDevpFrameForDebugFunctiondevpsignalgroup6 1;
BA_ "GenSigSendType" SG_ 1378 ZCUDMDevpFrameForDebugFunctiondevpsignalgroup7 1;
BA_ "GenSigSendType" SG_ 1378 ZCUDMDevpFrameForDebugFunctiondevpsignalgroup8 1;
BA_ "GenSigSendType" SG_ 1377 ZCUDMdevelpsignalgroupReqFunctiondevpsignalgroup1 1;
BA_ "GenSigSendType" SG_ 1377 ZCUDMdevelpsignalgroupReqFunctiondevpsignalgroup2 1;
BA_ "GenSigSendType" SG_ 1377 ZCUDMdevelpsignalgroupReqFunctiondevpsignalgroup3 1;
BA_ "GenSigSendType" SG_ 1377 ZCUDMdevelpsignalgroupReqFunctiondevpsignalgroup4 1;
BA_ "GenSigSendType" SG_ 1377 ZCUDMdevelpsignalgroupReqFunctiondevpsignalgroup5 1;
BA_ "GenSigSendType" SG_ 1377 ZCUDMdevelpsignalgroupReqFunctiondevpsignalgroup6 1;
BA_ "GenSigSendType" SG_ 1377 ZCUDMdevelpsignalgroupReqFunctiondevpsignalgroup7 1;
BA_ "GenSigSendType" SG_ 1377 ZCUDMdevelpsignalgroupReqFunctiondevpsignalgroup8 1;
BA_ "GenSigSendType" SG_ 1378 ZCUDMdevelpsignalgroupRespFunctiondevpsignalgroup1 1;
BA_ "GenSigSendType" SG_ 1378 ZCUDMdevelpsignalgroupRespFunctiondevpsignalgroup2 1;
BA_ "GenSigSendType" SG_ 1378 ZCUDMdevelpsignalgroupRespFunctiondevpsignalgroup3 1;
BA_ "GenSigSendType" SG_ 1378 ZCUDMdevelpsignalgroupRespFunctiondevpsignalgroup4 1;
BA_ "GenSigSendType" SG_ 1378 ZCUDMdevelpsignalgroupRespFunctiondevpsignalgroup5 1;
BA_ "GenSigSendType" SG_ 1378 ZCUDMdevelpsignalgroupRespFunctiondevpsignalgroup6 1;
BA_ "GenSigSendType" SG_ 1378 ZCUDMdevelpsignalgroupRespFunctiondevpsignalgroup7 1;
BA_ "GenSigSendType" SG_ 1378 ZCUDMdevelpsignalgroupRespFunctiondevpsignalgroup8 1;
BA_ "GenSigSendType" SG_ 1377 ZCUPdevelpsignalgroupReqFunctiondevpsignalgroup1 1;
BA_ "GenSigSendType" SG_ 1377 ZCUPdevelpsignalgroupReqFunctiondevpsignalgroup2 1;
BA_ "GenSigSendType" SG_ 1377 ZCUPdevelpsignalgroupReqFunctiondevpsignalgroup3 1;
BA_ "GenSigSendType" SG_ 1377 ZCUPdevelpsignalgroupReqFunctiondevpsignalgroup4 1;
BA_ "GenSigSendType" SG_ 1377 ZCUPdevelpsignalgroupReqFunctiondevpsignalgroup5 1;
BA_ "GenSigSendType" SG_ 1377 ZCUPdevelpsignalgroupReqFunctiondevpsignalgroup6 1;
BA_ "GenSigSendType" SG_ 1377 ZCUPdevelpsignalgroupReqFunctiondevpsignalgroup7 1;
BA_ "GenSigSendType" SG_ 1377 ZCUPdevelpsignalgroupReqFunctiondevpsignalgroup8 1;
VAL_ 371 AmbTIndcdWithUnitAmbTIndcdUnit 0 "AmbTIndcdUnit_Celsius" 1 "AmbTIndcdUnit_Fahrenheit" 2 "AmbTIndcdUnit_UkwnUnit";
VAL_ 371 AmbTIndcdWithUnitQF 0 "GenQf1_UndefindDataAccur" 1 "GenQf1_TmpUndefdData" 2 "GenQf1_DataAccurNotWithinSpcn" 3 "GenQf1_AccurData";
VAL_ 371 BltRmnTelltl 0 "Trig1_NoTrig" 1 "Trig1_Trig";
VAL_ 371 DrvrCrsCtrlFctDeactvnReq 0 "OnOff1_Off" 1 "OnOff1_On";
VAL_ 371 DrvrCrsCtrlFctReActvReq 0 "OnOff1_Off" 1 "OnOff1_On";
VAL_ 371 DrvrCrsCtrlFctSeld 0 "DrvrCrsCtrlFctSeldTyp_Off" 1 "DrvrCrsCtrlFctSeldTyp_SpdLimFct_Main_Swt" 2 "DrvrCrsCtrlFctSeldTyp_SpdLimFct_Resu" 3 "DrvrCrsCtrlFctSeldTyp_CrsCtrlFct_Main_Swt" 4 "DrvrCrsCtrlFctSeldTyp_CrsCtrlFct_Resu" 5 "DrvrCrsCtrlFctSeldTyp_AccFct_Main_Swt" 6 "DrvrCrsCtrlFctSeldTyp_AccFct_Resu" 7 "DrvrCrsCtrlFctSeldTyp_OffRoadCrsCtrlFc";
VAL_ 371 FuFillgDetnForUseInt 0 "NoYes1_No" 1 "NoYes1_Yes";
VAL_ 371 FuLvlRawActvSideGenQF 0 "GenQf1_UndefindDataAccur" 1 "GenQf1_TmpUndefdData" 2 "GenQf1_DataAccurNotWithinSpcn" 3 "GenQf1_AccurData";
VAL_ 371 FuLvlRawPasSideGenQF 0 "GenQf1_UndefindDataAccur" 1 "GenQf1_TmpUndefdData" 2 "GenQf1_DataAccurNotWithinSpcn" 3 "GenQf1_AccurData";
VAL_ 371 PwrCnsAvgIndcdPwrCnsUnit 0 "PwrCnsUnit_KWhPer100Km" 1 "PwrCnsUnit_KWhPer100Mile";
VAL_ 371 RstTrip1 0 "RstTrip1_Idle" 1 "RstTrip1_ManualResetAll" 2 "RstTrip1_MaximumResetAll" 3 "RstTrip1_RstTripCompterDataRstAEC" 4 "RstTrip1_RstTripCompterDataRstAFC" 5 "RstTrip1_RstTripCompterDataRstAVS" 6 "RstTrip1_RstTripCompterDataRstEDT" 7 "RstTrip1_RstTripCompterDataRstALL" 8 "RstTrip1_RstTripCompterDataManRst" 9 "RstTrip1_RstTripCompterDataRstTrip" 10 "RstTrip1_OdoReset" 11 "RstTrip1_Reserve2" 12 "RstTrip1_Reserve3" 13 "RstTrip1_Reserve4" 14 "RstTrip1_Reserve5" 15 "RstTrip1_Reserve6";
VAL_ 371 RstTrip2 0 "RstTrip2_Idle" 1 "RstTrip2_NewTripRestting" 2 "RstTrip2_FuelfillORchargReset" 3 "RstTrip2_ManualReset" 4 "RstTrip2_MaximumReset" 5 "RstTrip2_OdoReset" 6 "RstTrip2_Reserve2" 7 "RstTrip2_Reserve3";
VAL_ 721 AmbTUnitForUseInt 0 "AmbTIndcdUnit_Celsius" 1 "AmbTIndcdUnit_Fahrenheit" 2 "AmbTIndcdUnit_UkwnUnit";
VAL_ 721 CarModDynoCnfrm 0 "CarModDynoCnfrm_Cfmd1" 1 "CarModDynoCnfrm_NotCfmd1" 2 "CarModDynoCnfrm_Cfmd2" 3 "CarModDynoCnfrm_NotCfmd2" 4 "CarModDynoCnfrm_WhlDrv2" 5 "CarModDynoCnfrm_WhlDrv4" 6 "CarModDynoCnfrm_ExitDyno" 7 "CarModDynoCnfrm_StayInDyno" 8 "CarModDynoCnfrm_Resd1" 9 "CarModDynoCnfrm_Resd2" 10 "CarModDynoCnfrm_Resd3" 11 "CarModDynoCnfrm_Resd4" 12 "CarModDynoCnfrm_Resd5" 13 "CarModDynoCnfrm_Resd6" 14 "CarModDynoCnfrm_Resd7" 15 "CarModDynoCnfrm_Resd8";
VAL_ 721 FuLvlLoIndcn 0 "Trig1_NoTrig" 1 "Trig1_Trig";
VAL_ 721 FuLvlLoWarn 0 "Trig1_NoTrig" 1 "Trig1_Trig";
VAL_ 721 KeyLostWarnIndcnAckd 0 "OnOff1_Off" 1 "OnOff1_On";
VAL_ 721 ReqForPassAirbIndcnAckd 0 "ReqForPassAirbIndcnAckd_Idle" 1 "ReqForPassAirbIndcnAckd_MsgAckd";
VAL_ 721 SrvRst 0 "Trig1_NoTrig" 1 "Trig1_Trig";
VAL_ 721 TotDstToEmptyDstUnit 0 "DstUnit_km" 1 "DstUnit_miles";
VAL_ 721 TrlrLampChkReqFromHmi 0 "StrtStopReq1_Idle" 1 "StrtStopReq1_StrtReq" 2 "StrtStopReq1_StopReq" 3 "StrtStopReq1_Resd";
VAL_ 558 AudWarnActv 0 "NoYesCrit1_NotVld1" 1 "NoYesCrit1_No" 2 "NoYesCrit1_Yes" 3 "NoYesCrit1_NotVld2";
VAL_ 63 ActvnOfDefdLiShow 0 "OnOff1_Off" 1 "OnOff1_On";
VAL_ 63 MusicShowPlaySts 0 "OnOff1_Off" 1 "OnOff1_On";
VAL_ 63 StreamingMirrBriAutoAdjmt 0 "OnOff1_Off" 1 "OnOff1_On";
VAL_ 63 StreamingMirrSwt 0 "OnOff1_Off" 1 "OnOff1_On";
VAL_ 461 CushExtnFirstDrvr 0 "SwtHozlSts1_Idle" 1 "SwtHozlSts1_Fwd" 2 "SwtHozlSts1_Backw";
VAL_ 461 FirstRowSeatInhbByMod 0 "ParkAssiLeRi1_None" 1 "ParkAssiLeRi1_Left" 2 "ParkAssiLeRi1_Right" 3 "ParkAssiLeRi1_LeftAndRight";
VAL_ 461 MagicCarpetSuspSet 0 "NoYes1_No" 1 "NoYes1_Yes";
VAL_ 461 PwrOutlOffSet 0 "PwrOutlOffSet_Off" 1 "PwrOutlOffSet_Level1" 2 "PwrOutlOffSet_Level2" 3 "PwrOutlOffSet_Level3" 4 "PwrOutlOffSet_Level4" 5 "PwrOutlOffSet_Level5" 6 "PwrOutlOffSet_Reserved" 7 "PwrOutlOffSet_NoReq";
VAL_ 461 PwrSldgDoorAutClsEnaHmiReq 0 "EnableDisableCoding_Disabled" 1 "EnableDisableCoding_Enabled";
VAL_ 461 RuranACModeSet 0 "RuranACModeSet_Classic" 1 "RuranACModeSet_ClodDew" 2 "RuranACModeSet_MorningBreeze" 3 "RuranACModeSet_WarnSun" 4 "RuranACModeSet_Fireplace" 5 "RuranACModeSet_Reserved" 6 "RuranACModeSet_Reserved1" 7 "RuranACModeSet_Reserved2";
VAL_ 461 SldngDoorLeReAutoManReq 0 "OnOffNoReq_NoReq" 1 "OnOffNoReq_On" 2 "OnOffNoReq_Off";
VAL_ 461 SldngDoorRiReAutoManReq 0 "OnOffNoReq_NoReq" 1 "OnOffNoReq_On" 2 "OnOffNoReq_Off";
VAL_ 447 DrvrSeatDispSwtFctMod 0 "SwtFctMod_Mod1" 1 "SwtFctMod_Mod2" 2 "SwtFctMod_Mod3" 3 "SwtFctMod_Mod4";
VAL_ 447 PassSeatDispSwtFctMod 0 "SwtFctMod_Mod1" 1 "SwtFctMod_Mod2" 2 "SwtFctMod_Mod3" 3 "SwtFctMod_Mod4";
VAL_ 447 SbwSteerBackToCenterSetgSetg 0 "NoYes1_No" 1 "NoYes1_Yes";
VAL_ 447 SbwSteerRatiosFolwSpdSetgSetg 0 "NoYes1_No" 1 "NoYes1_Yes";
VAL_ 447 SbwSteerRatiosLvlSetgSetg 0 "Level3_Level1" 1 "Level3_Level2" 2 "Level3_Level3" 3 "Level3_Level4" 4 "Level3_Level5" 5 "Level3_Level6" 6 "Level3_Level7" 7 "Level3_Level8";
VAL_ 447 SbwSteerRemainsStatySetgSetg 0 "NoYes1_No" 1 "NoYes1_Yes";
VAL_ 447 VoiceCtrlLocking 0 "OnOff1_Off" 1 "OnOff1_On";
VAL_ 356 AudWarnOfSnsrParkAssiRe1 0 "BuzzerReq_BuzzerOFF" 1 "BuzzerReq_BuzzerON" 2 "BuzzerReq_BuzzerONat4Hz" 3 "BuzzerReq_BuzzerONat2Hz" 4 "BuzzerReq_LeftON" 5 "BuzzerReq_LeftONat4Hz" 6 "BuzzerReq_LeftONat2Hz" 7 "BuzzerReq_RightON" 8 "BuzzerReq_RightONat4Hz" 9 "BuzzerReq_RightONat2Hz";
VAL_ 356 BlutoothPhoneWorkingSts 0 "BlutoothPhoneWorkingSts_NoCall" 1 "BlutoothPhoneWorkingSts_CallsIn" 2 "BlutoothPhoneWorkingSts_DialOut" 3 "BlutoothPhoneWorkingSts_TwoWayCalls" 4 "BlutoothPhoneWorkingSts_ThreeWayCalls";
VAL_ 356 SphDvExtnLg 0 "NoResponse" 1 "Updateprocessing" 2 "Updatesucess" 3 "Updatefail_NoSDcard" 4 "Updatefail_NoFile" 5 "Updatefail_Fileerror" 6 "Updatefail_otherreason" 7 "Reserved";
VAL_ 1169 AccmFltSts 0 "TMcloudFltSts_NoFault" 1 "TMcloudFltSts_CPSRPowerOff" 2 "TMcloudFltSts_FaultByAmbientTemp" 3 "TMcloudFltSts_CPSRVoltageFault" 4 "TMcloudFltSts_MissingMessage" 10 "TMcloudFltSts_InitializationUnsuccess" 11 "TMcloudFltSts_Fault" 12 "TMcloudFltSts_Blocked" 13 "TMcloudFltSts_HighTempFault" 14 "TMcloudFltSts_Resd";
VAL_ 1169 AccrpedlStsFltSts 0 "Flt_NoFault" 1 "Flt_Fault";
VAL_ 1169 ActnOfAssistantLi 0 "OnOff1_Off" 1 "OnOff1_On";
VAL_ 1169 ActnOfDynEDIForChrgn 0 "OnOff1_Off" 1 "OnOff1_On";
VAL_ 1169 ActnOfLedHiBeam 0 "OnOff1_Off" 1 "OnOff1_On";
VAL_ 1169 ActnOfLedLoBeamActnOfLedLoBeam 0 "OnOff1_Off" 1 "OnOff1_On";
VAL_ 1169 ActvnOfEIDForVSTD 0 "AlrmSt_Disarmd" 1 "AlrmSt_Armd" 2 "AlrmSt_Actv";
VAL_ 1169 ActvnOfShowModLi 0 "OnOff1_Off" 1 "OnOff1_On";
VAL_ 1169 ActvnOfWiprRe 0 "OnOff1_Off" 1 "OnOff1_On";
VAL_ 1169 AgmFltSts 0 "TMcloudFltSts_NoFault" 1 "TMcloudFltSts_CPSRPowerOff" 2 "TMcloudFltSts_FaultByAmbientTemp" 3 "TMcloudFltSts_CPSRVoltageFault" 4 "TMcloudFltSts_MissingMessage" 10 "TMcloudFltSts_InitializationUnsuccess" 11 "TMcloudFltSts_Fault" 12 "TMcloudFltSts_Blocked" 13 "TMcloudFltSts_HighTempFault" 14 "TMcloudFltSts_Resd";
VAL_ 1169 AsySftyStandStillReq 0 "OnOff1_Off" 1 "OnOff1_On";
VAL_ 1169 BattSnsrCalcnNotVldRaw 0 "DevErrSts2_NoFlt" 1 "DevErrSts2_Flt";
VAL_ 1169 BattSnsrHwFltRaw 0 "DevErrSts2_NoFlt" 1 "DevErrSts2_Flt";
VAL_ 1169 BcpfFltSts 0 "TMcloudFltSts_NoFault" 1 "TMcloudFltSts_CPSRPowerOff" 2 "TMcloudFltSts_FaultByAmbientTemp" 3 "TMcloudFltSts_CPSRVoltageFault" 4 "TMcloudFltSts_MissingMessage" 10 "TMcloudFltSts_InitializationUnsuccess" 11 "TMcloudFltSts_Fault" 12 "TMcloudFltSts_Blocked" 13 "TMcloudFltSts_HighTempFault" 14 "TMcloudFltSts_Resd";
VAL_ 1169 BexvFltSts 0 "TMcloudFltSts_NoFault" 1 "TMcloudFltSts_CPSRPowerOff" 2 "TMcloudFltSts_FaultByAmbientTemp" 3 "TMcloudFltSts_CPSRVoltageFault" 4 "TMcloudFltSts_MissingMessage" 10 "TMcloudFltSts_InitializationUnsuccess" 11 "TMcloudFltSts_Fault" 12 "TMcloudFltSts_Blocked" 13 "TMcloudFltSts_HighTempFault" 14 "TMcloudFltSts_Resd";
VAL_ 1169 CarModDispdWdDispd 0 "CarModDisp1_NoDisp" 1 "CarModDisp1_Facy" 2 "CarModDisp1_FacyStop" 3 "CarModDisp1_Trnsp" 4 "CarModDisp1_TrnspStop" 5 "CarModDisp1_Dyno" 6 "CarModDisp1_Norm" 7 "CarModDisp1_Crash";
VAL_ 1169 CarModDynoReq 1 "CarModDynoReq_Cnfrm1" 2 "CarModDynoReq_Cnfrm2" 3 "CarModDynoReq_Confg" 4 "CarModDynoReq_Dyno";
VAL_ 1169 CcvFltSts 0 "TMcloudFltSts_NoFault" 1 "TMcloudFltSts_CPSRPowerOff" 2 "TMcloudFltSts_FaultByAmbientTemp" 3 "TMcloudFltSts_CPSRVoltageFault" 4 "TMcloudFltSts_MissingMessage" 10 "TMcloudFltSts_InitializationUnsuccess" 11 "TMcloudFltSts_Fault" 12 "TMcloudFltSts_Blocked" 13 "TMcloudFltSts_HighTempFault" 14 "TMcloudFltSts_Resd";
VAL_ 1169 CcvmFltSts 0 "TMcloudFltSts_NoFault" 1 "TMcloudFltSts_CPSRPowerOff" 2 "TMcloudFltSts_FaultByAmbientTemp" 3 "TMcloudFltSts_CPSRVoltageFault" 4 "TMcloudFltSts_MissingMessage" 10 "TMcloudFltSts_InitializationUnsuccess" 11 "TMcloudFltSts_Fault" 12 "TMcloudFltSts_Blocked" 13 "TMcloudFltSts_HighTempFault" 14 "TMcloudFltSts_Resd";
VAL_ 1169 CnvnAllwd 0 "OkNotOk_NotOk" 1 "OkNotOk_Ok";
VAL_ 1169 CnvnReq 0 "CnvnReq_NotReqd" 1 "CnvnReq_Chrgn" 2 "CnvnReq_Resd1" 3 "CnvnReq_Resd2" 4 "CnvnReq_Resd3" 5 "CnvnReq_Resd4" 6 "CnvnReq_Resd5" 7 "CnvnReq_Resd6";
VAL_ 1169 DoorDrvrSwtIntrLockgReq 0 "LockgCenReq2_Idle" 1 "LockgCenReq2_Unlck" 2 "LockgCenReq2_Lock";
VAL_ 1169 DrvrSteerWhlHldGroupDrvrSteerWhlHld 0 "OnOffDetd1_NoInfo" 1 "OnOffDetd1_OffDetd" 2 "OnOffDetd1_NotOnOrOffDetd" 3 "OnOffDetd1_OnDetd";
VAL_ 1169 EdcpFltSts 0 "TMcloudFltSts_NoFault" 1 "TMcloudFltSts_CPSRPowerOff" 2 "TMcloudFltSts_FaultByAmbientTemp" 3 "TMcloudFltSts_CPSRVoltageFault" 4 "TMcloudFltSts_MissingMessage" 10 "TMcloudFltSts_InitializationUnsuccess" 11 "TMcloudFltSts_Fault" 12 "TMcloudFltSts_Blocked" 13 "TMcloudFltSts_HighTempFault" 14 "TMcloudFltSts_Resd";
VAL_ 1169 EexvFltSts 0 "TMcloudFltSts_NoFault" 1 "TMcloudFltSts_CPSRPowerOff" 2 "TMcloudFltSts_FaultByAmbientTemp" 3 "TMcloudFltSts_CPSRVoltageFault" 4 "TMcloudFltSts_MissingMessage" 10 "TMcloudFltSts_InitializationUnsuccess" 11 "TMcloudFltSts_Fault" 12 "TMcloudFltSts_Blocked" 13 "TMcloudFltSts_HighTempFault" 14 "TMcloudFltSts_Resd";
VAL_ 1169 ElecMot2ModReq 0 "IsgModTyp1_Inin" 1 "IsgModTyp1_Stb" 2 "IsgModTyp1_TqCtrl" 3 "IsgModTyp1_SpdCtrl" 4 "IsgModTyp1_UDcCtrl" 5 "IsgModTyp1_PreChrg" 6 "IsgModTyp1_PwrDwn" 7 "IsgModTyp1_Flt" 8 "IsgModTyp1_TcsCtrl" 9 "IsgModTyp1_Reserved1" 10 "IsgModTyp1_Reserved2" 11 "IsgModTyp1_Reserved3" 12 "IsgModTyp1_Reserved4" 13 "IsgModTyp1_Reserved5" 14 "IsgModTyp1_Reserved6" 15 "IsgModTyp1_Reserved7";
VAL_ 1169 ElecStepDrvr 0 "OnOffNoReq_NoReq" 1 "OnOffNoReq_On" 2 "OnOffNoReq_Off";
VAL_ 1169 ElecStepPass 0 "OnOffNoReq_NoReq" 1 "OnOffNoReq_On" 2 "OnOffNoReq_Off";
VAL_ 306 ActnOfDaytiRunngLampPass 0 "OnOff1_Off" 1 "OnOff1_On";
VAL_ 306 ActnOfFrntFogLampPass 0 "OnOff1_Off" 1 "OnOff1_On";
VAL_ 306 ActnOfFrntPosnLampPass 0 "OnOff1_Off" 1 "OnOff1_On";
VAL_ 306 ActnOfHiBeamPass 0 "OnOff1_Off" 1 "OnOff1_On";
VAL_ 306 ActnOfLedLeLogoLampDyn 0 "OnOff1_Off" 1 "OnOff1_On";
VAL_ 306 ActnOfLoBeamPassOnOff 0 "OnOff1_Off" 1 "OnOff1_On";
VAL_ 306 ActnOfReFogLampDrv 0 "OnOff1_Off" 1 "OnOff1_On";
VAL_ 306 ActnOfRePosnLampPass 0 "OnOff1_Off" 1 "OnOff1_On";
VAL_ 306 ActnOfReRegPlateLamp 0 "OnOff1_Off" 1 "OnOff1_On";
VAL_ 306 ActnOfRvsgLampPass 0 "OnOff1_Off" 1 "OnOff1_On";
VAL_ 306 ActvnOfApproach 0 "OnOff1_Off" 1 "OnOff1_On";
VAL_ 306 ActvnOfCarLoctr 0 "OnOff1_Off" 1 "OnOff1_On";
VAL_ 306 ActvnOfGoodByeLi 0 "OnOff1_Off" 1 "OnOff1_On";
VAL_ 306 ActvnOfHndlDoorLi1HndlDoorLiDrvr 0 "ApproachLiSetReq_Off" 1 "ApproachLiSetReq_ONStatic" 2 "ApproachLiSetReq_ONDynamic";
VAL_ 306 ActvnOfHndlDoorLi1HndlDoorLiDrvrRe 0 "ApproachLiSetReq_Off" 1 "ApproachLiSetReq_ONStatic" 2 "ApproachLiSetReq_ONDynamic";
VAL_ 306 ActvnOfHndlDoorLi1HndlDoorLiPass 0 "ApproachLiSetReq_Off" 1 "ApproachLiSetReq_ONStatic" 2 "ApproachLiSetReq_ONDynamic";
VAL_ 306 ActvnOfHndlDoorLi1HndlDoorLiPassRe 0 "ApproachLiSetReq_Off" 1 "ApproachLiSetReq_ONStatic" 2 "ApproachLiSetReq_ONDynamic";
VAL_ 306 ActvnOfHomeSafe 0 "OnOff1_Off" 1 "OnOff1_On";
VAL_ 306 ActvnOfLiForComity 0 "OnOff1_Off" 1 "OnOff1_On";
VAL_ 306 ActvnOfLiForSpkr 0 "OnOff1_Off" 1 "OnOff1_On";
VAL_ 306 ActvnOfLiForWait 0 "OnOff1_Off" 1 "OnOff1_On";
VAL_ 306 ActvnOfPudLi 0 "OnOff1_Off" 1 "OnOff1_On";
VAL_ 306 ActvnOfSideLogo 0 "ApproachLiSetReq_Off" 1 "ApproachLiSetReq_ONStatic" 2 "ApproachLiSetReq_ONDynamic";
VAL_ 306 ActvnOfWaitMode 0 "OnOff1_Off" 1 "OnOff1_On";
VAL_ 306 ChdLockLeftSts 0 "OnOffSafe1_OnOffSafeInvld1" 1 "OnOffSafe1_OnOffSafeOn" 2 "OnOffSafe1_OnOffSafeOff" 3 "OnOffSafe1_OnOffSafeInvld2";
VAL_ 306 ChdLockRightStsToHmi 0 "OnOffSafe1_OnOffSafeInvld1" 1 "OnOffSafe1_OnOffSafeOn" 2 "OnOffSafe1_OnOffSafeOff" 3 "OnOffSafe1_OnOffSafeInvld2";
VAL_ 306 ChdPrtnLeftStsToHmi 0 "OnOffSafe1_OnOffSafeInvld1" 1 "OnOffSafe1_OnOffSafeOn" 2 "OnOffSafe1_OnOffSafeOff" 3 "OnOffSafe1_OnOffSafeInvld2";
VAL_ 306 ChrgLidCombLockCmd 0 "LockActvn2_LockActvnOff" 1 "LockActvn2_LockActvnUnlck" 2 "LockActvn2_LockActvnLock" 3 "LockActvn2_LockActvnSafe" 4 "LockActvn2_LockActvnUnlckByCrash";
VAL_ 306 ChrgnLtgSts 0 "DevSts4_Off" 1 "DevSts4_On" 2 "DevSts4_Err" 3 "DevSts4_Resd";
VAL_ 306 CinhDrvrReSts 0 "PsdNotPsd1_NotPsd" 1 "PsdNotPsd1_Psd";
VAL_ 306 CinhDrvrReSwt 0 "PsdNotPsd1_NotPsd" 1 "PsdNotPsd1_Psd";
VAL_ 306 CinhDrvrSts 0 "Boolean_FALSE" 1 "Boolean_TRUE";
VAL_ 306 CinhDrvrSwt 0 "PsdNotPsd1_NotPsd" 1 "PsdNotPsd1_Psd";
VAL_ 306 DigKeyPasEntryDiSts 0 "OnOff1_Off" 1 "OnOff1_On";
VAL_ 306 DlyClsActv 0 "Boolean_FALSE" 1 "Boolean_TRUE";
VAL_ 306 DoorLeReHndlCmd 0 "DoorHndlCmd_Idle" 1 "DoorHndlCmd_Deploy" 2 "DoorHndlCmd_Retract";
VAL_ 306 DrvrGearLvrInfoIndcn 0 "BrkMsgWarn1_NoReq" 1 "BrkMsgWarn1_Msg1" 2 "BrkMsgWarn1_Msg2" 3 "BrkMsgWarn1_Msg3" 4 "BrkMsgWarn1_Msg4" 5 "BrkMsgWarn1_Msg5" 6 "BrkMsgWarn1_Msg6" 7 "BrkMsgWarn1_Msg7";
VAL_ 306 DrvrGearLvrLockIndcn 0 "DrvrGearLvrLockIndcn3_NoIndcn" 1 "DrvrGearLvrLockIndcn3_GearLvrRelsByBrkPedl" 2 "DrvrGearLvrLockIndcn3_GearLvrMovmtToManNotAllwd" 3 "DrvrGearLvrLockIndcn3_EngStrtNoPsbl" 4 "DrvrGearLvrLockIndcn3_ChgOfVehMovmtDirNotPsbl" 5 "DrvrGearLvrLockIndcn3_GearShiftSrvRqrd" 6 "DrvrGearLvrLockIndcn3_ManModActvd" 7 "DrvrGearLvrLockIndcn3_ReleaseLockButton" 8 "DrvrGearLvrLockIndcn3_GearLvrRelsByBrkPedlAndLockButton" 9 "DrvrGearLvrLockIndcn3_RetuenShifterToInitialState" 10 "DrvrGearLvrLockIndcn3_ShiftToDOrMToAllowManualMode" 11 "DrvrGearLvrLockIndcn3_StopPushingPButton" 12 "DrvrGearLvrLockIndcn3_StopPushingLockButton" 13 "DrvrGearLvrLockIndcn3_ReturnPaddleToInitialState" 14 "DrvrGearLvrLockIndcn3_PLockUnavailable" 15 "DrvrGearLvrLockIndcn3_HoldNeuralPosition";
VAL_ 306 DstTrvldVldFromSftyBkp 0 "InvldVld1_Invld" 1 "InvldVld1_Vld";
VAL_ 306 EmgyBrkLiIndcrTurn 0 "OnOffCrit1_NotVld1" 1 "OnOffCrit1_Off" 2 "OnOffCrit1_On" 3 "OnOffCrit1_NotVld2";
VAL_ 306 ErsStrtApplSts 0 "ErsStrtApplSts_ErsStsOff" 1 "ErsStrtApplSts_ErsStsStrtg" 2 "ErsStrtApplSts_ErsStsRunng";
VAL_ 306 ExtrLiShowStoreStsFrntLe 0 "OnOff1_Off" 1 "OnOff1_On";
VAL_ 306 ExtrLiShowStoreStsFrntRi 0 "OnOff1_Off" 1 "OnOff1_On";
VAL_ 306 ExtrLiShowStoreStsReLe1 0 "OnOff1_Off" 1 "OnOff1_On";
VAL_ 306 ExtrLiShowStoreStsReRi1 0 "OnOff1_Off" 1 "OnOff1_On";
VAL_ 306 GlvBoxRelsReq 0 "OnOff1_Off" 1 "OnOff1_On";
VAL_ 306 HvBattHeatgReq 0 "HvBattCoolgReq_NotReqd" 1 "HvBattCoolgReq_LoReq" 2 "HvBattCoolgReq_MedReq" 3 "HvBattCoolgReq_HiReq";
VAL_ 306 IndcrNoSeq 0 "OnOff1_Off" 1 "OnOff1_On";
VAL_ 306 KeyEnaStsKey0 0 "KeySts1_KeyStsIdle" 1 "KeySts1_KeyStsDi" 2 "KeySts1_KeyStsEna" 3 "KeySts1_KeyStsLimd";
VAL_ 306 KeyEnaStsKey1 0 "KeySts1_KeyStsIdle" 1 "KeySts1_KeyStsDi" 2 "KeySts1_KeyStsEna" 3 "KeySts1_KeyStsLimd";
VAL_ 306 KeyEnaStsKey10 0 "KeySts1_KeyStsIdle" 1 "KeySts1_KeyStsDi" 2 "KeySts1_KeyStsEna" 3 "KeySts1_KeyStsLimd";
VAL_ 306 KeyEnaStsKey11 0 "KeySts1_KeyStsIdle" 1 "KeySts1_KeyStsDi" 2 "KeySts1_KeyStsEna" 3 "KeySts1_KeyStsLimd";
VAL_ 306 KeyEnaStsKey2 0 "KeySts1_KeyStsIdle" 1 "KeySts1_KeyStsDi" 2 "KeySts1_KeyStsEna" 3 "KeySts1_KeyStsLimd";
VAL_ 306 KeyEnaStsKey3 0 "KeySts1_KeyStsIdle" 1 "KeySts1_KeyStsDi" 2 "KeySts1_KeyStsEna" 3 "KeySts1_KeyStsLimd";
VAL_ 306 KeyEnaStsKey4 0 "KeySts1_KeyStsIdle" 1 "KeySts1_KeyStsDi" 2 "KeySts1_KeyStsEna" 3 "KeySts1_KeyStsLimd";
VAL_ 306 KeyEnaStsKey5 0 "KeySts1_KeyStsIdle" 1 "KeySts1_KeyStsDi" 2 "KeySts1_KeyStsEna" 3 "KeySts1_KeyStsLimd";
VAL_ 306 KeyEnaStsKey6 0 "KeySts1_KeyStsIdle" 1 "KeySts1_KeyStsDi" 2 "KeySts1_KeyStsEna" 3 "KeySts1_KeyStsLimd";
VAL_ 306 KeyEnaStsKey7 0 "KeySts1_KeyStsIdle" 1 "KeySts1_KeyStsDi" 2 "KeySts1_KeyStsEna" 3 "KeySts1_KeyStsLimd";
VAL_ 306 KeyEnaStsKey8 0 "KeySts1_KeyStsIdle" 1 "KeySts1_KeyStsDi" 2 "KeySts1_KeyStsEna" 3 "KeySts1_KeyStsLimd";
VAL_ 306 KeyEnaStsKey9 0 "KeySts1_KeyStsIdle" 1 "KeySts1_KeyStsDi" 2 "KeySts1_KeyStsEna" 3 "KeySts1_KeyStsLimd";
VAL_ 306 KeyScanActv 0 "Boolean_FALSE" 1 "Boolean_TRUE";
VAL_ 306 MirrDefrstAtPassCmd 0 "OnOff1_Off" 1 "OnOff1_On";
VAL_ 306 MirrDwnStsAtDrvr 0 "MirrDwnStsTyp_MirrTiltUndefd" 1 "MirrDwnStsTyp_MirrUpPosn" 2 "MirrDwnStsTyp_MirrTiltPosn" 3 "MirrDwnStsTyp_MirrMovgToUpPosn" 4 "MirrDwnStsTyp_MirrMovgToTiltPosn";
VAL_ 306 PedProtnMsgReqForFlt 0 "OnOffCrit1_NotVld1" 1 "OnOffCrit1_Off" 2 "OnOffCrit1_On" 3 "OnOffCrit1_NotVld2";
VAL_ 306 PedProtnMsgReqForImpct 0 "OnOff1_Off" 1 "OnOff1_On";
VAL_ 306 PrpsnHvBattUsgOfChrgBlkd2 0 "HvBattUsgBlkdTyp_NotBlkd" 1 "HvBattUsgBlkdTyp_BlkdByBattLvl" 2 "HvBattUsgBlkdTyp_BlkdBySysFlt" 3 "HvBattUsgBlkdTyp_NotOfUse";
VAL_ 306 PrpsnHvBattUsgOfHldBlkd2 0 "HvBattUsgBlkdTyp_NotBlkd" 1 "HvBattUsgBlkdTyp_BlkdByBattLvl" 2 "HvBattUsgBlkdTyp_BlkdBySysFlt" 3 "HvBattUsgBlkdTyp_NotOfUse";
VAL_ 306 RegenAutLvlNotAvlMsg 0 "OnOff1_Off" 1 "OnOff1_On";
VAL_ 306 RestrntSysLampReq 0 "RestrntSysLampReq_LampOff" 1 "RestrntSysLampReq_Ukwn" 2 "RestrntSysLampReq_LampFlash" 3 "RestrntSysLampReq_LampOn";
VAL_ 306 RestrntSysMsgReq 0 "OnOffCrit1_NotVld1" 1 "OnOffCrit1_Off" 2 "OnOffCrit1_On" 3 "OnOffCrit1_NotVld2";
VAL_ 306 SeatHeatgLvlStsRowSecLe 0 "SeatClimaLvl_Off" 1 "SeatClimaLvl_Lvl1" 2 "SeatClimaLvl_Lvl2" 3 "SeatClimaLvl_Lvl3";
VAL_ 306 SeatHeatgLvlStsRowSecRi 0 "SeatClimaLvl_Off" 1 "SeatClimaLvl_Lvl1" 2 "SeatClimaLvl_Lvl2" 3 "SeatClimaLvl_Lvl3";
VAL_ 306 SeatHeatgLvlStsRowThrdLe 0 "SeatClimaLvl_Off" 1 "SeatClimaLvl_Lvl1" 2 "SeatClimaLvl_Lvl2" 3 "SeatClimaLvl_Lvl3";
VAL_ 306 SeatHeatgLvlStsRowThrdRi 0 "SeatClimaLvl_Off" 1 "SeatClimaLvl_Lvl1" 2 "SeatClimaLvl_Lvl2" 3 "SeatClimaLvl_Lvl3";
VAL_ 306 SeatRowSecLeSwtStsPassSeatSwtAdjmtOfSpplFctHozlSts 0 "SwtHozlSts1_Idle" 1 "SwtHozlSts1_Fwd" 2 "SwtHozlSts1_Backw";
VAL_ 306 SeatRowSecLeSwtStsPassSeatSwtAdjmtOfSpplFctVerSts 0 "SwtVertSts1_Idle" 1 "SwtVertSts1_Up" 2 "SwtVertSts1_Dwn";
VAL_ 306 SeatRowSecLeSwtStsPassSeatSwtHdrstHozlSts 0 "SwtHozlSts1_Idle" 1 "SwtHozlSts1_Fwd" 2 "SwtHozlSts1_Backw";
VAL_ 306 SeatRowSecLeSwtStsPassSeatSwtHdrstVertSts 0 "SwtVertSts1_Idle" 1 "SwtVertSts1_Up" 2 "SwtVertSts1_Dwn";
VAL_ 306 SeatRowSecLeSwtStsPassSeatSwtHeiFrntSts 0 "SwtVertSts1_Idle" 1 "SwtVertSts1_Up" 2 "SwtVertSts1_Dwn";
VAL_ 306 SeatRowSecLeSwtStsPassSeatSwtHeiSts 0 "SwtVertSts1_Idle" 1 "SwtVertSts1_Up" 2 "SwtVertSts1_Dwn";
VAL_ 306 SeatRowSecLeSwtStsPassSeatSwtInclSts 0 "SwtHozlSts1_Idle" 1 "SwtHozlSts1_Fwd" 2 "SwtHozlSts1_Backw";
VAL_ 306 SeatRowSecLeSwtStsPassSeatSwtSelnOfSpplFctStsSts 0 "SwtVertSts1_Idle" 1 "SwtVertSts1_Up" 2 "SwtVertSts1_Dwn";
VAL_ 306 SeatRowSecLeSwtStsPassSeatSwtSldSts 0 "SwtHozlSts1_Idle" 1 "SwtHozlSts1_Fwd" 2 "SwtHozlSts1_Backw";
VAL_ 306 SeatRowSecRiSwtStsPassSeatSwtAdjmtOfSpplFctHozlSts 0 "SwtHozlSts1_Idle" 1 "SwtHozlSts1_Fwd" 2 "SwtHozlSts1_Backw";
VAL_ 306 SeatRowSecRiSwtStsPassSeatSwtAdjmtOfSpplFctVerSts 0 "SwtVertSts1_Idle" 1 "SwtVertSts1_Up" 2 "SwtVertSts1_Dwn";
VAL_ 306 SeatRowSecRiSwtStsPassSeatSwtHdrstHozlSts 0 "SwtHozlSts1_Idle" 1 "SwtHozlSts1_Fwd" 2 "SwtHozlSts1_Backw";
VAL_ 306 SeatRowSecRiSwtStsPassSeatSwtHdrstVertSts 0 "SwtVertSts1_Idle" 1 "SwtVertSts1_Up" 2 "SwtVertSts1_Dwn";
VAL_ 306 SeatRowSecRiSwtStsPassSeatSwtHeiFrntSts 0 "SwtVertSts1_Idle" 1 "SwtVertSts1_Up" 2 "SwtVertSts1_Dwn";
VAL_ 306 SeatRowSecRiSwtStsPassSeatSwtHeiSts 0 "SwtVertSts1_Idle" 1 "SwtVertSts1_Up" 2 "SwtVertSts1_Dwn";
VAL_ 306 SeatRowSecRiSwtStsPassSeatSwtInclSts 0 "SwtHozlSts1_Idle" 1 "SwtHozlSts1_Fwd" 2 "SwtHozlSts1_Backw";
VAL_ 306 SeatRowSecRiSwtStsPassSeatSwtSelnOfSpplFctStsSts 0 "SwtVertSts1_Idle" 1 "SwtVertSts1_Up" 2 "SwtVertSts1_Dwn";
VAL_ 306 SeatRowSecRiSwtStsPassSeatSwtSldSts 0 "SwtHozlSts1_Idle" 1 "SwtHozlSts1_Fwd" 2 "SwtHozlSts1_Backw";
VAL_ 306 SeatRowThrdLeMassgRunng 0 "OnOff1_Off" 1 "OnOff1_On";
VAL_ 306 SeatRowThrdLeSldPosPercSeatPosQf 0 "Qf1_DevOfDataUndefd" 1 "Qf1_DataTmpUndefdAndEvlnInProgs" 2 "Qf1_DevOfDataNotWithinRngAllwd" 3 "Qf1_DataCalcdWithDevDefd";
VAL_ 306 SeatRowThrdRiFoldRaiseWarn 0 "Boolean_FALSE" 1 "Boolean_TRUE";
VAL_ 306 SeatRowThrdRiFoldStsSeatFoldRaiseFlt 0 "Flt_NoFault" 1 "Flt_Fault";
VAL_ 306 SeatRowThrdRiFoldStsSeatFoldRaiseMovmt 0 "FoldRaiseMovmt_Uknwn" 1 "FoldRaiseMovmt_Fld" 2 "FoldRaiseMovmt_Rsd" 3 "FoldRaiseMovmt_MovmtToFld" 4 "FoldRaiseMovmt_MovmtToRsd" 5 "FoldRaiseMovmt_BtwnFldAndRsd";
VAL_ 306 SeatRowThrdRiMassgRunng 0 "OnOff1_Off" 1 "OnOff1_On";
VAL_ 306 SeatRowThrdRiSldPosPercSeatPosQf 0 "Qf1_DevOfDataUndefd" 1 "Qf1_DataTmpUndefdAndEvlnInProgs" 2 "Qf1_DevOfDataNotWithinRngAllwd" 3 "Qf1_DataCalcdWithDevDefd";
VAL_ 306 SeatVentnLvlStsRowSecLe 0 "SeatClimaLvl_Off" 1 "SeatClimaLvl_Lvl1" 2 "SeatClimaLvl_Lvl2" 3 "SeatClimaLvl_Lvl3";
VAL_ 306 SeatVentnLvlStsRowSecRi 0 "SeatClimaLvl_Off" 1 "SeatClimaLvl_Lvl1" 2 "SeatClimaLvl_Lvl2" 3 "SeatClimaLvl_Lvl3";
VAL_ 306 SeatVentnLvlStsRowThrdLe 0 "SeatClimaLvl_Off" 1 "SeatClimaLvl_Lvl1" 2 "SeatClimaLvl_Lvl2" 3 "SeatClimaLvl_Lvl3";
VAL_ 306 SeatVentnLvlStsRowThrdRi 0 "SeatClimaLvl_Off" 1 "SeatClimaLvl_Lvl1" 2 "SeatClimaLvl_Lvl2" 3 "SeatClimaLvl_Lvl3";
VAL_ 306 SecRowLeHeatgAutoSts 0 "OffOnErrInvalid_Off" 1 "OffOnErrInvalid_On" 2 "OffOnErrInvalid_Err" 3 "OffOnErrInvalid_Invalid";
VAL_ 306 SecRowLeVentnAutoSts 0 "OffOnErrInvalid_Off" 1 "OffOnErrInvalid_On" 2 "OffOnErrInvalid_Err" 3 "OffOnErrInvalid_Invalid";
VAL_ 306 SecRowRiHeatgAutoSts 0 "OffOnErrInvalid_Off" 1 "OffOnErrInvalid_On" 2 "OffOnErrInvalid_Err" 3 "OffOnErrInvalid_Invalid";
VAL_ 306 SecRowRiVentnAutoSts 0 "OffOnErrInvalid_Off" 1 "OffOnErrInvalid_On" 2 "OffOnErrInvalid_Err" 3 "OffOnErrInvalid_Invalid";
VAL_ 306 SnowFlg 0 "OnOff1_Off" 1 "OnOff1_On";
VAL_ 306 SteerServoSts 0 "SteerServoSts1_SteerPwrAssidElecFullFct" 1 "SteerServoSts1_SteerPwrAssidElecCritErr";
VAL_ 306 SuspTarHei 0 "SuspTarHei_Reserve1" 1 "SuspTarHei_Hi2" 2 "SuspTarHei_Hi1" 3 "SuspTarHei_Norm" 4 "SuspTarHei_Lo1" 5 "SuspTarHei_Lo2" 6 "SuspTarHei_Reserve2" 7 "SuspTarHei_Reserve3";
VAL_ 306 ThrdRowLeHeatgAutoSts 0 "OffOnErrInvalid_Off" 1 "OffOnErrInvalid_On" 2 "OffOnErrInvalid_Err" 3 "OffOnErrInvalid_Invalid";
VAL_ 306 ThrdRowRiHeatgAutoSts 0 "OffOnErrInvalid_Off" 1 "OffOnErrInvalid_On" 2 "OffOnErrInvalid_Err" 3 "OffOnErrInvalid_Invalid";
VAL_ 306 TopPosHmiFeedBack 0 "TailgatePos_Unknown" 1 "TailgatePos_Fail" 2 "TailgatePos_0to20PercTopPos" 3 "TailgatePos_21to40PercTopPos" 4 "TailgatePos_41to60PercTopPos" 5 "TailgatePos_61to80PercTopPos" 6 "TailgatePos_81to100PercTopPos";
VAL_ 306 TrOpenerSts 0 "TrOpenerSts1_Ukwn" 1 "TrOpenerSts1_FullClsd" 2 "TrOpenerSts1_MovgUp" 3 "TrOpenerSts1_MovgUpBrkg" 4 "TrOpenerSts1_StopDurgOpen" 5 "TrOpenerSts1_FullOpend" 6 "TrOpenerSts1_MovgDwn" 7 "TrOpenerSts1_MovgDwnBrkg" 8 "TrOpenerSts1_StopDurgCls" 9 "TrOpenerSts1_HalfClsd" 10 "TrOpenerSts1_StopMinPntForCls";
VAL_ 306 VehActvMsgToDrvr 0 "VehActv1_NoMsg" 1 "VehActv1_Msg1" 2 "VehActv1_Msg2" 3 "VehActv1_Msg3";
VAL_ 306 VehEgyCoornDataReq 0 "ReqSts1_NotReqd" 1 "ReqSts1_Reqd";
VAL_ 369 AudWarn 0 "Boolean_FALSE" 1 "Boolean_TRUE";
VAL_ 369 AutoShowModPrpsnEna 0 "OkNotOk_NotOk" 1 "OkNotOk_Ok";
VAL_ 369 BltLockStAtPassMidBltLockEquid 0 "CptEquid_Equid" 1 "CptEquid_NotEquid";
VAL_ 369 BltLockStAtPassMidBltLockSt1 0 "BltLockSt1_Unlock" 1 "BltLockSt1_Lock";
VAL_ 369 BltLockStAtPassMidBltLockSts 0 "DevErrSts2_NoFlt" 1 "DevErrSts2_Flt";
VAL_ 369 BltLockStAtRowFrthLeBltLockEquid 0 "CptEquid_Equid" 1 "CptEquid_NotEquid";
VAL_ 369 BltLockStAtRowFrthLeBltLockSt1 0 "BltLockSt1_Unlock" 1 "BltLockSt1_Lock";
VAL_ 369 BltLockStAtRowFrthLeBltLockSts 0 "DevErrSts2_NoFlt" 1 "DevErrSts2_Flt";
VAL_ 369 BltLockStAtRowFrthMidBltLockEquid 0 "CptEquid_Equid" 1 "CptEquid_NotEquid";
VAL_ 369 BltLockStAtRowFrthMidBltLockSt1 0 "BltLockSt1_Unlock" 1 "BltLockSt1_Lock";
VAL_ 369 BltLockStAtRowFrthMidBltLockSts 0 "DevErrSts2_NoFlt" 1 "DevErrSts2_Flt";
VAL_ 369 BltLockStAtRowFrthRiBltLockEquid 0 "CptEquid_Equid" 1 "CptEquid_NotEquid";
VAL_ 369 BltLockStAtRowFrthRiBltLockSt1 0 "BltLockSt1_Unlock" 1 "BltLockSt1_Lock";
VAL_ 369 BltLockStAtRowFrthRiBltLockSts 0 "DevErrSts2_NoFlt" 1 "DevErrSts2_Flt";
VAL_ 369 BltLockStAtRowThrdMidBltLockEquid 0 "CptEquid_Equid" 1 "CptEquid_NotEquid";
VAL_ 369 BltLockStAtRowThrdMidBltLockSt1 0 "BltLockSt1_Unlock" 1 "BltLockSt1_Lock";
VAL_ 369 BltLockStAtRowThrdMidBltLockSts 0 "DevErrSts2_NoFlt" 1 "DevErrSts2_Flt";
VAL_ 369 BtnLockStsAndKeyIdBtnSts 0 "PsdNotPsd1_NotPsd" 1 "PsdNotPsd1_Psd";
VAL_ 369 BtnLockStsAndKeyIdKeyId 0 "KeyId1_Key0" 1 "KeyId1_Key1" 2 "KeyId1_Key2" 3 "KeyId1_Key3" 4 "KeyId1_Key4" 5 "KeyId1_Key5" 6 "KeyId1_Key6" 7 "KeyId1_Key7" 8 "KeyId1_Key8" 9 "KeyId1_Key9" 10 "KeyId1_Key10" 11 "KeyId1_Key11";
VAL_ 369 BtnUnlckStsAndKeyIdBtnSts 0 "PsdNotPsd1_NotPsd" 1 "PsdNotPsd1_Psd";
VAL_ 369 BtnUnlckStsAndKeyIdKeyId 0 "KeyId1_Key0" 1 "KeyId1_Key1" 2 "KeyId1_Key2" 3 "KeyId1_Key3" 4 "KeyId1_Key4" 5 "KeyId1_Key5" 6 "KeyId1_Key6" 7 "KeyId1_Key7" 8 "KeyId1_Key8" 9 "KeyId1_Key9" 10 "KeyId1_Key10" 11 "KeyId1_Key11";
VAL_ 369 CDCModIndcn 0 "CDCModIndcn_Ukwn" 1 "CDCModIndcn_Cmf" 2 "CDCModIndcn_Sport" 3 "CDCModIndcn_Norm" 4 "CDCModIndcn_Adv" 5 "CDCModIndcn_Offroad" 6 "CDCModIndcn_Resd1" 7 "CDCModIndcn_Resd2";
VAL_ 369 CoolgLoadGroupCoolgLimd 0 "Flg1_Rst" 1 "Flg1_Set";
VAL_ 369 DigKeyApproachReqDigKeyApproaReq 0 "DigKeyApproaReq_Idle" 1 "DigKeyApproaReq_ApproachLightRequest" 2 "DigKeyApproaReq_ApproachUnlockRequest" 3 "DigKeyApproaReq_ApproachLockRequest" 4 "DigKeyApproaReq_ApproachTrunkRequest1" 5 "DigKeyApproaReq_ApproachTrunkRequest2" 6 "DigKeyApproaReq_ApproachTrunkRequest3" 7 "DigKeyApproaReq_ApproachUnlckReqFromDrvr";
VAL_ 369 DigKeyApproachReqKeyId3 0 "KeyId3_Key0" 1 "KeyId3_Key1" 2 "KeyId3_Key2" 3 "KeyId3_Key3" 4 "KeyId3_Key4" 5 "KeyId3_Key5" 6 "KeyId3_Key6" 7 "KeyId3_Key7" 8 "KeyId3_Key8" 9 "KeyId3_Key9" 10 "KeyId3_Key10" 11 "KeyId3_Key11" 12 "KeyId3_Key12" 13 "KeyId3_Key13" 14 "KeyId3_Key14" 15 "KeyId3_Key15";
VAL_ 369 DoorLockUnlockCmdNFCKeyId3 0 "KeyId3_Key0" 1 "KeyId3_Key1" 2 "KeyId3_Key2" 3 "KeyId3_Key3" 4 "KeyId3_Key4" 5 "KeyId3_Key5" 6 "KeyId3_Key6" 7 "KeyId3_Key7" 8 "KeyId3_Key8" 9 "KeyId3_Key9" 10 "KeyId3_Key10" 11 "KeyId3_Key11" 12 "KeyId3_Key12" 13 "KeyId3_Key13" 14 "KeyId3_Key14" 15 "KeyId3_Key15";
VAL_ 369 DoorLockUnlockCmdNFCKeyPrsntSts1 0 "KeyPrsntSts1_KeyPrsntStsIdle" 1 "KeyPrsntSts1_KeyPrsntStsInProgs" 2 "KeyPrsntSts1_KeyPrsntStsNotPrsnt" 3 "KeyPrsntSts1_KeyPrsntStsPrsnt";
VAL_ 369 DoorLockUnlockCmdNFCPsdNotPsd 0 "PsdNotPsd_NotPsd" 1 "PsdNotPsd_Psd";
VAL_ 369 DoorPassHndlCmd 0 "DoorHndlCmd_Idle" 1 "DoorHndlCmd_Deploy" 2 "DoorHndlCmd_Retract";
VAL_ 369 DoorRiReHndlCmd 0 "DoorHndlCmd_Idle" 1 "DoorHndlCmd_Deploy" 2 "DoorHndlCmd_Retract";
VAL_ 369 DrvrElecRunngBdSts 0 "OnOff1_Off" 1 "OnOff1_On";
VAL_ 369 DrvrSeatAdjmtLimnWarn 0 "Boolean_FALSE" 1 "Boolean_TRUE";
VAL_ 369 DrvrSeatPosPercSeatPosFrntHeiQF 0 "Qf1_DevOfDataUndefd" 1 "Qf1_DataTmpUndefdAndEvlnInProgs" 2 "Qf1_DevOfDataNotWithinRngAllwd" 3 "Qf1_DataCalcdWithDevDefd";
VAL_ 369 DrvrSeatPosPercSeatPosHeiQF 0 "Qf1_DevOfDataUndefd" 1 "Qf1_DataTmpUndefdAndEvlnInProgs" 2 "Qf1_DevOfDataNotWithinRngAllwd" 3 "Qf1_DataCalcdWithDevDefd";
VAL_ 369 DrvrSeatPosPercSeatPosSldQF 0 "Qf1_DevOfDataUndefd" 1 "Qf1_DataTmpUndefdAndEvlnInProgs" 2 "Qf1_DevOfDataNotWithinRngAllwd" 3 "Qf1_DataCalcdWithDevDefd";
VAL_ 369 EgyAvgCnsDstSg 0 "Boolean_FALSE" 1 "Boolean_TRUE";
VAL_ 369 GearIndcnRecGearIndcn 0 "GearIndcnTyp2_NoIndcn" 1 "GearIndcnTyp2_Gear1" 2 "GearIndcnTyp2_Gear2" 3 "GearIndcnTyp2_Gear3" 4 "GearIndcnTyp2_Gear4" 5 "GearIndcnTyp2_Gear5" 6 "GearIndcnTyp2_Gear6" 7 "GearIndcnTyp2_Gear7" 8 "GearIndcnTyp2_Gear8" 9 "GearIndcnTyp2_Gear9" 10 "GearIndcnTyp2_Gear10" 11 "GearIndcnTyp2_Gear11" 12 "GearIndcnTyp2_Gear2468" 13 "GearIndcnTyp2_Gear13579" 14 "GearIndcnTyp2_Neut" 15 "GearIndcnTyp2_Rvs";
VAL_ 369 GearIndcnRecGearShiftIndcn 0 "GearShiftIndcn_NoShiftIndcn" 1 "GearShiftIndcn_ShiftUpIndcn" 2 "GearShiftIndcn_CoolShiftIndcn" 3 "GearShiftIndcn_ShiftDwnIndcn";
VAL_ 369 GearIndcnRecGearTarIndcn 0 "GearIndcnTyp2_NoIndcn" 1 "GearIndcnTyp2_Gear1" 2 "GearIndcnTyp2_Gear2" 3 "GearIndcnTyp2_Gear3" 4 "GearIndcnTyp2_Gear4" 5 "GearIndcnTyp2_Gear5" 6 "GearIndcnTyp2_Gear6" 7 "GearIndcnTyp2_Gear7" 8 "GearIndcnTyp2_Gear8" 9 "GearIndcnTyp2_Gear9" 10 "GearIndcnTyp2_Gear10" 11 "GearIndcnTyp2_Gear11" 12 "GearIndcnTyp2_Gear2468" 13 "GearIndcnTyp2_Gear13579" 14 "GearIndcnTyp2_Neut" 15 "GearIndcnTyp2_Rvs";
VAL_ 369 ImobRemMgrChkSts 0 "AvlSts1_TmpNotAvl" 1 "AvlSts1_PrmntNotAvl" 2 "AvlSts1_Avl";
VAL_ 369 ImobVehRemMgrSts1ImobVehRemMgrSts 0 "ImobVehRemMgrSts_IdleRemMgrSts" 1 "ImobVehRemMgrSts_ImobnRemMgrSts" 2 "ImobVehRemMgrSts_NoImobnRemMgrSts" 3 "ImobVehRemMgrSts_ImobnStrtDiRemMgrSts";
VAL_ 369 LnchModIndcnMsg 0 "LaunchModeIndcn_NoIndcn" 1 "LaunchModeIndcn_BattLow" 2 "LaunchModeIndcn_TempTooHigh" 3 "LaunchModeIndcn_TempTooLow" 4 "LaunchModeIndcn_EscNotOff" 5 "LaunchModeIndcn_TrlrPrsnt" 6 "LaunchModeIndcn_SteerWhlNotStraight" 7 "LaunchModeIndcn_EpbNotRels" 8 "LaunchModeIndcn_BltNotRels" 9 "LaunchModeIndcn_DoorNotClsd" 10 "LaunchModeIndcn_FctNotTrigTiOut" 11 "LaunchModeIndcn_BrkPedlPsdTiOut" 12 "LaunchModeIndcn_FctReqTooFrequent" 13 "LaunchModeIndcn_Reserved1" 14 "LaunchModeIndcn_Reserved2" 15 "LaunchModeIndcn_Reserved3";
VAL_ 369 LockgFbAcoustReq 0 "LockActvn2_LockActvnOff" 1 "LockActvn2_LockActvnUnlck" 2 "LockActvn2_LockActvnLock" 3 "LockActvn2_LockActvnSafe" 4 "LockActvn2_LockActvnUnlckByCrash";
VAL_ 369 LockgFbToExtLi 0 "LockActvn2_LockActvnOff" 1 "LockActvn2_LockActvnUnlck" 2 "LockActvn2_LockActvnLock" 3 "LockActvn2_LockActvnSafe" 4 "LockActvn2_LockActvnUnlckByCrash";
VAL_ 369 MobDevVentReq 0 "PsdNotPsd1_NotPsd" 1 "PsdNotPsd1_Psd";
VAL_ 369 OpenClsCmftReqOpenClsCmftReq 0 "OpenClsCmftReq1_NoCmftReq" 1 "OpenClsCmftReq1_OpenCmft" 2 "OpenClsCmftReq1_ClsCmft" 3 "OpenClsCmftReq1_StopCmft";
VAL_ 369 OpenClsCmftReqOpenClsCmftTrigSrc 0 "OpenClsCmftTrigSrc1_OpenClsCmftNoTrigSrc" 1 "OpenClsCmftTrigSrc1_OpenClsCmftFromSwtInt" 2 "OpenClsCmftTrigSrc1_OpenClsCmfFromKeyRem" 3 "OpenClsCmftTrigSrc1_OpenClsCmftFromKeyls";
VAL_ 369 PassMidSeatSts 0 "PassSeatSts1_Empty" 1 "PassSeatSts1_Fmale" 2 "PassSeatSts1_OccptLrg" 3 "PassSeatSts1_Ukwn";
VAL_ 369 RainDetected 0 "Boolean_FALSE" 1 "Boolean_TRUE";
VAL_ 369 RemAllowStrt 0 "Validity_NotValid" 1 "Validity_Valid";
VAL_ 369 RemClimaHVReqFb 0 "HVReqFb_Default" 1 "HVReqFb_HvOnOk" 2 "HVReqFb_HvSocLow" 3 "HVReqFb_HvFalut";
VAL_ 369 RowSecRiSeatZeroGrvySts 0 "ZeroGrvySts_Idle" 1 "ZeroGrvySts_EntryZeroGrvyInProg" 2 "ZeroGrvySts_ZeroGrvyComplete" 3 "ZeroGrvySts_ZeroGrvyNotComplete" 4 "ZeroGrvySts_ReturnInProg";
VAL_ 369 RowSecRiSeatZeroGrvyWarn 0 "Boolean_FALSE" 1 "Boolean_TRUE";
VAL_ 369 SeatOccptAtRowFrthLe 0 "PassSeatSts1_Empty" 1 "PassSeatSts1_Fmale" 2 "PassSeatSts1_OccptLrg" 3 "PassSeatSts1_Ukwn";
VAL_ 369 SeatOccptAtRowFrthMid 0 "PassSeatSts1_Empty" 1 "PassSeatSts1_Fmale" 2 "PassSeatSts1_OccptLrg" 3 "PassSeatSts1_Ukwn";
VAL_ 369 SeatOccptAtRowFrthRi 0 "PassSeatSts1_Empty" 1 "PassSeatSts1_Fmale" 2 "PassSeatSts1_OccptLrg" 3 "PassSeatSts1_Ukwn";
VAL_ 369 SeatOccptAtRowThrdMid 0 "PassSeatSts1_Empty" 1 "PassSeatSts1_Fmale" 2 "PassSeatSts1_OccptLrg" 3 "PassSeatSts1_Ukwn";
VAL_ 369 ShortDropWinLeReDoor2 0 "ShortDrop_Idle" 1 "ShortDrop_Close" 2 "ShortDrop_Open";
VAL_ 369 ShortDropWinPassDoor2 0 "ShortDrop_Idle" 1 "ShortDrop_Close" 2 "ShortDrop_Open";
VAL_ 369 ShortDropWinRiReDoor2 0 "ShortDrop_Idle" 1 "ShortDrop_Close" 2 "ShortDrop_Open";
VAL_ 369 SunCurtPosnSts 0 "WinAndRoofAndCurtPosnTyp_PosnUkwn" 1 "WinAndRoofAndCurtPosnTyp_ClsFull" 2 "WinAndRoofAndCurtPosnTyp_PercOpen4" 3 "WinAndRoofAndCurtPosnTyp_PercOpen8" 4 "WinAndRoofAndCurtPosnTyp_PercOpen12" 5 "WinAndRoofAndCurtPosnTyp_PercOpen16" 6 "WinAndRoofAndCurtPosnTyp_PercOpen20" 7 "WinAndRoofAndCurtPosnTyp_PercOpen24" 8 "WinAndRoofAndCurtPosnTyp_PercOpen28" 9 "WinAndRoofAndCurtPosnTyp_PercOpen32" 10 "WinAndRoofAndCurtPosnTyp_PercOpen36" 11 "WinAndRoofAndCurtPosnTyp_PercOpen40" 12 "WinAndRoofAndCurtPosnTyp_PercOpen44" 13 "WinAndRoofAndCurtPosnTyp_PercOpen48" 14 "WinAndRoofAndCurtPosnTyp_PercOpen52" 15 "WinAndRoofAndCurtPosnTyp_PercOpen56" 16 "WinAndRoofAndCurtPosnTyp_PercOpen60" 17 "WinAndRoofAndCurtPosnTyp_PercOpen64" 18 "WinAndRoofAndCurtPosnTyp_PercOpen68" 19 "WinAndRoofAndCurtPosnTyp_PercOpen72" 20 "WinAndRoofAndCurtPosnTyp_PercOpen76" 21 "WinAndRoofAndCurtPosnTyp_PercOpen80" 22 "WinAndRoofAndCurtPosnTyp_PercOpen84" 23 "WinAndRoofAndCurtPosnTyp_PercOpen88" 24 "WinAndRoofAndCurtPosnTyp_PercOpen92" 25 "WinAndRoofAndCurtPosnTyp_PercOpen96" 26 "WinAndRoofAndCurtPosnTyp_OpenFull" 27 "WinAndRoofAndCurtPosnTyp_Resd1" 28 "WinAndRoofAndCurtPosnTyp_Resd2" 29 "WinAndRoofAndCurtPosnTyp_Resd3" 30 "WinAndRoofAndCurtPosnTyp_Resd4" 31 "WinAndRoofAndCurtPosnTyp_Movg";
VAL_ 369 TankFlapLockgCmd 0 "LockActvn2_LockActvnOff" 1 "LockActvn2_LockActvnUnlck" 2 "LockActvn2_LockActvnLock" 3 "LockActvn2_LockActvnSafe" 4 "LockActvn2_LockActvnUnlckByCrash";
VAL_ 369 TrHndlOutdOpenSts 0 "PsdNotPsd1_NotPsd" 1 "PsdNotPsd1_Psd";
VAL_ 369 TrsmFltIndcn 0 "TrsmFltIndcn1_TrsmFltIndcnNoReq" 1 "TrsmFltIndcn1_TrsmFltIndcn1" 2 "TrsmFltIndcn1_TrsmFltIndcn2" 3 "TrsmFltIndcn1_TrsmFltIndcn3" 4 "TrsmFltIndcn1_TrsmFltIndcn4" 5 "TrsmFltIndcn1_TrsmFltIndcn5" 6 "TrsmFltIndcn1_TrsmFltIndcn6" 7 "TrsmFltIndcn1_TrsmFltIndcn7" 8 "TrsmFltIndcn1_TrsmFltIndcn8" 9 "TrsmFltIndcn1_TrsmFltIndcn9" 10 "TrsmFltIndcn1_TrsmFltIndcn10" 11 "TrsmFltIndcn1_TrsmFltIndcn11" 12 "TrsmFltIndcn1_TrsmFltIndcn12" 13 "TrsmFltIndcn1_TrsmFltIndcn13" 14 "TrsmFltIndcn1_TrsmFltIndcn14" 15 "TrsmFltIndcn1_TrsmFltIndcn15" 16 "TrsmFltIndcn1_TrsmFltIndcn16" 17 "TrsmFltIndcn1_TrsmFltIndcn17" 18 "TrsmFltIndcn1_TrsmFltIndcn18" 19 "TrsmFltIndcn1_TrsmFltIndcn19" 20 "TrsmFltIndcn1_TrsmFltIndcn20" 21 "TrsmFltIndcn1_TrsmFltIndcn21" 22 "TrsmFltIndcn1_TrsmFltIndcn22" 23 "TrsmFltIndcn1_TrsmFltIndcn23" 24 "TrsmFltIndcn1_TrsmFltIndcn24" 25 "TrsmFltIndcn1_TrsmFltIndcn25" 26 "TrsmFltIndcn1_TrsmFltIndcn26" 27 "TrsmFltIndcn1_TrsmFltIndcn27" 28 "TrsmFltIndcn1_TrsmFltIndcn28" 29 "TrsmFltIndcn1_TrsmFltIndcn29" 30 "TrsmFltIndcn1_TrsmFltIndcn30" 31 "TrsmFltIndcn1_TrsmFltIndcn31";
VAL_ 666 ActvnOfWshrFrntSafe 0 "OnOffCrit1_NotVld1" 1 "OnOffCrit1_Off" 2 "OnOffCrit1_On" 3 "OnOffCrit1_NotVld2";
VAL_ 666 ActvOfHorn 0 "OnOff1_Off" 1 "OnOff1_On";
VAL_ 666 AutoTrainModReq 0 "TrainModReq_Idle" 1 "TrainModReq_Normal" 2 "TrainModReq_Snow" 3 "TrainModReq_Sand" 4 "TrainModReq_Mud" 5 "TrainModReq_Rock" 6 "TrainModReq_Offroad" 7 "TrainModReq_Mountain";
VAL_ 666 DChrgStrtEngRes 0 "DChrgStrt_NotSet" 1 "DChrgStrt_Start" 2 "DChrgStrt_Finished" 3 "DChrgStrt_MaxNoStart" 4 "DChrgStrt_HoodOpen" 5 "DChrgStrt_CarUnlocked" 6 "DChrgStrt_ValidKeyInCar" 7 "DChrgStrt_PwrSplyErr" 8 "DChrgStrt_FuelLow" 9 "DChrgStrt_PropFlt" 10 "DChrgStrt_MaxTi" 11 "DChrgStrt_NoValidKeyInCar";
VAL_ 666 ElecStepFltActrFlt1 0 "Flt_NoFault" 1 "Flt_Fault";
VAL_ 666 ElecStepFltActrFlt2 0 "Flt_NoFault" 1 "Flt_Fault";
VAL_ 666 ElecStepFltActrFlt3 0 "Flt_NoFault" 1 "Flt_Fault";
VAL_ 666 ElecStepFltActrFlt4 0 "Flt_NoFault" 1 "Flt_Fault";
VAL_ 666 ElecStepFltActrFlt5 0 "Flt_NoFault" 1 "Flt_Fault";
VAL_ 666 ElecStepFltTmrFlt 0 "Flt_NoFault" 1 "Flt_Fault";
VAL_ 666 EngCooltInhbFlow 0 "CooltInhb_CoolntFlowReqToEngAllwd" 1 "CooltInhb_CoolntFlowReqToEngNotAllwd";
VAL_ 666 HvahFltIndcnReq 0 "Flg1_Rst" 1 "Flg1_Set";
VAL_ 666 HvEgyLoadFctReq 0 "Boolean_FALSE" 1 "Boolean_TRUE";
VAL_ 666 HvPwrEgyPrio 0 "HvPwrEgyPrio_Standby" 1 "HvPwrEgyPrio_Dischrgning" 2 "HvPwrEgyPrio_Chrgning" 3 "HvPwrEgyPrio_ClimaWithAc" 4 "HvPwrEgyPrio_ClimaWithoutAc" 5 "HvPwrEgyPrio_RemoteClimatisaiton";
VAL_ 666 HwRowRearLeLegRstHeiMotCtrl 0 "SwtVertSts1_Idle" 1 "SwtVertSts1_Up" 2 "SwtVertSts1_Dwn";
VAL_ 666 HwRowRearLeLegRstLenMotCtrl 0 "SwtHozlSts1_Idle" 1 "SwtHozlSts1_Fwd" 2 "SwtHozlSts1_Backw";
VAL_ 666 HwRowRearRiLegRstHeiMotCtrl 0 "SwtVertSts1_Idle" 1 "SwtVertSts1_Up" 2 "SwtVertSts1_Dwn";
VAL_ 666 HwRowRearRiLegRstLenMotCtrl 0 "SwtHozlSts1_Idle" 1 "SwtHozlSts1_Fwd" 2 "SwtHozlSts1_Backw";
VAL_ 666 HwRowSecLeInclMotCtrl 0 "SwtHozlSts1_Idle" 1 "SwtHozlSts1_Fwd" 2 "SwtHozlSts1_Backw";
VAL_ 666 HwRowSecLeSldMotCtrl 0 "SwtHozlSts1_Idle" 1 "SwtHozlSts1_Fwd" 2 "SwtHozlSts1_Backw";
VAL_ 666 HwRowSecRiInclMotCtrl 0 "SwtHozlSts1_Idle" 1 "SwtHozlSts1_Fwd" 2 "SwtHozlSts1_Backw";
VAL_ 666 HwRowSecRiSldMotCtrl 0 "SwtHozlSts1_Idle" 1 "SwtHozlSts1_Fwd" 2 "SwtHozlSts1_Backw";
VAL_ 666 HwRowThrdLeInclMotCtrl 0 "SwtHozlSts1_Idle" 1 "SwtHozlSts1_Fwd" 2 "SwtHozlSts1_Backw";
VAL_ 666 HwRowThrdRiInclMotCtrl 0 "SwtHozlSts1_Idle" 1 "SwtHozlSts1_Fwd" 2 "SwtHozlSts1_Backw";
VAL_ 666 MirrActvBtn 0 "PsdNotPsd_NotPsd" 1 "PsdNotPsd_Psd";
VAL_ 666 MirrCmdAtDrvrMirrDwnCmd 0 "MirrDwnCmdTyp_Idle" 1 "MirrDwnCmdTyp_MirrUp" 2 "MirrDwnCmdTyp_MirrDwn";
VAL_ 666 MirrCmdAtDrvrMirrFoldCmd 0 "MirrFoldCmdTyp_Idle" 1 "MirrFoldCmdTyp_FoldIn" 2 "MirrFoldCmdTyp_FoldOut";
VAL_ 666 MirrCmdAtDrvrMirrPosAdjCmd 0 "MirrAdjCmdTyp_Idle" 1 "MirrAdjCmdTyp_Up" 2 "MirrAdjCmdTyp_Dwn" 3 "MirrAdjCmdTyp_Le" 4 "MirrAdjCmdTyp_Ri";
VAL_ 666 MirrDefrstAtDrvSts 0 "OnOff1_Off" 1 "OnOff1_On";
VAL_ 666 MirrDirReq 0 "MirrDirReqTyp_Idle" 1 "MirrDirReqTyp_Up" 2 "MirrDirReqTyp_Down" 3 "MirrDirReqTyp_Left" 4 "MirrDirReqTyp_Right";
VAL_ 666 MirrSelnReq 0 "MirrSelnReqTyp_Idle" 1 "MirrSelnReqTyp_Le" 2 "MirrSelnReqTyp_Ri" 3 "MirrSelnReqTyp_LeAndRi";
VAL_ 666 SecPwrSrcUloWarnULoWarn 0 "ULoWarn_UOk" 1 "ULoWarn_ULoTmp" 2 "ULoWarn_ULoPrmnt" 3 "ULoWarn_ULoDcDc";
VAL_ 666 SldgActiveInteWarn 0 "IdleVal_NoInterruption" 1 "IdleVal_PitchAngleOver12Degrees" 2 "IdleVal_RollAngleOver12Degrees" 3 "IdleVal_VehicleMoveOnGoingOpen" 4 "IdleVal_HMIDisabledSldngDoors" 5 "IdleVal_EnergyLevelInVehicleLow" 6 "IdleVal_Reserved1" 7 "IdleVal_Reserved2";
VAL_ 666 TrlrModPrpsnSts 0 "VehActv1_NoMsg" 1 "VehActv1_Msg1" 2 "VehActv1_Msg2" 3 "VehActv1_Msg3";
SIG_GROUP_ 1169 AccrpedlSts 1 : AccrpedlStsChks AccrpedlStsCntr AccrpedlStsFltSts;
SIG_GROUP_ 1169 ActnOfLedLoBeam 1 : ActnOfLedLoBeamActnOfLedLoBeam ActnOfLedLoBeamChks ActnOfLedLoBeamCntr;
SIG_GROUP_ 306 ActnOfLoBeamPass 1 : ActnOfLoBeamPassChks ActnOfLoBeamPassCntr ActnOfLoBeamPassOnOff;
SIG_GROUP_ 306 ActvnOfHndlDoorLi1 1 : ActvnOfHndlDoorLi1HndlDoorLiDrvr ActvnOfHndlDoorLi1HndlDoorLiDrvrRe ActvnOfHndlDoorLi1HndlDoorLiPass ActvnOfHndlDoorLi1HndlDoorLiPassRe;
SIG_GROUP_ 371 AmbTIndcdWithUnit 1 : AmbTIndcdWithUnitAmbTIndcd AmbTIndcdWithUnitAmbTIndcdUnit AmbTIndcdWithUnitQF;
SIG_GROUP_ 369 BltLockStAtPassMid 1 : BltLockStAtPassMidBltLockEquid BltLockStAtPassMidBltLockSt1 BltLockStAtPassMidBltLockSts;
SIG_GROUP_ 369 BltLockStAtRowFrthLe 1 : BltLockStAtRowFrthLeBltLockEquid BltLockStAtRowFrthLeBltLockSt1 BltLockStAtRowFrthLeBltLockSts;
SIG_GROUP_ 369 BltLockStAtRowFrthMid 1 : BltLockStAtRowFrthMidBltLockEquid BltLockStAtRowFrthMidBltLockSt1 BltLockStAtRowFrthMidBltLockSts;
SIG_GROUP_ 369 BltLockStAtRowFrthRi 1 : BltLockStAtRowFrthRiBltLockEquid BltLockStAtRowFrthRiBltLockSt1 BltLockStAtRowFrthRiBltLockSts;
SIG_GROUP_ 369 BltLockStAtRowThrdMid 1 : BltLockStAtRowThrdMidBltLockEquid BltLockStAtRowThrdMidBltLockSt1 BltLockStAtRowThrdMidBltLockSts;
SIG_GROUP_ 369 BtnLockStsAndKeyId 1 : BtnLockStsAndKeyIdBtnSts BtnLockStsAndKeyIdKeyId;
SIG_GROUP_ 369 BtnUnlckStsAndKeyId 1 : BtnUnlckStsAndKeyIdBtnSts BtnUnlckStsAndKeyIdKeyId;
SIG_GROUP_ 369 CchForFuEco 1 : CchForFuEcoBarForFuEco CchForFuEcoGrdForFuEco;
SIG_GROUP_ 369 CchForPwrEco 1 : CchForPwrEcoBarForPwrEco CchForPwrEcoGrdForPwrEco;
SIG_GROUP_ 1169 CEMdevelpsignalgroupVMM1 1 : CEMdevelpsignalgroupVMM1Functiondevpsignalgroup1 CEMdevelpsignalgroupVMM1Functiondevpsignalgroup2 CEMdevelpsignalgroupVMM1Functiondevpsignalgroup3 CEMdevelpsignalgroupVMM1Functiondevpsignalgroup4 CEMdevelpsignalgroupVMM1Functiondevpsignalgroup5 CEMdevelpsignalgroupVMM1Functiondevpsignalgroup6 CEMdevelpsignalgroupVMM1Functiondevpsignalgroup7 CEMdevelpsignalgroupVMM1Functiondevpsignalgroup8;
SIG_GROUP_ 369 CoolgLoadGroup 1 : CoolgLoadGroupCoolgLimd CoolgLoadGroupCoolgLoad2;
SIG_GROUP_ 369 DigKeyApproachReq 1 : DigKeyApproachReqDigKeyApproaReq DigKeyApproachReqKeyId3;
SIG_GROUP_ 369 DoorLockUnlockCmdNFC 1 : DoorLockUnlockCmdNFCKeyId3 DoorLockUnlockCmdNFCKeyPrsntSts1 DoorLockUnlockCmdNFCPsdNotPsd;
SIG_GROUP_ 369 DrvrSeatPosPerc 1 : DrvrSeatPosPercSeatPosFrntHeiPerc DrvrSeatPosPercSeatPosFrntHeiQF DrvrSeatPosPercSeatPosHeiPerc DrvrSeatPosPercSeatPosHeiQF DrvrSeatPosPercSeatPosSldPerc DrvrSeatPosPercSeatPosSldQF;
SIG_GROUP_ 1169 DrvrSteerWhlHldGroup 1 : DrvrSteerWhlHldGroupDrvrSteerWhlHld DrvrSteerWhlHldGroupDrvrSteerWhlHldQly;
SIG_GROUP_ 1169 EgyMeasIntl 1 : EgyMeasIntlIntl1 EgyMeasIntlIntl2 EgyMeasIntlIntl3 EgyMeasIntlIntl4;
SIG_GROUP_ 666 ElecStepFlt 1 : ElecStepFltActrFlt1 ElecStepFltActrFlt2 ElecStepFltActrFlt3 ElecStepFltActrFlt4 ElecStepFltActrFlt5 ElecStepFltTmrFlt;
SIG_GROUP_ 371 FuLvlRawActvSide 1 : FuLvlRawActvSideFuLvlValFromFuTbl FuLvlRawActvSideGenQF;
SIG_GROUP_ 371 FuLvlRawPasSide 1 : FuLvlRawPasSideFuLvlValFromFuTbl FuLvlRawPasSideGenQF;
SIG_GROUP_ 369 GearIndcnRec 1 : GearIndcnRecGearIndcn GearIndcnRecGearShiftIndcn GearIndcnRecGearTarIndcn;
SIG_GROUP_ 369 ImobRemMgrChk 1 : ImobRemMgrChkImobDataRemMgrChk0 ImobRemMgrChkImobDataRemMgrChk1 ImobRemMgrChkImobDataRemMgrChk2 ImobRemMgrChkImobDataRemMgrChk3 ImobRemMgrChkImobDataRemMgrChk4 ImobRemMgrChkSts;
SIG_GROUP_ 369 ImobVehRemMgrSts1 1 : ImobVehRemMgrSts1ImobVehRemMgrSts ImobVehRemMgrSts1SpdLimRemMgrSts;
SIG_GROUP_ 306 KeyEnaSts 1 : KeyEnaStsKey0 KeyEnaStsKey1 KeyEnaStsKey10 KeyEnaStsKey11 KeyEnaStsKey2 KeyEnaStsKey3 KeyEnaStsKey4 KeyEnaStsKey5 KeyEnaStsKey6 KeyEnaStsKey7 KeyEnaStsKey8 KeyEnaStsKey9;
SIG_GROUP_ 666 MirrCmdAtDrvr 1 : MirrCmdAtDrvrMirrDwnCmd MirrCmdAtDrvrMirrFoldCmd MirrCmdAtDrvrMirrPosAdjCmd;
SIG_GROUP_ 306 MirrPosnAdjFromSetTarPosnPass 1 : MirrPosnAdjFromSetTarPosnPassMirrAdjLeRi MirrPosnAdjFromSetTarPosnPassMirrAdjUpDown;
SIG_GROUP_ 369 OpenClsCmftReq 1 : OpenClsCmftReqOpenClsCmftReq OpenClsCmftReqOpenClsCmftTrigSrc;
SIG_GROUP_ 371 PwrCnsAvgIndcd 1 : PwrCnsAvgIndcdEcoDrvInfo1 PwrCnsAvgIndcdPwrCnsUnit;
SIG_GROUP_ 447 SbwSteerBackToCenterSetg 1 : SbwSteerBackToCenterSetgChks SbwSteerBackToCenterSetgCntr SbwSteerBackToCenterSetgSetg;
SIG_GROUP_ 447 SbwSteerRatiosFolwSpdSetg 1 : SbwSteerRatiosFolwSpdSetgChks SbwSteerRatiosFolwSpdSetgCntr SbwSteerRatiosFolwSpdSetgSetg;
SIG_GROUP_ 447 SbwSteerRatiosLvlSetg 1 : SbwSteerRatiosLvlSetgChks SbwSteerRatiosLvlSetgCntr SbwSteerRatiosLvlSetgSetg;
SIG_GROUP_ 447 SbwSteerRatiosSetg 1 : SbwSteerRatiosSetgChks SbwSteerRatiosSetgCntr SbwSteerRatiosSetgSetg;
SIG_GROUP_ 447 SbwSteerRemainsStatySetg 1 : SbwSteerRemainsStatySetgChks SbwSteerRemainsStatySetgCntr SbwSteerRemainsStatySetgSetg;
SIG_GROUP_ 306 SeatRowSecLeSwtSts 1 : SeatRowSecLeSwtStsPassSeatSwtAdjmtOfSpplFctHozlSts SeatRowSecLeSwtStsPassSeatSwtAdjmtOfSpplFctVerSts SeatRowSecLeSwtStsPassSeatSwtHdrstHozlSts SeatRowSecLeSwtStsPassSeatSwtHdrstVertSts SeatRowSecLeSwtStsPassSeatSwtHeiFrntSts SeatRowSecLeSwtStsPassSeatSwtHeiSts SeatRowSecLeSwtStsPassSeatSwtInclSts SeatRowSecLeSwtStsPassSeatSwtSelnOfSpplFctStsSts SeatRowSecLeSwtStsPassSeatSwtSldSts;
SIG_GROUP_ 306 SeatRowSecRiSwtSts 1 : SeatRowSecRiSwtStsPassSeatSwtAdjmtOfSpplFctHozlSts SeatRowSecRiSwtStsPassSeatSwtAdjmtOfSpplFctVerSts SeatRowSecRiSwtStsPassSeatSwtHdrstHozlSts SeatRowSecRiSwtStsPassSeatSwtHdrstVertSts SeatRowSecRiSwtStsPassSeatSwtHeiFrntSts SeatRowSecRiSwtStsPassSeatSwtHeiSts SeatRowSecRiSwtStsPassSeatSwtInclSts SeatRowSecRiSwtStsPassSeatSwtSelnOfSpplFctStsSts SeatRowSecRiSwtStsPassSeatSwtSldSts;
SIG_GROUP_ 306 SeatRowThrdLeSldPosPerc 1 : SeatRowThrdLeSldPosPercSeatPosPerc SeatRowThrdLeSldPosPercSeatPosQf;
SIG_GROUP_ 306 SeatRowThrdRiFoldSts 1 : SeatRowThrdRiFoldStsSeatFoldRaiseFlt SeatRowThrdRiFoldStsSeatFoldRaiseMovmt;
SIG_GROUP_ 306 SeatRowThrdRiSldPosPerc 1 : SeatRowThrdRiSldPosPercSeatPosPerc SeatRowThrdRiSldPosPercSeatPosQf;
SIG_GROUP_ 666 SecPwrSrcUloWarn 1 : SecPwrSrcUloWarnChks SecPwrSrcUloWarnCntr SecPwrSrcUloWarnULoWarn;
SIG_GROUP_ 721 TotDstToEmpty 1 : TotDstToEmptyDstToEmpty TotDstToEmptyDstUnit;
SIG_GROUP_ 1377 ZCUDMdevelpsignalgroupReq 1 : ZCUDMdevelpsignalgroupReqFunctiondevpsignalgroup1 ZCUDMdevelpsignalgroupReqFunctiondevpsignalgroup2 ZCUDMdevelpsignalgroupReqFunctiondevpsignalgroup3 ZCUDMdevelpsignalgroupReqFunctiondevpsignalgroup4 ZCUDMdevelpsignalgroupReqFunctiondevpsignalgroup5 ZCUDMdevelpsignalgroupReqFunctiondevpsignalgroup6 ZCUDMdevelpsignalgroupReqFunctiondevpsignalgroup7 ZCUDMdevelpsignalgroupReqFunctiondevpsignalgroup8;
SIG_GROUP_ 1378 ZCUDMdevelpsignalgroupResp 1 : ZCUDMdevelpsignalgroupRespFunctiondevpsignalgroup1 ZCUDMdevelpsignalgroupRespFunctiondevpsignalgroup2 ZCUDMdevelpsignalgroupRespFunctiondevpsignalgroup3 ZCUDMdevelpsignalgroupRespFunctiondevpsignalgroup4 ZCUDMdevelpsignalgroupRespFunctiondevpsignalgroup5 ZCUDMdevelpsignalgroupRespFunctiondevpsignalgroup6 ZCUDMdevelpsignalgroupRespFunctiondevpsignalgroup7 ZCUDMdevelpsignalgroupRespFunctiondevpsignalgroup8;
SIG_GROUP_ 1378 ZCUDMDevpFrameForDebug 1 : ZCUDMDevpFrameForDebugFunctiondevpsignalgroup1 ZCUDMDevpFrameForDebugFunctiondevpsignalgroup2 ZCUDMDevpFrameForDebugFunctiondevpsignalgroup3 ZCUDMDevpFrameForDebugFunctiondevpsignalgroup4 ZCUDMDevpFrameForDebugFunctiondevpsignalgroup5 ZCUDMDevpFrameForDebugFunctiondevpsignalgroup6 ZCUDMDevpFrameForDebugFunctiondevpsignalgroup7 ZCUDMDevpFrameForDebugFunctiondevpsignalgroup8;
SIG_GROUP_ 1377 ZCUPdevelpsignalgroupReq 1 : ZCUPdevelpsignalgroupReqFunctiondevpsignalgroup1 ZCUPdevelpsignalgroupReqFunctiondevpsignalgroup2 ZCUPdevelpsignalgroupReqFunctiondevpsignalgroup3 ZCUPdevelpsignalgroupReqFunctiondevpsignalgroup4 ZCUPdevelpsignalgroupReqFunctiondevpsignalgroup5 ZCUPdevelpsignalgroupReqFunctiondevpsignalgroup6 ZCUPdevelpsignalgroupReqFunctiondevpsignalgroup7 ZCUPdevelpsignalgroupReqFunctiondevpsignalgroup8;
