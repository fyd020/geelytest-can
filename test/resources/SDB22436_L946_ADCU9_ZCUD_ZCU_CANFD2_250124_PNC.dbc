// *************************************************************************** *
// *                                                                           *
// * Description:         CANDB File                                           *
// * Generated at:        2025-01-24 14:38                                     *
// * System:              SDB22436                                             *
// * Variant:             L946_ADCU9_ZCUD                                      *
// * Network:             ZCU_CANFD2                                           *
// *                                                                           *
// *************************************************************************** *
VERSION "ZCU_CANFD2"

NS_ :

BS_ :

BU_ :  ETC IHU ZCUD ZCUP

BO_ 2047 DhuToAllFuncZCUCANFD2DiagReqFr : 8 IHU

BO_ 1820 DhuToZcudCmdZCUCANFD2DiagReqFr : 64 IHU

BO_ 1821 DhuToZcudCmpZCUCANFD2DiagReqFr : 64 IHU

BO_ 1850 DhuToZcudDlmZCUCANFD2DiagReqFr : 64 IHU

BO_ 1969 DhuToZcudDpod2ZCUCANFD2DiagReqFr : 64 IHU

BO_ 1971 DhuToZcudHcmlZCUCANFD2DiagReqFr : 64 IHU

BO_ 1972 DhuToZcudHcmrZCUCANFD2DiagReqFr : 64 IHU

BO_ 1968 DhuToZcudLpod2ZCUCANFD2DiagReqFr : 64 IHU

BO_ 1813 DhuToZcudPotZCUCANFD2DiagReqFr : 64 IHU

BO_ 1980 DhuToZcudPpod2ZCUCANFD2DiagReqFr : 64 IHU

BO_ 1970 DhuToZcudRcmZCUCANFD2DiagReqFr : 64 IHU

BO_ 1808 DhuToZcudRmlZCUCANFD2DiagReqFr : 64 IHU

BO_ 1809 DhuToZcudRmrZCUCANFD2DiagReqFr : 64 IHU

BO_ 1979 DhuToZcudRpod2ZCUCANFD2DiagReqFr : 64 IHU

BO_ 1827 DhuToZcudSdlZCUCANFD2DiagReqFr : 64 IHU

BO_ 1828 DhuToZcudSdrZCUCANFD2DiagReqFr : 64 IHU

BO_ 1841 DhuToZcudSmblZCUCANFD2DiagReqFr : 64 IHU

BO_ 1842 DhuToZcudSmbrZCUCANFD2DiagReqFr : 64 IHU

BO_ 1833 DhuToZcudSmbZCUCANFD2DiagReqFr : 64 IHU

BO_ 1832 DhuToZcudSmp2ZCUCANFD2DiagReqFr : 64 IHU

BO_ 2033 DhuToZcudSrsISO26021ZCUCanFD2ReqFr : 8 IHU

BO_ 1849 DhuToZcudSrsZCUCANFD2DiagReqFr : 64 IHU

BO_ 1906 DhuToZcudSwmZCUCANFD2DiagReqFr : 64 IHU

BO_ 1834 DhuToZcudTcmbZCUCANFD2DiagReqFr : 64 IHU

BO_ 1815 DhuToZcudTrmZCUCANFD2DiagReqFr : 64 IHU

BO_ 1793 DhuToZcudZCUCANFD2DiagReqFr : 64 IHU

BO_ 1825 DhuToZcudZcudsZCUCANFD2DiagReqFr : 64 IHU

BO_ 1794 DhuToZcupZCUCANFD2DiagReqFr : 64 IHU

BO_ 432 DhuZCUCANFD2Fr01 : 64 IHU
 SG_ ActvnOfGiveWay : 7|1@0+ (1,0) [0|1] "" ZCUD
 SG_ ActvnOfGiveWay_UB : 145|1@0+ (1,0) [0|1] "" ZCUD
 SG_ ActvnOfTakeOverMic : 6|2@0+ (1,0) [0|3] "" ZCUD
 SG_ ActvnOfTakeOverMic_UB : 144|1@0+ (1,0) [0|1] "" ZCUD
 SG_ ActvReSplrHldSwt : 459|1@0+ (1,0) [0|1] "" ZCUD
 SG_ ActvReSplrHldSwt_UB : 458|1@0+ (1,0) [0|1] "" ZCUD
 SG_ AFSSetReq : 4|1@0+ (1,0) [0|1] "" ZCUD
 SG_ AFSSetReq_UB : 152|1@0+ (1,0) [0|1] "" ZCUD
 SG_ AllSeatResetReq : 302|1@0+ (1,0) [0|1] "" ZCUD,ZCUP
 SG_ AllSeatResetReq_UB : 301|1@0+ (1,0) [0|1] "" ZCUD,ZCUP
 SG_ ApproachLiSetReq : 3|2@0+ (1,0) [0|3] "" ZCUD
 SG_ ApproachLiSetReq_UB : 153|1@0+ (1,0) [0|1] "" ZCUD
 SG_ ApproachOpenTrOnOff : 237|1@0+ (1,0) [0|1] "" ZCUD
 SG_ ApproachOpenTrOnOff_UB : 236|1@0+ (1,0) [0|1] "" ZCUD
 SG_ AutHiBeamSwt : 1|1@0+ (1,0) [0|1] "" ZCUD
 SG_ AutHiBeamSwt_UB : 155|1@0+ (1,0) [0|1] "" ZCUD
 SG_ BackrestAdjmtRowSecLe : 297|2@0+ (1,0) [0|3] "" ZCUD
 SG_ BackrestAdjmtRowSecLe_UB : 311|1@0+ (1,0) [0|1] "" ZCUD
 SG_ BackrestAdjmtRowSecRi : 309|2@0+ (1,0) [0|3] "" ZCUD
 SG_ BackrestAdjmtRowSecRi_UB : 310|1@0+ (1,0) [0|1] "" ZCUD
 SG_ BackrestAdjmtRowThrdLe : 95|2@0+ (1,0) [0|3] "" ZCUD
 SG_ BackrestAdjmtRowThrdLe_UB : 13|1@0+ (1,0) [0|1] "" ZCUD
 SG_ BackrestAdjmtRowThrdRi : 93|2@0+ (1,0) [0|3] "" ZCUD
 SG_ BackrestAdjmtRowThrdRi_UB : 136|1@0+ (1,0) [0|1] "" ZCUD
 SG_ BendingLiSetReq : 0|1@0+ (1,0) [0|1] "" ZCUD
 SG_ BendingLiSetReq_UB : 157|1@0+ (1,0) [0|1] "" ZCUD
 SG_ CallSts : 12|1@0+ (1,0) [0|1] "" ZCUP
 SG_ CallSts_UB : 158|1@0+ (1,0) [0|1] "" ZCUP
 SG_ CarFindrHornLiSetActv : 11|2@0+ (1,0) [0|3] "" ZCUD
 SG_ CarFindrHornLiSetActv_UB : 159|1@0+ (1,0) [0|1] "" ZCUD
 SG_ CarpetLiSwtReq : 9|1@0+ (1,0) [0|1] "" ZCUD
 SG_ CarpetLiSwtReq_UB : 160|1@0+ (1,0) [0|1] "" ZCUD
 SG_ CarpetLiTiReq : 23|4@0+ (1,0) [0|15] "" ZCUD
 SG_ CarpetLiTiReq_UB : 161|1@0+ (1,0) [0|1] "" ZCUD
 SG_ CenLockHmiReq : 19|2@0+ (1,0) [0|3] "" ZCUD
 SG_ CenLockHmiReq_UB : 162|1@0+ (1,0) [0|1] "" ZCUD
 SG_ ChrgLidCtrlHmiReq_UB : 163|1@0+ (1,0) [0|1] "" ZCUD
 SG_ ChrgLidCtrlHmiReqACandDCchargelid : 31|2@0+ (1,0) [0|3] "" ZCUD
 SG_ ChrgLidCtrlHmiReqACchargelid : 29|2@0+ (1,0) [0|3] "" ZCUD
 SG_ ChrgLidCtrlHmiReqDCchargelid : 27|2@0+ (1,0) [0|3] "" ZCUD
 SG_ ChrgnLiSwt : 17|2@0+ (1,0) [0|3] "" ZCUD
 SG_ ChrgnLiSwt_UB : 164|1@0+ (1,0) [0|1] "" ZCUD
 SG_ ClsAutEna : 8|1@0+ (1,0) [0|1] "" ZCUD
 SG_ ClsAutEna_UB : 165|1@0+ (1,0) [0|1] "" ZCUD
 SG_ ComityPedLiSwt : 39|1@0+ (1,0) [0|1] "" ZCUD
 SG_ ComityPedLiSwt_UB : 166|1@0+ (1,0) [0|1] "" ZCUD
 SG_ DrvrSeatAdpvLumSetg : 239|1@0+ (1,0) [0|1] "" ZCUD
 SG_ DrvrSeatAdpvLumSetg_UB : 238|1@0+ (1,0) [0|1] "" ZCUD
 SG_ DrvrSeatAdpvSideSpprtSetg : 453|2@0+ (1,0) [0|3] "" ZCUD
 SG_ DrvrSeatAdpvSideSpprtSetg_UB : 451|1@0+ (1,0) [0|1] "" ZCUD
 SG_ DstToDestination : 47|32@0+ (1.0,0.0) [0.0|4294967295.0] "Unitless" ZCUD
 SG_ DstToDestination_UB : 168|1@0+ (1,0) [0|1] "" ZCUD
 SG_ EasyInOutFrntPassReq : 79|2@0+ (1,0) [0|3] "" ZCUD
 SG_ EasyInOutFrntPassReq_UB : 169|1@0+ (1,0) [0|1] "" ZCUD
 SG_ FrnPosnLiFolwDayTiRunngLiOnOff : 32|1@0+ (1,0) [0|1] "" ZCUD
 SG_ FrnPosnLiFolwDayTiRunngLiOnOff_UB : 172|1@0+ (1,0) [0|1] "" ZCUD
 SG_ FrntDstPrjSwt : 77|1@0+ (1,0) [0|1] "" ZCUD
 SG_ FrntDstPrjSwt_UB : 173|1@0+ (1,0) [0|1] "" ZCUD
 SG_ HmiCarLocatorSetReq : 327|1@0+ (1,0) [0|1] "" ZCUD
 SG_ HmiCarLocatorSetReq_UB : 326|1@0+ (1,0) [0|1] "" ZCUD
 SG_ HmiPM25PopUpResp : 299|2@0+ (1,0) [0|3] "" ZCUP
 SG_ HmiPM25PopUpResp_UB : 300|1@0+ (1,0) [0|1] "" ZCUP
 SG_ HmiSeatHeatAutStrtRowSecLe : 38|1@0+ (1,0) [0|1] "" ZCUD
 SG_ HmiSeatHeatAutStrtRowSecLe_UB : 37|1@0+ (1,0) [0|1] "" ZCUD
 SG_ HmiSeatHeatAutStrtRowSecRi : 36|1@0+ (1,0) [0|1] "" ZCUD
 SG_ HmiSeatHeatAutStrtRowSecRi_UB : 35|1@0+ (1,0) [0|1] "" ZCUD
 SG_ HmiSeatHeatAutStrtRowThrdLe : 34|1@0+ (1,0) [0|1] "" ZCUD
 SG_ HmiSeatHeatAutStrtRowThrdLe_UB : 33|1@0+ (1,0) [0|1] "" ZCUD
 SG_ HmiSeatHeatAutStrtRowThrdRi : 87|1@0+ (1,0) [0|1] "" ZCUD
 SG_ HmiSeatHeatAutStrtRowThrdRi_UB : 86|1@0+ (1,0) [0|1] "" ZCUD
 SG_ HmiSeatVentAutStrtRowSecLe : 85|1@0+ (1,0) [0|1] "" ZCUD
 SG_ HmiSeatVentAutStrtRowSecLe_UB : 84|1@0+ (1,0) [0|1] "" ZCUD
 SG_ HmiSeatVentAutStrtRowSecRi : 83|1@0+ (1,0) [0|1] "" ZCUD
 SG_ HmiSeatVentAutStrtRowSecRi_UB : 82|1@0+ (1,0) [0|1] "" ZCUD
 SG_ HMIToVMMSet_UB : 441|1@0+ (1,0) [0|1] "" ZCUD
 SG_ HMIToVMMSetSetting1 : 421|3@0+ (1,0) [0|7] "" ZCUD
 SG_ HMIToVMMSetSetting2 : 418|3@0+ (1,0) [0|7] "" ZCUD
 SG_ HMIToVMMSetSetting3 : 431|3@0+ (1,0) [0|7] "" ZCUD
 SG_ HMIToVMMSetSetting4 : 428|3@0+ (1,0) [0|7] "" ZCUD
 SG_ HMIToVMMSetSetting5 : 439|3@0+ (1,0) [0|7] "" ZCUD
 SG_ HMIToVMMSetSetting6 : 436|3@0+ (1,0) [0|7] "" ZCUD
 SG_ HMIToVMMSetSetting7 : 447|3@0+ (1,0) [0|7] "" ZCUD
 SG_ HMIToVMMSetSetting8 : 444|3@0+ (1,0) [0|7] "" ZCUD
 SG_ LaneChgAsscPrjSwt : 73|1@0+ (1,0) [0|1] "" ZCUD
 SG_ LaneChgAsscPrjSwt_UB : 177|1@0+ (1,0) [0|1] "" ZCUD
 SG_ LDACSoftBtnSwtSt : 233|2@0+ (1,0) [0|3] "" ZCUD
 SG_ LDACSoftBtnSwtSt_UB : 449|1@0+ (1,0) [0|1] "" ZCUD
 SG_ LDACUsgModReq : 317|1@0+ (1,0) [0|1] "" ZCUD
 SG_ LDACUsgModReq_UB : 316|1@0+ (1,0) [0|1] "" ZCUD
 SG_ LegRestRotAdjmtRowSecLe : 182|2@0+ (1,0) [0|3] "" ZCUD
 SG_ LegRestRotAdjmtRowSecLe_UB : 167|1@0+ (1,0) [0|1] "" ZCUD
 SG_ LegRestRotAdjmtRowSecRi : 199|2@0+ (1,0) [0|3] "" ZCUD
 SG_ LegRestRotAdjmtRowSecRi_UB : 176|1@0+ (1,0) [0|1] "" ZCUD
 SG_ LenAdjmtRowSecLe : 307|2@0+ (1,0) [0|3] "" ZCUD
 SG_ LenAdjmtRowSecLe_UB : 305|1@0+ (1,0) [0|1] "" ZCUD
 SG_ LenAdjmtRowSecRi : 319|2@0+ (1,0) [0|3] "" ZCUD
 SG_ LenAdjmtRowSecRi_UB : 304|1@0+ (1,0) [0|1] "" ZCUD
 SG_ LenAdjmtRowThrdLe : 367|2@0+ (1,0) [0|3] "" ZCUD
 SG_ LenAdjmtRowThrdLe_UB : 365|1@0+ (1,0) [0|1] "" ZCUD
 SG_ LenAdjmtRowThrdRi : 363|2@0+ (1,0) [0|3] "" ZCUD
 SG_ LenAdjmtRowThrdRi_UB : 364|1@0+ (1,0) [0|1] "" ZCUD
 SG_ LockgFbSoundReq : 91|1@0+ (1,0) [0|1] "" ZCUD
 SG_ LockgFbSoundReq_UB : 90|1@0+ (1,0) [0|1] "" ZCUD
 SG_ LumHeiAdjmtSecRowLe : 197|2@0+ (1,0) [0|3] "" ZCUD
 SG_ LumHeiAdjmtSecRowLe_UB : 188|1@0+ (1,0) [0|1] "" ZCUD
 SG_ LumHeiAdjmtSecRowRi : 195|2@0+ (1,0) [0|3] "" ZCUD
 SG_ LumHeiAdjmtSecRowRi_UB : 246|1@0+ (1,0) [0|1] "" ZCUD
 SG_ LumLenAdjmtSecRowLe : 245|2@0+ (1,0) [0|3] "" ZCUD
 SG_ LumLenAdjmtSecRowLe_UB : 243|1@0+ (1,0) [0|1] "" ZCUD
 SG_ LumLenAdjmtSecRowRi : 242|2@0+ (1,0) [0|3] "" ZCUD
 SG_ LumLenAdjmtSecRowRi_UB : 240|1@0+ (1,0) [0|1] "" ZCUD
 SG_ ParkGearUnlckHmiReq : 81|2@0+ (1,0) [0|3] "" ZCUD
 SG_ ParkGearUnlckHmiReq_UB : 178|1@0+ (1,0) [0|1] "" ZCUD
 SG_ PasAlrmDeactvnReq : 74|1@0+ (1,0) [0|1] "" ZCUD
 SG_ PasAlrmDeactvnReq_UB : 154|1@0+ (1,0) [0|1] "" ZCUD
 SG_ PassSeatAdpvLumSetg : 223|1@0+ (1,0) [0|1] "" ZCUD,ZCUP
 SG_ PassSeatAdpvLumSetg_UB : 222|1@0+ (1,0) [0|1] "" ZCUD,ZCUP
 SG_ PassSeatAdpvSideSpprtSetg : 221|2@0+ (1,0) [0|3] "" ZCUD,ZCUP
 SG_ PassSeatAdpvSideSpprtSetg_UB : 219|1@0+ (1,0) [0|1] "" ZCUD,ZCUP
 SG_ PassSeatFootRstAdjmt : 217|2@0+ (1,0) [0|3] "" ZCUP
 SG_ PassSeatFootRstAdjmt_UB : 218|1@0+ (1,0) [0|1] "" ZCUP
 SG_ PassSeatFootRstTargPosPerc : 231|7@0+ (1.0,0.0) [0.0|127.0] "%" ZCUP
 SG_ PassSeatFootRstTargPosPerc_UB : 224|1@0+ (1,0) [0|1] "" ZCUP
 SG_ PassSeatTarPosnCmdReq_UB : 193|1@0+ (1,0) [0|1] "" ZCUP
 SG_ PassSeatTarPosnCmdReqSeatBackrTargPosAg : 383|8@0+ (1.0,0.0) [0.0|180.0] "Deg" ZCUP
 SG_ PassSeatTarPosnCmdReqSeatFrntHeiTargPosPerc : 361|10@0+ (0.1,0.0) [0.0|100.0] "%" ZCUP
 SG_ PassSeatTarPosnCmdReqSeatHeiTargPosPerc : 391|10@0+ (0.1,0.0) [0.0|100.0] "%" ZCUP
 SG_ PassSeatTarPosnCmdReqSeatLenTargPosPerc : 393|10@0+ (0.1,0.0) [0.0|100.0] "%" ZCUP
 SG_ PassSeatTarPosnCmdReqSeatPosFrntExtPerc : 415|10@0+ (0.1,0.0) [0.0|100.0] "%" ZCUP
 SG_ PassSeatTarPosnCmdReqTarPosnCmd : 397|3@0+ (1,0) [0|7] "" ZCUP
 SG_ PedRmnSwt : 72|1@0+ (1,0) [0|1] "" ZCUD
 SG_ PedRmnSwt_UB : 179|1@0+ (1,0) [0|1] "" ZCUD
 SG_ PrkgCmftModTiCtrl : 103|8@0+ (1.0,0.0) [0.0|255.0] "Unitless" ZCUD
 SG_ PrkgCmftModTiCtrl_UB : 180|1@0+ (1,0) [0|1] "" ZCUD
 SG_ PwrTonneauCoverHmiReqRadar : 455|2@0+ (1,0) [0|3] "" ZCUD
 SG_ PwrTonneauCoverHmiReqRadar_UB : 440|1@0+ (1,0) [0|1] "" ZCUD
 SG_ RFDRestrictsts : 463|4@0+ (1.0,0.0) [0.0|15.0] "Unitless" ZCUD,ZCUP
 SG_ RFDRestrictsts_UB : 450|1@0+ (1,0) [0|1] "" ZCUD,ZCUP
 SG_ SeatFoldRaiseReqRowThrdLe : 270|2@0+ (1,0) [0|3] "" ZCUD
 SG_ SeatFoldRaiseReqRowThrdLe_UB : 268|1@0+ (1,0) [0|1] "" ZCUD
 SG_ SeatFoldRaiseReqRowThrdRi : 267|2@0+ (1,0) [0|3] "" ZCUD
 SG_ SeatFoldRaiseReqRowThrdRi_UB : 265|1@0+ (1,0) [0|1] "" ZCUD
 SG_ SeatRowSecLeRotateAdjmt : 279|8@0- (1.0,0.0) [-128.0|127.0] "Unitless" ZCUD
 SG_ SeatRowSecLeRotateAdjmt_UB : 264|1@0+ (1,0) [0|1] "" ZCUD
 SG_ SeatRowSecRiRotateAdjmt : 287|8@0- (1.0,0.0) [-128.0|127.0] "Unitless" ZCUD
 SG_ SeatRowSecRiRotateAdjmt_UB : 295|1@0+ (1,0) [0|1] "" ZCUD
 SG_ SecRowLeCmftSet : 291|2@0+ (1,0) [0|3] "" ZCUD
 SG_ SecRowLeCmftSet_UB : 289|1@0+ (1,0) [0|1] "" ZCUD
 SG_ SecRowLeSeatDispMassgFct_UB : 344|1@0+ (1,0) [0|1] "" ZCUD
 SG_ SecRowLeSeatDispMassgFctMassgInten : 351|2@0+ (1,0) [0|3] "" ZCUD
 SG_ SecRowLeSeatDispMassgFctMassgProg : 349|3@0+ (1,0) [0|7] "" ZCUD
 SG_ SecRowLeSeatDispMassgFctOnOffl2 : 346|2@0+ (1,0) [0|3] "" ZCUD
 SG_ SecRowRiCmftSet : 294|2@0+ (1,0) [0|3] "" ZCUD
 SG_ SecRowRiCmftSet_UB : 292|1@0+ (1,0) [0|1] "" ZCUD
 SG_ SecRowRiSeatDispMassgFct_UB : 352|1@0+ (1,0) [0|1] "" ZCUD
 SG_ SecRowRiSeatDispMassgFctMassgInten : 359|2@0+ (1,0) [0|3] "" ZCUD
 SG_ SecRowRiSeatDispMassgFctMassgProg : 357|3@0+ (1,0) [0|7] "" ZCUD
 SG_ SecRowRiSeatDispMassgFctOnOffl2 : 354|2@0+ (1,0) [0|3] "" ZCUD
 SG_ SngDoorOrFourDoorSelectReq : 115|1@0+ (1,0) [0|1] "" ZCUD
 SG_ SngDoorOrFourDoorSelectReq_UB : 114|1@0+ (1,0) [0|1] "" ZCUD
 SG_ SoftLiBtnSwtSetReq_UB : 183|1@0+ (1,0) [0|1] "" ZCUD
 SG_ SoftLiBtnSwtSetReqChks : 127|8@0+ (1.0,0.0) [0.0|255.0] "Unitless" ZCUD
 SG_ SoftLiBtnSwtSetReqCntr : 135|4@0+ (1.0,0.0) [0.0|15.0] "Unitless" ZCUD
 SG_ SoftLiBtnSwtSetReqLiExtFctReq1 : 131|2@0+ (1,0) [0|3] "" ZCUD
 SG_ SteerAdjSwtBackSts : 111|1@0+ (1,0) [0|1] "" ZCUD
 SG_ SteerAdjSwtBackSts_UB : 110|1@0+ (1,0) [0|1] "" ZCUD
 SG_ SteerAdjSwtDwnSts : 109|1@0+ (1,0) [0|1] "" ZCUD
 SG_ SteerAdjSwtDwnSts_UB : 108|1@0+ (1,0) [0|1] "" ZCUD
 SG_ SteerAdjSwtFwdSts : 119|1@0+ (1,0) [0|1] "" ZCUD
 SG_ SteerAdjSwtFwdSts_UB : 118|1@0+ (1,0) [0|1] "" ZCUD
 SG_ SteerAdjSwtUpSts : 117|1@0+ (1,0) [0|1] "" ZCUD
 SG_ SteerAdjSwtUpSts_UB : 116|1@0+ (1,0) [0|1] "" ZCUD
 SG_ SunCurtOpenPosnReq : 142|5@0+ (1,0) [0|31] "" ZCUD
 SG_ SunCurtOpenPosnReq_UB : 185|1@0+ (1,0) [0|1] "" ZCUD
 SG_ SunRoofOpenPosnReq : 151|5@0+ (1,0) [0|31] "" ZCUD
 SG_ SunRoofOpenPosnReq_UB : 186|1@0+ (1,0) [0|1] "" ZCUD
 SG_ SunRoofTiltReq : 137|1@0+ (1,0) [0|1] "" ZCUD
 SG_ SunRoofTiltReq_UB : 187|1@0+ (1,0) [0|1] "" ZCUD
 SG_ ThrdRowLeSeatDispMassgFct_UB : 200|1@0+ (1,0) [0|1] "" ZCUD
 SG_ ThrdRowLeSeatDispMassgFctMassgInten : 207|2@0+ (1,0) [0|3] "" ZCUD
 SG_ ThrdRowLeSeatDispMassgFctMassgProg : 205|3@0+ (1,0) [0|7] "" ZCUD
 SG_ ThrdRowLeSeatDispMassgFctOnOffl2 : 202|2@0+ (1,0) [0|3] "" ZCUD
 SG_ ThrdRowRiSeatDispMassgFct_UB : 208|1@0+ (1,0) [0|1] "" ZCUD
 SG_ ThrdRowRiSeatDispMassgFctMassgInten : 215|2@0+ (1,0) [0|3] "" ZCUD
 SG_ ThrdRowRiSeatDispMassgFctMassgProg : 213|3@0+ (1,0) [0|7] "" ZCUD
 SG_ ThrdRowRiSeatDispMassgFctOnOffl2 : 210|2@0+ (1,0) [0|3] "" ZCUD
 SG_ TiToDestNavRoute_UB : 325|1@0+ (1,0) [0|1] "" ZCUD
 SG_ TiToDestNavRouteDay2 : 343|4@0+ (1.0,0.0) [0.0|15.0] "Days" ZCUD
 SG_ TiToDestNavRouteHr1 : 324|5@0+ (1.0,0.0) [0.0|23.0] "hours" ZCUD
 SG_ TiToDestNavRouteMins1 : 335|6@0+ (1.0,0.0) [0.0|59.0] "Mins" ZCUD
 SG_ TrFootMovmtDetnSwt : 288|1@0+ (1,0) [0|1] "" ZCUD
 SG_ TrFootMovmtDetnSwt_UB : 303|1@0+ (1,0) [0|1] "" ZCUD
 SG_ TrLiSwt : 457|2@0+ (1,0) [0|3] "" ZCUD
 SG_ TrlrLampChkAutReq : 235|1@0+ (1,0) [0|1] "" ZCUD
 SG_ TrlrLampChkAutReq_UB : 234|1@0+ (1,0) [0|1] "" ZCUD
 SG_ UsgModChgReqFromUWB : 171|1@0+ (1,0) [0|1] "" ZCUD
 SG_ UsgModChgReqFromUWB_UB : 170|1@0+ (1,0) [0|1] "" ZCUD
 SG_ VehWidthPrjSwt : 146|1@0+ (1,0) [0|1] "" ZCUD
 SG_ VehWidthPrjSwt_UB : 189|1@0+ (1,0) [0|1] "" ZCUD
 SG_ VoiceRemoteCtrlRquestSPKey : 25|1@0+ (1,0) [0|1] "" ZCUD
 SG_ VoiceRemoteCtrlRquestSPKey_UB : 24|1@0+ (1,0) [0|1] "" ZCUD
 SG_ WarnLvlMsg : 315|3@0+ (1,0) [0|7] "" ZCUP
 SG_ WarnLvlMsg_UB : 312|1@0+ (1,0) [0|1] "" ZCUP
 SG_ WelcomeGoodbyeModeReq : 107|4@0+ (1,0) [0|15] "" ZCUD
 SG_ WelcomeGoodbyeModeReq_UB : 190|1@0+ (1,0) [0|1] "" ZCUD
 SG_ WiprFrntSrvModReq : 113|2@0+ (1,0) [0|3] "" ZCUD,ZCUP
 SG_ WiprFrntSrvModReq_UB : 191|1@0+ (1,0) [0|1] "" ZCUD,ZCUP
 SG_ WiprReSrvModReq : 129|2@0+ (1,0) [0|3] "" ZCUD
 SG_ WiprReSrvModReq_UB : 192|1@0+ (1,0) [0|1] "" ZCUD

BO_ 448 DhuZCUCANFD2Fr02 : 64 IHU
 SG_ ActvReSplrPrkgInteractionSwt : 70|1@0+ (1,0) [0|1] "" ZCUD
 SG_ ActvReSplrPrkgInteractionSwt_UB : 112|1@0+ (1,0) [0|1] "" ZCUD
 SG_ AmbientLiEffectStatus_UB : 14|1@0+ (1,0) [0|1] "" ZCUP
 SG_ AmbientLiEffectStatusBreathingEffectStatus : 13|1@0+ (1,0) [0|1] "" ZCUP
 SG_ AmbientLiEffectStatusTransitionEffectStatus : 12|1@0+ (1,0) [0|1] "" ZCUP
 SG_ AmbLiAll : 15|1@0+ (1,0) [0|1] "" ZCUP
 SG_ AmbLiAll_UB : 0|1@0+ (1,0) [0|1] "" ZCUP
 SG_ AmbLiClimateCorrlnReq : 31|1@0+ (1,0) [0|1] "" ZCUP
 SG_ AmbLiClimateCorrlnReq_UB : 30|1@0+ (1,0) [0|1] "" ZCUP
 SG_ AmbLiColorModReq : 23|3@0+ (1,0) [0|7] "" ZCUP
 SG_ AmbLiColorModReq_UB : 20|1@0+ (1,0) [0|1] "" ZCUP
 SG_ AmbLiEnduranceMilgOpenReq : 19|1@0+ (1,0) [0|1] "" ZCUP
 SG_ AmbLiEnduranceMilgOpenReq_UB : 10|1@0+ (1,0) [0|1] "" ZCUP
 SG_ AmbLiModExt : 183|5@0+ (1,0) [0|31] "" ZCUP
 SG_ AmbLiModExt_UB : 169|1@0+ (1,0) [0|1] "" ZCUP
 SG_ AmbLiMusicCorrlnReq : 26|1@0+ (1,0) [0|1] "" ZCUP
 SG_ AmbLiMusicCorrlnReq_UB : 25|1@0+ (1,0) [0|1] "" ZCUP
 SG_ AmbLiPhoneOpenReq : 27|1@0+ (1,0) [0|1] "" ZCUP
 SG_ AmbLiPhoneOpenReq_UB : 9|1@0+ (1,0) [0|1] "" ZCUP
 SG_ AmbLiSpeechCorrlnReq : 29|1@0+ (1,0) [0|1] "" ZCUP
 SG_ AmbLiSpeechCorrlnReq_UB : 28|1@0+ (1,0) [0|1] "" ZCUP
 SG_ AntithftRednReq : 32|1@0+ (1,0) [0|1] "" ZCUD
 SG_ AntithftRednReq_UB : 33|1@0+ (1,0) [0|1] "" ZCUD
 SG_ BackRestAdjmtRowFirstDrvr : 50|2@0+ (1,0) [0|3] "" ZCUD
 SG_ BackRestAdjmtRowFirstDrvr_UB : 48|1@0+ (1,0) [0|1] "" ZCUD
 SG_ BackRestAdjmtRowFirstPass : 66|2@0+ (1,0) [0|3] "" ZCUP
 SG_ BackRestAdjmtRowFirstPass_UB : 64|1@0+ (1,0) [0|1] "" ZCUP
 SG_ CurrentRoadcongestionLength : 177|10@0+ (0.1,0.0) [0.0|99.0] "KiloMtr" ZCUD
 SG_ CurrentRoadcongestionLength_UB : 178|1@0+ (1,0) [0|1] "" ZCUD
 SG_ CurrentRoadcongestionLvl : 207|2@0+ (1,0) [0|3] "" ZCUD
 SG_ CurrentRoadcongestionLvl_UB : 205|1@0+ (1,0) [0|1] "" ZCUD
 SG_ CurrentRoadCongstionPassTime : 199|8@0+ (1.0,0.0) [0.0|255.0] "Mins" ZCUD
 SG_ CurrentRoadCongstionPassTime_UB : 204|1@0+ (1,0) [0|1] "" ZCUD
 SG_ DrvModDispd : 41|1@0+ (1,0) [0|1] "" ZCUD
 SG_ DrvModDispd_UB : 40|1@0+ (1,0) [0|1] "" ZCUD
 SG_ DrvrEntryLoReq : 17|1@0+ (1,0) [0|1] "" ZCUD
 SG_ DrvrEntryLoReq_UB : 24|1@0+ (1,0) [0|1] "" ZCUD
 SG_ DrvrSeatTarPosnCmdReq_UB : 316|1@0+ (1,0) [0|1] "" ZCUD
 SG_ DrvrSeatTarPosnCmdReqSeatBackrTargPosAg : 279|8@0+ (1.0,0.0) [0.0|180.0] "Deg" ZCUD
 SG_ DrvrSeatTarPosnCmdReqSeatFrntHeiTargPosPerc : 287|10@0+ (0.1,0.0) [0.0|100.0] "%" ZCUD
 SG_ DrvrSeatTarPosnCmdReqSeatHeiTargPosPerc : 293|10@0+ (0.1,0.0) [0.0|100.0] "%" ZCUD
 SG_ DrvrSeatTarPosnCmdReqSeatLenTargPosPerc : 299|10@0+ (0.1,0.0) [0.0|100.0] "%" ZCUD
 SG_ DrvrSeatTarPosnCmdReqTarPosnCmd : 319|3@0+ (1,0) [0|7] "" ZCUD
 SG_ DstToNextCongestionRrd : 201|10@0+ (0.1,0.0) [0.0|99.0] "KiloMtr" ZCUD
 SG_ DstToNextCongestionRrd_UB : 202|1@0+ (1,0) [0|1] "" ZCUD
 SG_ ExtrMirrFoldSetg_UB : 8|1@0+ (1,0) [0|1] "" ZCUD
 SG_ ExtrMirrFoldSetgMirrDrvr : 35|1@0+ (1,0) [0|1] "" ZCUD
 SG_ ExtrMirrFoldSetgMirrPass : 34|1@0+ (1,0) [0|1] "" ZCUD
 SG_ ExtrMirrTiltSetg_UB : 16|1@0+ (1,0) [0|1] "" ZCUD
 SG_ ExtrMirrTiltSetgMirrDrvr : 43|1@0+ (1,0) [0|1] "" ZCUD
 SG_ ExtrMirrTiltSetgMirrPass : 42|1@0+ (1,0) [0|1] "" ZCUD
 SG_ FrntTechLiInfoDispSetReq : 11|1@0+ (1,0) [0|1] "" ZCUD
 SG_ FrntTechLiInfoDispSetReq_UB : 1|1@0+ (1,0) [0|1] "" ZCUD
 SG_ GoodbyeLiOpenReq : 267|1@0+ (1,0) [0|1] "" ZCUP
 SG_ GoodbyeLiOpenReq_UB : 266|1@0+ (1,0) [0|1] "" ZCUP
 SG_ HmiAirDistbnRow1 : 39|3@0+ (1,0) [0|7] "" ZCUD,ZCUP
 SG_ HmiAirDistbnRow1_UB : 36|1@0+ (1,0) [0|1] "" ZCUD,ZCUP
 SG_ HmiAirDistbnRow2 : 47|3@0+ (1,0) [0|7] "" ZCUD,ZCUP
 SG_ HmiAirDistbnRow2_UB : 44|1@0+ (1,0) [0|1] "" ZCUD,ZCUP
 SG_ HMIAutDemstSet : 55|1@0+ (1,0) [0|1] "" ZCUP
 SG_ HMIAutDemstSet_UB : 54|1@0+ (1,0) [0|1] "" ZCUP
 SG_ HmiAutoRow1 : 175|1@0+ (1,0) [0|1] "" ZCUP
 SG_ HmiAutoRow1_UB : 174|1@0+ (1,0) [0|1] "" ZCUP
 SG_ HmiAutoRow2 : 231|1@0+ (1,0) [0|1] "" ZCUP
 SG_ HmiAutoRow2_UB : 230|1@0+ (1,0) [0|1] "" ZCUP
 SG_ HmiCbnOverHeatPrevnReq : 69|2@0+ (1,0) [0|3] "" ZCUP
 SG_ HmiCbnOverHeatPrevnReq_UB : 67|1@0+ (1,0) [0|1] "" ZCUP
 SG_ HmiClimaRow1Pwr : 351|1@0+ (1,0) [0|1] "" ZCUP
 SG_ HmiClimaRow1Pwr_UB : 350|1@0+ (1,0) [0|1] "" ZCUP
 SG_ HmiClimaRow2Pwr : 349|1@0+ (1,0) [0|1] "" ZCUP
 SG_ HmiClimaRow2Pwr_UB : 348|1@0+ (1,0) [0|1] "" ZCUP
 SG_ HmiClimaRow3Pwr : 347|1@0+ (1,0) [0|1] "" ZCUP
 SG_ HmiClimaRow3Pwr_UB : 346|1@0+ (1,0) [0|1] "" ZCUP
 SG_ HmiCmptmtTSp_UB : 239|1@0+ (1,0) [0|1] "" ZCUD,ZCUP
 SG_ HmiCmptmtTSpForRowFirstLe : 383|5@0+ (0.5,15.0) [15.0|30.5] "Deg" ZCUD,ZCUP
 SG_ HmiCmptmtTSpForRowFirstRi : 391|5@0+ (0.5,15.0) [15.0|30.5] "Deg" ZCUD,ZCUP
 SG_ HmiCmptmtTSpForRowSecLe : 399|5@0+ (0.5,15.0) [15.0|30.5] "Deg" ZCUD,ZCUP
 SG_ HmiCmptmtTSpForRowSecRi : 407|5@0+ (0.5,15.0) [15.0|30.5] "Deg" ZCUD,ZCUP
 SG_ HmiCmptmtTSpSpclForRowFirstLe : 378|2@0+ (1,0) [0|3] "" ZCUD,ZCUP
 SG_ HmiCmptmtTSpSpclForRowFirstRi : 386|2@0+ (1,0) [0|3] "" ZCUD,ZCUP
 SG_ HmiCmptmtTSpSpclForRowSecLe : 394|2@0+ (1,0) [0|3] "" ZCUD,ZCUP
 SG_ HmiCmptmtTSpSpclForRowSecRi : 369|2@0+ (1,0) [0|3] "" ZCUD,ZCUP
 SG_ HmiEcoClimaReq : 53|2@0+ (1,0) [0|3] "" ZCUP
 SG_ HmiEcoClimaReq_UB : 51|1@0+ (1,0) [0|1] "" ZCUP
 SG_ HmiElecAirAdpvReq_UB : 400|1@0+ (1,0) [0|1] "" ZCUP
 SG_ HmiElecAirAdpvReqDrvrAdpv : 402|1@0+ (1,0) [0|1] "" ZCUP
 SG_ HmiElecAirAdpvReqPassAdpv : 401|1@0+ (1,0) [0|1] "" ZCUP
 SG_ HmiElecAirDirCrtlReq_UB : 479|1@0+ (1,0) [0|1] "" ZCUP
 SG_ HmiElecAirDirCrtlReqDrvrLePosX : 415|8@0+ (1.0,0.0) [0.0|255.0] "Unitless" ZCUP
 SG_ HmiElecAirDirCrtlReqDrvrLePosY : 423|8@0+ (1.0,0.0) [0.0|255.0] "Unitless" ZCUP
 SG_ HmiElecAirDirCrtlReqDrvrRiPosX : 431|8@0+ (1.0,0.0) [0.0|255.0] "Unitless" ZCUP
 SG_ HmiElecAirDirCrtlReqDrvrRiPosY : 439|8@0+ (1.0,0.0) [0.0|255.0] "Unitless" ZCUP
 SG_ HmiElecAirDirCrtlReqPassLePosX : 447|8@0+ (1.0,0.0) [0.0|255.0] "Unitless" ZCUP
 SG_ HmiElecAirDirCrtlReqPassLePosY : 455|8@0+ (1.0,0.0) [0.0|255.0] "Unitless" ZCUP
 SG_ HmiElecAirDirCrtlReqPassRiPosX : 463|8@0+ (1.0,0.0) [0.0|255.0] "Unitless" ZCUP
 SG_ HmiElecAirDirCrtlReqPassRiPosY : 471|8@0+ (1.0,0.0) [0.0|255.0] "Unitless" ZCUP
 SG_ HmiElecAirDirModReq_UB : 476|1@0+ (1,0) [0|1] "" ZCUP
 SG_ HmiElecAirDirModReqDrvrMod : 475|2@0+ (1,0) [0|3] "" ZCUP
 SG_ HmiElecAirDirModReqPassMod : 473|2@0+ (1,0) [0|3] "" ZCUP
 SG_ HmiElecAirFrntSwtReq_UB : 478|1@0+ (1,0) [0|1] "" ZCUP
 SG_ HmiElecAirFrntSwtReqHmiElecAirDrvrLeSwtReq : 487|1@0+ (1,0) [0|1] "" ZCUP
 SG_ HmiElecAirFrntSwtReqHmiElecAirDrvrRiSwtReq : 486|1@0+ (1,0) [0|1] "" ZCUP
 SG_ HmiElecAirFrntSwtReqHmiElecAirPassLeSwtReq : 485|1@0+ (1,0) [0|1] "" ZCUP
 SG_ HmiElecAirFrntSwtReqHmiElecAirPassRiSwtReq : 484|1@0+ (1,0) [0|1] "" ZCUP
 SG_ HmiElecAirSwngReq_UB : 477|1@0+ (1,0) [0|1] "" ZCUP
 SG_ HmiElecAirSwngReqDrvrLeRiSwng : 483|1@0+ (1,0) [0|1] "" ZCUP
 SG_ HmiElecAirSwngReqDrvrUpOnSwng : 482|1@0+ (1,0) [0|1] "" ZCUP
 SG_ HmiElecAirSwngReqPassLeRiSwng : 481|1@0+ (1,0) [0|1] "" ZCUP
 SG_ HmiElecAirSwngReqPassUpOnSwng : 480|1@0+ (1,0) [0|1] "" ZCUP
 SG_ HmiFanLvlRow1 : 367|4@0+ (1,0) [0|15] "" ZCUD,ZCUP
 SG_ HmiFanLvlRow1_UB : 374|1@0+ (1,0) [0|1] "" ZCUD,ZCUP
 SG_ HmiFanLvlRow2 : 363|4@0+ (1,0) [0|15] "" ZCUP
 SG_ HmiFanLvlRow2_UB : 375|1@0+ (1,0) [0|1] "" ZCUP
 SG_ HmiFragraCh : 372|3@0+ (1,0) [0|7] "" ZCUP
 SG_ HmiFragraCh_UB : 373|1@0+ (1,0) [0|1] "" ZCUP
 SG_ HmiFragraLvl : 173|2@0+ (1,0) [0|3] "" ZCUP
 SG_ HmiFragraLvl_UB : 171|1@0+ (1,0) [0|1] "" ZCUP
 SG_ HmiHvacRecircCmd : 229|2@0+ (1,0) [0|3] "" ZCUP
 SG_ HmiHvacRecircCmd_UB : 168|1@0+ (1,0) [0|1] "" ZCUP
 SG_ HmiMaxAC : 345|1@0+ (1,0) [0|1] "" ZCUP
 SG_ HmiMaxAC_UB : 344|1@0+ (1,0) [0|1] "" ZCUP
 SG_ HmiMaxDefrst : 359|1@0+ (1,0) [0|1] "" ZCUD,ZCUP
 SG_ HmiMaxDefrst_UB : 358|1@0+ (1,0) [0|1] "" ZCUD,ZCUP
 SG_ HMIRapidHeatgUpSet : 7|2@0+ (1,0) [0|3] "" ZCUP
 SG_ HMIRapidHeatgUpSet_UB : 5|1@0+ (1,0) [0|1] "" ZCUP
 SG_ HMIRapidTDrpSet : 3|2@0+ (1,0) [0|3] "" ZCUP
 SG_ HMIRapidTDrpSet_UB : 4|1@0+ (1,0) [0|1] "" ZCUP
 SG_ HmiSeatHeatAutStrtDrvr : 511|1@0+ (1,0) [0|1] "" ZCUD
 SG_ HmiSeatHeatAutStrtDrvr_UB : 510|1@0+ (1,0) [0|1] "" ZCUD
 SG_ HmiSeatHeatAutStrtPass : 509|1@0+ (1,0) [0|1] "" ZCUP
 SG_ HmiSeatHeatAutStrtPass_UB : 508|1@0+ (1,0) [0|1] "" ZCUP
 SG_ HmiSeatHeatLvlDrvr : 495|3@0+ (1,0) [0|7] "" ZCUD
 SG_ HmiSeatHeatLvlDrvr_UB : 492|1@0+ (1,0) [0|1] "" ZCUD
 SG_ HmiSeatHeatLvlPass : 491|3@0+ (1,0) [0|7] "" ZCUP
 SG_ HmiSeatHeatLvlPass_UB : 488|1@0+ (1,0) [0|1] "" ZCUP
 SG_ HmiSeatVentAutStrtDrvr : 507|1@0+ (1,0) [0|1] "" ZCUD
 SG_ HmiSeatVentAutStrtDrvr_UB : 506|1@0+ (1,0) [0|1] "" ZCUD
 SG_ HmiSeatVentAutStrtPass : 505|1@0+ (1,0) [0|1] "" ZCUP
 SG_ HmiSeatVentAutStrtPass_UB : 504|1@0+ (1,0) [0|1] "" ZCUP
 SG_ HmiSeatVentLvlDrvr : 503|3@0+ (1,0) [0|7] "" ZCUD
 SG_ HmiSeatVentLvlDrvr_UB : 500|1@0+ (1,0) [0|1] "" ZCUD
 SG_ HmiSeatVentLvlPass : 499|3@0+ (1,0) [0|7] "" ZCUP
 SG_ HmiSeatVentLvlPass_UB : 496|1@0+ (1,0) [0|1] "" ZCUP
 SG_ HmiTSyncn : 357|1@0+ (1,0) [0|1] "" ZCUP
 SG_ HmiTSyncn_UB : 356|1@0+ (1,0) [0|1] "" ZCUP
 SG_ IntrMirrAntiGlareSwt : 59|1@0+ (1,0) [0|1] "" ZCUD
 SG_ IntrMirrAntiGlareSwt_UB : 71|1@0+ (1,0) [0|1] "" ZCUD
 SG_ LiHomeSafeReq : 63|4@0+ (1,0) [0|15] "" ZCUD
 SG_ LiHomeSafeReq_UB : 18|1@0+ (1,0) [0|1] "" ZCUD
 SG_ LockgPrsnlReqFromHmi : 227|2@0+ (1,0) [0|3] "" ZCUD
 SG_ LockgPrsnlReqFromHmi_UB : 238|1@0+ (1,0) [0|1] "" ZCUD
 SG_ NextRoadCongestionLen : 233|10@0+ (0.1,0.0) [0.0|99.0] "KiloMtr" ZCUD
 SG_ NextRoadCongestionLen_UB : 237|1@0+ (1,0) [0|1] "" ZCUD
 SG_ NextRoadcongestionLvl : 225|2@0+ (1,0) [0|3] "" ZCUD
 SG_ NextRoadcongestionLvl_UB : 236|1@0+ (1,0) [0|1] "" ZCUD
 SG_ NextRoadCongestionPassTi : 223|8@0+ (1.0,0.0) [0.0|255.0] "Mins" ZCUD
 SG_ NextRoadCongestionPassTi_UB : 203|1@0+ (1,0) [0|1] "" ZCUD
 SG_ PassSeatFoldRaiseReq : 58|2@0+ (1,0) [0|3] "" ZCUP
 SG_ PassSeatFoldRaiseReq_UB : 56|1@0+ (1,0) [0|1] "" ZCUP
 SG_ SeatCushTiltAdjmtRowFirstDrvr : 255|2@0+ (1,0) [0|3] "" ZCUD
 SG_ SeatCushTiltAdjmtRowFirstDrvr_UB : 268|1@0+ (1,0) [0|1] "" ZCUD
 SG_ SeatCushTiltAdjmtRowFirstPass : 253|2@0+ (1,0) [0|3] "" ZCUP
 SG_ SeatCushTiltAdjmtRowFirstPass_UB : 269|1@0+ (1,0) [0|1] "" ZCUP
 SG_ SeatHeiAdjmtRowFirstDrvr : 251|2@0+ (1,0) [0|3] "" ZCUD
 SG_ SeatHeiAdjmtRowFirstDrvr_UB : 270|1@0+ (1,0) [0|1] "" ZCUD
 SG_ SeatHeiAdjmtRowFirstPass : 249|2@0+ (1,0) [0|3] "" ZCUP
 SG_ SeatHeiAdjmtRowFirstPass_UB : 271|1@0+ (1,0) [0|1] "" ZCUP
 SG_ SeatLenAdjmtRowFirstDrvr : 263|2@0+ (1,0) [0|3] "" ZCUD
 SG_ SeatLenAdjmtRowFirstDrvr_UB : 256|1@0+ (1,0) [0|1] "" ZCUD
 SG_ SeatLenAdjmtRowFirstPass : 261|2@0+ (1,0) [0|3] "" ZCUP
 SG_ SeatLenAdjmtRowFirstPass_UB : 257|1@0+ (1,0) [0|1] "" ZCUP
 SG_ SetTiAndDate_UB : 79|1@0+ (1,0) [0|1] "" ZCUD
 SG_ SetTiAndDateDateOrTi : 87|4@0+ (1,0) [0|15] "" ZCUD
 SG_ SetTiAndDateDay : 111|5@0+ (1.0,0.0) [1.0|31.0] "Days" ZCUD
 SG_ SetTiAndDateHour : 119|5@0+ (1.0,0.0) [0.0|23.0] "hours" ZCUD
 SG_ SetTiAndDateMinute : 95|6@0+ (1.0,0.0) [0.0|59.0] "Mins" ZCUD
 SG_ SetTiAndDateMonth : 83|4@0+ (1.0,0.0) [1.0|12.0] "Month" ZCUD
 SG_ SetTiAndDateSecond : 103|6@0+ (1.0,0.0) [0.0|59.0] "s" ZCUD
 SG_ SetTiAndDateYear : 78|7@0+ (1.0,0.0) [0.0|99.0] "Year" ZCUD
 SG_ SpeechExtnSts : 355|3@0+ (1,0) [0|7] "" ZCUP
 SG_ SpeechExtnSts_UB : 352|1@0+ (1,0) [0|1] "" ZCUP
 SG_ SteerTarPosnCmdReq_UB : 315|1@0+ (1,0) [0|1] "" ZCUD
 SG_ SteerTarPosnCmdReqSteerWhlPosnAng : 327|12@0+ (0.01,-20.48) [-20.48|20.470000000000002] "Deg" ZCUD
 SG_ SteerTarPosnCmdReqSteerWhlPosnX : 331|12@0+ (0.1,-204.8) [-204.8|204.7] "mm" ZCUD
 SG_ SteerTarPosnCmdReqTarPosnCmd : 314|3@0+ (1,0) [0|7] "" ZCUD
 SG_ TiAndDateGNSS_UB : 127|1@0+ (1,0) [0|1] "" ZCUD
 SG_ TiAndDateGNSSDataValid : 129|1@0+ (1,0) [0|1] "" ZCUD
 SG_ TiAndDateGNSSDay : 151|5@0+ (1.0,0.0) [1.0|31.0] "Days" ZCUD
 SG_ TiAndDateGNSSHr1 : 159|5@0+ (1.0,0.0) [0.0|23.0] "hours" ZCUD
 SG_ TiAndDateGNSSMins1 : 143|6@0+ (1.0,0.0) [0.0|59.0] "Mins" ZCUD
 SG_ TiAndDateGNSSMth1 : 167|4@0+ (1.0,0.0) [1.0|12.0] "Month" ZCUD
 SG_ TiAndDateGNSSSec1 : 135|6@0+ (1.0,0.0) [0.0|59.0] "s" ZCUD
 SG_ TiAndDateGNSSYr1 : 126|7@0+ (1.0,0.0) [0.0|99.0] "Year" ZCUD
 SG_ VoiceVMMPowerModeSet : 114|1@0+ (1,0) [0|1] "" ZCUD
 SG_ VoiceVMMPowerModeSet_UB : 258|1@0+ (1,0) [0|1] "" ZCUD
 SG_ WelcomeGoodbyeSetReq : 113|1@0+ (1,0) [0|1] "" ZCUD
 SG_ WelcomeGoodbyeSetReq_UB : 259|1@0+ (1,0) [0|1] "" ZCUD
 SG_ WelcomeLiOpenReq : 265|1@0+ (1,0) [0|1] "" ZCUP
 SG_ WelcomeLiOpenReq_UB : 264|1@0+ (1,0) [0|1] "" ZCUP

BO_ 304 DhuZCUCANFD2Fr03 : 64 IHU
 SG_ AmbLiBreathColor_UB : 396|1@0+ (1,0) [0|1] "" ZCUP
 SG_ AmbLiBreathColor2_UB : 131|1@0+ (1,0) [0|1] "" ZCUP
 SG_ AmbLiBreathColor2Blue : 143|8@0+ (1.0,0.0) [0.0|255.0] "Unitless" ZCUP
 SG_ AmbLiBreathColor2Green : 151|8@0+ (1.0,0.0) [0.0|255.0] "Unitless" ZCUP
 SG_ AmbLiBreathColor2Red : 159|8@0+ (1.0,0.0) [0.0|255.0] "Unitless" ZCUP
 SG_ AmbLiBreathColor3_UB : 130|1@0+ (1,0) [0|1] "" ZCUP
 SG_ AmbLiBreathColor3Blue : 167|8@0+ (1.0,0.0) [0.0|255.0] "Unitless" ZCUP
 SG_ AmbLiBreathColor3Green : 175|8@0+ (1.0,0.0) [0.0|255.0] "Unitless" ZCUP
 SG_ AmbLiBreathColor3Red : 183|8@0+ (1.0,0.0) [0.0|255.0] "Unitless" ZCUP
 SG_ AmbLiBreathColorBlue : 7|8@0+ (1.0,0.0) [0.0|255.0] "Unitless" ZCUP
 SG_ AmbLiBreathColorGreen : 15|8@0+ (1.0,0.0) [0.0|255.0] "Unitless" ZCUP
 SG_ AmbLiBreathColorRed : 23|8@0+ (1.0,0.0) [0.0|255.0] "Unitless" ZCUP
 SG_ AmbLiTransColor1_UB : 429|1@0+ (1,0) [0|1] "" ZCUP
 SG_ AmbLiTransColor1Blue : 31|8@0+ (1.0,0.0) [0.0|255.0] "Unitless" ZCUP
 SG_ AmbLiTransColor1Green : 39|8@0+ (1.0,0.0) [0.0|255.0] "Unitless" ZCUP
 SG_ AmbLiTransColor1Red : 47|8@0+ (1.0,0.0) [0.0|255.0] "Unitless" ZCUP
 SG_ AmbLiTransColor2_UB : 428|1@0+ (1,0) [0|1] "" ZCUP
 SG_ AmbLiTransColor2Blue : 55|8@0+ (1.0,0.0) [0.0|255.0] "Unitless" ZCUP
 SG_ AmbLiTransColor2Green : 63|8@0+ (1.0,0.0) [0.0|255.0] "Unitless" ZCUP
 SG_ AmbLiTransColor2Red : 71|8@0+ (1.0,0.0) [0.0|255.0] "Unitless" ZCUP
 SG_ CargoBoxIllumOpenReq : 389|2@0+ (1,0) [0|3] "" ZCUD
 SG_ CargoBoxIllumOpenReq_UB : 387|1@0+ (1,0) [0|1] "" ZCUD
 SG_ ChdLockReLeCtrlHmiReq : 386|2@0+ (1,0) [0|3] "" ZCUD
 SG_ ChdLockReLeCtrlHmiReq_UB : 384|1@0+ (1,0) [0|1] "" ZCUD
 SG_ ChdLockReRiCtrlHmiReq : 399|2@0+ (1,0) [0|3] "" ZCUD
 SG_ ChdLockReRiCtrlHmiReq_UB : 397|1@0+ (1,0) [0|1] "" ZCUD
 SG_ ColrOfSreenZone1_UB : 406|1@0+ (1,0) [0|1] "" ZCUP
 SG_ ColrOfSreenZone1Blue : 325|8@0+ (1.0,0.0) [0.0|255.0] "Unitless" ZCUP
 SG_ ColrOfSreenZone1Green : 333|8@0+ (1.0,0.0) [0.0|255.0] "Unitless" ZCUP
 SG_ ColrOfSreenZone1Red : 341|8@0+ (1.0,0.0) [0.0|255.0] "Unitless" ZCUP
 SG_ ColrOfSreenZone2_UB : 405|1@0+ (1,0) [0|1] "" ZCUP
 SG_ ColrOfSreenZone2Blue : 349|8@0+ (1.0,0.0) [0.0|255.0] "Unitless" ZCUP
 SG_ ColrOfSreenZone2Green : 357|8@0+ (1.0,0.0) [0.0|255.0] "Unitless" ZCUP
 SG_ ColrOfSreenZone2Red : 365|8@0+ (1.0,0.0) [0.0|255.0] "Unitless" ZCUP
 SG_ CourtesyLiOpenReq : 411|1@0+ (1,0) [0|1] "" ZCUD
 SG_ CourtesyLiOpenReq_UB : 404|1@0+ (1,0) [0|1] "" ZCUD
 SG_ DestinationPOI_UB : 259|1@0+ (1,0) [0|1] "" ZCUD
 SG_ DestinationPOIPosnLat : 258|30@0- (0.000000277778,0.0) [-90.000072|90.000072] "Deg" ZCUD
 SG_ DestinationPOIPosnLgt : 292|31@0- (0.000000277778,0.0) [-180.000144|180.000144] "Deg" ZCUD
 SG_ DstProtnReq : 423|9@0+ (1.0,0.0) [0.0|511.0] "Unitless" ZCUD
 SG_ DstProtnReq_UB : 430|1@0+ (1,0) [0|1] "" ZCUD
 SG_ EasyInOutDrvrSeatAdjmt : 425|1@0+ (1,0) [0|1] "" ZCUD
 SG_ EasyInOutDrvrSeatAdjmt_UB : 424|1@0+ (1,0) [0|1] "" ZCUD
 SG_ EasyInOutSecRowLeReq : 263|1@0+ (1,0) [0|1] "" ZCUD
 SG_ EasyInOutSecRowLeReq_UB : 262|1@0+ (1,0) [0|1] "" ZCUD
 SG_ EasyInOutSecRowRiReq : 261|1@0+ (1,0) [0|1] "" ZCUD
 SG_ EasyInOutSecRowRiReq_UB : 260|1@0+ (1,0) [0|1] "" ZCUD
 SG_ EgyRgnLvlSet : 410|2@0+ (1,0) [0|3] "" ZCUD
 SG_ EgyRgnLvlSet_UB : 408|1@0+ (1,0) [0|1] "" ZCUD
 SG_ EngStrtStopDrvModIndSetg : 435|1@0+ (1,0) [0|1] "" ZCUD
 SG_ EngStrtStopDrvModIndSetg_UB : 434|1@0+ (1,0) [0|1] "" ZCUD
 SG_ EngStrtStopSetg : 433|1@0+ (1,0) [0|1] "" ZCUD
 SG_ EngStrtStopSetg_UB : 432|1@0+ (1,0) [0|1] "" ZCUD
 SG_ GlvBoxHMIReq : 447|2@0+ (1,0) [0|3] "" ZCUD
 SG_ GlvBoxHMIReq_UB : 445|1@0+ (1,0) [0|1] "" ZCUD
 SG_ HMICDCSet : 439|3@0+ (1,0) [0|7] "" ZCUD
 SG_ HMICDCSet_UB : 436|1@0+ (1,0) [0|1] "" ZCUD
 SG_ HmiSeatHeatgForRowSecLe : 79|3@0+ (1,0) [0|7] "" ZCUD
 SG_ HmiSeatHeatgForRowSecLe_UB : 76|1@0+ (1,0) [0|1] "" ZCUD
 SG_ HmiSeatHeatgForRowSecRi : 75|3@0+ (1,0) [0|7] "" ZCUD
 SG_ HmiSeatHeatgForRowSecRi_UB : 72|1@0+ (1,0) [0|1] "" ZCUD
 SG_ HmiSeatHeatgForRowThrdLe : 87|3@0+ (1,0) [0|7] "" ZCUD
 SG_ HmiSeatHeatgForRowThrdLe_UB : 84|1@0+ (1,0) [0|1] "" ZCUD
 SG_ HmiSeatHeatgForRowThrdRi : 83|3@0+ (1,0) [0|7] "" ZCUD
 SG_ HmiSeatHeatgForRowThrdRi_UB : 80|1@0+ (1,0) [0|1] "" ZCUD
 SG_ HmiSeatVentnForRowSecLe : 95|3@0+ (1,0) [0|7] "" ZCUD
 SG_ HmiSeatVentnForRowSecLe_UB : 92|1@0+ (1,0) [0|1] "" ZCUD
 SG_ HmiSeatVentnForRowSecRi : 91|3@0+ (1,0) [0|7] "" ZCUD
 SG_ HmiSeatVentnForRowSecRi_UB : 88|1@0+ (1,0) [0|1] "" ZCUD
 SG_ HmiSeatVentnForRowThrdLe : 103|3@0+ (1,0) [0|7] "" ZCUD
 SG_ HmiSeatVentnForRowThrdLe_UB : 100|1@0+ (1,0) [0|1] "" ZCUD
 SG_ HmiSeatVentnForRowThrdRi : 99|3@0+ (1,0) [0|7] "" ZCUD
 SG_ HmiSeatVentnForRowThrdRi_UB : 96|1@0+ (1,0) [0|1] "" ZCUD
 SG_ ImobVehRemReqAndResp_UB : 443|1@0+ (1,0) [0|1] "" ZCUD
 SG_ ImobVehRemReqAndRespImobVehDataRemReq0 : 455|8@0+ (1.0,0.0) [0.0|255.0] "Unitless" ZCUD
 SG_ ImobVehRemReqAndRespImobVehDataRemReq1 : 463|8@0+ (1.0,0.0) [0.0|255.0] "Unitless" ZCUD
 SG_ ImobVehRemReqAndRespImobVehDataRemReq2 : 471|8@0+ (1.0,0.0) [0.0|255.0] "Unitless" ZCUD
 SG_ ImobVehRemReqAndRespImobVehDataRemReq3 : 479|8@0+ (1.0,0.0) [0.0|255.0] "Unitless" ZCUD
 SG_ ImobVehRemReqAndRespImobVehDataRemReq4 : 487|8@0+ (1.0,0.0) [0.0|255.0] "Unitless" ZCUD
 SG_ ImobVehRemReqAndRespImobVehRemReqCmd : 442|3@0+ (1,0) [0|7] "" ZCUD
 SG_ ImobVehRemReqAndRespImobVehRemTmrOrSpdLim : 495|8@0+ (1.0,0.0) [0.0|255.0] "Unitless" ZCUD
 SG_ IntrBriLvlCtrlSts : 503|4@0+ (1.0,0.0) [0.0|15.0] "Unitless" ZCUD
 SG_ IntrBriLvlCtrlSts_UB : 444|1@0+ (1,0) [0|1] "" ZCUD
 SG_ LowrReAxle : 427|1@0+ (1,0) [0|1] "" ZCUD
 SG_ LowrReAxle_UB : 426|1@0+ (1,0) [0|1] "" ZCUD
 SG_ MobDevRCVReq1_UB : 132|1@0+ (1,0) [0|1] "" ZCUD
 SG_ MobDevRCVReq1Chks : 111|8@0+ (1.0,0.0) [0.0|255.0] "Unitless" ZCUD
 SG_ MobDevRCVReq1Cntr : 119|4@0+ (1.0,0.0) [0.0|15.0] "Unitless" ZCUD
 SG_ MobDevRCVReq1MobDevSts : 127|8@0+ (1.0,0.0) [0.0|255.0] "Unitless" ZCUD
 SG_ MobDevRCVReq1RCVCtrl : 115|4@0+ (1,0) [0|15] "" ZCUD
 SG_ MobDevRCVReq1Steertrim : 135|3@0+ (1,0) [0|7] "" ZCUD
 SG_ PasAcsInHmiReq : 395|1@0+ (1,0) [0|1] "" ZCUD
 SG_ PasAcsInHmiReq_UB : 394|1@0+ (1,0) [0|1] "" ZCUD
 SG_ PasAcsOutHmiReq : 393|1@0+ (1,0) [0|1] "" ZCUD
 SG_ PasAcsOutHmiReq_UB : 392|1@0+ (1,0) [0|1] "" ZCUD
 SG_ RePosnLiFolwDayTiRunngLiOnOff : 415|1@0+ (1,0) [0|1] "" ZCUD
 SG_ RePosnLiFolwDayTiRunngLiOnOff_UB : 414|1@0+ (1,0) [0|1] "" ZCUD
 SG_ ReSunCurtOpenPosnReq : 191|5@0+ (1,0) [0|31] "" ZCUD
 SG_ ReSunCurtOpenPosnReq_UB : 186|1@0+ (1,0) [0|1] "" ZCUD
 SG_ RoofDispFoldSts : 199|8@0+ (1.0,0.0) [0.0|255.0] "Unitless" ZCUD,ZCUP
 SG_ RoofDispFoldSts_UB : 185|1@0+ (1,0) [0|1] "" ZCUD,ZCUP
 SG_ RoofDispSldgSts : 207|8@0+ (1.0,0.0) [0.0|255.0] "Unitless" ZCUD,ZCUP
 SG_ RoofDispSldgSts_UB : 184|1@0+ (1,0) [0|1] "" ZCUD,ZCUP
 SG_ RowSecRiSeatZeroGrvyChdLockSwt : 413|1@0+ (1,0) [0|1] "" ZCUD
 SG_ RowSecRiSeatZeroGrvyChdLockSwt_UB : 412|1@0+ (1,0) [0|1] "" ZCUD
 SG_ TechnologyLiMusicCorrlnSwt : 129|1@0+ (1,0) [0|1] "" ZCUD
 SG_ TechnologyLiMusicCorrlnSwt_UB : 128|1@0+ (1,0) [0|1] "" ZCUD
 SG_ TopPercTrFromHmi : 511|7@0+ (1.0,0.0) [0.0|101.0] "%" ZCUD
 SG_ TopPercTrFromHmi_UB : 504|1@0+ (1,0) [0|1] "" ZCUD
 SG_ VoiceCtrlEasyLoad : 499|3@0+ (1,0) [0|7] "" ZCUD
 SG_ VoiceCtrlEasyLoad_UB : 496|1@0+ (1,0) [0|1] "" ZCUD

BO_ 85 DhuZCUCANFD2Fr04 : 64 IHU
 SG_ DwnLoadDynLtgPrmForFrntLeGrp1_UB : 36|1@0+ (1,0) [0|1] "" ZCUD
 SG_ DwnLoadDynLtgPrmForFrntLeGrp10_UB : 396|1@0+ (1,0) [0|1] "" ZCUD
 SG_ DwnLoadDynLtgPrmForFrntLeGrp10ContinueTime : 367|8@0+ (1.0,0.0) [0.0|255.0] "Unitless" ZCUD
 SG_ DwnLoadDynLtgPrmForFrntLeGrp10HighBrightness : 375|4@0+ (1.0,0.0) [0.0|10.0] "Unitless" ZCUD
 SG_ DwnLoadDynLtgPrmForFrntLeGrp10LowBrightness : 371|4@0+ (1.0,0.0) [0.0|10.0] "Unitless" ZCUD
 SG_ DwnLoadDynLtgPrmForFrntLeGrp10Mode1 : 383|6@0+ (1,0) [0|63] "" ZCUD
 SG_ DwnLoadDynLtgPrmForFrntLeGrp10OffsetTime : 391|6@0+ (1.0,0.0) [0.0|63.0] "Unitless" ZCUD
 SG_ DwnLoadDynLtgPrmForFrntLeGrp10Timestamp : 399|3@0+ (1.0,0.0) [0.0|7.0] "Unitless" ZCUD
 SG_ DwnLoadDynLtgPrmForFrntLeGrp11_UB : 436|1@0+ (1,0) [0|1] "" ZCUD
 SG_ DwnLoadDynLtgPrmForFrntLeGrp11ContinueTime : 407|8@0+ (1.0,0.0) [0.0|255.0] "Unitless" ZCUD
 SG_ DwnLoadDynLtgPrmForFrntLeGrp11HighBrightness : 415|4@0+ (1.0,0.0) [0.0|10.0] "Unitless" ZCUD
 SG_ DwnLoadDynLtgPrmForFrntLeGrp11LowBrightness : 411|4@0+ (1.0,0.0) [0.0|10.0] "Unitless" ZCUD
 SG_ DwnLoadDynLtgPrmForFrntLeGrp11Mode1 : 423|6@0+ (1,0) [0|63] "" ZCUD
 SG_ DwnLoadDynLtgPrmForFrntLeGrp11OffsetTime : 431|6@0+ (1.0,0.0) [0.0|63.0] "Unitless" ZCUD
 SG_ DwnLoadDynLtgPrmForFrntLeGrp11Timestamp : 439|3@0+ (1.0,0.0) [0.0|7.0] "Unitless" ZCUD
 SG_ DwnLoadDynLtgPrmForFrntLeGrp12_UB : 476|1@0+ (1,0) [0|1] "" ZCUD
 SG_ DwnLoadDynLtgPrmForFrntLeGrp12ContinueTime : 447|8@0+ (1.0,0.0) [0.0|255.0] "Unitless" ZCUD
 SG_ DwnLoadDynLtgPrmForFrntLeGrp12HighBrightness : 455|4@0+ (1.0,0.0) [0.0|10.0] "Unitless" ZCUD
 SG_ DwnLoadDynLtgPrmForFrntLeGrp12LowBrightness : 451|4@0+ (1.0,0.0) [0.0|10.0] "Unitless" ZCUD
 SG_ DwnLoadDynLtgPrmForFrntLeGrp12Mode1 : 463|6@0+ (1,0) [0|63] "" ZCUD
 SG_ DwnLoadDynLtgPrmForFrntLeGrp12OffsetTime : 471|6@0+ (1.0,0.0) [0.0|63.0] "Unitless" ZCUD
 SG_ DwnLoadDynLtgPrmForFrntLeGrp12Timestamp : 479|3@0+ (1.0,0.0) [0.0|7.0] "Unitless" ZCUD
 SG_ DwnLoadDynLtgPrmForFrntLeGrp1ContinueTime : 7|8@0+ (1.0,0.0) [0.0|255.0] "Unitless" ZCUD
 SG_ DwnLoadDynLtgPrmForFrntLeGrp1HighBrightness : 15|4@0+ (1.0,0.0) [0.0|10.0] "Unitless" ZCUD
 SG_ DwnLoadDynLtgPrmForFrntLeGrp1LowBrightness : 11|4@0+ (1.0,0.0) [0.0|10.0] "Unitless" ZCUD
 SG_ DwnLoadDynLtgPrmForFrntLeGrp1Mode1 : 23|6@0+ (1,0) [0|63] "" ZCUD
 SG_ DwnLoadDynLtgPrmForFrntLeGrp1OffsetTime : 31|6@0+ (1.0,0.0) [0.0|63.0] "Unitless" ZCUD
 SG_ DwnLoadDynLtgPrmForFrntLeGrp1Timestamp : 39|3@0+ (1.0,0.0) [0.0|7.0] "Unitless" ZCUD
 SG_ DwnLoadDynLtgPrmForFrntLeGrp2_UB : 76|1@0+ (1,0) [0|1] "" ZCUD
 SG_ DwnLoadDynLtgPrmForFrntLeGrp2ContinueTime : 47|8@0+ (1.0,0.0) [0.0|255.0] "Unitless" ZCUD
 SG_ DwnLoadDynLtgPrmForFrntLeGrp2HighBrightness : 55|4@0+ (1.0,0.0) [0.0|10.0] "Unitless" ZCUD
 SG_ DwnLoadDynLtgPrmForFrntLeGrp2LowBrightness : 51|4@0+ (1.0,0.0) [0.0|10.0] "Unitless" ZCUD
 SG_ DwnLoadDynLtgPrmForFrntLeGrp2Mode1 : 63|6@0+ (1,0) [0|63] "" ZCUD
 SG_ DwnLoadDynLtgPrmForFrntLeGrp2OffsetTime : 71|6@0+ (1.0,0.0) [0.0|63.0] "Unitless" ZCUD
 SG_ DwnLoadDynLtgPrmForFrntLeGrp2Timestamp : 79|3@0+ (1.0,0.0) [0.0|7.0] "Unitless" ZCUD
 SG_ DwnLoadDynLtgPrmForFrntLeGrp3_UB : 116|1@0+ (1,0) [0|1] "" ZCUD
 SG_ DwnLoadDynLtgPrmForFrntLeGrp3ContinueTime : 87|8@0+ (1.0,0.0) [0.0|255.0] "Unitless" ZCUD
 SG_ DwnLoadDynLtgPrmForFrntLeGrp3HighBrightness : 95|4@0+ (1.0,0.0) [0.0|10.0] "Unitless" ZCUD
 SG_ DwnLoadDynLtgPrmForFrntLeGrp3LowBrightness : 91|4@0+ (1.0,0.0) [0.0|10.0] "Unitless" ZCUD
 SG_ DwnLoadDynLtgPrmForFrntLeGrp3Mode1 : 103|6@0+ (1,0) [0|63] "" ZCUD
 SG_ DwnLoadDynLtgPrmForFrntLeGrp3OffsetTime : 111|6@0+ (1.0,0.0) [0.0|63.0] "Unitless" ZCUD
 SG_ DwnLoadDynLtgPrmForFrntLeGrp3Timestamp : 119|3@0+ (1.0,0.0) [0.0|7.0] "Unitless" ZCUD
 SG_ DwnLoadDynLtgPrmForFrntLeGrp4_UB : 156|1@0+ (1,0) [0|1] "" ZCUD
 SG_ DwnLoadDynLtgPrmForFrntLeGrp4ContinueTime : 127|8@0+ (1.0,0.0) [0.0|255.0] "Unitless" ZCUD
 SG_ DwnLoadDynLtgPrmForFrntLeGrp4HighBrightness : 135|4@0+ (1.0,0.0) [0.0|10.0] "Unitless" ZCUD
 SG_ DwnLoadDynLtgPrmForFrntLeGrp4LowBrightness : 131|4@0+ (1.0,0.0) [0.0|10.0] "Unitless" ZCUD
 SG_ DwnLoadDynLtgPrmForFrntLeGrp4Mode1 : 143|6@0+ (1,0) [0|63] "" ZCUD
 SG_ DwnLoadDynLtgPrmForFrntLeGrp4OffsetTime : 151|6@0+ (1.0,0.0) [0.0|63.0] "Unitless" ZCUD
 SG_ DwnLoadDynLtgPrmForFrntLeGrp4Timestamp : 159|3@0+ (1.0,0.0) [0.0|7.0] "Unitless" ZCUD
 SG_ DwnLoadDynLtgPrmForFrntLeGrp5_UB : 196|1@0+ (1,0) [0|1] "" ZCUD
 SG_ DwnLoadDynLtgPrmForFrntLeGrp5ContinueTime : 167|8@0+ (1.0,0.0) [0.0|255.0] "Unitless" ZCUD
 SG_ DwnLoadDynLtgPrmForFrntLeGrp5HighBrightness : 175|4@0+ (1.0,0.0) [0.0|10.0] "Unitless" ZCUD
 SG_ DwnLoadDynLtgPrmForFrntLeGrp5LowBrightness : 171|4@0+ (1.0,0.0) [0.0|10.0] "Unitless" ZCUD
 SG_ DwnLoadDynLtgPrmForFrntLeGrp5Mode1 : 183|6@0+ (1,0) [0|63] "" ZCUD
 SG_ DwnLoadDynLtgPrmForFrntLeGrp5OffsetTime : 191|6@0+ (1.0,0.0) [0.0|63.0] "Unitless" ZCUD
 SG_ DwnLoadDynLtgPrmForFrntLeGrp5Timestamp : 199|3@0+ (1.0,0.0) [0.0|7.0] "Unitless" ZCUD
 SG_ DwnLoadDynLtgPrmForFrntLeGrp6_UB : 236|1@0+ (1,0) [0|1] "" ZCUD
 SG_ DwnLoadDynLtgPrmForFrntLeGrp6ContinueTime : 207|8@0+ (1.0,0.0) [0.0|255.0] "Unitless" ZCUD
 SG_ DwnLoadDynLtgPrmForFrntLeGrp6HighBrightness : 215|4@0+ (1.0,0.0) [0.0|10.0] "Unitless" ZCUD
 SG_ DwnLoadDynLtgPrmForFrntLeGrp6LowBrightness : 211|4@0+ (1.0,0.0) [0.0|10.0] "Unitless" ZCUD
 SG_ DwnLoadDynLtgPrmForFrntLeGrp6Mode1 : 223|6@0+ (1,0) [0|63] "" ZCUD
 SG_ DwnLoadDynLtgPrmForFrntLeGrp6OffsetTime : 231|6@0+ (1.0,0.0) [0.0|63.0] "Unitless" ZCUD
 SG_ DwnLoadDynLtgPrmForFrntLeGrp6Timestamp : 239|3@0+ (1.0,0.0) [0.0|7.0] "Unitless" ZCUD
 SG_ DwnLoadDynLtgPrmForFrntLeGrp7_UB : 276|1@0+ (1,0) [0|1] "" ZCUD
 SG_ DwnLoadDynLtgPrmForFrntLeGrp7ContinueTime : 247|8@0+ (1.0,0.0) [0.0|255.0] "Unitless" ZCUD
 SG_ DwnLoadDynLtgPrmForFrntLeGrp7HighBrightness : 255|4@0+ (1.0,0.0) [0.0|10.0] "Unitless" ZCUD
 SG_ DwnLoadDynLtgPrmForFrntLeGrp7LowBrightness : 251|4@0+ (1.0,0.0) [0.0|10.0] "Unitless" ZCUD
 SG_ DwnLoadDynLtgPrmForFrntLeGrp7Mode1 : 263|6@0+ (1,0) [0|63] "" ZCUD
 SG_ DwnLoadDynLtgPrmForFrntLeGrp7OffsetTime : 271|6@0+ (1.0,0.0) [0.0|63.0] "Unitless" ZCUD
 SG_ DwnLoadDynLtgPrmForFrntLeGrp7Timestamp : 279|3@0+ (1.0,0.0) [0.0|7.0] "Unitless" ZCUD
 SG_ DwnLoadDynLtgPrmForFrntLeGrp8_UB : 316|1@0+ (1,0) [0|1] "" ZCUD
 SG_ DwnLoadDynLtgPrmForFrntLeGrp8ContinueTime : 287|8@0+ (1.0,0.0) [0.0|255.0] "Unitless" ZCUD
 SG_ DwnLoadDynLtgPrmForFrntLeGrp8HighBrightness : 295|4@0+ (1.0,0.0) [0.0|10.0] "Unitless" ZCUD
 SG_ DwnLoadDynLtgPrmForFrntLeGrp8LowBrightness : 291|4@0+ (1.0,0.0) [0.0|10.0] "Unitless" ZCUD
 SG_ DwnLoadDynLtgPrmForFrntLeGrp8Mode1 : 303|6@0+ (1,0) [0|63] "" ZCUD
 SG_ DwnLoadDynLtgPrmForFrntLeGrp8OffsetTime : 311|6@0+ (1.0,0.0) [0.0|63.0] "Unitless" ZCUD
 SG_ DwnLoadDynLtgPrmForFrntLeGrp8Timestamp : 319|3@0+ (1.0,0.0) [0.0|7.0] "Unitless" ZCUD
 SG_ DwnLoadDynLtgPrmForFrntLeGrp9_UB : 356|1@0+ (1,0) [0|1] "" ZCUD
 SG_ DwnLoadDynLtgPrmForFrntLeGrp9ContinueTime : 327|8@0+ (1.0,0.0) [0.0|255.0] "Unitless" ZCUD
 SG_ DwnLoadDynLtgPrmForFrntLeGrp9HighBrightness : 335|4@0+ (1.0,0.0) [0.0|10.0] "Unitless" ZCUD
 SG_ DwnLoadDynLtgPrmForFrntLeGrp9LowBrightness : 331|4@0+ (1.0,0.0) [0.0|10.0] "Unitless" ZCUD
 SG_ DwnLoadDynLtgPrmForFrntLeGrp9Mode1 : 343|6@0+ (1,0) [0|63] "" ZCUD
 SG_ DwnLoadDynLtgPrmForFrntLeGrp9OffsetTime : 351|6@0+ (1.0,0.0) [0.0|63.0] "Unitless" ZCUD
 SG_ DwnLoadDynLtgPrmForFrntLeGrp9Timestamp : 359|3@0+ (1.0,0.0) [0.0|7.0] "Unitless" ZCUD
 SG_ RemACChrgLidTelmReq : 195|2@0+ (1,0) [0|3] "" ZCUD
 SG_ RemACChrgLidTelmReq_UB : 393|1@0+ (1,0) [0|1] "" ZCUD
 SG_ RemChkTInVeh : 353|1@0+ (1,0) [0|1] "" ZCUP
 SG_ RemChkTInVeh_UB : 354|1@0+ (1,0) [0|1] "" ZCUP
 SG_ RemDCChrgLidTelmReq : 193|2@0+ (1,0) [0|3] "" ZCUD
 SG_ RemDCChrgLidTelmReq_UB : 392|1@0+ (1,0) [0|1] "" ZCUD
 SG_ RemsSetDchaTarVal : 473|10@0+ (0.1,0.0) [0.0|100.0] "%" ZCUD
 SG_ RemsSetDchaTarVal_UB : 355|1@0+ (1,0) [0|1] "" ZCUD
 SG_ RemStrtExtnTiReq : 511|6@0+ (1.0,0.0) [0.0|59.0] "Mins" ZCUP
 SG_ RemStrtExtnTiReq_UB : 352|1@0+ (1,0) [0|1] "" ZCUP
 SG_ RemStrtHvCtrlReq_UB : 312|1@0+ (1,0) [0|1] "" ZCUP
 SG_ RemStrtHvCtrlReqErsCmd : 489|2@0+ (1,0) [0|3] "" ZCUP
 SG_ RemStrtHvCtrlReqErsRunTime : 495|6@0+ (1.0,0.0) [0.0|59.0] "Mins" ZCUP
 SG_ RemVentReq : 155|2@0+ (1,0) [0|3] "" ZCUP
 SG_ RemVentReq_UB : 313|1@0+ (1,0) [0|1] "" ZCUP
 SG_ ReqFragLvlTelm : 153|2@0+ (1,0) [0|3] "" ZCUP
 SG_ ReqFragLvlTelm_UB : 314|1@0+ (1,0) [0|1] "" ZCUP
 SG_ SeatHeatDurgClimaEnadFromTelm : 75|3@0+ (1,0) [0|7] "" ZCUP
 SG_ SeatHeatDurgClimaEnadFromTelm_UB : 72|1@0+ (1,0) [0|1] "" ZCUP
 SG_ SiteOfcommCharn : 315|1@0+ (1,0) [0|1] "" ZCUD
 SG_ SiteOfcommCharn_UB : 272|1@0+ (1,0) [0|1] "" ZCUD
 SG_ SocInFoOfCommChargn : 35|3@0+ (1,0) [0|7] "" ZCUD
 SG_ SocInFoOfCommChargn_UB : 32|1@0+ (1,0) [0|1] "" ZCUD
 SG_ SocOfCommChargn : 235|1@0+ (1,0) [0|1] "" ZCUD
 SG_ SocOfCommChargn_UB : 273|1@0+ (1,0) [0|1] "" ZCUD
 SG_ SteerWhlHeatgDurgClimaEnadFromTelm : 234|1@0+ (1,0) [0|1] "" ZCUP
 SG_ SteerWhlHeatgDurgClimaEnadFromTelm_UB : 274|1@0+ (1,0) [0|1] "" ZCUP
 SG_ SunRoofAndCurtCmdTelm : 503|8@0+ (1,0) [0|255] "" ZCUD
 SG_ SunRoofAndCurtCmdTelm_UB : 232|1@0+ (1,0) [0|1] "" ZCUD
 SG_ TankFlapTelmLockgReq : 435|3@0+ (1,0) [0|7] "" ZCUD
 SG_ TankFlapTelmLockgReq_UB : 474|1@0+ (1,0) [0|1] "" ZCUD
 SG_ TelmBookSteerWhlHeatClimalReq : 432|1@0+ (1,0) [0|1] "" ZCUP
 SG_ TelmBookSteerWhlHeatClimalReq_UB : 505|1@0+ (1,0) [0|1] "" ZCUP
 SG_ TelmFctReq : 475|1@0+ (1,0) [0|1] "" ZCUD
 SG_ TelmFctReq_UB : 504|1@0+ (1,0) [0|1] "" ZCUD

// Node Comments
CM_ BU_ ETC "External Tester Connector";

// Signal Comments
CM_ SG_ 432 ActvnOfGiveWay "The signal of Give way sound from DHU to CEM";
CM_ SG_ 432 ActvnOfTakeOverMic "Activation of takeover MIC.";
CM_ SG_ 432 ActvReSplrHldSwt "active rear spoiler holding  switch";
CM_ SG_ 432 AFSSetReq "this signal is used to set exterior   AFS light  able  or enable";
CM_ SG_ 432 AllSeatResetReq "all seat one button reset soft switch";
CM_ SG_ 432 ApproachLiSetReq "this signal is used to set Approach light  for exterior  light systerm ";
CM_ SG_ 432 ApproachOpenTrOnOff "request opening/closing approach tailgate";
CM_ SG_ 432 AutHiBeamSwt "AHBC(Automatic high beam) switch status";
CM_ SG_ 432 BackrestAdjmtRowSecLe "the backrest adjustment of the second row left seat";
CM_ SG_ 432 BackrestAdjmtRowSecRi "the backrest adjustment of the second row right seat";
CM_ SG_ 432 BackrestAdjmtRowThrdLe "the backrest adjustment of the third row left seat";
CM_ SG_ 432 BackrestAdjmtRowThrdRi "the backrest adjustment of the third row right seat";
CM_ SG_ 432 BendingLiSetReq "this signal is used to set bending light  for exterior  light systerm ";
CM_ SG_ 432 CallSts "call status";
CM_ SG_ 432 CarFindrHornLiSetActv "Find the car reminder way setting ";
CM_ SG_ 432 CarpetLiSwtReq "this port is used to inform exterior light subsystem whether driver want to active carpet light.";
CM_ SG_ 432 CarpetLiTiReq "this port is used to inform the exterior light subsystem the user choose how long of lighting carpet light.";
CM_ SG_ 432 CenLockHmiReq "Lock/Unlock central lock";
CM_ SG_ 432 ChrgLidCtrlHmiReqACandDCchargelid "Charge lid open/close request, not for loop1";
CM_ SG_ 432 ChrgLidCtrlHmiReqACchargelid "Charge lid open/close request, not for loop1";
CM_ SG_ 432 ChrgLidCtrlHmiReqDCchargelid "Charge lid open/close request, not for loop1";
CM_ SG_ 432 ChrgnLiSwt "used to control on or off the charging light";
CM_ SG_ 432 ClsAutEna "Determine the setting for automatic Roof Hatch Maneuvering upon ignition off";
CM_ SG_ 432 ComityPedLiSwt "Comity pedestrian light soft switch";
CM_ SG_ 432 DrvrSeatAdpvLumSetg "driver seat adaptive lumbar support setting";
CM_ SG_ 432 DrvrSeatAdpvSideSpprtSetg "driver seat adaptive side support setting";
CM_ SG_ 432 DstToDestination "remaining distance to destination ";
CM_ SG_ 432 EasyInOutFrntPassReq "Easy in out passager seat adjustment";
CM_ SG_ 432 FrnPosnLiFolwDayTiRunngLiOnOff "indicate whether FPL follow DRL";
CM_ SG_ 432 FrntDstPrjSwt "Front Distance gauge projection soft switch";
CM_ SG_ 432 HmiCarLocatorSetReq "HMI send a button to control Tcam Locate Vehicle service request .";
CM_ SG_ 432 HmiPM25PopUpResp "PM2.5 PopUp function Response";
CM_ SG_ 432 HmiSeatHeatAutStrtRowSecLe "HmiSeatHeatAutStrtRowSecLe";
CM_ SG_ 432 HmiSeatHeatAutStrtRowSecRi "HmiSeatHeatAutStrtRowSecRi";
CM_ SG_ 432 HmiSeatHeatAutStrtRowThrdLe "HmiSeatHeatAutStrtRowThrdLe";
CM_ SG_ 432 HmiSeatHeatAutStrtRowThrdRi "HmiSeatHeatAutStrtRowThrdRi";
CM_ SG_ 432 HmiSeatVentAutStrtRowSecLe "HmiSeatVentAutStrtRowSecLe";
CM_ SG_ 432 HmiSeatVentAutStrtRowSecRi "HmiSeatVentAutStrtRowSecRi";
CM_ SG_ 432 HMIToVMMSetSetting1 "Setting from HMI to VMM";
CM_ SG_ 432 HMIToVMMSetSetting2 "Setting from HMI to VMM";
CM_ SG_ 432 HMIToVMMSetSetting3 "Setting from HMI to VMM";
CM_ SG_ 432 HMIToVMMSetSetting4 "Setting from HMI to VMM";
CM_ SG_ 432 HMIToVMMSetSetting5 "Setting from HMI to VMM";
CM_ SG_ 432 HMIToVMMSetSetting6 "Setting from HMI to VMM";
CM_ SG_ 432 HMIToVMMSetSetting7 "Setting from HMI to VMM";
CM_ SG_ 432 HMIToVMMSetSetting8 "Setting from HMI to VMM";
CM_ SG_ 432 LaneChgAsscPrjSwt "Lane change assistance projection soft switch";
CM_ SG_ 432 LDACSoftBtnSwtSt "Life Detection and Care Soft Button Switch State(DHU)";
CM_ SG_ 432 LDACUsgModReq " keep UsageMode in inactive status";
CM_ SG_ 432 LegRestRotAdjmtRowSecLe "The second row left seat leg rest rotiation(up/down) adjustment";
CM_ SG_ 432 LegRestRotAdjmtRowSecRi "The second row right seat leg rest rotiation(up/down) adjustment";
CM_ SG_ 432 LenAdjmtRowSecLe "Second row left seat length adjustment";
CM_ SG_ 432 LenAdjmtRowSecRi "Second row Ri seat length adjustment";
CM_ SG_ 432 LenAdjmtRowThrdLe "LenAdjmtRowThrdle";
CM_ SG_ 432 LenAdjmtRowThrdRi "LenAdjmtRowThrdRi";
CM_ SG_ 432 LockgFbSoundReq "Turn on or turn off audible locking feedback";
CM_ SG_ 432 LumHeiAdjmtSecRowLe "to adjust the height of lumbar support for second row left";
CM_ SG_ 432 LumHeiAdjmtSecRowRi "to adjust the height of lumbar support for second row right";
CM_ SG_ 432 LumLenAdjmtSecRowLe "to adjust the lenght of lumbar support for second row left";
CM_ SG_ 432 LumLenAdjmtSecRowRi "to adjust the lenght of lumbar support for second row right";
CM_ SG_ 432 ParkGearUnlckHmiReq "set if unlock the car when P gear";
CM_ SG_ 432 PasAlrmDeactvnReq "Distribution of the setting temporary deactivation of passive arming";
CM_ SG_ 432 PassSeatAdpvLumSetg "passenger seat adaptive lumbar support setting";
CM_ SG_ 432 PassSeatAdpvSideSpprtSetg "passenger seat adaptive side support setting";
CM_ SG_ 432 PassSeatFootRstAdjmt "passenger seat foot rest soft switch adjustment ";
CM_ SG_ 432 PassSeatFootRstTargPosPerc "passenger seat foot rest target position percentage request";
CM_ SG_ 432 PassSeatTarPosnCmdReqSeatBackrTargPosAg "Seat Backrest";
CM_ SG_ 432 PassSeatTarPosnCmdReqSeatFrntHeiTargPosPerc "Seat Cushion Height";
CM_ SG_ 432 PassSeatTarPosnCmdReqSeatHeiTargPosPerc "Seat Height";
CM_ SG_ 432 PassSeatTarPosnCmdReqSeatLenTargPosPerc "Seat Length";
CM_ SG_ 432 PassSeatTarPosnCmdReqSeatPosFrntExtPerc "Seat Front Extension";
CM_ SG_ 432 PassSeatTarPosnCmdReqTarPosnCmd "request passenger seat adjusting to target position";
CM_ SG_ 432 PedRmnSwt "Pedestrians reminders soft switch";
CM_ SG_ 432 PrkgCmftModTiCtrl "a Timer setting option for Parking Comfort Mode, Parking Comfort Mode means that vehicle will stay in Convenience mode for the set Timer";
CM_ SG_ 432 PwrTonneauCoverHmiReqRadar "Pickup tailgate open or close request

Cls-close
Open-open
Stop-stop";
CM_ SG_ 432 RFDRestrictsts "RFDRestrictsts";
CM_ SG_ 432 SeatFoldRaiseReqRowThrdLe "seat fold req";
CM_ SG_ 432 SeatFoldRaiseReqRowThrdRi "seart fold req";
CM_ SG_ 432 SeatRowSecLeRotateAdjmt "second row seats left rotate adjmt";
CM_ SG_ 432 SeatRowSecRiRotateAdjmt "second row seats right rotate adjmt";
CM_ SG_ 432 SecRowLeCmftSet "One-key seat comfort or recover position adjustment control for Second row left customer.";
CM_ SG_ 432 SecRowLeSeatDispMassgFctMassgInten "Massage program Intensity Level";
CM_ SG_ 432 SecRowLeSeatDispMassgFctMassgProg "Massage Programs Types";
CM_ SG_ 432 SecRowLeSeatDispMassgFctOnOffl2 "Turn on or off seat massage";
CM_ SG_ 432 SecRowRiCmftSet "One-key seat comfort or recover position adjustment control for Second row right customer.";
CM_ SG_ 432 SecRowRiSeatDispMassgFctMassgInten "Massage program Intensity Level";
CM_ SG_ 432 SecRowRiSeatDispMassgFctMassgProg "Massage Programs Types";
CM_ SG_ 432 SecRowRiSeatDispMassgFctOnOffl2 "Turn on or off seat massage";
CM_ SG_ 432 SngDoorOrFourDoorSelectReq "Select to open single door or four doors for passive access unlock function";
CM_ SG_ 432 SoftLiBtnSwtSetReqChks "this signal is used to tell exterior light systerm which one button driver has choosen";
CM_ SG_ 432 SoftLiBtnSwtSetReqCntr "this signal is used to tell exterior light systerm which one button driver has choosen";
CM_ SG_ 432 SoftLiBtnSwtSetReqLiExtFctReq1 "this signal is used to tell exterior light systerm which one button driver has choosen";
CM_ SG_ 432 SteerAdjSwtBackSts "steering adjustment switch back";
CM_ SG_ 432 SteerAdjSwtDwnSts "steering adjustment switch down";
CM_ SG_ 432 SteerAdjSwtFwdSts "steering adjustment switch forward";
CM_ SG_ 432 SteerAdjSwtUpSts "steering adjustment switch up";
CM_ SG_ 432 SunCurtOpenPosnReq "Sun curtain open or close position request";
CM_ SG_ 432 SunRoofOpenPosnReq "Sunroof open or close position request";
CM_ SG_ 432 SunRoofTiltReq "Sunroof tilt request";
CM_ SG_ 432 ThrdRowLeSeatDispMassgFctMassgInten "Massage program Intensity Level";
CM_ SG_ 432 ThrdRowLeSeatDispMassgFctMassgProg "Massage Programs Types";
CM_ SG_ 432 ThrdRowLeSeatDispMassgFctOnOffl2 "Turn on or off seat massage";
CM_ SG_ 432 ThrdRowRiSeatDispMassgFctMassgInten "Massage program Intensity Level";
CM_ SG_ 432 ThrdRowRiSeatDispMassgFctMassgProg "Massage Programs Types";
CM_ SG_ 432 ThrdRowRiSeatDispMassgFctOnOffl2 "Turn on or off seat massage";
CM_ SG_ 432 TiToDestNavRouteDay2 "Remained Estimated time to desination";
CM_ SG_ 432 TiToDestNavRouteHr1 "Remained Estimated time to desination";
CM_ SG_ 432 TiToDestNavRouteMins1 "Remained Estimated time to desination";
CM_ SG_ 432 TrFootMovmtDetnSwt "Foot movement detection to open trunk switch";
CM_ SG_ 432 TrLiSwt "Turn on/off trunk light";
CM_ SG_ 432 TrlrLampChkAutReq "Distribution of the setting automatic trailer lamp check";
CM_ SG_ 432 UsgModChgReqFromUWB "Request UsgMod change to inactive from abandon for UWB key";
CM_ SG_ 432 VehWidthPrjSwt "Vehicle Width projection soft switch";
CM_ SG_ 432 VoiceRemoteCtrlRquestSPKey "signal for voice search key ";
CM_ SG_ 432 WarnLvlMsg "LDAC warning level";
CM_ SG_ 432 WelcomeGoodbyeModeReq "this port is used to inform the CEM the user choose which one mode of  welcome goodbye  founction.";
CM_ SG_ 432 WiprFrntSrvModReq "To make it possible to change the wiper blades there shall be a command for the wiper motor to park the wipers in service position. ";
CM_ SG_ 432 WiprReSrvModReq "To make it possible to change the wiper blades there shall be a command for the wiper motor";
CM_ SG_ 448 ActvReSplrPrkgInteractionSwt "active rear spoiler parking interaction switch";
CM_ SG_ 448 AmbientLiEffectStatusBreathingEffectStatus "Breathing effect enable or disable";
CM_ SG_ 448 AmbientLiEffectStatusTransitionEffectStatus "Transition effect enable or disable";
CM_ SG_ 448 AmbLiAll "A main on/off button to control Ambience light";
CM_ SG_ 448 AmbLiClimateCorrlnReq "Turn on or turn off ambience light and air condition correlation.";
CM_ SG_ 448 AmbLiColorModReq "Select color mode type";
CM_ SG_ 448 AmbLiEnduranceMilgOpenReq "Turn on or turn off ambience light endurance mileage remind";
CM_ SG_ 448 AmbLiModExt "Ambient light mode setting extend signal";
CM_ SG_ 448 AmbLiMusicCorrlnReq "Open or close ambience light music show correlation";
CM_ SG_ 448 AmbLiPhoneOpenReq "Turn on or turn off ambience light phone reminding";
CM_ SG_ 448 AmbLiSpeechCorrlnReq "Turn on or turn off ambience light and speech correlation";
CM_ SG_ 448 AntithftRednReq "Used to distribute the setting Reduced guard.";
CM_ SG_ 448 BackRestAdjmtRowFirstDrvr "the backrest adjustment of the first row driver seat";
CM_ SG_ 448 BackRestAdjmtRowFirstPass "the backrest adjustment of the first row passanger seat";
CM_ SG_ 448 CurrentRoadcongestionLength "remained length of current congestion road";
CM_ SG_ 448 CurrentRoadcongestionLvl "Congestion level of current road";
CM_ SG_ 448 CurrentRoadCongstionPassTime "Estimated remained passing time of current congestion road";
CM_ SG_ 448 DrvModDispd "Driver mode Display OnOff Signal";
CM_ SG_ 448 DrvrEntryLoReq "Driver Entry Low Request";
CM_ SG_ 448 DrvrSeatTarPosnCmdReqSeatBackrTargPosAg "Seat Backrest data";
CM_ SG_ 448 DrvrSeatTarPosnCmdReqSeatFrntHeiTargPosPerc "Seat Cushion Tilt data";
CM_ SG_ 448 DrvrSeatTarPosnCmdReqSeatHeiTargPosPerc "Seat Height data";
CM_ SG_ 448 DrvrSeatTarPosnCmdReqSeatLenTargPosPerc "Seat Length data";
CM_ SG_ 448 DrvrSeatTarPosnCmdReqTarPosnCmd "request driver seat adjusting to target position";
CM_ SG_ 448 DstToNextCongestionRrd "Distance to next congestion road";
CM_ SG_ 448 ExtrMirrFoldSetgMirrDrvr "Driver side mirror tilting";
CM_ SG_ 448 ExtrMirrFoldSetgMirrPass "Passenger side mirror tilting";
CM_ SG_ 448 ExtrMirrTiltSetgMirrDrvr "Determine the setting for Mirror Tilting";
CM_ SG_ 448 ExtrMirrTiltSetgMirrPass "Determine the setting for Mirror Tilting";
CM_ SG_ 448 FrntTechLiInfoDispSetReq "Technology information display enable switch";
CM_ SG_ 448 GoodbyeLiOpenReq "Turn on or turn off ambience light goodbye show";
CM_ SG_ 448 HmiAirDistbnRow1 "Hmi Air Distribution Row 1";
CM_ SG_ 448 HmiAirDistbnRow2 "By user requested air distribution for second row";
CM_ SG_ 448 HMIAutDemstSet "Automatic Defrost";
CM_ SG_ 448 HmiAutoRow1 "HMI request automatic air condition on/off for front row";
CM_ SG_ 448 HmiAutoRow2 "HMI request automatic air condition on/off for second row";
CM_ SG_ 448 HmiCbnOverHeatPrevnReq "Hmi Cabin Over Heat Prevention Request";
CM_ SG_ 448 HmiClimaRow1Pwr "Hmi Climatisation Row 1 Power";
CM_ SG_ 448 HmiClimaRow2Pwr "Hmi Climatisation Row 2 Power";
CM_ SG_ 448 HmiClimaRow3Pwr "Hmi Climatisation Row 3 Power";
CM_ SG_ 448 HmiCmptmtTSpForRowFirstLe "First row, left side, climate set point settings from HMI";
CM_ SG_ 448 HmiCmptmtTSpForRowFirstRi "First row, right side, climate setpoint temperature from HMI";
CM_ SG_ 448 HmiCmptmtTSpForRowSecLe "Second row, left side, climate setpoint temperature from HMI";
CM_ SG_ 448 HmiCmptmtTSpForRowSecRi "Second row, right side, climate setpoint temperature from HMI";
CM_ SG_ 448 HmiCmptmtTSpSpclForRowFirstLe "HI/LO setting first row left";
CM_ SG_ 448 HmiCmptmtTSpSpclForRowFirstRi "HI/LO first row right";
CM_ SG_ 448 HmiCmptmtTSpSpclForRowSecLe "HI/LO second row left side";
CM_ SG_ 448 HmiCmptmtTSpSpclForRowSecRi "HI/LO second row, right side ";
CM_ SG_ 448 HmiEcoClimaReq "Hmi ECO Climatisation";
CM_ SG_ 448 HmiElecAirAdpvReqDrvrAdpv "driver adaptive mode request";
CM_ SG_ 448 HmiElecAirAdpvReqPassAdpv "passenger adaptive mode request";
CM_ SG_ 448 HmiElecAirDirCrtlReqDrvrLePosX "electric air ventilation coordinate X";
CM_ SG_ 448 HmiElecAirDirCrtlReqDrvrLePosY "electric air ventilation coordinate Y";
CM_ SG_ 448 HmiElecAirDirCrtlReqDrvrRiPosX "electric air ventilation coordinate X";
CM_ SG_ 448 HmiElecAirDirCrtlReqDrvrRiPosY "electric air ventilation coordinate Ri Y";
CM_ SG_ 448 HmiElecAirDirCrtlReqPassLePosX "electric air ventilation coordinate Le X";
CM_ SG_ 448 HmiElecAirDirCrtlReqPassLePosY "electric air ventilation coordinate Le Y";
CM_ SG_ 448 HmiElecAirDirCrtlReqPassRiPosX "electric air ventilation coordinate Ri X";
CM_ SG_ 448 HmiElecAirDirCrtlReqPassRiPosY "electric air ventilation coordinate Ri Y";
CM_ SG_ 448 HmiElecAirDirModReqDrvrMod "HMI request electric air ventilation mode for drive";
CM_ SG_ 448 HmiElecAirDirModReqPassMod "HMI request electric air ventilation mode for passenger";
CM_ SG_ 448 HmiElecAirFrntSwtReqHmiElecAirDrvrLeSwtReq "open/close the each electric air ventilation in front driver seat Left";
CM_ SG_ 448 HmiElecAirFrntSwtReqHmiElecAirDrvrRiSwtReq "open/close the each electric air ventilation in front driver seat right";
CM_ SG_ 448 HmiElecAirFrntSwtReqHmiElecAirPassLeSwtReq "open/close the each electric air ventilation in front passenger seat Left";
CM_ SG_ 448 HmiElecAirFrntSwtReqHmiElecAirPassRiSwtReq "open/close the each electric air ventilation in front passenger seat right";
CM_ SG_ 448 HmiElecAirSwngReqDrvrLeRiSwng "Driver air vent left and right swing";
CM_ SG_ 448 HmiElecAirSwngReqDrvrUpOnSwng "Driver air vent up and down swing";
CM_ SG_ 448 HmiElecAirSwngReqPassLeRiSwng "Passenger air vent left and right swing";
CM_ SG_ 448 HmiElecAirSwngReqPassUpOnSwng "Passenger air vent up and down swing";
CM_ SG_ 448 HmiFanLvlRow1 "Hmi Hvac Fan Level Front";
CM_ SG_ 448 HmiFanLvlRow2 "Hmi Hvac Fan Level Rear";
CM_ SG_ 448 HmiFragraCh "Hmi Fragrance Channel Setting";
CM_ SG_ 448 HmiFragraLvl "Hmi fragrance Level";
CM_ SG_ 448 HmiHvacRecircCmd "Interpretation: 0 - OsaFull - Full OSA 1 - RecircFull - Full recirculation 2 - RecircFullWithTiOut - Full REC with timeout 3 - AutWithAirQly - AUTO with AQS 4 - Aut - Auto 5 - Resd - Reserved ";
CM_ SG_ 448 HmiMaxAC "Hmi request MAX AC function on/off";
CM_ SG_ 448 HmiMaxDefrst "Hmi Maximum Defrost";
CM_ SG_ 448 HMIRapidHeatgUpSet "HMIRapidHeatgUpSet";
CM_ SG_ 448 HMIRapidTDrpSet "HMIRapidTDrpSet";
CM_ SG_ 448 HmiSeatHeatAutStrtDrvr "Hmi Seat Heat Automatic Start Driver";
CM_ SG_ 448 HmiSeatHeatAutStrtPass "Hmi Seat Heat Automatic Start Passenger";
CM_ SG_ 448 HmiSeatHeatLvlDrvr "HMI/user requests for heating of seats for first row left.";
CM_ SG_ 448 HmiSeatHeatLvlPass "HMI/user requests for heating of seats for first row right.";
CM_ SG_ 448 HmiSeatVentAutStrtDrvr "Hmi Seat Vent Automatic Start Driver";
CM_ SG_ 448 HmiSeatVentAutStrtPass "Hmi Seat Vent Automatic Start Passenger";
CM_ SG_ 448 HmiSeatVentLvlDrvr "HMI/user requests for ventilation of seats for first row left.";
CM_ SG_ 448 HmiSeatVentLvlPass "HMI/user requests for ventilation of seats for first row right.";
CM_ SG_ 448 HmiTSyncn "Hmi Temperature Synchronization";
CM_ SG_ 448 IntrMirrAntiGlareSwt "switch for interior mirror anti-glare function
";
CM_ SG_ 448 LiHomeSafeReq "Determine the setting for Home Safe Light";
CM_ SG_ 448 LockgPrsnlReqFromHmi "Handles private locking, both unlock and locking mechanism.";
CM_ SG_ 448 NextRoadCongestionLen "lenth of next congestion road";
CM_ SG_ 448 NextRoadcongestionLvl "Congestion level of next congestion road";
CM_ SG_ 448 NextRoadCongestionPassTi "Estimated passing time of next congestion road";
CM_ SG_ 448 PassSeatFoldRaiseReq "passenger seat fold raise req";
CM_ SG_ 448 SeatCushTiltAdjmtRowFirstDrvr "front row seat cushion tilt left adjustment";
CM_ SG_ 448 SeatCushTiltAdjmtRowFirstPass "front row seat cushion tilt left adjustment";
CM_ SG_ 448 SeatHeiAdjmtRowFirstDrvr "seat height adjustment ";
CM_ SG_ 448 SeatHeiAdjmtRowFirstPass "seat height adjustment ";
CM_ SG_ 448 SeatLenAdjmtRowFirstDrvr "seat Length adjustment ";
CM_ SG_ 448 SeatLenAdjmtRowFirstPass "seat Length adjustment ";
CM_ SG_ 448 SetTiAndDateDateOrTi "Signal between the infotainment system and the CEM that will be used for update the clock and date calculation data in CEM. See requirement for better understanding of the clock settings signals. DateAndOrTiSeln";
CM_ SG_ 448 SetTiAndDateDay "Signal between the infotainment system and the CEM that will be used for update the clock and date calculation data in CEM. See requirement for better understanding of the clock settings signals. Day";
CM_ SG_ 448 SetTiAndDateHour "Signal between the infotainment system and the CEM that will be used for update the clock and date calculation data in CEM. See requirement for better understanding of the clock settings signals. Hour";
CM_ SG_ 448 SetTiAndDateMinute "Signal between the infotainment system and the CEM that will be used for update the clock and date calculation data in CEM. See requirement for better understanding of the clock settings signals. Minute";
CM_ SG_ 448 SetTiAndDateMonth "Signal between the infotainment system and the CEM that will be used for update the clock and date calculation data in CEM. See requirement for better understanding of the clock settings signals. Month";
CM_ SG_ 448 SetTiAndDateSecond "Signal between the infotainment system and the CEM that will be used for update the clock and date calculation data in CEM. See requirement for better understanding of the clock settings signals. Second";
CM_ SG_ 448 SetTiAndDateYear "Signal between the infotainment system and the CEM that will be used for update the clock and date calculation data in CEM. See requirement for better understanding of the clock settings signals. Year";
CM_ SG_ 448 SpeechExtnSts "indicate voice recognization zones";
CM_ SG_ 448 SteerTarPosnCmdReqSteerWhlPosnAng "Angle adjustment-Height";
CM_ SG_ 448 SteerTarPosnCmdReqSteerWhlPosnX "Length adjustment data";
CM_ SG_ 448 SteerTarPosnCmdReqTarPosnCmd "request steering adjusting to target position";
CM_ SG_ 448 TiAndDateGNSSDataValid "Vehicle time (Hr, Min and Sec) and date (Year, Months and days) data for indication. See requirement for more information about the signals. Signal qualifier, No means values should be ignored.";
CM_ SG_ 448 TiAndDateGNSSDay "Vehicle time (Hr, Min and Sec) and date (Year, Months and days) data for indication. See requirement for more information about the signals. Day";
CM_ SG_ 448 TiAndDateGNSSHr1 "Vehicle time (Hr, Min and Sec) and date (Year, Months and days) data for indication. See requirement for more information about the signals. Hour";
CM_ SG_ 448 TiAndDateGNSSMins1 "Vehicle time (Hr, Min and Sec) and date (Year, Months and days) data for indication. See requirement for more information about the signals. Minutes";
CM_ SG_ 448 TiAndDateGNSSMth1 "Vehicle time (Hr, Min and Sec) and date (Year, Months and days) data for indication. See requirement for more information about the signals. Month, 1-12";
CM_ SG_ 448 TiAndDateGNSSSec1 "Vehicle time (Hr, Min and Sec) and date (Year, Months and days) data for indication. See requirement for more information about the signals. Seconds";
CM_ SG_ 448 TiAndDateGNSSYr1 "Vehicle time (Hr, Min and Sec) and date (Year, Months and days) data for indication. See requirement for more information about the signals. Year, 0-99";
CM_ SG_ 448 VoiceVMMPowerModeSet "It is used to notify the vehicle power mode to enter the Convention state";
CM_ SG_ 448 WelcomeGoodbyeSetReq "this port is used to informal extra light subsystem whether driver want to active welcome light and goodbye
founction.   ";
CM_ SG_ 448 WelcomeLiOpenReq "Turn on or turn off ambience light welcome show";
CM_ SG_ 304 AmbLiBreathColor2Blue "Ambient light breathing effect color2";
CM_ SG_ 304 AmbLiBreathColor2Green "Ambient light breathing effect color2";
CM_ SG_ 304 AmbLiBreathColor2Red "Ambient light breathing effect color2";
CM_ SG_ 304 AmbLiBreathColor3Blue "Ambient light breathing effect color3";
CM_ SG_ 304 AmbLiBreathColor3Green "Ambient light breathing effect color3";
CM_ SG_ 304 AmbLiBreathColor3Red "Ambient light breathing effect color3";
CM_ SG_ 304 AmbLiBreathColorBlue "Ambient light transition effect color1";
CM_ SG_ 304 AmbLiBreathColorGreen "Ambient light transition effect color1";
CM_ SG_ 304 AmbLiBreathColorRed "Ambient light transition effect color1";
CM_ SG_ 304 AmbLiTransColor1Blue "Ambient light transition effect color1";
CM_ SG_ 304 AmbLiTransColor1Green "Ambient light transition effect color1";
CM_ SG_ 304 AmbLiTransColor1Red "Ambient light transition effect color1";
CM_ SG_ 304 AmbLiTransColor2Blue "Ambient light transition effect color1";
CM_ SG_ 304 AmbLiTransColor2Green "Ambient light transition effect color1";
CM_ SG_ 304 AmbLiTransColor2Red "Ambient light transition effect color1";
CM_ SG_ 304 CargoBoxIllumOpenReq "Cargo Box Illumnation Open of Close request";
CM_ SG_ 304 ChdLockReLeCtrlHmiReq "Child lock rear left lock or unlock request";
CM_ SG_ 304 ChdLockReRiCtrlHmiReq "Child lock rear right lock or unlock request";
CM_ SG_ 304 ColrOfSreenZone1Blue "ambient light - color of screen zone1-blue";
CM_ SG_ 304 ColrOfSreenZone1Green "ambient light - color of screen zone1-green
";
CM_ SG_ 304 ColrOfSreenZone1Red "ambient light - color of screen zone1-red
";
CM_ SG_ 304 ColrOfSreenZone2Blue "ambient light - color of screen zone2-blue";
CM_ SG_ 304 ColrOfSreenZone2Green "ambient light - color of screen zone2-green
";
CM_ SG_ 304 ColrOfSreenZone2Red "ambient light - color of screen zone2-red
";
CM_ SG_ 304 CourtesyLiOpenReq "Turn on or turn off courtesy light";
CM_ SG_ 304 DestinationPOIPosnLat "latitude of location";
CM_ SG_ 304 DestinationPOIPosnLgt "longitude of location";
CM_ SG_ 304 DstProtnReq "Distance protection setting.";
CM_ SG_ 304 EasyInOutDrvrSeatAdjmt "Easy In Out Driver Seat Adjustment";
CM_ SG_ 304 EasyInOutSecRowLeReq "Easy In Out Second Row Left Request";
CM_ SG_ 304 EasyInOutSecRowRiReq "Easy In Out Second Row Right Request";
CM_ SG_ 304 EgyRgnLvlSet "This signal represents the setting of the energy regeneration level.
0x0: level1
0x1: level2
0x2: level3
0x3: level4";
CM_ SG_ 304 EngStrtStopDrvModIndSetg "EngStrtStopDrvModIndSetg";
CM_ SG_ 304 EngStrtStopSetg "distribution of ss status";
CM_ SG_ 304 GlvBoxHMIReq "Glove box soft switch signal.";
CM_ SG_ 304 HMICDCSet "HMI CDC setting";
CM_ SG_ 304 HmiSeatHeatgForRowSecLe "HMI/user Request of Seat Heat Row 2 Left Level ";
CM_ SG_ 304 HmiSeatHeatgForRowSecRi "HMI/user Request of Seat Heat Row 2 Right Level ";
CM_ SG_ 304 HmiSeatHeatgForRowThrdLe "HMI/user Request of Seat Heat Row 3 Left Level ";
CM_ SG_ 304 HmiSeatHeatgForRowThrdRi "HMI/user Request of Seat Heat Row 3 Right Level ";
CM_ SG_ 304 HmiSeatVentnForRowSecLe "HMI/user Request of Seat Vent Row 2 Left Level ";
CM_ SG_ 304 HmiSeatVentnForRowSecRi "HMI/user Request of Seat Vent Row 2 Right Level ";
CM_ SG_ 304 HmiSeatVentnForRowThrdLe "HMI/user Request of Seat Vent Row 3 Left Level ";
CM_ SG_ 304 HmiSeatVentnForRowThrdRi "HMI/user Request of Seat Vent Row 3 Rignt Level ";
CM_ SG_ 304 ImobVehRemReqAndRespImobVehDataRemReq0 "RVI request from TEM to CEM, 5 bytes of response and timer value. Byte nummer 0";
CM_ SG_ 304 ImobVehRemReqAndRespImobVehDataRemReq1 "RVI request from TEM to CEM, 5 bytes of response and timer value. Byte nummer 1";
CM_ SG_ 304 ImobVehRemReqAndRespImobVehDataRemReq2 "RVI request from TEM to CEM, 5 bytes of response and timer value. Byte nummer 2";
CM_ SG_ 304 ImobVehRemReqAndRespImobVehDataRemReq3 "RVI request from TEM to CEM, 5 bytes of response and timer value. Byte nummer 3";
CM_ SG_ 304 ImobVehRemReqAndRespImobVehDataRemReq4 "RVI request from TEM to CEM, 5 bytes of response and timer value. Byte nummer 4";
CM_ SG_ 304 ImobVehRemReqAndRespImobVehRemReqCmd "RVI request from TEM to CEM, 5 bytes of response and timer value. Request from TEM";
CM_ SG_ 304 ImobVehRemReqAndRespImobVehRemTmrOrSpdLim "RVI request from TEM to CEM, 5 bytes of response and timer value. Time or Speed Limit";
CM_ SG_ 304 IntrBriLvlCtrlSts "Control backlight brightness";
CM_ SG_ 304 LowrReAxle "Lower rear axle request";
CM_ SG_ 304 MobDevRCVReq1Chks "Checksum calculation for E2E";
CM_ SG_ 304 MobDevRCVReq1Cntr "E2E counter";
CM_ SG_ 304 MobDevRCVReq1MobDevSts "Mobile device status";
CM_ SG_ 304 MobDevRCVReq1RCVCtrl "RCV request";
CM_ SG_ 304 MobDevRCVReq1Steertrim "RcvSteeringRequest";
CM_ SG_ 304 PasAcsInHmiReq "Set if car unlocks automatically when user walks in the car with key";
CM_ SG_ 304 PasAcsOutHmiReq "Set if car locks automatically when user leave the car with key";
CM_ SG_ 304 RePosnLiFolwDayTiRunngLiOnOff "indicate whether RPL follows DRL";
CM_ SG_ 304 ReSunCurtOpenPosnReq "Rear sun curtain open or close position request";
CM_ SG_ 304 RoofDispFoldSts "RoofDispFoldSts";
CM_ SG_ 304 RoofDispSldgSts "RoofDispSldgSts";
CM_ SG_ 304 RowSecRiSeatZeroGrvyChdLockSwt "Second row right seat zero gravity child lock switch";
CM_ SG_ 304 TechnologyLiMusicCorrlnSwt "Front technology light and music correlation switch";
CM_ SG_ 304 TopPercTrFromHmi "This signal is used to set top percent of tailgate";
CM_ SG_ 304 VoiceCtrlEasyLoad "easy load feature control by voice";
CM_ SG_ 85 DwnLoadDynLtgPrmForFrntLeGrp10ContinueTime "Light Show Continue Time Parameter 2";
CM_ SG_ 85 DwnLoadDynLtgPrmForFrntLeGrp10HighBrightness "Light Show Upper Brightness Parameter 2";
CM_ SG_ 85 DwnLoadDynLtgPrmForFrntLeGrp10LowBrightness "Light Show Lower Brightness Parameter 2";
CM_ SG_ 85 DwnLoadDynLtgPrmForFrntLeGrp10Mode1 "Light Show Mode Parameter 2";
CM_ SG_ 85 DwnLoadDynLtgPrmForFrntLeGrp10OffsetTime "Light Show Offset Time Parameter 2";
CM_ SG_ 85 DwnLoadDynLtgPrmForFrntLeGrp10Timestamp "Light Show time stamp 2";
CM_ SG_ 85 DwnLoadDynLtgPrmForFrntLeGrp11ContinueTime "Light Show Continue Time Parameter 2";
CM_ SG_ 85 DwnLoadDynLtgPrmForFrntLeGrp11HighBrightness "Light Show Upper Brightness Parameter 2";
CM_ SG_ 85 DwnLoadDynLtgPrmForFrntLeGrp11LowBrightness "Light Show Lower Brightness Parameter 2";
CM_ SG_ 85 DwnLoadDynLtgPrmForFrntLeGrp11Mode1 "Light Show Mode Parameter 2";
CM_ SG_ 85 DwnLoadDynLtgPrmForFrntLeGrp11OffsetTime "Light Show Offset Time Parameter 2";
CM_ SG_ 85 DwnLoadDynLtgPrmForFrntLeGrp11Timestamp "Light Show time stamp 2";
CM_ SG_ 85 DwnLoadDynLtgPrmForFrntLeGrp12ContinueTime "Light Show Continue Time Parameter 2";
CM_ SG_ 85 DwnLoadDynLtgPrmForFrntLeGrp12HighBrightness "Light Show Upper Brightness Parameter 2";
CM_ SG_ 85 DwnLoadDynLtgPrmForFrntLeGrp12LowBrightness "Light Show Lower Brightness Parameter 2";
CM_ SG_ 85 DwnLoadDynLtgPrmForFrntLeGrp12Mode1 "Light Show Mode Parameter 2";
CM_ SG_ 85 DwnLoadDynLtgPrmForFrntLeGrp12OffsetTime "Light Show Offset Time Parameter 2";
CM_ SG_ 85 DwnLoadDynLtgPrmForFrntLeGrp12Timestamp "Light Show time stamp 2";
CM_ SG_ 85 DwnLoadDynLtgPrmForFrntLeGrp1ContinueTime "Light Show Continue Time Parameter 2";
CM_ SG_ 85 DwnLoadDynLtgPrmForFrntLeGrp1HighBrightness "Light Show Upper Brightness Parameter 2";
CM_ SG_ 85 DwnLoadDynLtgPrmForFrntLeGrp1LowBrightness "Light Show Lower Brightness Parameter 2";
CM_ SG_ 85 DwnLoadDynLtgPrmForFrntLeGrp1Mode1 "Light Show Mode Parameter 2";
CM_ SG_ 85 DwnLoadDynLtgPrmForFrntLeGrp1OffsetTime "Light Show Offset Time Parameter 2";
CM_ SG_ 85 DwnLoadDynLtgPrmForFrntLeGrp1Timestamp "Light Show time stamp 2";
CM_ SG_ 85 DwnLoadDynLtgPrmForFrntLeGrp2ContinueTime "Light Show Continue Time Parameter 2";
CM_ SG_ 85 DwnLoadDynLtgPrmForFrntLeGrp2HighBrightness "Light Show Upper Brightness Parameter 2";
CM_ SG_ 85 DwnLoadDynLtgPrmForFrntLeGrp2LowBrightness "Light Show Lower Brightness Parameter 2";
CM_ SG_ 85 DwnLoadDynLtgPrmForFrntLeGrp2Mode1 "Light Show Mode Parameter 2";
CM_ SG_ 85 DwnLoadDynLtgPrmForFrntLeGrp2OffsetTime "Light Show Offset Time Parameter 2";
CM_ SG_ 85 DwnLoadDynLtgPrmForFrntLeGrp2Timestamp "Light Show time stamp 2";
CM_ SG_ 85 DwnLoadDynLtgPrmForFrntLeGrp3ContinueTime "Light Show Continue Time Parameter 2";
CM_ SG_ 85 DwnLoadDynLtgPrmForFrntLeGrp3HighBrightness "Light Show Upper Brightness Parameter 2";
CM_ SG_ 85 DwnLoadDynLtgPrmForFrntLeGrp3LowBrightness "Light Show Lower Brightness Parameter 2";
CM_ SG_ 85 DwnLoadDynLtgPrmForFrntLeGrp3Mode1 "Light Show Mode Parameter 2";
CM_ SG_ 85 DwnLoadDynLtgPrmForFrntLeGrp3OffsetTime "Light Show Offset Time Parameter 2";
CM_ SG_ 85 DwnLoadDynLtgPrmForFrntLeGrp3Timestamp "Light Show time stamp 2";
CM_ SG_ 85 DwnLoadDynLtgPrmForFrntLeGrp4ContinueTime "Light Show Continue Time Parameter 2";
CM_ SG_ 85 DwnLoadDynLtgPrmForFrntLeGrp4HighBrightness "Light Show Upper Brightness Parameter 2";
CM_ SG_ 85 DwnLoadDynLtgPrmForFrntLeGrp4LowBrightness "Light Show Lower Brightness Parameter 2";
CM_ SG_ 85 DwnLoadDynLtgPrmForFrntLeGrp4Mode1 "Light Show Mode Parameter 2";
CM_ SG_ 85 DwnLoadDynLtgPrmForFrntLeGrp4OffsetTime "Light Show Offset Time Parameter 2";
CM_ SG_ 85 DwnLoadDynLtgPrmForFrntLeGrp4Timestamp "Light Show time stamp 2";
CM_ SG_ 85 DwnLoadDynLtgPrmForFrntLeGrp5ContinueTime "Light Show Continue Time Parameter 2";
CM_ SG_ 85 DwnLoadDynLtgPrmForFrntLeGrp5HighBrightness "Light Show Upper Brightness Parameter 2";
CM_ SG_ 85 DwnLoadDynLtgPrmForFrntLeGrp5LowBrightness "Light Show Lower Brightness Parameter 2";
CM_ SG_ 85 DwnLoadDynLtgPrmForFrntLeGrp5Mode1 "Light Show Mode Parameter 2";
CM_ SG_ 85 DwnLoadDynLtgPrmForFrntLeGrp5OffsetTime "Light Show Offset Time Parameter 2";
CM_ SG_ 85 DwnLoadDynLtgPrmForFrntLeGrp5Timestamp "Light Show time stamp 2";
CM_ SG_ 85 DwnLoadDynLtgPrmForFrntLeGrp6ContinueTime "Light Show Continue Time Parameter 2";
CM_ SG_ 85 DwnLoadDynLtgPrmForFrntLeGrp6HighBrightness "Light Show Upper Brightness Parameter 2";
CM_ SG_ 85 DwnLoadDynLtgPrmForFrntLeGrp6LowBrightness "Light Show Lower Brightness Parameter 2";
CM_ SG_ 85 DwnLoadDynLtgPrmForFrntLeGrp6Mode1 "Light Show Mode Parameter 2";
CM_ SG_ 85 DwnLoadDynLtgPrmForFrntLeGrp6OffsetTime "Light Show Offset Time Parameter 2";
CM_ SG_ 85 DwnLoadDynLtgPrmForFrntLeGrp6Timestamp "Light Show time stamp 2";
CM_ SG_ 85 DwnLoadDynLtgPrmForFrntLeGrp7ContinueTime "Light Show Continue Time Parameter 2";
CM_ SG_ 85 DwnLoadDynLtgPrmForFrntLeGrp7HighBrightness "Light Show Upper Brightness Parameter 2";
CM_ SG_ 85 DwnLoadDynLtgPrmForFrntLeGrp7LowBrightness "Light Show Lower Brightness Parameter 2";
CM_ SG_ 85 DwnLoadDynLtgPrmForFrntLeGrp7Mode1 "Light Show Mode Parameter 2";
CM_ SG_ 85 DwnLoadDynLtgPrmForFrntLeGrp7OffsetTime "Light Show Offset Time Parameter 2";
CM_ SG_ 85 DwnLoadDynLtgPrmForFrntLeGrp7Timestamp "Light Show time stamp 2";
CM_ SG_ 85 DwnLoadDynLtgPrmForFrntLeGrp8ContinueTime "Light Show Continue Time Parameter 2";
CM_ SG_ 85 DwnLoadDynLtgPrmForFrntLeGrp8HighBrightness "Light Show Upper Brightness Parameter 2";
CM_ SG_ 85 DwnLoadDynLtgPrmForFrntLeGrp8LowBrightness "Light Show Lower Brightness Parameter 2";
CM_ SG_ 85 DwnLoadDynLtgPrmForFrntLeGrp8Mode1 "Light Show Mode Parameter 2";
CM_ SG_ 85 DwnLoadDynLtgPrmForFrntLeGrp8OffsetTime "Light Show Offset Time Parameter 2";
CM_ SG_ 85 DwnLoadDynLtgPrmForFrntLeGrp8Timestamp "Light Show time stamp 2";
CM_ SG_ 85 DwnLoadDynLtgPrmForFrntLeGrp9ContinueTime "Light Show Continue Time Parameter 2";
CM_ SG_ 85 DwnLoadDynLtgPrmForFrntLeGrp9HighBrightness "Light Show Upper Brightness Parameter 2";
CM_ SG_ 85 DwnLoadDynLtgPrmForFrntLeGrp9LowBrightness "Light Show Lower Brightness Parameter 2";
CM_ SG_ 85 DwnLoadDynLtgPrmForFrntLeGrp9Mode1 "Light Show Mode Parameter 2";
CM_ SG_ 85 DwnLoadDynLtgPrmForFrntLeGrp9OffsetTime "Light Show Offset Time Parameter 2";
CM_ SG_ 85 DwnLoadDynLtgPrmForFrntLeGrp9Timestamp "Light Show time stamp 2";
CM_ SG_ 85 RemACChrgLidTelmReq "Remote DC charge lid open/close request";
CM_ SG_ 85 RemChkTInVeh "Remote Check Temperature In Vehicle";
CM_ SG_ 85 RemDCChrgLidTelmReq "Remote DC charge lid open/close request";
CM_ SG_ 85 RemsSetDchaTarVal "remote setting the discharging SOC";
CM_ SG_ 85 RemStrtExtnTiReq "remote start high voltage extend time request";
CM_ SG_ 85 RemStrtHvCtrlReqErsCmd "remote start high voltage control request";
CM_ SG_ 85 RemStrtHvCtrlReqErsRunTime "remote start high voltage control time";
CM_ SG_ 85 RemVentReq "remote cockpit ventilate request";
CM_ SG_ 85 ReqFragLvlTelm "remote  Fragrance lever request";
CM_ SG_ 85 SeatHeatDurgClimaEnadFromTelm "Request signal from Telematics to start the seat heater during a pre-climatization.";
CM_ SG_ 85 SiteOfcommCharn "false or true";
CM_ SG_ 85 SocInFoOfCommChargn "SOC percentage from TSP";
CM_ SG_ 85 SocOfCommChargn "false or true";
CM_ SG_ 85 SteerWhlHeatgDurgClimaEnadFromTelm "Request signal from Telematics to start the stearing wheel heater during a pre-climatization.";
CM_ SG_ 85 SunRoofAndCurtCmdTelm " sunRoof and Curt Remote Command ";
CM_ SG_ 85 TankFlapTelmLockgReq "LockActvnOff";
CM_ SG_ 85 TelmBookSteerWhlHeatClimalReq "Telm Book Steer Whleel Heat Request On/Off";
CM_ SG_ 85 TelmFctReq "Telematis Function Request";

// Attribute definitions
BA_DEF_  "BaudRateCANFD" FLOAT 1000 10000000; // [bps]
BA_DEF_  "Baudrate" INT 1000 1000000; // [bps]
BA_DEF_  "BusType" STRING;
BA_DEF_  "DBName" STRING;
BA_DEF_  "ProtocolType" STRING;
BA_DEF_ BO_ "CANFD_BRS" ENUM "0","1";
BA_DEF_ BO_ "GenMsgCycleTime" INT 0 65536; // [ms]
BA_DEF_ BO_ "GenMsgDelayTime" INT 0 65536; // [ms]
BA_DEF_ BO_ "GenMsgSendType" ENUM "cyclic", "spontaneous", "not-used", "not-used", "not-used", "cyclicAndSpontaneous", "not-used", "cyclicIfActive", "NoMsgSendType"; // [us]
BA_DEF_ BO_ "GenMsgStartDelayTime" INT 0 65536; // [ms]
BA_DEF_ BO_ "VFrameFormat" ENUM "StandardCAN","ExtendedCAN","reserved","J1939PG","reserved","reserved","reserved","reserved","reserved","reserved","reserved","reserved","reserved","reserved","StandardCAN_FD","ExtendedCAN_FD";
BA_DEF_ SG_ "GenSigSendType" ENUM "Cyclic","OnWrite","OnWriteWithRepetition","OnChange","OnChangeWithRepetition","IfActive","IfActiveWithRepetition","NoSigSendType";
BA_DEF_ SG_ "GenSigStartValue" HEX 0 80000000;
BA_DEF_ BO_ "GenMsgILSupport" ENUM "No","Yes";
BA_DEF_ BO_ "NmAsrMessage" ENUM "No","Yes";
BA_DEF_  "NmAsrBaseAddress" HEX 0 536870911;
BA_DEF_  "NmAsrMessageCount" INT 0 255;
BA_DEF_ BU_ "NodeLayerModules" STRING;
BA_DEF_ BU_ "ILused" ENUM "No","Yes";
BA_DEF_ SG_ "GenSigFuncType" ENUM "NoFunction","n/a","n/a","n/a","n/a","n/a","n/a","n/a","n/a","n/a","n/a","n/a","n/a","n/a","n/a","CHK","CNTR","n/a","n/a","n/a","CNTR_AR_01","CRC_AR_01_BOTH","CRC_AR_01_ALT","CRC_AR_01_LOW","CRC_AR_01_NIBBLE","CNTR_AR_04","CRC_AR_04A","CNTR_AR_05","CRC_AR_05";
BA_DEF_ SG_ "GenSigDataID" STRING;

BA_DEF_DEF_ "BusType" "";
BA_DEF_DEF_ "DBName" "";
BA_DEF_DEF_ "ProtocolType" "";
BA_DEF_DEF_ "CANFD_BRS" "1";
BA_DEF_DEF_ "GenSigStartValue" 0;
BA_DEF_DEF_ "VFrameFormat" "J1939PG";
BA_DEF_DEF_ "GenSigSendType" "NoSigSendType";
BA_DEF_DEF_ "GenMsgCycleTime" 0;
BA_DEF_DEF_ "GenMsgDelayTime" 0;
BA_DEF_DEF_ "GenMsgStartDelayTime" 0;
BA_DEF_DEF_ "GenMsgSendType" "NoMsgSendType";
BA_DEF_DEF_ "GenMsgILSupport" "Yes";
BA_DEF_DEF_ "NmAsrMessage" "No";
BA_DEF_DEF_ "NmAsrBaseAddress" 1280;
BA_DEF_DEF_ "NmAsrMessageCount" 64;
BA_DEF_DEF_ "NodeLayerModules" "CANoeILNLSPA.dll";
BA_DEF_DEF_ "ILused" "Yes";
BA_DEF_DEF_ "GenSigFuncType" "NoFunction";
BA_DEF_DEF_ "GenSigDataID" "";

BA_ "BaudRateCANFD" 2000000;
BA_ "Baudrate" 500000;
BA_ "BusType" "CAN FD";
BA_ "DBName" "ZCU_CANFD2";
BA_ "ProtocolType" "CAN";
// ECU: ETC
BA_ "ILused" BU_ ETC 0;
// ECU: IHU
BA_ "ILused" BU_ IHU 0;
// ECU: ZCUD
BA_ "ILused" BU_ ZCUD 0;
// ECU: ZCUP
BA_ "ILused" BU_ ZCUP 0;
// Frame: DhuToAllFuncZCUCANFD2DiagReqFr
BA_ "GenMsgDelayTime" BO_ 2047 5.000;
BA_ "GenMsgSendType" BO_ 2047 1;
BA_ "VFrameFormat" BO_ 2047 14;
// Frame: DhuToZcudCmdZCUCANFD2DiagReqFr
BA_ "GenMsgDelayTime" BO_ 1820 5.000;
BA_ "GenMsgSendType" BO_ 1820 1;
BA_ "VFrameFormat" BO_ 1820 14;
// Frame: DhuToZcudCmpZCUCANFD2DiagReqFr
BA_ "GenMsgDelayTime" BO_ 1821 5.000;
BA_ "GenMsgSendType" BO_ 1821 1;
BA_ "VFrameFormat" BO_ 1821 14;
// Frame: DhuToZcudDlmZCUCANFD2DiagReqFr
BA_ "GenMsgDelayTime" BO_ 1850 5.000;
BA_ "GenMsgSendType" BO_ 1850 1;
BA_ "VFrameFormat" BO_ 1850 14;
// Frame: DhuToZcudDpod2ZCUCANFD2DiagReqFr
BA_ "GenMsgDelayTime" BO_ 1969 5.000;
BA_ "GenMsgSendType" BO_ 1969 1;
BA_ "VFrameFormat" BO_ 1969 14;
// Frame: DhuToZcudHcmlZCUCANFD2DiagReqFr
BA_ "GenMsgDelayTime" BO_ 1971 5.000;
BA_ "GenMsgSendType" BO_ 1971 1;
BA_ "VFrameFormat" BO_ 1971 14;
// Frame: DhuToZcudHcmrZCUCANFD2DiagReqFr
BA_ "GenMsgDelayTime" BO_ 1972 5.000;
BA_ "GenMsgSendType" BO_ 1972 1;
BA_ "VFrameFormat" BO_ 1972 14;
// Frame: DhuToZcudLpod2ZCUCANFD2DiagReqFr
BA_ "GenMsgDelayTime" BO_ 1968 5.000;
BA_ "GenMsgSendType" BO_ 1968 1;
BA_ "VFrameFormat" BO_ 1968 14;
// Frame: DhuToZcudPotZCUCANFD2DiagReqFr
BA_ "GenMsgDelayTime" BO_ 1813 5.000;
BA_ "GenMsgSendType" BO_ 1813 1;
BA_ "VFrameFormat" BO_ 1813 14;
// Frame: DhuToZcudPpod2ZCUCANFD2DiagReqFr
BA_ "GenMsgDelayTime" BO_ 1980 5.000;
BA_ "GenMsgSendType" BO_ 1980 1;
BA_ "VFrameFormat" BO_ 1980 14;
// Frame: DhuToZcudRcmZCUCANFD2DiagReqFr
BA_ "GenMsgDelayTime" BO_ 1970 5.000;
BA_ "GenMsgSendType" BO_ 1970 1;
BA_ "VFrameFormat" BO_ 1970 14;
// Frame: DhuToZcudRmlZCUCANFD2DiagReqFr
BA_ "GenMsgDelayTime" BO_ 1808 5.000;
BA_ "GenMsgSendType" BO_ 1808 1;
BA_ "VFrameFormat" BO_ 1808 14;
// Frame: DhuToZcudRmrZCUCANFD2DiagReqFr
BA_ "GenMsgDelayTime" BO_ 1809 5.000;
BA_ "GenMsgSendType" BO_ 1809 1;
BA_ "VFrameFormat" BO_ 1809 14;
// Frame: DhuToZcudRpod2ZCUCANFD2DiagReqFr
BA_ "GenMsgDelayTime" BO_ 1979 5.000;
BA_ "GenMsgSendType" BO_ 1979 1;
BA_ "VFrameFormat" BO_ 1979 14;
// Frame: DhuToZcudSdlZCUCANFD2DiagReqFr
BA_ "GenMsgDelayTime" BO_ 1827 5.000;
BA_ "GenMsgSendType" BO_ 1827 1;
BA_ "VFrameFormat" BO_ 1827 14;
// Frame: DhuToZcudSdrZCUCANFD2DiagReqFr
BA_ "GenMsgDelayTime" BO_ 1828 5.000;
BA_ "GenMsgSendType" BO_ 1828 1;
BA_ "VFrameFormat" BO_ 1828 14;
// Frame: DhuToZcudSmbZCUCANFD2DiagReqFr
BA_ "GenMsgDelayTime" BO_ 1833 5.000;
BA_ "GenMsgSendType" BO_ 1833 1;
BA_ "VFrameFormat" BO_ 1833 14;
// Frame: DhuToZcudSmblZCUCANFD2DiagReqFr
BA_ "GenMsgDelayTime" BO_ 1841 5.000;
BA_ "GenMsgSendType" BO_ 1841 1;
BA_ "VFrameFormat" BO_ 1841 14;
// Frame: DhuToZcudSmbrZCUCANFD2DiagReqFr
BA_ "GenMsgDelayTime" BO_ 1842 5.000;
BA_ "GenMsgSendType" BO_ 1842 1;
BA_ "VFrameFormat" BO_ 1842 14;
// Frame: DhuToZcudSmp2ZCUCANFD2DiagReqFr
BA_ "GenMsgDelayTime" BO_ 1832 5.000;
BA_ "GenMsgSendType" BO_ 1832 1;
BA_ "VFrameFormat" BO_ 1832 14;
// Frame: DhuToZcudSrsISO26021ZCUCanFD2ReqFr
BA_ "GenMsgDelayTime" BO_ 2033 5.000;
BA_ "GenMsgSendType" BO_ 2033 1;
BA_ "VFrameFormat" BO_ 2033 0;
// Frame: DhuToZcudSrsZCUCANFD2DiagReqFr
BA_ "GenMsgDelayTime" BO_ 1849 5.000;
BA_ "GenMsgSendType" BO_ 1849 1;
BA_ "VFrameFormat" BO_ 1849 14;
// Frame: DhuToZcudSwmZCUCANFD2DiagReqFr
BA_ "GenMsgDelayTime" BO_ 1906 5.000;
BA_ "GenMsgSendType" BO_ 1906 1;
BA_ "VFrameFormat" BO_ 1906 14;
// Frame: DhuToZcudTcmbZCUCANFD2DiagReqFr
BA_ "GenMsgDelayTime" BO_ 1834 5.000;
BA_ "GenMsgSendType" BO_ 1834 1;
BA_ "VFrameFormat" BO_ 1834 14;
// Frame: DhuToZcudTrmZCUCANFD2DiagReqFr
BA_ "GenMsgDelayTime" BO_ 1815 5.000;
BA_ "GenMsgSendType" BO_ 1815 1;
BA_ "VFrameFormat" BO_ 1815 14;
// Frame: DhuToZcudZCUCANFD2DiagReqFr
BA_ "GenMsgDelayTime" BO_ 1793 5.000;
BA_ "GenMsgSendType" BO_ 1793 1;
BA_ "VFrameFormat" BO_ 1793 14;
// Frame: DhuToZcudZcudsZCUCANFD2DiagReqFr
BA_ "GenMsgDelayTime" BO_ 1825 5.000;
BA_ "GenMsgSendType" BO_ 1825 1;
BA_ "VFrameFormat" BO_ 1825 14;
// Frame: DhuToZcupZCUCANFD2DiagReqFr
BA_ "GenMsgDelayTime" BO_ 1794 5.000;
BA_ "GenMsgSendType" BO_ 1794 1;
BA_ "VFrameFormat" BO_ 1794 14;
// Frame: DhuZCUCANFD2Fr01
BA_ "GenMsgCycleTime" BO_ 432 100.000;
BA_ "GenMsgSendType" BO_ 432 0;
BA_ "VFrameFormat" BO_ 432 14;
// Frame: DhuZCUCANFD2Fr02
BA_ "GenMsgCycleTime" BO_ 448 60.000;
BA_ "GenMsgSendType" BO_ 448 0;
BA_ "VFrameFormat" BO_ 448 14;
// Frame: DhuZCUCANFD2Fr03
BA_ "GenMsgCycleTime" BO_ 304 50.000;
BA_ "GenMsgSendType" BO_ 304 0;
BA_ "VFrameFormat" BO_ 304 14;
// Frame: DhuZCUCANFD2Fr04
BA_ "GenMsgDelayTime" BO_ 85 30.000;
BA_ "GenMsgSendType" BO_ 85 1;
BA_ "VFrameFormat" BO_ 85 14;
BA_ "GenSigSendType" SG_ 432 AFSSetReq 0;
BA_ "GenSigSendType" SG_ 432 ActvReSplrHldSwt 0;
BA_ "GenSigSendType" SG_ 448 ActvReSplrPrkgInteractionSwt 0;
BA_ "GenSigSendType" SG_ 432 ActvnOfGiveWay 0;
BA_ "GenSigSendType" SG_ 432 ActvnOfTakeOverMic 0;
BA_ "GenSigSendType" SG_ 432 AllSeatResetReq 0;
BA_ "GenSigSendType" SG_ 448 AmbLiAll 0;
BA_ "GenSigSendType" SG_ 304 AmbLiBreathColor2Blue 0;
BA_ "GenSigSendType" SG_ 304 AmbLiBreathColor2Green 0;
BA_ "GenSigSendType" SG_ 304 AmbLiBreathColor2Red 0;
BA_ "GenSigSendType" SG_ 304 AmbLiBreathColor3Blue 0;
BA_ "GenSigSendType" SG_ 304 AmbLiBreathColor3Green 0;
BA_ "GenSigSendType" SG_ 304 AmbLiBreathColor3Red 0;
BA_ "GenSigSendType" SG_ 304 AmbLiBreathColorBlue 0;
BA_ "GenSigSendType" SG_ 304 AmbLiBreathColorGreen 0;
BA_ "GenSigSendType" SG_ 304 AmbLiBreathColorRed 0;
BA_ "GenSigSendType" SG_ 448 AmbLiClimateCorrlnReq 0;
BA_ "GenSigSendType" SG_ 448 AmbLiColorModReq 0;
BA_ "GenSigSendType" SG_ 448 AmbLiEnduranceMilgOpenReq 0;
BA_ "GenSigSendType" SG_ 448 AmbLiModExt 0;
BA_ "GenSigSendType" SG_ 448 AmbLiMusicCorrlnReq 0;
BA_ "GenSigSendType" SG_ 448 AmbLiPhoneOpenReq 0;
BA_ "GenSigSendType" SG_ 448 AmbLiSpeechCorrlnReq 0;
BA_ "GenSigSendType" SG_ 304 AmbLiTransColor1Blue 0;
BA_ "GenSigSendType" SG_ 304 AmbLiTransColor1Green 0;
BA_ "GenSigSendType" SG_ 304 AmbLiTransColor1Red 0;
BA_ "GenSigSendType" SG_ 304 AmbLiTransColor2Blue 0;
BA_ "GenSigSendType" SG_ 304 AmbLiTransColor2Green 0;
BA_ "GenSigSendType" SG_ 304 AmbLiTransColor2Red 0;
BA_ "GenSigSendType" SG_ 448 AmbientLiEffectStatusBreathingEffectStatus 0;
BA_ "GenSigSendType" SG_ 448 AmbientLiEffectStatusTransitionEffectStatus 0;
BA_ "GenSigSendType" SG_ 448 AntithftRednReq 0;
BA_ "GenSigSendType" SG_ 432 ApproachLiSetReq 0;
BA_ "GenSigSendType" SG_ 432 ApproachOpenTrOnOff 0;
BA_ "GenSigSendType" SG_ 432 AutHiBeamSwt 0;
BA_ "GenSigSendType" SG_ 448 BackRestAdjmtRowFirstDrvr 0;
BA_ "GenSigSendType" SG_ 448 BackRestAdjmtRowFirstPass 0;
BA_ "GenSigSendType" SG_ 432 BackrestAdjmtRowSecLe 0;
BA_ "GenSigSendType" SG_ 432 BackrestAdjmtRowSecRi 0;
BA_ "GenSigSendType" SG_ 432 BackrestAdjmtRowThrdLe 0;
BA_ "GenSigSendType" SG_ 432 BackrestAdjmtRowThrdRi 0;
BA_ "GenSigSendType" SG_ 432 BendingLiSetReq 0;
BA_ "GenSigSendType" SG_ 432 CallSts 0;
BA_ "GenSigSendType" SG_ 432 CarFindrHornLiSetActv 0;
BA_ "GenSigSendType" SG_ 304 CargoBoxIllumOpenReq 0;
BA_ "GenSigSendType" SG_ 432 CarpetLiSwtReq 0;
BA_ "GenSigSendType" SG_ 432 CarpetLiTiReq 0;
BA_ "GenSigSendType" SG_ 432 CenLockHmiReq 0;
BA_ "GenSigSendType" SG_ 304 ChdLockReLeCtrlHmiReq 0;
BA_ "GenSigSendType" SG_ 304 ChdLockReRiCtrlHmiReq 0;
BA_ "GenSigSendType" SG_ 432 ChrgLidCtrlHmiReqACandDCchargelid 0;
BA_ "GenSigSendType" SG_ 432 ChrgLidCtrlHmiReqACchargelid 0;
BA_ "GenSigSendType" SG_ 432 ChrgLidCtrlHmiReqDCchargelid 0;
BA_ "GenSigSendType" SG_ 432 ChrgnLiSwt 1;
BA_ "GenSigSendType" SG_ 432 ClsAutEna 0;
BA_ "GenSigSendType" SG_ 304 ColrOfSreenZone1Blue 0;
BA_ "GenSigStartValue" SG_ 304 ColrOfSreenZone1Blue 25;
BA_ "GenSigSendType" SG_ 304 ColrOfSreenZone1Green 0;
BA_ "GenSigStartValue" SG_ 304 ColrOfSreenZone1Green 254;
BA_ "GenSigSendType" SG_ 304 ColrOfSreenZone1Red 0;
BA_ "GenSigStartValue" SG_ 304 ColrOfSreenZone1Red 238;
BA_ "GenSigSendType" SG_ 304 ColrOfSreenZone2Blue 0;
BA_ "GenSigStartValue" SG_ 304 ColrOfSreenZone2Blue 25;
BA_ "GenSigSendType" SG_ 304 ColrOfSreenZone2Green 0;
BA_ "GenSigStartValue" SG_ 304 ColrOfSreenZone2Green 254;
BA_ "GenSigSendType" SG_ 304 ColrOfSreenZone2Red 0;
BA_ "GenSigStartValue" SG_ 304 ColrOfSreenZone2Red 238;
BA_ "GenSigSendType" SG_ 432 ComityPedLiSwt 0;
BA_ "GenSigSendType" SG_ 304 CourtesyLiOpenReq 0;
BA_ "GenSigSendType" SG_ 448 CurrentRoadCongstionPassTime 0;
BA_ "GenSigSendType" SG_ 448 CurrentRoadcongestionLength 0;
BA_ "GenSigSendType" SG_ 448 CurrentRoadcongestionLvl 0;
BA_ "GenSigSendType" SG_ 304 DestinationPOIPosnLat 0;
BA_ "GenSigStartValue" SG_ 304 DestinationPOIPosnLat 323999740.8002074;
BA_ "GenSigSendType" SG_ 304 DestinationPOIPosnLgt 0;
BA_ "GenSigStartValue" SG_ 304 DestinationPOIPosnLgt 647999481.6004148;
BA_ "GenSigSendType" SG_ 448 DrvModDispd 0;
BA_ "GenSigSendType" SG_ 448 DrvrEntryLoReq 0;
BA_ "GenSigSendType" SG_ 432 DrvrSeatAdpvLumSetg 0;
BA_ "GenSigSendType" SG_ 432 DrvrSeatAdpvSideSpprtSetg 0;
BA_ "GenSigSendType" SG_ 448 DrvrSeatTarPosnCmdReqSeatBackrTargPosAg 0;
BA_ "GenSigStartValue" SG_ 448 DrvrSeatTarPosnCmdReqSeatBackrTargPosAg 115;
BA_ "GenSigSendType" SG_ 448 DrvrSeatTarPosnCmdReqSeatFrntHeiTargPosPerc 0;
BA_ "GenSigSendType" SG_ 448 DrvrSeatTarPosnCmdReqSeatHeiTargPosPerc 0;
BA_ "GenSigStartValue" SG_ 448 DrvrSeatTarPosnCmdReqSeatHeiTargPosPerc 500;
BA_ "GenSigSendType" SG_ 448 DrvrSeatTarPosnCmdReqSeatLenTargPosPerc 0;
BA_ "GenSigStartValue" SG_ 448 DrvrSeatTarPosnCmdReqSeatLenTargPosPerc 300;
BA_ "GenSigSendType" SG_ 448 DrvrSeatTarPosnCmdReqTarPosnCmd 0;
BA_ "GenSigSendType" SG_ 304 DstProtnReq 0;
BA_ "GenSigStartValue" SG_ 304 DstProtnReq 150;
BA_ "GenSigSendType" SG_ 432 DstToDestination 0;
BA_ "GenSigSendType" SG_ 448 DstToNextCongestionRrd 0;
BA_ "GenSigSendType" SG_ 85 DwnLoadDynLtgPrmForFrntLeGrp10ContinueTime 1;
BA_ "GenSigSendType" SG_ 85 DwnLoadDynLtgPrmForFrntLeGrp10HighBrightness 1;
BA_ "GenSigSendType" SG_ 85 DwnLoadDynLtgPrmForFrntLeGrp10LowBrightness 1;
BA_ "GenSigSendType" SG_ 85 DwnLoadDynLtgPrmForFrntLeGrp10Mode1 1;
BA_ "GenSigSendType" SG_ 85 DwnLoadDynLtgPrmForFrntLeGrp10OffsetTime 1;
BA_ "GenSigSendType" SG_ 85 DwnLoadDynLtgPrmForFrntLeGrp10Timestamp 1;
BA_ "GenSigSendType" SG_ 85 DwnLoadDynLtgPrmForFrntLeGrp11ContinueTime 1;
BA_ "GenSigSendType" SG_ 85 DwnLoadDynLtgPrmForFrntLeGrp11HighBrightness 1;
BA_ "GenSigSendType" SG_ 85 DwnLoadDynLtgPrmForFrntLeGrp11LowBrightness 1;
BA_ "GenSigSendType" SG_ 85 DwnLoadDynLtgPrmForFrntLeGrp11Mode1 1;
BA_ "GenSigSendType" SG_ 85 DwnLoadDynLtgPrmForFrntLeGrp11OffsetTime 1;
BA_ "GenSigSendType" SG_ 85 DwnLoadDynLtgPrmForFrntLeGrp11Timestamp 1;
BA_ "GenSigSendType" SG_ 85 DwnLoadDynLtgPrmForFrntLeGrp12ContinueTime 1;
BA_ "GenSigSendType" SG_ 85 DwnLoadDynLtgPrmForFrntLeGrp12HighBrightness 1;
BA_ "GenSigSendType" SG_ 85 DwnLoadDynLtgPrmForFrntLeGrp12LowBrightness 1;
BA_ "GenSigSendType" SG_ 85 DwnLoadDynLtgPrmForFrntLeGrp12Mode1 1;
BA_ "GenSigSendType" SG_ 85 DwnLoadDynLtgPrmForFrntLeGrp12OffsetTime 1;
BA_ "GenSigSendType" SG_ 85 DwnLoadDynLtgPrmForFrntLeGrp12Timestamp 1;
BA_ "GenSigSendType" SG_ 85 DwnLoadDynLtgPrmForFrntLeGrp1ContinueTime 1;
BA_ "GenSigSendType" SG_ 85 DwnLoadDynLtgPrmForFrntLeGrp1HighBrightness 1;
BA_ "GenSigSendType" SG_ 85 DwnLoadDynLtgPrmForFrntLeGrp1LowBrightness 1;
BA_ "GenSigSendType" SG_ 85 DwnLoadDynLtgPrmForFrntLeGrp1Mode1 1;
BA_ "GenSigSendType" SG_ 85 DwnLoadDynLtgPrmForFrntLeGrp1OffsetTime 1;
BA_ "GenSigSendType" SG_ 85 DwnLoadDynLtgPrmForFrntLeGrp1Timestamp 1;
BA_ "GenSigSendType" SG_ 85 DwnLoadDynLtgPrmForFrntLeGrp2ContinueTime 1;
BA_ "GenSigSendType" SG_ 85 DwnLoadDynLtgPrmForFrntLeGrp2HighBrightness 1;
BA_ "GenSigSendType" SG_ 85 DwnLoadDynLtgPrmForFrntLeGrp2LowBrightness 1;
BA_ "GenSigSendType" SG_ 85 DwnLoadDynLtgPrmForFrntLeGrp2Mode1 1;
BA_ "GenSigSendType" SG_ 85 DwnLoadDynLtgPrmForFrntLeGrp2OffsetTime 1;
BA_ "GenSigSendType" SG_ 85 DwnLoadDynLtgPrmForFrntLeGrp2Timestamp 1;
BA_ "GenSigSendType" SG_ 85 DwnLoadDynLtgPrmForFrntLeGrp3ContinueTime 1;
BA_ "GenSigSendType" SG_ 85 DwnLoadDynLtgPrmForFrntLeGrp3HighBrightness 1;
BA_ "GenSigSendType" SG_ 85 DwnLoadDynLtgPrmForFrntLeGrp3LowBrightness 1;
BA_ "GenSigSendType" SG_ 85 DwnLoadDynLtgPrmForFrntLeGrp3Mode1 1;
BA_ "GenSigSendType" SG_ 85 DwnLoadDynLtgPrmForFrntLeGrp3OffsetTime 1;
BA_ "GenSigSendType" SG_ 85 DwnLoadDynLtgPrmForFrntLeGrp3Timestamp 1;
BA_ "GenSigSendType" SG_ 85 DwnLoadDynLtgPrmForFrntLeGrp4ContinueTime 1;
BA_ "GenSigSendType" SG_ 85 DwnLoadDynLtgPrmForFrntLeGrp4HighBrightness 1;
BA_ "GenSigSendType" SG_ 85 DwnLoadDynLtgPrmForFrntLeGrp4LowBrightness 1;
BA_ "GenSigSendType" SG_ 85 DwnLoadDynLtgPrmForFrntLeGrp4Mode1 1;
BA_ "GenSigSendType" SG_ 85 DwnLoadDynLtgPrmForFrntLeGrp4OffsetTime 1;
BA_ "GenSigSendType" SG_ 85 DwnLoadDynLtgPrmForFrntLeGrp4Timestamp 1;
BA_ "GenSigSendType" SG_ 85 DwnLoadDynLtgPrmForFrntLeGrp5ContinueTime 1;
BA_ "GenSigSendType" SG_ 85 DwnLoadDynLtgPrmForFrntLeGrp5HighBrightness 1;
BA_ "GenSigSendType" SG_ 85 DwnLoadDynLtgPrmForFrntLeGrp5LowBrightness 1;
BA_ "GenSigSendType" SG_ 85 DwnLoadDynLtgPrmForFrntLeGrp5Mode1 1;
BA_ "GenSigSendType" SG_ 85 DwnLoadDynLtgPrmForFrntLeGrp5OffsetTime 1;
BA_ "GenSigSendType" SG_ 85 DwnLoadDynLtgPrmForFrntLeGrp5Timestamp 1;
BA_ "GenSigSendType" SG_ 85 DwnLoadDynLtgPrmForFrntLeGrp6ContinueTime 1;
BA_ "GenSigSendType" SG_ 85 DwnLoadDynLtgPrmForFrntLeGrp6HighBrightness 1;
BA_ "GenSigSendType" SG_ 85 DwnLoadDynLtgPrmForFrntLeGrp6LowBrightness 1;
BA_ "GenSigSendType" SG_ 85 DwnLoadDynLtgPrmForFrntLeGrp6Mode1 1;
BA_ "GenSigSendType" SG_ 85 DwnLoadDynLtgPrmForFrntLeGrp6OffsetTime 1;
BA_ "GenSigSendType" SG_ 85 DwnLoadDynLtgPrmForFrntLeGrp6Timestamp 1;
BA_ "GenSigSendType" SG_ 85 DwnLoadDynLtgPrmForFrntLeGrp7ContinueTime 1;
BA_ "GenSigSendType" SG_ 85 DwnLoadDynLtgPrmForFrntLeGrp7HighBrightness 1;
BA_ "GenSigSendType" SG_ 85 DwnLoadDynLtgPrmForFrntLeGrp7LowBrightness 1;
BA_ "GenSigSendType" SG_ 85 DwnLoadDynLtgPrmForFrntLeGrp7Mode1 1;
BA_ "GenSigSendType" SG_ 85 DwnLoadDynLtgPrmForFrntLeGrp7OffsetTime 1;
BA_ "GenSigSendType" SG_ 85 DwnLoadDynLtgPrmForFrntLeGrp7Timestamp 1;
BA_ "GenSigSendType" SG_ 85 DwnLoadDynLtgPrmForFrntLeGrp8ContinueTime 1;
BA_ "GenSigSendType" SG_ 85 DwnLoadDynLtgPrmForFrntLeGrp8HighBrightness 1;
BA_ "GenSigSendType" SG_ 85 DwnLoadDynLtgPrmForFrntLeGrp8LowBrightness 1;
BA_ "GenSigSendType" SG_ 85 DwnLoadDynLtgPrmForFrntLeGrp8Mode1 1;
BA_ "GenSigSendType" SG_ 85 DwnLoadDynLtgPrmForFrntLeGrp8OffsetTime 1;
BA_ "GenSigSendType" SG_ 85 DwnLoadDynLtgPrmForFrntLeGrp8Timestamp 1;
BA_ "GenSigSendType" SG_ 85 DwnLoadDynLtgPrmForFrntLeGrp9ContinueTime 1;
BA_ "GenSigSendType" SG_ 85 DwnLoadDynLtgPrmForFrntLeGrp9HighBrightness 1;
BA_ "GenSigSendType" SG_ 85 DwnLoadDynLtgPrmForFrntLeGrp9LowBrightness 1;
BA_ "GenSigSendType" SG_ 85 DwnLoadDynLtgPrmForFrntLeGrp9Mode1 1;
BA_ "GenSigSendType" SG_ 85 DwnLoadDynLtgPrmForFrntLeGrp9OffsetTime 1;
BA_ "GenSigSendType" SG_ 85 DwnLoadDynLtgPrmForFrntLeGrp9Timestamp 1;
BA_ "GenSigSendType" SG_ 304 EasyInOutDrvrSeatAdjmt 0;
BA_ "GenSigSendType" SG_ 432 EasyInOutFrntPassReq 0;
BA_ "GenSigSendType" SG_ 304 EasyInOutSecRowLeReq 0;
BA_ "GenSigSendType" SG_ 304 EasyInOutSecRowRiReq 0;
BA_ "GenSigSendType" SG_ 304 EgyRgnLvlSet 0;
BA_ "GenSigSendType" SG_ 304 EngStrtStopDrvModIndSetg 0;
BA_ "GenSigSendType" SG_ 304 EngStrtStopSetg 0;
BA_ "GenSigSendType" SG_ 448 ExtrMirrFoldSetgMirrDrvr 0;
BA_ "GenSigSendType" SG_ 448 ExtrMirrFoldSetgMirrPass 0;
BA_ "GenSigSendType" SG_ 448 ExtrMirrTiltSetgMirrDrvr 0;
BA_ "GenSigSendType" SG_ 448 ExtrMirrTiltSetgMirrPass 0;
BA_ "GenSigSendType" SG_ 432 FrnPosnLiFolwDayTiRunngLiOnOff 0;
BA_ "GenSigSendType" SG_ 432 FrntDstPrjSwt 0;
BA_ "GenSigSendType" SG_ 448 FrntTechLiInfoDispSetReq 0;
BA_ "GenSigSendType" SG_ 304 GlvBoxHMIReq 0;
BA_ "GenSigSendType" SG_ 448 GoodbyeLiOpenReq 0;
BA_ "GenSigSendType" SG_ 448 HMIAutDemstSet 0;
BA_ "GenSigSendType" SG_ 304 HMICDCSet 0;
BA_ "GenSigStartValue" SG_ 304 HMICDCSet 2;
BA_ "GenSigSendType" SG_ 448 HMIRapidHeatgUpSet 0;
BA_ "GenSigSendType" SG_ 448 HMIRapidTDrpSet 0;
BA_ "GenSigSendType" SG_ 432 HMIToVMMSetSetting1 0;
BA_ "GenSigStartValue" SG_ 432 HMIToVMMSetSetting1 7;
BA_ "GenSigSendType" SG_ 432 HMIToVMMSetSetting2 0;
BA_ "GenSigStartValue" SG_ 432 HMIToVMMSetSetting2 7;
BA_ "GenSigSendType" SG_ 432 HMIToVMMSetSetting3 0;
BA_ "GenSigStartValue" SG_ 432 HMIToVMMSetSetting3 7;
BA_ "GenSigSendType" SG_ 432 HMIToVMMSetSetting4 0;
BA_ "GenSigStartValue" SG_ 432 HMIToVMMSetSetting4 7;
BA_ "GenSigSendType" SG_ 432 HMIToVMMSetSetting5 0;
BA_ "GenSigStartValue" SG_ 432 HMIToVMMSetSetting5 7;
BA_ "GenSigSendType" SG_ 432 HMIToVMMSetSetting6 0;
BA_ "GenSigStartValue" SG_ 432 HMIToVMMSetSetting6 7;
BA_ "GenSigSendType" SG_ 432 HMIToVMMSetSetting7 0;
BA_ "GenSigStartValue" SG_ 432 HMIToVMMSetSetting7 7;
BA_ "GenSigSendType" SG_ 432 HMIToVMMSetSetting8 0;
BA_ "GenSigStartValue" SG_ 432 HMIToVMMSetSetting8 7;
BA_ "GenSigSendType" SG_ 448 HmiAirDistbnRow1 0;
BA_ "GenSigSendType" SG_ 448 HmiAirDistbnRow2 0;
BA_ "GenSigSendType" SG_ 448 HmiAutoRow1 0;
BA_ "GenSigSendType" SG_ 448 HmiAutoRow2 0;
BA_ "GenSigSendType" SG_ 432 HmiCarLocatorSetReq 0;
BA_ "GenSigStartValue" SG_ 432 HmiCarLocatorSetReq 1;
BA_ "GenSigSendType" SG_ 448 HmiCbnOverHeatPrevnReq 0;
BA_ "GenSigSendType" SG_ 448 HmiClimaRow1Pwr 0;
BA_ "GenSigSendType" SG_ 448 HmiClimaRow2Pwr 0;
BA_ "GenSigSendType" SG_ 448 HmiClimaRow3Pwr 0;
BA_ "GenSigSendType" SG_ 448 HmiCmptmtTSpForRowFirstLe 0;
BA_ "GenSigStartValue" SG_ 448 HmiCmptmtTSpForRowFirstLe 14;
BA_ "GenSigSendType" SG_ 448 HmiCmptmtTSpForRowFirstRi 0;
BA_ "GenSigStartValue" SG_ 448 HmiCmptmtTSpForRowFirstRi 14;
BA_ "GenSigSendType" SG_ 448 HmiCmptmtTSpForRowSecLe 0;
BA_ "GenSigStartValue" SG_ 448 HmiCmptmtTSpForRowSecLe 14;
BA_ "GenSigSendType" SG_ 448 HmiCmptmtTSpForRowSecRi 0;
BA_ "GenSigStartValue" SG_ 448 HmiCmptmtTSpForRowSecRi 14;
BA_ "GenSigSendType" SG_ 448 HmiCmptmtTSpSpclForRowFirstLe 0;
BA_ "GenSigSendType" SG_ 448 HmiCmptmtTSpSpclForRowFirstRi 0;
BA_ "GenSigSendType" SG_ 448 HmiCmptmtTSpSpclForRowSecLe 0;
BA_ "GenSigSendType" SG_ 448 HmiCmptmtTSpSpclForRowSecRi 0;
BA_ "GenSigSendType" SG_ 448 HmiEcoClimaReq 0;
BA_ "GenSigSendType" SG_ 448 HmiElecAirAdpvReqDrvrAdpv 0;
BA_ "GenSigSendType" SG_ 448 HmiElecAirAdpvReqPassAdpv 0;
BA_ "GenSigSendType" SG_ 448 HmiElecAirDirCrtlReqDrvrLePosX 0;
BA_ "GenSigSendType" SG_ 448 HmiElecAirDirCrtlReqDrvrLePosY 0;
BA_ "GenSigSendType" SG_ 448 HmiElecAirDirCrtlReqDrvrRiPosX 0;
BA_ "GenSigSendType" SG_ 448 HmiElecAirDirCrtlReqDrvrRiPosY 0;
BA_ "GenSigSendType" SG_ 448 HmiElecAirDirCrtlReqPassLePosX 0;
BA_ "GenSigSendType" SG_ 448 HmiElecAirDirCrtlReqPassLePosY 0;
BA_ "GenSigSendType" SG_ 448 HmiElecAirDirCrtlReqPassRiPosX 0;
BA_ "GenSigSendType" SG_ 448 HmiElecAirDirCrtlReqPassRiPosY 0;
BA_ "GenSigSendType" SG_ 448 HmiElecAirDirModReqDrvrMod 0;
BA_ "GenSigSendType" SG_ 448 HmiElecAirDirModReqPassMod 0;
BA_ "GenSigSendType" SG_ 448 HmiElecAirFrntSwtReqHmiElecAirDrvrLeSwtReq 0;
BA_ "GenSigSendType" SG_ 448 HmiElecAirFrntSwtReqHmiElecAirDrvrRiSwtReq 0;
BA_ "GenSigSendType" SG_ 448 HmiElecAirFrntSwtReqHmiElecAirPassLeSwtReq 0;
BA_ "GenSigSendType" SG_ 448 HmiElecAirFrntSwtReqHmiElecAirPassRiSwtReq 0;
BA_ "GenSigSendType" SG_ 448 HmiElecAirSwngReqDrvrLeRiSwng 0;
BA_ "GenSigSendType" SG_ 448 HmiElecAirSwngReqDrvrUpOnSwng 0;
BA_ "GenSigSendType" SG_ 448 HmiElecAirSwngReqPassLeRiSwng 0;
BA_ "GenSigSendType" SG_ 448 HmiElecAirSwngReqPassUpOnSwng 0;
BA_ "GenSigSendType" SG_ 448 HmiFanLvlRow1 0;
BA_ "GenSigSendType" SG_ 448 HmiFanLvlRow2 0;
BA_ "GenSigSendType" SG_ 448 HmiFragraCh 0;
BA_ "GenSigSendType" SG_ 448 HmiFragraLvl 0;
BA_ "GenSigSendType" SG_ 448 HmiHvacRecircCmd 0;
BA_ "GenSigSendType" SG_ 448 HmiMaxAC 0;
BA_ "GenSigSendType" SG_ 448 HmiMaxDefrst 0;
BA_ "GenSigSendType" SG_ 432 HmiPM25PopUpResp 0;
BA_ "GenSigSendType" SG_ 448 HmiSeatHeatAutStrtDrvr 0;
BA_ "GenSigSendType" SG_ 448 HmiSeatHeatAutStrtPass 0;
BA_ "GenSigSendType" SG_ 432 HmiSeatHeatAutStrtRowSecLe 0;
BA_ "GenSigSendType" SG_ 432 HmiSeatHeatAutStrtRowSecRi 0;
BA_ "GenSigSendType" SG_ 432 HmiSeatHeatAutStrtRowThrdLe 0;
BA_ "GenSigSendType" SG_ 432 HmiSeatHeatAutStrtRowThrdRi 0;
BA_ "GenSigSendType" SG_ 448 HmiSeatHeatLvlDrvr 0;
BA_ "GenSigStartValue" SG_ 448 HmiSeatHeatLvlDrvr 7;
BA_ "GenSigSendType" SG_ 448 HmiSeatHeatLvlPass 0;
BA_ "GenSigStartValue" SG_ 448 HmiSeatHeatLvlPass 7;
BA_ "GenSigSendType" SG_ 304 HmiSeatHeatgForRowSecLe 0;
BA_ "GenSigStartValue" SG_ 304 HmiSeatHeatgForRowSecLe 7;
BA_ "GenSigSendType" SG_ 304 HmiSeatHeatgForRowSecRi 0;
BA_ "GenSigStartValue" SG_ 304 HmiSeatHeatgForRowSecRi 7;
BA_ "GenSigSendType" SG_ 304 HmiSeatHeatgForRowThrdLe 0;
BA_ "GenSigStartValue" SG_ 304 HmiSeatHeatgForRowThrdLe 7;
BA_ "GenSigSendType" SG_ 304 HmiSeatHeatgForRowThrdRi 0;
BA_ "GenSigStartValue" SG_ 304 HmiSeatHeatgForRowThrdRi 7;
BA_ "GenSigSendType" SG_ 448 HmiSeatVentAutStrtDrvr 0;
BA_ "GenSigSendType" SG_ 448 HmiSeatVentAutStrtPass 0;
BA_ "GenSigSendType" SG_ 432 HmiSeatVentAutStrtRowSecLe 0;
BA_ "GenSigSendType" SG_ 432 HmiSeatVentAutStrtRowSecRi 0;
BA_ "GenSigSendType" SG_ 448 HmiSeatVentLvlDrvr 0;
BA_ "GenSigStartValue" SG_ 448 HmiSeatVentLvlDrvr 7;
BA_ "GenSigSendType" SG_ 448 HmiSeatVentLvlPass 0;
BA_ "GenSigStartValue" SG_ 448 HmiSeatVentLvlPass 7;
BA_ "GenSigSendType" SG_ 304 HmiSeatVentnForRowSecLe 0;
BA_ "GenSigStartValue" SG_ 304 HmiSeatVentnForRowSecLe 7;
BA_ "GenSigSendType" SG_ 304 HmiSeatVentnForRowSecRi 0;
BA_ "GenSigStartValue" SG_ 304 HmiSeatVentnForRowSecRi 7;
BA_ "GenSigSendType" SG_ 304 HmiSeatVentnForRowThrdLe 0;
BA_ "GenSigStartValue" SG_ 304 HmiSeatVentnForRowThrdLe 7;
BA_ "GenSigSendType" SG_ 304 HmiSeatVentnForRowThrdRi 0;
BA_ "GenSigStartValue" SG_ 304 HmiSeatVentnForRowThrdRi 7;
BA_ "GenSigSendType" SG_ 448 HmiTSyncn 0;
BA_ "GenSigSendType" SG_ 304 ImobVehRemReqAndRespImobVehDataRemReq0 0;
BA_ "GenSigSendType" SG_ 304 ImobVehRemReqAndRespImobVehDataRemReq1 0;
BA_ "GenSigSendType" SG_ 304 ImobVehRemReqAndRespImobVehDataRemReq2 0;
BA_ "GenSigSendType" SG_ 304 ImobVehRemReqAndRespImobVehDataRemReq3 0;
BA_ "GenSigSendType" SG_ 304 ImobVehRemReqAndRespImobVehDataRemReq4 0;
BA_ "GenSigSendType" SG_ 304 ImobVehRemReqAndRespImobVehRemReqCmd 0;
BA_ "GenSigSendType" SG_ 304 ImobVehRemReqAndRespImobVehRemTmrOrSpdLim 0;
BA_ "GenSigSendType" SG_ 304 IntrBriLvlCtrlSts 0;
BA_ "GenSigSendType" SG_ 448 IntrMirrAntiGlareSwt 0;
BA_ "GenSigSendType" SG_ 432 LDACSoftBtnSwtSt 0;
BA_ "GenSigSendType" SG_ 432 LDACUsgModReq 0;
BA_ "GenSigSendType" SG_ 432 LaneChgAsscPrjSwt 0;
BA_ "GenSigSendType" SG_ 432 LegRestRotAdjmtRowSecLe 0;
BA_ "GenSigSendType" SG_ 432 LegRestRotAdjmtRowSecRi 0;
BA_ "GenSigSendType" SG_ 432 LenAdjmtRowSecLe 0;
BA_ "GenSigSendType" SG_ 432 LenAdjmtRowSecRi 0;
BA_ "GenSigSendType" SG_ 432 LenAdjmtRowThrdLe 0;
BA_ "GenSigSendType" SG_ 432 LenAdjmtRowThrdRi 0;
BA_ "GenSigSendType" SG_ 448 LiHomeSafeReq 0;
BA_ "GenSigSendType" SG_ 432 LockgFbSoundReq 0;
BA_ "GenSigSendType" SG_ 448 LockgPrsnlReqFromHmi 0;
BA_ "GenSigSendType" SG_ 304 LowrReAxle 0;
BA_ "GenSigSendType" SG_ 432 LumHeiAdjmtSecRowLe 0;
BA_ "GenSigSendType" SG_ 432 LumHeiAdjmtSecRowRi 0;
BA_ "GenSigSendType" SG_ 432 LumLenAdjmtSecRowLe 0;
BA_ "GenSigSendType" SG_ 432 LumLenAdjmtSecRowRi 0;
BA_ "GenSigSendType" SG_ 304 MobDevRCVReq1Chks 0;
BA_ "GenSigSendType" SG_ 304 MobDevRCVReq1Cntr 0;
BA_ "GenSigSendType" SG_ 304 MobDevRCVReq1MobDevSts 0;
BA_ "GenSigSendType" SG_ 304 MobDevRCVReq1RCVCtrl 0;
BA_ "GenSigSendType" SG_ 304 MobDevRCVReq1Steertrim 0;
BA_ "GenSigSendType" SG_ 448 NextRoadCongestionLen 0;
BA_ "GenSigSendType" SG_ 448 NextRoadCongestionPassTi 0;
BA_ "GenSigSendType" SG_ 448 NextRoadcongestionLvl 0;
BA_ "GenSigSendType" SG_ 432 ParkGearUnlckHmiReq 0;
BA_ "GenSigStartValue" SG_ 432 ParkGearUnlckHmiReq 2;
BA_ "GenSigSendType" SG_ 304 PasAcsInHmiReq 0;
BA_ "GenSigSendType" SG_ 304 PasAcsOutHmiReq 0;
BA_ "GenSigSendType" SG_ 432 PasAlrmDeactvnReq 0;
BA_ "GenSigSendType" SG_ 432 PassSeatAdpvLumSetg 0;
BA_ "GenSigSendType" SG_ 432 PassSeatAdpvSideSpprtSetg 0;
BA_ "GenSigSendType" SG_ 448 PassSeatFoldRaiseReq 0;
BA_ "GenSigSendType" SG_ 432 PassSeatFootRstAdjmt 0;
BA_ "GenSigSendType" SG_ 432 PassSeatFootRstTargPosPerc 0;
BA_ "GenSigStartValue" SG_ 432 PassSeatFootRstTargPosPerc 127;
BA_ "GenSigSendType" SG_ 432 PassSeatTarPosnCmdReqSeatBackrTargPosAg 0;
BA_ "GenSigSendType" SG_ 432 PassSeatTarPosnCmdReqSeatFrntHeiTargPosPerc 0;
BA_ "GenSigSendType" SG_ 432 PassSeatTarPosnCmdReqSeatHeiTargPosPerc 0;
BA_ "GenSigSendType" SG_ 432 PassSeatTarPosnCmdReqSeatLenTargPosPerc 0;
BA_ "GenSigSendType" SG_ 432 PassSeatTarPosnCmdReqSeatPosFrntExtPerc 0;
BA_ "GenSigSendType" SG_ 432 PassSeatTarPosnCmdReqTarPosnCmd 0;
BA_ "GenSigSendType" SG_ 432 PedRmnSwt 0;
BA_ "GenSigSendType" SG_ 432 PrkgCmftModTiCtrl 0;
BA_ "GenSigSendType" SG_ 432 PwrTonneauCoverHmiReqRadar 0;
BA_ "GenSigSendType" SG_ 432 RFDRestrictsts 0;
BA_ "GenSigSendType" SG_ 304 RePosnLiFolwDayTiRunngLiOnOff 0;
BA_ "GenSigSendType" SG_ 304 ReSunCurtOpenPosnReq 0;
BA_ "GenSigSendType" SG_ 85 RemACChrgLidTelmReq 1;
BA_ "GenSigSendType" SG_ 85 RemChkTInVeh 1;
BA_ "GenSigSendType" SG_ 85 RemDCChrgLidTelmReq 1;
BA_ "GenSigSendType" SG_ 85 RemStrtExtnTiReq 1;
BA_ "GenSigSendType" SG_ 85 RemStrtHvCtrlReqErsCmd 1;
BA_ "GenSigSendType" SG_ 85 RemStrtHvCtrlReqErsRunTime 1;
BA_ "GenSigSendType" SG_ 85 RemVentReq 1;
BA_ "GenSigSendType" SG_ 85 RemsSetDchaTarVal 1;
BA_ "GenSigSendType" SG_ 85 ReqFragLvlTelm 1;
BA_ "GenSigSendType" SG_ 304 RoofDispFoldSts 0;
BA_ "GenSigSendType" SG_ 304 RoofDispSldgSts 0;
BA_ "GenSigSendType" SG_ 304 RowSecRiSeatZeroGrvyChdLockSwt 0;
BA_ "GenSigSendType" SG_ 448 SeatCushTiltAdjmtRowFirstDrvr 0;
BA_ "GenSigSendType" SG_ 448 SeatCushTiltAdjmtRowFirstPass 0;
BA_ "GenSigSendType" SG_ 432 SeatFoldRaiseReqRowThrdLe 0;
BA_ "GenSigSendType" SG_ 432 SeatFoldRaiseReqRowThrdRi 0;
BA_ "GenSigSendType" SG_ 85 SeatHeatDurgClimaEnadFromTelm 1;
BA_ "GenSigSendType" SG_ 448 SeatHeiAdjmtRowFirstDrvr 0;
BA_ "GenSigSendType" SG_ 448 SeatHeiAdjmtRowFirstPass 0;
BA_ "GenSigSendType" SG_ 448 SeatLenAdjmtRowFirstDrvr 0;
BA_ "GenSigSendType" SG_ 448 SeatLenAdjmtRowFirstPass 0;
BA_ "GenSigSendType" SG_ 432 SeatRowSecLeRotateAdjmt 0;
BA_ "GenSigStartValue" SG_ 432 SeatRowSecLeRotateAdjmt -128;
BA_ "GenSigSendType" SG_ 432 SeatRowSecRiRotateAdjmt 0;
BA_ "GenSigStartValue" SG_ 432 SeatRowSecRiRotateAdjmt -128;
BA_ "GenSigSendType" SG_ 432 SecRowLeCmftSet 0;
BA_ "GenSigSendType" SG_ 432 SecRowLeSeatDispMassgFctMassgInten 0;
BA_ "GenSigSendType" SG_ 432 SecRowLeSeatDispMassgFctMassgProg 0;
BA_ "GenSigSendType" SG_ 432 SecRowLeSeatDispMassgFctOnOffl2 0;
BA_ "GenSigStartValue" SG_ 432 SecRowLeSeatDispMassgFctOnOffl2 2;
BA_ "GenSigSendType" SG_ 432 SecRowRiCmftSet 0;
BA_ "GenSigSendType" SG_ 432 SecRowRiSeatDispMassgFctMassgInten 0;
BA_ "GenSigSendType" SG_ 432 SecRowRiSeatDispMassgFctMassgProg 0;
BA_ "GenSigSendType" SG_ 432 SecRowRiSeatDispMassgFctOnOffl2 0;
BA_ "GenSigStartValue" SG_ 432 SecRowRiSeatDispMassgFctOnOffl2 2;
BA_ "GenSigSendType" SG_ 448 SetTiAndDateDateOrTi 0;
BA_ "GenSigSendType" SG_ 448 SetTiAndDateDay 0;
BA_ "GenSigStartValue" SG_ 448 SetTiAndDateDay 1;
BA_ "GenSigSendType" SG_ 448 SetTiAndDateHour 0;
BA_ "GenSigSendType" SG_ 448 SetTiAndDateMinute 0;
BA_ "GenSigSendType" SG_ 448 SetTiAndDateMonth 0;
BA_ "GenSigStartValue" SG_ 448 SetTiAndDateMonth 1;
BA_ "GenSigSendType" SG_ 448 SetTiAndDateSecond 0;
BA_ "GenSigSendType" SG_ 448 SetTiAndDateYear 0;
BA_ "GenSigSendType" SG_ 85 SiteOfcommCharn 1;
BA_ "GenSigSendType" SG_ 432 SngDoorOrFourDoorSelectReq 0;
BA_ "GenSigSendType" SG_ 85 SocInFoOfCommChargn 1;
BA_ "GenSigSendType" SG_ 85 SocOfCommChargn 1;
BA_ "GenSigDataID" SG_ 432 SoftLiBtnSwtSetReqChks "0x2140";
BA_ "GenSigFuncType" SG_ 432 SoftLiBtnSwtSetReqChks 15;
BA_ "GenSigSendType" SG_ 432 SoftLiBtnSwtSetReqChks 0;
BA_ "GenSigFuncType" SG_ 432 SoftLiBtnSwtSetReqCntr 16;
BA_ "GenSigSendType" SG_ 432 SoftLiBtnSwtSetReqCntr 0;
BA_ "GenSigSendType" SG_ 432 SoftLiBtnSwtSetReqLiExtFctReq1 0;
BA_ "GenSigSendType" SG_ 448 SpeechExtnSts 0;
BA_ "GenSigSendType" SG_ 432 SteerAdjSwtBackSts 0;
BA_ "GenSigSendType" SG_ 432 SteerAdjSwtDwnSts 0;
BA_ "GenSigSendType" SG_ 432 SteerAdjSwtFwdSts 0;
BA_ "GenSigSendType" SG_ 432 SteerAdjSwtUpSts 0;
BA_ "GenSigSendType" SG_ 448 SteerTarPosnCmdReqSteerWhlPosnAng 0;
BA_ "GenSigStartValue" SG_ 448 SteerTarPosnCmdReqSteerWhlPosnAng 2048;
BA_ "GenSigSendType" SG_ 448 SteerTarPosnCmdReqSteerWhlPosnX 0;
BA_ "GenSigStartValue" SG_ 448 SteerTarPosnCmdReqSteerWhlPosnX 2048;
BA_ "GenSigSendType" SG_ 448 SteerTarPosnCmdReqTarPosnCmd 0;
BA_ "GenSigSendType" SG_ 85 SteerWhlHeatgDurgClimaEnadFromTelm 1;
BA_ "GenSigSendType" SG_ 432 SunCurtOpenPosnReq 0;
BA_ "GenSigSendType" SG_ 85 SunRoofAndCurtCmdTelm 1;
BA_ "GenSigSendType" SG_ 432 SunRoofOpenPosnReq 0;
BA_ "GenSigSendType" SG_ 432 SunRoofTiltReq 0;
BA_ "GenSigSendType" SG_ 85 TankFlapTelmLockgReq 1;
BA_ "GenSigSendType" SG_ 304 TechnologyLiMusicCorrlnSwt 0;
BA_ "GenSigSendType" SG_ 85 TelmBookSteerWhlHeatClimalReq 1;
BA_ "GenSigSendType" SG_ 85 TelmFctReq 1;
BA_ "GenSigSendType" SG_ 432 ThrdRowLeSeatDispMassgFctMassgInten 0;
BA_ "GenSigSendType" SG_ 432 ThrdRowLeSeatDispMassgFctMassgProg 0;
BA_ "GenSigSendType" SG_ 432 ThrdRowLeSeatDispMassgFctOnOffl2 0;
BA_ "GenSigStartValue" SG_ 432 ThrdRowLeSeatDispMassgFctOnOffl2 2;
BA_ "GenSigSendType" SG_ 432 ThrdRowRiSeatDispMassgFctMassgInten 0;
BA_ "GenSigSendType" SG_ 432 ThrdRowRiSeatDispMassgFctMassgProg 0;
BA_ "GenSigSendType" SG_ 432 ThrdRowRiSeatDispMassgFctOnOffl2 0;
BA_ "GenSigStartValue" SG_ 432 ThrdRowRiSeatDispMassgFctOnOffl2 2;
BA_ "GenSigSendType" SG_ 448 TiAndDateGNSSDataValid 0;
BA_ "GenSigSendType" SG_ 448 TiAndDateGNSSDay 0;
BA_ "GenSigStartValue" SG_ 448 TiAndDateGNSSDay 1;
BA_ "GenSigSendType" SG_ 448 TiAndDateGNSSHr1 0;
BA_ "GenSigSendType" SG_ 448 TiAndDateGNSSMins1 0;
BA_ "GenSigSendType" SG_ 448 TiAndDateGNSSMth1 0;
BA_ "GenSigStartValue" SG_ 448 TiAndDateGNSSMth1 1;
BA_ "GenSigSendType" SG_ 448 TiAndDateGNSSSec1 0;
BA_ "GenSigSendType" SG_ 448 TiAndDateGNSSYr1 0;
BA_ "GenSigSendType" SG_ 432 TiToDestNavRouteDay2 0;
BA_ "GenSigSendType" SG_ 432 TiToDestNavRouteHr1 0;
BA_ "GenSigSendType" SG_ 432 TiToDestNavRouteMins1 0;
BA_ "GenSigSendType" SG_ 304 TopPercTrFromHmi 0;
BA_ "GenSigStartValue" SG_ 304 TopPercTrFromHmi 101;
BA_ "GenSigSendType" SG_ 432 TrFootMovmtDetnSwt 0;
BA_ "GenSigSendType" SG_ 432 TrLiSwt 0;
BA_ "GenSigSendType" SG_ 432 TrlrLampChkAutReq 0;
BA_ "GenSigSendType" SG_ 432 UsgModChgReqFromUWB 0;
BA_ "GenSigSendType" SG_ 432 VehWidthPrjSwt 0;
BA_ "GenSigSendType" SG_ 304 VoiceCtrlEasyLoad 0;
BA_ "GenSigSendType" SG_ 432 VoiceRemoteCtrlRquestSPKey 0;
BA_ "GenSigSendType" SG_ 448 VoiceVMMPowerModeSet 0;
BA_ "GenSigSendType" SG_ 432 WarnLvlMsg 0;
BA_ "GenSigSendType" SG_ 432 WelcomeGoodbyeModeReq 0;
BA_ "GenSigSendType" SG_ 448 WelcomeGoodbyeSetReq 0;
BA_ "GenSigSendType" SG_ 448 WelcomeLiOpenReq 0;
BA_ "GenSigSendType" SG_ 432 WiprFrntSrvModReq 0;
BA_ "GenSigSendType" SG_ 432 WiprReSrvModReq 0;

VAL_ 432 ActvnOfGiveWay 0 "OnOff1_Off" 1 "OnOff1_On";
VAL_ 432 ActvnOfTakeOverMic 0 "OffOnErrInvalid_Off" 1 "OffOnErrInvalid_On" 2 "OffOnErrInvalid_Err" 3 "OffOnErrInvalid_Invalid";
VAL_ 432 ActvReSplrHldSwt 0 "OnOff1_Off" 1 "OnOff1_On";
VAL_ 432 AFSSetReq 0 "OnOff1_Off" 1 "OnOff1_On";
VAL_ 432 AllSeatResetReq 0 "Boolean_FALSE" 1 "Boolean_TRUE";
VAL_ 432 ApproachLiSetReq 0 "ApproachLiSetReq_Off" 1 "ApproachLiSetReq_ONStatic" 2 "ApproachLiSetReq_ONDynamic";
VAL_ 432 ApproachOpenTrOnOff 0 "OnOff2_On" 1 "OnOff2_Off";
VAL_ 432 AutHiBeamSwt 0 "OnOff1_Off" 1 "OnOff1_On";
VAL_ 432 BackrestAdjmtRowSecLe 0 "SwtHozlSts1_Idle" 1 "SwtHozlSts1_Fwd" 2 "SwtHozlSts1_Backw";
VAL_ 432 BackrestAdjmtRowSecRi 0 "SwtHozlSts1_Idle" 1 "SwtHozlSts1_Fwd" 2 "SwtHozlSts1_Backw";
VAL_ 432 BackrestAdjmtRowThrdLe 0 "SwtHozlSts1_Idle" 1 "SwtHozlSts1_Fwd" 2 "SwtHozlSts1_Backw";
VAL_ 432 BackrestAdjmtRowThrdRi 0 "SwtHozlSts1_Idle" 1 "SwtHozlSts1_Fwd" 2 "SwtHozlSts1_Backw";
VAL_ 432 BendingLiSetReq 0 "OnOff1_Off" 1 "OnOff1_On";
VAL_ 432 CallSts 0 "CallSts_Inactive" 1 "CallSts_Active";
VAL_ 432 CarFindrHornLiSetActv 0 "CarFindrHornLiSetActv_HornLiSetActv" 1 "CarFindrHornLiSetActv_HornSetActv" 2 "CarFindrHornLiSetActv_LiSetActv" 3 "CarFindrHornLiSetActv_Reserved";
VAL_ 432 CarpetLiSwtReq 0 "OnOff1_Off" 1 "OnOff1_On";
VAL_ 432 CarpetLiTiReq 0 "ModeReq_Mode1" 1 "ModeReq_Mode2" 2 "ModeReq_Mode3" 3 "ModeReq_Mode4" 4 "ModeReq_Mode5" 5 "ModeReq_Mode6";
VAL_ 432 CenLockHmiReq 0 "LockgCenReq2_Idle" 1 "LockgCenReq2_Unlck" 2 "LockgCenReq2_Lock";
VAL_ 432 ChrgLidCtrlHmiReqACandDCchargelid 0 "OnOffNoReq_NoReq" 1 "OnOffNoReq_On" 2 "OnOffNoReq_Off";
VAL_ 432 ChrgLidCtrlHmiReqACchargelid 0 "OnOffNoReq_NoReq" 1 "OnOffNoReq_On" 2 "OnOffNoReq_Off";
VAL_ 432 ChrgLidCtrlHmiReqDCchargelid 0 "OnOffNoReq_NoReq" 1 "OnOffNoReq_On" 2 "OnOffNoReq_Off";
VAL_ 432 ChrgnLiSwt 0 "OnOffNoReq_NoReq" 1 "OnOffNoReq_On" 2 "OnOffNoReq_Off";
VAL_ 432 ClsAutEna 0 "EnableDisableCoding_Disabled" 1 "EnableDisableCoding_Enabled";
VAL_ 432 ComityPedLiSwt 0 "OnOff1_Off" 1 "OnOff1_On";
VAL_ 432 DrvrSeatAdpvLumSetg 0 "OnOff1_Off" 1 "OnOff1_On";
VAL_ 432 DrvrSeatAdpvSideSpprtSetg 0 "Snvty1_NotInUse" 1 "Snvty1_LoSnvty" 2 "Snvty1_NormSnvty" 3 "Snvty1_HiSnvty";
VAL_ 432 EasyInOutFrntPassReq 0 "EasyInOut_Off" 1 "EasyInOut_IngressAndEgress" 2 "EasyInOut_EgressOnly" 3 "EasyInOut_Reserved";
VAL_ 432 FrnPosnLiFolwDayTiRunngLiOnOff 0 "OnOff1_Off" 1 "OnOff1_On";
VAL_ 432 FrntDstPrjSwt 0 "OnOff1_Off" 1 "OnOff1_On";
VAL_ 432 HmiCarLocatorSetReq 0 "OnOff1_Off" 1 "OnOff1_On";
VAL_ 432 HmiPM25PopUpResp 0 "HmiPM25PopUpResp_Idle" 1 "HmiPM25PopUpResp_Confirm" 2 "HmiPM25PopUpResp_Cancel" 3 "HmiPM25PopUpResp_Timeout";
VAL_ 432 HmiSeatHeatAutStrtRowSecLe 0 "OnOff1_Off" 1 "OnOff1_On";
VAL_ 432 HmiSeatHeatAutStrtRowSecRi 0 "OnOff1_Off" 1 "OnOff1_On";
VAL_ 432 HmiSeatHeatAutStrtRowThrdLe 0 "OnOff1_Off" 1 "OnOff1_On";
VAL_ 432 HmiSeatHeatAutStrtRowThrdRi 0 "OnOff1_Off" 1 "OnOff1_On";
VAL_ 432 HmiSeatVentAutStrtRowSecLe 0 "OnOff1_Off" 1 "OnOff1_On";
VAL_ 432 HmiSeatVentAutStrtRowSecRi 0 "OnOff1_Off" 1 "OnOff1_On";
VAL_ 432 HMIToVMMSetSetting1 0 "HMIsetting_Off" 1 "HMIsetting_Level1" 2 "HMIsetting_Level2" 3 "HMIsetting_Level3" 4 "HMIsetting_Level4" 5 "HMIsetting_Level5" 6 "HMIsetting_Level6" 7 "HMIsetting_NoReq";
VAL_ 432 HMIToVMMSetSetting2 0 "HMIsetting_Off" 1 "HMIsetting_Level1" 2 "HMIsetting_Level2" 3 "HMIsetting_Level3" 4 "HMIsetting_Level4" 5 "HMIsetting_Level5" 6 "HMIsetting_Level6" 7 "HMIsetting_NoReq";
VAL_ 432 HMIToVMMSetSetting3 0 "HMIsetting_Off" 1 "HMIsetting_Level1" 2 "HMIsetting_Level2" 3 "HMIsetting_Level3" 4 "HMIsetting_Level4" 5 "HMIsetting_Level5" 6 "HMIsetting_Level6" 7 "HMIsetting_NoReq";
VAL_ 432 HMIToVMMSetSetting4 0 "HMIsetting_Off" 1 "HMIsetting_Level1" 2 "HMIsetting_Level2" 3 "HMIsetting_Level3" 4 "HMIsetting_Level4" 5 "HMIsetting_Level5" 6 "HMIsetting_Level6" 7 "HMIsetting_NoReq";
VAL_ 432 HMIToVMMSetSetting5 0 "HMIsetting_Off" 1 "HMIsetting_Level1" 2 "HMIsetting_Level2" 3 "HMIsetting_Level3" 4 "HMIsetting_Level4" 5 "HMIsetting_Level5" 6 "HMIsetting_Level6" 7 "HMIsetting_NoReq";
VAL_ 432 HMIToVMMSetSetting6 0 "HMIsetting_Off" 1 "HMIsetting_Level1" 2 "HMIsetting_Level2" 3 "HMIsetting_Level3" 4 "HMIsetting_Level4" 5 "HMIsetting_Level5" 6 "HMIsetting_Level6" 7 "HMIsetting_NoReq";
VAL_ 432 HMIToVMMSetSetting7 0 "HMIsetting_Off" 1 "HMIsetting_Level1" 2 "HMIsetting_Level2" 3 "HMIsetting_Level3" 4 "HMIsetting_Level4" 5 "HMIsetting_Level5" 6 "HMIsetting_Level6" 7 "HMIsetting_NoReq";
VAL_ 432 HMIToVMMSetSetting8 0 "HMIsetting_Off" 1 "HMIsetting_Level1" 2 "HMIsetting_Level2" 3 "HMIsetting_Level3" 4 "HMIsetting_Level4" 5 "HMIsetting_Level5" 6 "HMIsetting_Level6" 7 "HMIsetting_NoReq";
VAL_ 432 LaneChgAsscPrjSwt 0 "OnOff1_Off" 1 "OnOff1_On";
VAL_ 432 LDACSoftBtnSwtSt 0 "LDACSoftBtnSwtSt_Idle" 1 "LDACSoftBtnSwtSt_LDAC_Off" 2 "LDACSoftBtnSwtSt_LDAC_On" 3 "LDACSoftBtnSwtSt_Reserved";
VAL_ 432 LDACUsgModReq 0 "OnOff1_Off" 1 "OnOff1_On";
VAL_ 432 LegRestRotAdjmtRowSecLe 0 "SwtVertSts1_Idle" 1 "SwtVertSts1_Up" 2 "SwtVertSts1_Dwn";
VAL_ 432 LegRestRotAdjmtRowSecRi 0 "SwtVertSts1_Idle" 1 "SwtVertSts1_Up" 2 "SwtVertSts1_Dwn";
VAL_ 432 LenAdjmtRowSecLe 0 "SwtHozlSts1_Idle" 1 "SwtHozlSts1_Fwd" 2 "SwtHozlSts1_Backw";
VAL_ 432 LenAdjmtRowSecRi 0 "SwtHozlSts1_Idle" 1 "SwtHozlSts1_Fwd" 2 "SwtHozlSts1_Backw";
VAL_ 432 LenAdjmtRowThrdLe 0 "SwtHozlSts1_Idle" 1 "SwtHozlSts1_Fwd" 2 "SwtHozlSts1_Backw";
VAL_ 432 LenAdjmtRowThrdRi 0 "SwtHozlSts1_Idle" 1 "SwtHozlSts1_Fwd" 2 "SwtHozlSts1_Backw";
VAL_ 432 LockgFbSoundReq 0 "OnOff1_Off" 1 "OnOff1_On";
VAL_ 432 LumHeiAdjmtSecRowLe 0 "SwtVertSts1_Idle" 1 "SwtVertSts1_Up" 2 "SwtVertSts1_Dwn";
VAL_ 432 LumHeiAdjmtSecRowRi 0 "SwtVertSts1_Idle" 1 "SwtVertSts1_Up" 2 "SwtVertSts1_Dwn";
VAL_ 432 LumLenAdjmtSecRowLe 0 "SwtHozlSts1_Idle" 1 "SwtHozlSts1_Fwd" 2 "SwtHozlSts1_Backw";
VAL_ 432 LumLenAdjmtSecRowRi 0 "SwtHozlSts1_Idle" 1 "SwtHozlSts1_Fwd" 2 "SwtHozlSts1_Backw";
VAL_ 432 ParkGearUnlckHmiReq 0 "OnOffNoReq_NoReq" 1 "OnOffNoReq_On" 2 "OnOffNoReq_Off";
VAL_ 432 PasAlrmDeactvnReq 0 "OnOff1_Off" 1 "OnOff1_On";
VAL_ 432 PassSeatAdpvLumSetg 0 "OnOff1_Off" 1 "OnOff1_On";
VAL_ 432 PassSeatAdpvSideSpprtSetg 0 "Snvty1_NotInUse" 1 "Snvty1_LoSnvty" 2 "Snvty1_NormSnvty" 3 "Snvty1_HiSnvty";
VAL_ 432 PassSeatFootRstAdjmt 0 "SwtVertSts1_Idle" 1 "SwtVertSts1_Up" 2 "SwtVertSts1_Dwn";
VAL_ 432 PassSeatTarPosnCmdReqTarPosnCmd 0 "TarPosnCmd_Idle" 1 "TarPosnCmd_MoveReq" 2 "TarPosnCmd_StopReq" 3 "TarPosnCmd_MemPosnSet" 4 "TarPosnCmd_MemPosnClr";
VAL_ 432 PedRmnSwt 0 "OnOff1_Off" 1 "OnOff1_On";
VAL_ 432 PwrTonneauCoverHmiReqRadar 0 "DoorOpenerIdle" 1 "DoorOpenerOpen" 2 "DoorOpenerCls" 3 "DoorOpenerStop";
VAL_ 432 SeatFoldRaiseReqRowThrdLe 0 "SeatFoldRaiseReq_Idle" 1 "SeatFoldRaiseReq_Fold" 2 "SeatFoldRaiseReq_Raise" 3 "SeatFoldRaiseReq_Stop";
VAL_ 432 SeatFoldRaiseReqRowThrdRi 0 "SeatFoldRaiseReq_Idle" 1 "SeatFoldRaiseReq_Fold" 2 "SeatFoldRaiseReq_Raise" 3 "SeatFoldRaiseReq_Stop";
VAL_ 432 SecRowLeCmftSet 0 "CmftSet_NoReq" 1 "CmftSet_ComfortReq" 2 "CmftSet_ReturnReq";
VAL_ 432 SecRowLeSeatDispMassgFctMassgInten 0 "MassgIntenLvl_IntenLo" 1 "MassgIntenLvl_IntenNorm" 2 "MassgIntenLvl_IntenHi" 3 "MassgIntenLvl_Off";
VAL_ 432 SecRowLeSeatDispMassgFctMassgProg 0 "MassgProgTyp_Prog1" 1 "MassgProgTyp_Prog2" 2 "MassgProgTyp_Prog3" 3 "MassgProgTyp_Prog4" 4 "MassgProgTyp_Prog5" 5 "MassgProgTyp_Prog6" 6 "MassgProgTyp_Prog7" 7 "MassgProgTyp_Prog8";
VAL_ 432 SecRowLeSeatDispMassgFctOnOffl2 0 "OnOffl2_Off" 1 "OnOffl2_On" 2 "OnOffl2_Idle";
VAL_ 432 SecRowRiCmftSet 0 "CmftSet_NoReq" 1 "CmftSet_ComfortReq" 2 "CmftSet_ReturnReq";
VAL_ 432 SecRowRiSeatDispMassgFctMassgInten 0 "MassgIntenLvl_IntenLo" 1 "MassgIntenLvl_IntenNorm" 2 "MassgIntenLvl_IntenHi" 3 "MassgIntenLvl_Off";
VAL_ 432 SecRowRiSeatDispMassgFctMassgProg 0 "MassgProgTyp_Prog1" 1 "MassgProgTyp_Prog2" 2 "MassgProgTyp_Prog3" 3 "MassgProgTyp_Prog4" 4 "MassgProgTyp_Prog5" 5 "MassgProgTyp_Prog6" 6 "MassgProgTyp_Prog7" 7 "MassgProgTyp_Prog8";
VAL_ 432 SecRowRiSeatDispMassgFctOnOffl2 0 "OnOffl2_Off" 1 "OnOffl2_On" 2 "OnOffl2_Idle";
VAL_ 432 SngDoorOrFourDoorSelectReq 0 "UnlckKeylsCfg2_UnlckCen" 1 "UnlckKeylsCfg2_UnlckInd";
VAL_ 432 SoftLiBtnSwtSetReqLiExtFctReq1 0 "LiExtFctReq1_Off" 1 "LiExtFctReq1_Pos" 2 "LiExtFctReq1_Lo" 3 "LiExtFctReq1_AutLi";
VAL_ 432 SteerAdjSwtBackSts 0 "Boolean_FALSE" 1 "Boolean_TRUE";
VAL_ 432 SteerAdjSwtDwnSts 0 "Boolean_FALSE" 1 "Boolean_TRUE";
VAL_ 432 SteerAdjSwtFwdSts 0 "Boolean_FALSE" 1 "Boolean_TRUE";
VAL_ 432 SteerAdjSwtUpSts 0 "Boolean_FALSE" 1 "Boolean_TRUE";
VAL_ 432 SunCurtOpenPosnReq 0 "WinAndRoofAndCurtPosnTyp_PosnUkwn" 1 "WinAndRoofAndCurtPosnTyp_ClsFull" 2 "WinAndRoofAndCurtPosnTyp_PercOpen4" 3 "WinAndRoofAndCurtPosnTyp_PercOpen8" 4 "WinAndRoofAndCurtPosnTyp_PercOpen12" 5 "WinAndRoofAndCurtPosnTyp_PercOpen16" 6 "WinAndRoofAndCurtPosnTyp_PercOpen20" 7 "WinAndRoofAndCurtPosnTyp_PercOpen24" 8 "WinAndRoofAndCurtPosnTyp_PercOpen28" 9 "WinAndRoofAndCurtPosnTyp_PercOpen32" 10 "WinAndRoofAndCurtPosnTyp_PercOpen36" 11 "WinAndRoofAndCurtPosnTyp_PercOpen40" 12 "WinAndRoofAndCurtPosnTyp_PercOpen44" 13 "WinAndRoofAndCurtPosnTyp_PercOpen48" 14 "WinAndRoofAndCurtPosnTyp_PercOpen52" 15 "WinAndRoofAndCurtPosnTyp_PercOpen56" 16 "WinAndRoofAndCurtPosnTyp_PercOpen60" 17 "WinAndRoofAndCurtPosnTyp_PercOpen64" 18 "WinAndRoofAndCurtPosnTyp_PercOpen68" 19 "WinAndRoofAndCurtPosnTyp_PercOpen72" 20 "WinAndRoofAndCurtPosnTyp_PercOpen76" 21 "WinAndRoofAndCurtPosnTyp_PercOpen80" 22 "WinAndRoofAndCurtPosnTyp_PercOpen84" 23 "WinAndRoofAndCurtPosnTyp_PercOpen88" 24 "WinAndRoofAndCurtPosnTyp_PercOpen92" 25 "WinAndRoofAndCurtPosnTyp_PercOpen96" 26 "WinAndRoofAndCurtPosnTyp_OpenFull" 27 "WinAndRoofAndCurtPosnTyp_Resd1" 28 "WinAndRoofAndCurtPosnTyp_Resd2" 29 "WinAndRoofAndCurtPosnTyp_Resd3" 30 "WinAndRoofAndCurtPosnTyp_Resd4" 31 "WinAndRoofAndCurtPosnTyp_Movg";
VAL_ 432 SunRoofOpenPosnReq 0 "WinAndRoofAndCurtPosnTyp_PosnUkwn" 1 "WinAndRoofAndCurtPosnTyp_ClsFull" 2 "WinAndRoofAndCurtPosnTyp_PercOpen4" 3 "WinAndRoofAndCurtPosnTyp_PercOpen8" 4 "WinAndRoofAndCurtPosnTyp_PercOpen12" 5 "WinAndRoofAndCurtPosnTyp_PercOpen16" 6 "WinAndRoofAndCurtPosnTyp_PercOpen20" 7 "WinAndRoofAndCurtPosnTyp_PercOpen24" 8 "WinAndRoofAndCurtPosnTyp_PercOpen28" 9 "WinAndRoofAndCurtPosnTyp_PercOpen32" 10 "WinAndRoofAndCurtPosnTyp_PercOpen36" 11 "WinAndRoofAndCurtPosnTyp_PercOpen40" 12 "WinAndRoofAndCurtPosnTyp_PercOpen44" 13 "WinAndRoofAndCurtPosnTyp_PercOpen48" 14 "WinAndRoofAndCurtPosnTyp_PercOpen52" 15 "WinAndRoofAndCurtPosnTyp_PercOpen56" 16 "WinAndRoofAndCurtPosnTyp_PercOpen60" 17 "WinAndRoofAndCurtPosnTyp_PercOpen64" 18 "WinAndRoofAndCurtPosnTyp_PercOpen68" 19 "WinAndRoofAndCurtPosnTyp_PercOpen72" 20 "WinAndRoofAndCurtPosnTyp_PercOpen76" 21 "WinAndRoofAndCurtPosnTyp_PercOpen80" 22 "WinAndRoofAndCurtPosnTyp_PercOpen84" 23 "WinAndRoofAndCurtPosnTyp_PercOpen88" 24 "WinAndRoofAndCurtPosnTyp_PercOpen92" 25 "WinAndRoofAndCurtPosnTyp_PercOpen96" 26 "WinAndRoofAndCurtPosnTyp_OpenFull" 27 "WinAndRoofAndCurtPosnTyp_Resd1" 28 "WinAndRoofAndCurtPosnTyp_Resd2" 29 "WinAndRoofAndCurtPosnTyp_Resd3" 30 "WinAndRoofAndCurtPosnTyp_Resd4" 31 "WinAndRoofAndCurtPosnTyp_Movg";
VAL_ 432 SunRoofTiltReq 0 "OnOff1_Off" 1 "OnOff1_On";
VAL_ 432 ThrdRowLeSeatDispMassgFctMassgInten 0 "MassgIntenLvl_IntenLo" 1 "MassgIntenLvl_IntenNorm" 2 "MassgIntenLvl_IntenHi" 3 "MassgIntenLvl_Off";
VAL_ 432 ThrdRowLeSeatDispMassgFctMassgProg 0 "MassgProgTyp_Prog1" 1 "MassgProgTyp_Prog2" 2 "MassgProgTyp_Prog3" 3 "MassgProgTyp_Prog4" 4 "MassgProgTyp_Prog5" 5 "MassgProgTyp_Prog6" 6 "MassgProgTyp_Prog7" 7 "MassgProgTyp_Prog8";
VAL_ 432 ThrdRowLeSeatDispMassgFctOnOffl2 0 "OnOffl2_Off" 1 "OnOffl2_On" 2 "OnOffl2_Idle";
VAL_ 432 ThrdRowRiSeatDispMassgFctMassgInten 0 "MassgIntenLvl_IntenLo" 1 "MassgIntenLvl_IntenNorm" 2 "MassgIntenLvl_IntenHi" 3 "MassgIntenLvl_Off";
VAL_ 432 ThrdRowRiSeatDispMassgFctMassgProg 0 "MassgProgTyp_Prog1" 1 "MassgProgTyp_Prog2" 2 "MassgProgTyp_Prog3" 3 "MassgProgTyp_Prog4" 4 "MassgProgTyp_Prog5" 5 "MassgProgTyp_Prog6" 6 "MassgProgTyp_Prog7" 7 "MassgProgTyp_Prog8";
VAL_ 432 ThrdRowRiSeatDispMassgFctOnOffl2 0 "OnOffl2_Off" 1 "OnOffl2_On" 2 "OnOffl2_Idle";
VAL_ 432 TrFootMovmtDetnSwt 0 "OnOff1_Off" 1 "OnOff1_On";
VAL_ 432 TrLiSwt 0 "OnOffNoReq_NoReq" 1 "OnOffNoReq_On" 2 "OnOffNoReq_Off";
VAL_ 432 TrlrLampChkAutReq 0 "OnOff1_Off" 1 "OnOff1_On";
VAL_ 432 UsgModChgReqFromUWB 0 "ReqSts1_NotReqd" 1 "ReqSts1_Reqd";
VAL_ 432 VehWidthPrjSwt 0 "OnOff1_Off" 1 "OnOff1_On";
VAL_ 432 VoiceRemoteCtrlRquestSPKey 0 "OnOff1_Off" 1 "OnOff1_On";
VAL_ 432 WarnLvlMsg 0 "WarnLvlMsg_Off" 1 "WarnLvlMsg_Lv1" 2 "WarnLvlMsg_Lv2" 3 "WarnLvlMsg_Lv3" 4 "WarnLvlMsg_Lv4_1" 5 "WarnLvlMsg_Lv4_2" 6 "WarnLvlMsg_Lv4_3" 7 "WarnLvlMsg_Reserved";
VAL_ 432 WelcomeGoodbyeModeReq 0 "ModeReq_Mode1" 1 "ModeReq_Mode2" 2 "ModeReq_Mode3" 3 "ModeReq_Mode4" 4 "ModeReq_Mode5" 5 "ModeReq_Mode6";
VAL_ 432 WiprFrntSrvModReq 0 "NoActn" 1 "ActvtSrvPosn" 2 "DeActvtSrvPosn";
VAL_ 432 WiprReSrvModReq 0 "NoActn" 1 "ActvtSrvPosn" 2 "DeActvtSrvPosn";
VAL_ 448 ActvReSplrPrkgInteractionSwt 0 "OnOff1_Off" 1 "OnOff1_On";
VAL_ 448 AmbientLiEffectStatusBreathingEffectStatus 0 "OnOff1_Off" 1 "OnOff1_On";
VAL_ 448 AmbientLiEffectStatusTransitionEffectStatus 0 "OnOff1_Off" 1 "OnOff1_On";
VAL_ 448 AmbLiAll 0 "OnOff1_Off" 1 "OnOff1_On";
VAL_ 448 AmbLiClimateCorrlnReq 0 "OnOff1_Off" 1 "OnOff1_On";
VAL_ 448 AmbLiColorModReq 0 "AmbReq2_NoReq" 1 "AmbReq2_Orange" 2 "AmbReq2_Purple" 3 "AmbReq2_Yellow" 4 "AmbReq2_Blue" 5 "AmbReq2_Red";
VAL_ 448 AmbLiEnduranceMilgOpenReq 0 "OnOff1_Off" 1 "OnOff1_On";
VAL_ 448 AmbLiModExt 0 "AmbLiMod01_None" 1 "AmbLiMod01_CustomizedMode" 2 "AmbLiMod01_DriveMode" 3 "AmbLiMod01_MusicShowMode" 4 "AmbLiMod01_WeatherIndn" 5 "AmbLiMod01_ThemeMode" 6 "AmbLiMod01_TimeMode" 7 "AmbLiMod01_ColorStypeMode" 8 "AmbLiMod01_MultiColorMode" 9 "AmbLiMod01_ColorMode" 10 "AmbLiMod01_FlowMode" 11 "AmbLiMod01_ScrenLinkMod";
VAL_ 448 AmbLiMusicCorrlnReq 0 "OnOff1_Off" 1 "OnOff1_On";
VAL_ 448 AmbLiPhoneOpenReq 0 "OnOff1_Off" 1 "OnOff1_On";
VAL_ 448 AmbLiSpeechCorrlnReq 0 "OnOff1_Off" 1 "OnOff1_On";
VAL_ 448 AntithftRednReq 0 "OnOff1_Off" 1 "OnOff1_On";
VAL_ 448 BackRestAdjmtRowFirstDrvr 0 "SwtHozlSts1_Idle" 1 "SwtHozlSts1_Fwd" 2 "SwtHozlSts1_Backw";
VAL_ 448 BackRestAdjmtRowFirstPass 0 "SwtHozlSts1_Idle" 1 "SwtHozlSts1_Fwd" 2 "SwtHozlSts1_Backw";
VAL_ 448 CurrentRoadcongestionLvl 0 "Lvl30_NoLvl" 1 "Lvl30_LoLvl" 2 "Lvl30_MidLvl" 3 "Lvl30_HiLvl";
VAL_ 448 DrvModDispd 0 "Boolean_FALSE" 1 "Boolean_TRUE";
VAL_ 448 DrvrEntryLoReq 0 "NoYes1_No" 1 "NoYes1_Yes";
VAL_ 448 DrvrSeatTarPosnCmdReqTarPosnCmd 0 "TarPosnCmd_Idle" 1 "TarPosnCmd_MoveReq" 2 "TarPosnCmd_StopReq" 3 "TarPosnCmd_MemPosnSet" 4 "TarPosnCmd_MemPosnClr";
VAL_ 448 ExtrMirrFoldSetgMirrDrvr 0 "OnOff2_On" 1 "OnOff2_Off";
VAL_ 448 ExtrMirrFoldSetgMirrPass 0 "OnOff2_On" 1 "OnOff2_Off";
VAL_ 448 ExtrMirrTiltSetgMirrDrvr 0 "OnOff2_On" 1 "OnOff2_Off";
VAL_ 448 ExtrMirrTiltSetgMirrPass 0 "OnOff2_On" 1 "OnOff2_Off";
VAL_ 448 FrntTechLiInfoDispSetReq 0 "OnOff1_Off" 1 "OnOff1_On";
VAL_ 448 GoodbyeLiOpenReq 0 "OnOff1_Off" 1 "OnOff1_On";
VAL_ 448 HmiAirDistbnRow1 0 "HmiCmptmtAirDistbnFrnt_Flr" 1 "HmiCmptmtAirDistbnFrnt_Vent" 2 "HmiCmptmtAirDistbnFrnt_Defrst" 3 "HmiCmptmtAirDistbnFrnt_FlrDefrst" 4 "HmiCmptmtAirDistbnFrnt_FlrVent" 5 "HmiCmptmtAirDistbnFrnt_VentDefrst" 6 "HmiCmptmtAirDistbnFrnt_FlrVentDefrst" 7 "HmiCmptmtAirDistbnFrnt_Aut";
VAL_ 448 HmiAirDistbnRow2 0 "HmiCmptmtAirDistbnFrnt_Flr" 1 "HmiCmptmtAirDistbnFrnt_Vent" 2 "HmiCmptmtAirDistbnFrnt_Defrst" 3 "HmiCmptmtAirDistbnFrnt_FlrDefrst" 4 "HmiCmptmtAirDistbnFrnt_FlrVent" 5 "HmiCmptmtAirDistbnFrnt_VentDefrst" 6 "HmiCmptmtAirDistbnFrnt_FlrVentDefrst" 7 "HmiCmptmtAirDistbnFrnt_Aut";
VAL_ 448 HMIAutDemstSet 0 "OnOff1_Off" 1 "OnOff1_On";
VAL_ 448 HmiAutoRow1 0 "OnOff1_Off" 1 "OnOff1_On";
VAL_ 448 HmiAutoRow2 0 "OnOff1_Off" 1 "OnOff1_On";
VAL_ 448 HmiCbnOverHeatPrevnReq 0 "OnOffNoReq_NoReq" 1 "OnOffNoReq_On" 2 "OnOffNoReq_Off";
VAL_ 448 HmiClimaRow1Pwr 0 "OnOff1_Off" 1 "OnOff1_On";
VAL_ 448 HmiClimaRow2Pwr 0 "OnOff1_Off" 1 "OnOff1_On";
VAL_ 448 HmiClimaRow3Pwr 0 "OnOff1_Off" 1 "OnOff1_On";
VAL_ 448 HmiCmptmtTSpSpclForRowFirstLe 0 "HmiCmptmtTSpSpcl_Norm" 1 "HmiCmptmtTSpSpcl_Lo" 2 "HmiCmptmtTSpSpcl_Hi";
VAL_ 448 HmiCmptmtTSpSpclForRowFirstRi 0 "HmiCmptmtTSpSpcl_Norm" 1 "HmiCmptmtTSpSpcl_Lo" 2 "HmiCmptmtTSpSpcl_Hi";
VAL_ 448 HmiCmptmtTSpSpclForRowSecLe 0 "HmiCmptmtTSpSpcl_Norm" 1 "HmiCmptmtTSpSpcl_Lo" 2 "HmiCmptmtTSpSpcl_Hi";
VAL_ 448 HmiCmptmtTSpSpclForRowSecRi 0 "HmiCmptmtTSpSpcl_Norm" 1 "HmiCmptmtTSpSpcl_Lo" 2 "HmiCmptmtTSpSpcl_Hi";
VAL_ 448 HmiEcoClimaReq 0 "OnOffNoReq_NoReq" 1 "OnOffNoReq_On" 2 "OnOffNoReq_Off";
VAL_ 448 HmiElecAirAdpvReqDrvrAdpv 0 "OnOff1_Off" 1 "OnOff1_On";
VAL_ 448 HmiElecAirAdpvReqPassAdpv 0 "OnOff1_Off" 1 "OnOff1_On";
VAL_ 448 HmiElecAirDirModReqDrvrMod 0 "AirDirModReq_Normal" 1 "AirDirModReq_Focus" 2 "AirDirModReq_Avoid" 3 "AirDirModReq_Customize";
VAL_ 448 HmiElecAirDirModReqPassMod 0 "AirDirModReq_Normal" 1 "AirDirModReq_Focus" 2 "AirDirModReq_Avoid" 3 "AirDirModReq_Customize";
VAL_ 448 HmiElecAirFrntSwtReqHmiElecAirDrvrLeSwtReq 0 "OnOff1_Off" 1 "OnOff1_On";
VAL_ 448 HmiElecAirFrntSwtReqHmiElecAirDrvrRiSwtReq 0 "OnOff1_Off" 1 "OnOff1_On";
VAL_ 448 HmiElecAirFrntSwtReqHmiElecAirPassLeSwtReq 0 "OnOff1_Off" 1 "OnOff1_On";
VAL_ 448 HmiElecAirFrntSwtReqHmiElecAirPassRiSwtReq 0 "OnOff1_Off" 1 "OnOff1_On";
VAL_ 448 HmiElecAirSwngReqDrvrLeRiSwng 0 "OnOff1_Off" 1 "OnOff1_On";
VAL_ 448 HmiElecAirSwngReqDrvrUpOnSwng 0 "OnOff1_Off" 1 "OnOff1_On";
VAL_ 448 HmiElecAirSwngReqPassLeRiSwng 0 "OnOff1_Off" 1 "OnOff1_On";
VAL_ 448 HmiElecAirSwngReqPassUpOnSwng 0 "OnOff1_Off" 1 "OnOff1_On";
VAL_ 448 HmiFanLvlRow1 0 "HmiHvacFanLvl_Off" 1 "HmiHvacFanLvl_LvlMan1" 2 "HmiHvacFanLvl_LvlMan2" 3 "HmiHvacFanLvl_LvlMan3" 4 "HmiHvacFanLvl_LvlMan4" 5 "HmiHvacFanLvl_LvlMan5" 6 "HmiHvacFanLvl_LvlMan6" 7 "HmiHvacFanLvl_LvlMan7" 8 "HmiHvacFanLvl_LvlMan8" 9 "HmiHvacFanLvl_LvlMan9" 10 "HmiHvacFanLvl_LvlAutMinusMinus" 11 "HmiHvacFanLvl_LvlAutMinus" 12 "HmiHvacFanLvl_LvlAutNorm" 13 "HmiHvacFanLvl_LvlAutPlus" 14 "HmiHvacFanLvl_LvlAutPlusPlus" 15 "HmiHvacFanLvl_Reserved";
VAL_ 448 HmiFanLvlRow2 0 "HmiHvacFanLvl_Off" 1 "HmiHvacFanLvl_LvlMan1" 2 "HmiHvacFanLvl_LvlMan2" 3 "HmiHvacFanLvl_LvlMan3" 4 "HmiHvacFanLvl_LvlMan4" 5 "HmiHvacFanLvl_LvlMan5" 6 "HmiHvacFanLvl_LvlMan6" 7 "HmiHvacFanLvl_LvlMan7" 8 "HmiHvacFanLvl_LvlMan8" 9 "HmiHvacFanLvl_LvlMan9" 10 "HmiHvacFanLvl_LvlAutMinusMinus" 11 "HmiHvacFanLvl_LvlAutMinus" 12 "HmiHvacFanLvl_LvlAutNorm" 13 "HmiHvacFanLvl_LvlAutPlus" 14 "HmiHvacFanLvl_LvlAutPlusPlus" 15 "HmiHvacFanLvl_Reserved";
VAL_ 448 HmiFragraCh 0 "ChSet_Idle" 1 "ChSet_Channel1" 2 "ChSet_Channel2" 3 "ChSet_Channel3" 4 "ChSet_Channel4" 5 "ChSet_Channel5" 6 "ChSet_Channel6" 7 "ChSet_Channel7";
VAL_ 448 HmiFragraLvl 0 "LvlOff" 1 "Lvl1" 2 "Lvl2" 3 "Lvl3";
VAL_ 448 HmiHvacRecircCmd 0 "HmiHvacRecircCmd_Aut" 1 "HmiHvacRecircCmd_AutWithAirQly" 2 "HmiHvacRecircCmd_RecircFull" 3 "HmiHvacRecircCmd_OscircFull";
VAL_ 448 HmiMaxAC 0 "OnOff1_Off" 1 "OnOff1_On";
VAL_ 448 HmiMaxDefrst 0 "OnOff1_Off" 1 "OnOff1_On";
VAL_ 448 HMIRapidHeatgUpSet 0 "OnOffNoReq_NoReq" 1 "OnOffNoReq_On" 2 "OnOffNoReq_Off";
VAL_ 448 HMIRapidTDrpSet 0 "OnOffNoReq_NoReq" 1 "OnOffNoReq_On" 2 "OnOffNoReq_Off";
VAL_ 448 HmiSeatHeatAutStrtDrvr 0 "OnOff1_Off" 1 "OnOff1_On";
VAL_ 448 HmiSeatHeatAutStrtPass 0 "OnOff1_Off" 1 "OnOff1_On";
VAL_ 448 HmiSeatHeatLvlDrvr 0 "SeatClimaLvl1_Off" 1 "SeatClimaLvl1_Lvl1" 2 "SeatClimaLvl1_Lvl2" 3 "SeatClimaLvl1_Lvl3" 4 "SeatClimaLvl1_Auto" 5 "SeatClimaLvl1_Resvd1" 6 "SeatClimaLvl1_Resvd2" 7 "SeatClimaLvl1_idle";
VAL_ 448 HmiSeatHeatLvlPass 0 "SeatClimaLvl1_Off" 1 "SeatClimaLvl1_Lvl1" 2 "SeatClimaLvl1_Lvl2" 3 "SeatClimaLvl1_Lvl3" 4 "SeatClimaLvl1_Auto" 5 "SeatClimaLvl1_Resvd1" 6 "SeatClimaLvl1_Resvd2" 7 "SeatClimaLvl1_idle";
VAL_ 448 HmiSeatVentAutStrtDrvr 0 "OnOff1_Off" 1 "OnOff1_On";
VAL_ 448 HmiSeatVentAutStrtPass 0 "OnOff1_Off" 1 "OnOff1_On";
VAL_ 448 HmiSeatVentLvlDrvr 0 "SeatClimaLvl1_Off" 1 "SeatClimaLvl1_Lvl1" 2 "SeatClimaLvl1_Lvl2" 3 "SeatClimaLvl1_Lvl3" 4 "SeatClimaLvl1_Auto" 5 "SeatClimaLvl1_Resvd1" 6 "SeatClimaLvl1_Resvd2" 7 "SeatClimaLvl1_idle";
VAL_ 448 HmiSeatVentLvlPass 0 "SeatClimaLvl1_Off" 1 "SeatClimaLvl1_Lvl1" 2 "SeatClimaLvl1_Lvl2" 3 "SeatClimaLvl1_Lvl3" 4 "SeatClimaLvl1_Auto" 5 "SeatClimaLvl1_Resvd1" 6 "SeatClimaLvl1_Resvd2" 7 "SeatClimaLvl1_idle";
VAL_ 448 HmiTSyncn 0 "OnOff1_Off" 1 "OnOff1_On";
VAL_ 448 IntrMirrAntiGlareSwt 0 "OnOff1_Off" 1 "OnOff1_On";
VAL_ 448 LiHomeSafeReq 0 "LiTi2_Sec0" 1 "LiTi2_Sec10" 2 "LiTi2_Sec20" 3 "LiTi2_Sec30" 4 "LiTi2_Sec40" 5 "LiTi2_Sec50" 6 "LiTi2_Sec60" 7 "LiTi2_Sec70" 8 "LiTi2_Sec80" 9 "LiTi2_Sec90" 10 "LiTi2_Sec100" 11 "LiTi2_Sec110" 12 "LiTi2_Sec120" 13 "LiTi2_Resd1" 14 "LiTi2_Resd2" 15 "LiTi2_Resd3";
VAL_ 448 LockgPrsnlReqFromHmi 0 "OnOffNoReq_NoReq" 1 "OnOffNoReq_On" 2 "OnOffNoReq_Off";
VAL_ 448 NextRoadcongestionLvl 0 "Lvl30_NoLvl" 1 "Lvl30_LoLvl" 2 "Lvl30_MidLvl" 3 "Lvl30_HiLvl";
VAL_ 448 PassSeatFoldRaiseReq 0 "SeatFoldRaiseReq_Idle" 1 "SeatFoldRaiseReq_Fold" 2 "SeatFoldRaiseReq_Raise" 3 "SeatFoldRaiseReq_Stop";
VAL_ 448 SeatCushTiltAdjmtRowFirstDrvr 0 "SwtVertSts1_Idle" 1 "SwtVertSts1_Up" 2 "SwtVertSts1_Dwn";
VAL_ 448 SeatCushTiltAdjmtRowFirstPass 0 "SwtVertSts1_Idle" 1 "SwtVertSts1_Up" 2 "SwtVertSts1_Dwn";
VAL_ 448 SeatHeiAdjmtRowFirstDrvr 0 "SwtVertSts1_Idle" 1 "SwtVertSts1_Up" 2 "SwtVertSts1_Dwn";
VAL_ 448 SeatHeiAdjmtRowFirstPass 0 "SwtVertSts1_Idle" 1 "SwtVertSts1_Up" 2 "SwtVertSts1_Dwn";
VAL_ 448 SeatLenAdjmtRowFirstDrvr 0 "SwtHozlSts1_Idle" 1 "SwtHozlSts1_Fwd" 2 "SwtHozlSts1_Backw";
VAL_ 448 SeatLenAdjmtRowFirstPass 0 "SwtHozlSts1_Idle" 1 "SwtHozlSts1_Fwd" 2 "SwtHozlSts1_Backw";
VAL_ 448 SetTiAndDateDateOrTi 0 "DateOrTi_None" 1 "DateOrTi_Date" 2 "DateOrTi_Ti" 3 "DateOrTi_DateTi";
VAL_ 448 SpeechExtnSts 0 "SpeechExtnSts_BeforeWakeUp" 1 "SpeechExtnSts_Reserved1" 2 "SpeechExtnSts_Reserved2" 3 "SpeechExtnSts_AftWakeUpSpeaking" 4 "SpeechExtnSts_AftWakUpLeFntRecgnzg" 5 "SpeechExtnSts_AftWakUpRiFntRecgnzg" 6 "SpeechExtnSts_AftWakUpLeReRecgnzg" 7 "SpeechExtnSts_AftWakUpRiReRecgnzg";
VAL_ 448 SteerTarPosnCmdReqTarPosnCmd 0 "TarPosnCmd_Idle" 1 "TarPosnCmd_MoveReq" 2 "TarPosnCmd_StopReq" 3 "TarPosnCmd_MemPosnSet" 4 "TarPosnCmd_MemPosnClr";
VAL_ 448 TiAndDateGNSSDataValid 0 "NoYes1_No" 1 "NoYes1_Yes";
VAL_ 448 VoiceVMMPowerModeSet 0 "OnOff1_Off" 1 "OnOff1_On";
VAL_ 448 WelcomeGoodbyeSetReq 0 "OnOff1_Off" 1 "OnOff1_On";
VAL_ 448 WelcomeLiOpenReq 0 "OnOff1_Off" 1 "OnOff1_On";
VAL_ 304 CargoBoxIllumOpenReq 0 "OnOffNoReq_NoReq" 1 "OnOffNoReq_On" 2 "OnOffNoReq_Off";
VAL_ 304 ChdLockReLeCtrlHmiReq 0 "LockgCenReq2_Idle" 1 "LockgCenReq2_Unlck" 2 "LockgCenReq2_Lock";
VAL_ 304 ChdLockReRiCtrlHmiReq 0 "LockgCenReq2_Idle" 1 "LockgCenReq2_Unlck" 2 "LockgCenReq2_Lock";
VAL_ 304 CourtesyLiOpenReq 0 "OnOff1_Off" 1 "OnOff1_On";
VAL_ 304 EasyInOutDrvrSeatAdjmt 0 "OnOff1_Off" 1 "OnOff1_On";
VAL_ 304 EasyInOutSecRowLeReq 0 "OnOff1_Off" 1 "OnOff1_On";
VAL_ 304 EasyInOutSecRowRiReq 0 "OnOff1_Off" 1 "OnOff1_On";
VAL_ 304 EgyRgnLvlSet 0 "EgyRgnLvlSet_Level1" 1 "EgyRgnLvlSet_Level2" 2 "EgyRgnLvlSet_Level3" 3 "EgyRgnLvlSet_Level4";
VAL_ 304 EngStrtStopDrvModIndSetg 0 "OnOff1_Off" 1 "OnOff1_On";
VAL_ 304 EngStrtStopSetg 0 "OnOff2_On" 1 "OnOff2_Off";
VAL_ 304 GlvBoxHMIReq 0 "LockgCenReq2_Idle" 1 "LockgCenReq2_Unlck" 2 "LockgCenReq2_Lock";
VAL_ 304 HMICDCSet 0 "SteerAsscLvl_Ukwn" 1 "SteerAsscLvl_Lvl1" 2 "SteerAsscLvl_Lvl2" 3 "SteerAsscLvl_Lvl3" 4 "SteerAsscLvl_Lvl4" 5 "SteerAsscLvl_Resd5" 6 "SteerAsscLvl_Resd6" 7 "SteerAsscLvl_Resd7";
VAL_ 304 HmiSeatHeatgForRowSecLe 0 "SeatClimaLvl1_Off" 1 "SeatClimaLvl1_Lvl1" 2 "SeatClimaLvl1_Lvl2" 3 "SeatClimaLvl1_Lvl3" 4 "SeatClimaLvl1_Auto" 5 "SeatClimaLvl1_Resvd1" 6 "SeatClimaLvl1_Resvd2" 7 "SeatClimaLvl1_idle";
VAL_ 304 HmiSeatHeatgForRowSecRi 0 "SeatClimaLvl1_Off" 1 "SeatClimaLvl1_Lvl1" 2 "SeatClimaLvl1_Lvl2" 3 "SeatClimaLvl1_Lvl3" 4 "SeatClimaLvl1_Auto" 5 "SeatClimaLvl1_Resvd1" 6 "SeatClimaLvl1_Resvd2" 7 "SeatClimaLvl1_idle";
VAL_ 304 HmiSeatHeatgForRowThrdLe 0 "SeatClimaLvl1_Off" 1 "SeatClimaLvl1_Lvl1" 2 "SeatClimaLvl1_Lvl2" 3 "SeatClimaLvl1_Lvl3" 4 "SeatClimaLvl1_Auto" 5 "SeatClimaLvl1_Resvd1" 6 "SeatClimaLvl1_Resvd2" 7 "SeatClimaLvl1_idle";
VAL_ 304 HmiSeatHeatgForRowThrdRi 0 "SeatClimaLvl1_Off" 1 "SeatClimaLvl1_Lvl1" 2 "SeatClimaLvl1_Lvl2" 3 "SeatClimaLvl1_Lvl3" 4 "SeatClimaLvl1_Auto" 5 "SeatClimaLvl1_Resvd1" 6 "SeatClimaLvl1_Resvd2" 7 "SeatClimaLvl1_idle";
VAL_ 304 HmiSeatVentnForRowSecLe 0 "SeatClimaLvl1_Off" 1 "SeatClimaLvl1_Lvl1" 2 "SeatClimaLvl1_Lvl2" 3 "SeatClimaLvl1_Lvl3" 4 "SeatClimaLvl1_Auto" 5 "SeatClimaLvl1_Resvd1" 6 "SeatClimaLvl1_Resvd2" 7 "SeatClimaLvl1_idle";
VAL_ 304 HmiSeatVentnForRowSecRi 0 "SeatClimaLvl1_Off" 1 "SeatClimaLvl1_Lvl1" 2 "SeatClimaLvl1_Lvl2" 3 "SeatClimaLvl1_Lvl3" 4 "SeatClimaLvl1_Auto" 5 "SeatClimaLvl1_Resvd1" 6 "SeatClimaLvl1_Resvd2" 7 "SeatClimaLvl1_idle";
VAL_ 304 HmiSeatVentnForRowThrdLe 0 "SeatClimaLvl1_Off" 1 "SeatClimaLvl1_Lvl1" 2 "SeatClimaLvl1_Lvl2" 3 "SeatClimaLvl1_Lvl3" 4 "SeatClimaLvl1_Auto" 5 "SeatClimaLvl1_Resvd1" 6 "SeatClimaLvl1_Resvd2" 7 "SeatClimaLvl1_idle";
VAL_ 304 HmiSeatVentnForRowThrdRi 0 "SeatClimaLvl1_Off" 1 "SeatClimaLvl1_Lvl1" 2 "SeatClimaLvl1_Lvl2" 3 "SeatClimaLvl1_Lvl3" 4 "SeatClimaLvl1_Auto" 5 "SeatClimaLvl1_Resvd1" 6 "SeatClimaLvl1_Resvd2" 7 "SeatClimaLvl1_idle";
VAL_ 304 ImobVehRemReqAndRespImobVehRemReqCmd 0 "ImobVehRemReqCmd_ImobRemReqIdle" 1 "ImobVehRemReqCmd_NoImobnRemReq" 2 "ImobVehRemReqCmd_ImobnRemReq" 3 "ImobVehRemReqCmd_SpdLimRemReq" 4 "ImobVehRemReqCmd_ImobRemChkReq" 5 "ImobVehRemReqCmd_ImobRemStsReq";
VAL_ 304 LowrReAxle 0 "ReqSts1_NotReqd" 1 "ReqSts1_Reqd";
VAL_ 304 MobDevRCVReq1RCVCtrl 0 "RCVCtrl_Idle" 1 "RCVCtrl_Request" 2 "RCVCtrl_Start" 3 "RCVCtrl_Forward" 4 "RCVCtrl_Backward" 5 "RCVCtrl_Release" 6 "RCVCtrl_Quit" 7 "RCVCtrl_Complete" 8 "RCVCtrl_ForwardExchange" 9 "RCVCtrl_BackwardExchange";
VAL_ 304 MobDevRCVReq1Steertrim 0 "Steertrim_Idle" 1 "Steertrim_TurnLeft" 2 "Steertrim_TurnRight" 3 "Steertrim_TurnLeftExchange" 4 "Steertrim_TurnRightExchange" 5 "Steertrim_Release";
VAL_ 304 PasAcsInHmiReq 0 "OnOff1_Off" 1 "OnOff1_On";
VAL_ 304 PasAcsOutHmiReq 0 "OnOff1_Off" 1 "OnOff1_On";
VAL_ 304 RePosnLiFolwDayTiRunngLiOnOff 0 "OnOff1_Off" 1 "OnOff1_On";
VAL_ 304 ReSunCurtOpenPosnReq 0 "WinAndRoofAndCurtPosnTyp_PosnUkwn" 1 "WinAndRoofAndCurtPosnTyp_ClsFull" 2 "WinAndRoofAndCurtPosnTyp_PercOpen4" 3 "WinAndRoofAndCurtPosnTyp_PercOpen8" 4 "WinAndRoofAndCurtPosnTyp_PercOpen12" 5 "WinAndRoofAndCurtPosnTyp_PercOpen16" 6 "WinAndRoofAndCurtPosnTyp_PercOpen20" 7 "WinAndRoofAndCurtPosnTyp_PercOpen24" 8 "WinAndRoofAndCurtPosnTyp_PercOpen28" 9 "WinAndRoofAndCurtPosnTyp_PercOpen32" 10 "WinAndRoofAndCurtPosnTyp_PercOpen36" 11 "WinAndRoofAndCurtPosnTyp_PercOpen40" 12 "WinAndRoofAndCurtPosnTyp_PercOpen44" 13 "WinAndRoofAndCurtPosnTyp_PercOpen48" 14 "WinAndRoofAndCurtPosnTyp_PercOpen52" 15 "WinAndRoofAndCurtPosnTyp_PercOpen56" 16 "WinAndRoofAndCurtPosnTyp_PercOpen60" 17 "WinAndRoofAndCurtPosnTyp_PercOpen64" 18 "WinAndRoofAndCurtPosnTyp_PercOpen68" 19 "WinAndRoofAndCurtPosnTyp_PercOpen72" 20 "WinAndRoofAndCurtPosnTyp_PercOpen76" 21 "WinAndRoofAndCurtPosnTyp_PercOpen80" 22 "WinAndRoofAndCurtPosnTyp_PercOpen84" 23 "WinAndRoofAndCurtPosnTyp_PercOpen88" 24 "WinAndRoofAndCurtPosnTyp_PercOpen92" 25 "WinAndRoofAndCurtPosnTyp_PercOpen96" 26 "WinAndRoofAndCurtPosnTyp_OpenFull" 27 "WinAndRoofAndCurtPosnTyp_Resd1" 28 "WinAndRoofAndCurtPosnTyp_Resd2" 29 "WinAndRoofAndCurtPosnTyp_Resd3" 30 "WinAndRoofAndCurtPosnTyp_Resd4" 31 "WinAndRoofAndCurtPosnTyp_Movg";
VAL_ 304 RowSecRiSeatZeroGrvyChdLockSwt 0 "OnOff1_Off" 1 "OnOff1_On";
VAL_ 304 TechnologyLiMusicCorrlnSwt 0 "OnOff1_Off" 1 "OnOff1_On";
VAL_ 304 VoiceCtrlEasyLoad 0 "Resvd1" 1 "Highway" 2 "Expressway" 3 "NationalroadAndProvinceroad" 4 "MainRoadAndCountyRoad" 5 "SecondaryRoadAndTownshipRoad" 6 "NormalRoadAndCountyRuralInteriorRoadAndAvenue" 7 "Resvd2";
VAL_ 85 DwnLoadDynLtgPrmForFrntLeGrp10Mode1 0 "Mode4_Off" 1 "Mode4_On" 2 "Mode4_GradualOn" 3 "Mode4_GradualOff" 4 "Mode4_ForwardWipingOn" 5 "Mode4_BackwardWipingOn" 6 "Mode4_OutwardWipingOn" 7 "Mode4_InwardWipingOn" 8 "Mode4_ForwardWipingOff" 9 "Mode4_BackwardWipingOff" 10 "Mode4_OutwardWipingOff" 11 "Mode4_InwardWipingOff" 12 "Mode4_ForwardScanning" 13 "Mode4_BackwardScanning" 14 "Mode4_BreathOn" 15 "Mode4_BreathOff" 16 "Mode4_1stHalfONand2ndHalfOFF" 17 "Mode4_HalfOFFHalfON" 18 "Mode4_HalfDimmingONHalfOFF" 19 "Mode4_HalfDimmingONHalfON" 20 "Mode4_HalfOFFHalfDimmingON" 21 "Mode4_HalfONHalfDimmingON" 22 "Mode4_HalfDimmingOFFHalfOFF" 23 "Mode4_HalfDimmingOFFHalfON" 24 "Mode4_HalfOFFHalfDimmingOFF" 25 "Mode4_HalfONHalfDimmingOFF" 26 "Mode4_SingleOn1" 27 "Mode4_SingleOn2" 28 "Mode4_SingleOn3" 29 "Mode4_SingleOn4" 30 "Mode4_SingleOn5" 31 "Mode4_SingleOn6" 32 "Mode4_SingleOn7" 33 "Mode4_SingleOn8" 34 "Mode4_SingleOn9" 35 "Mode4_SingleOn10" 36 "Mode4_SingleOn11" 37 "Mode4_SingleOn12" 38 "Mode4_SingleOff1" 39 "Mode4_SingleOff2" 40 "Mode4_SingleOff3" 41 "Mode4_SingleOff4" 42 "Mode4_SingleOff5" 43 "Mode4_SingleOff6" 44 "Mode4_SingleOff7" 45 "Mode4_SingleOff8" 46 "Mode4_SingleOff9" 47 "Mode4_SingleOff10" 48 "Mode4_SingleOff11" 49 "Mode4_SingleOff12";
VAL_ 85 DwnLoadDynLtgPrmForFrntLeGrp11Mode1 0 "Mode4_Off" 1 "Mode4_On" 2 "Mode4_GradualOn" 3 "Mode4_GradualOff" 4 "Mode4_ForwardWipingOn" 5 "Mode4_BackwardWipingOn" 6 "Mode4_OutwardWipingOn" 7 "Mode4_InwardWipingOn" 8 "Mode4_ForwardWipingOff" 9 "Mode4_BackwardWipingOff" 10 "Mode4_OutwardWipingOff" 11 "Mode4_InwardWipingOff" 12 "Mode4_ForwardScanning" 13 "Mode4_BackwardScanning" 14 "Mode4_BreathOn" 15 "Mode4_BreathOff" 16 "Mode4_1stHalfONand2ndHalfOFF" 17 "Mode4_HalfOFFHalfON" 18 "Mode4_HalfDimmingONHalfOFF" 19 "Mode4_HalfDimmingONHalfON" 20 "Mode4_HalfOFFHalfDimmingON" 21 "Mode4_HalfONHalfDimmingON" 22 "Mode4_HalfDimmingOFFHalfOFF" 23 "Mode4_HalfDimmingOFFHalfON" 24 "Mode4_HalfOFFHalfDimmingOFF" 25 "Mode4_HalfONHalfDimmingOFF" 26 "Mode4_SingleOn1" 27 "Mode4_SingleOn2" 28 "Mode4_SingleOn3" 29 "Mode4_SingleOn4" 30 "Mode4_SingleOn5" 31 "Mode4_SingleOn6" 32 "Mode4_SingleOn7" 33 "Mode4_SingleOn8" 34 "Mode4_SingleOn9" 35 "Mode4_SingleOn10" 36 "Mode4_SingleOn11" 37 "Mode4_SingleOn12" 38 "Mode4_SingleOff1" 39 "Mode4_SingleOff2" 40 "Mode4_SingleOff3" 41 "Mode4_SingleOff4" 42 "Mode4_SingleOff5" 43 "Mode4_SingleOff6" 44 "Mode4_SingleOff7" 45 "Mode4_SingleOff8" 46 "Mode4_SingleOff9" 47 "Mode4_SingleOff10" 48 "Mode4_SingleOff11" 49 "Mode4_SingleOff12";
VAL_ 85 DwnLoadDynLtgPrmForFrntLeGrp12Mode1 0 "Mode4_Off" 1 "Mode4_On" 2 "Mode4_GradualOn" 3 "Mode4_GradualOff" 4 "Mode4_ForwardWipingOn" 5 "Mode4_BackwardWipingOn" 6 "Mode4_OutwardWipingOn" 7 "Mode4_InwardWipingOn" 8 "Mode4_ForwardWipingOff" 9 "Mode4_BackwardWipingOff" 10 "Mode4_OutwardWipingOff" 11 "Mode4_InwardWipingOff" 12 "Mode4_ForwardScanning" 13 "Mode4_BackwardScanning" 14 "Mode4_BreathOn" 15 "Mode4_BreathOff" 16 "Mode4_1stHalfONand2ndHalfOFF" 17 "Mode4_HalfOFFHalfON" 18 "Mode4_HalfDimmingONHalfOFF" 19 "Mode4_HalfDimmingONHalfON" 20 "Mode4_HalfOFFHalfDimmingON" 21 "Mode4_HalfONHalfDimmingON" 22 "Mode4_HalfDimmingOFFHalfOFF" 23 "Mode4_HalfDimmingOFFHalfON" 24 "Mode4_HalfOFFHalfDimmingOFF" 25 "Mode4_HalfONHalfDimmingOFF" 26 "Mode4_SingleOn1" 27 "Mode4_SingleOn2" 28 "Mode4_SingleOn3" 29 "Mode4_SingleOn4" 30 "Mode4_SingleOn5" 31 "Mode4_SingleOn6" 32 "Mode4_SingleOn7" 33 "Mode4_SingleOn8" 34 "Mode4_SingleOn9" 35 "Mode4_SingleOn10" 36 "Mode4_SingleOn11" 37 "Mode4_SingleOn12" 38 "Mode4_SingleOff1" 39 "Mode4_SingleOff2" 40 "Mode4_SingleOff3" 41 "Mode4_SingleOff4" 42 "Mode4_SingleOff5" 43 "Mode4_SingleOff6" 44 "Mode4_SingleOff7" 45 "Mode4_SingleOff8" 46 "Mode4_SingleOff9" 47 "Mode4_SingleOff10" 48 "Mode4_SingleOff11" 49 "Mode4_SingleOff12";
VAL_ 85 DwnLoadDynLtgPrmForFrntLeGrp1Mode1 0 "Mode4_Off" 1 "Mode4_On" 2 "Mode4_GradualOn" 3 "Mode4_GradualOff" 4 "Mode4_ForwardWipingOn" 5 "Mode4_BackwardWipingOn" 6 "Mode4_OutwardWipingOn" 7 "Mode4_InwardWipingOn" 8 "Mode4_ForwardWipingOff" 9 "Mode4_BackwardWipingOff" 10 "Mode4_OutwardWipingOff" 11 "Mode4_InwardWipingOff" 12 "Mode4_ForwardScanning" 13 "Mode4_BackwardScanning" 14 "Mode4_BreathOn" 15 "Mode4_BreathOff" 16 "Mode4_1stHalfONand2ndHalfOFF" 17 "Mode4_HalfOFFHalfON" 18 "Mode4_HalfDimmingONHalfOFF" 19 "Mode4_HalfDimmingONHalfON" 20 "Mode4_HalfOFFHalfDimmingON" 21 "Mode4_HalfONHalfDimmingON" 22 "Mode4_HalfDimmingOFFHalfOFF" 23 "Mode4_HalfDimmingOFFHalfON" 24 "Mode4_HalfOFFHalfDimmingOFF" 25 "Mode4_HalfONHalfDimmingOFF" 26 "Mode4_SingleOn1" 27 "Mode4_SingleOn2" 28 "Mode4_SingleOn3" 29 "Mode4_SingleOn4" 30 "Mode4_SingleOn5" 31 "Mode4_SingleOn6" 32 "Mode4_SingleOn7" 33 "Mode4_SingleOn8" 34 "Mode4_SingleOn9" 35 "Mode4_SingleOn10" 36 "Mode4_SingleOn11" 37 "Mode4_SingleOn12" 38 "Mode4_SingleOff1" 39 "Mode4_SingleOff2" 40 "Mode4_SingleOff3" 41 "Mode4_SingleOff4" 42 "Mode4_SingleOff5" 43 "Mode4_SingleOff6" 44 "Mode4_SingleOff7" 45 "Mode4_SingleOff8" 46 "Mode4_SingleOff9" 47 "Mode4_SingleOff10" 48 "Mode4_SingleOff11" 49 "Mode4_SingleOff12";
VAL_ 85 DwnLoadDynLtgPrmForFrntLeGrp2Mode1 0 "Mode4_Off" 1 "Mode4_On" 2 "Mode4_GradualOn" 3 "Mode4_GradualOff" 4 "Mode4_ForwardWipingOn" 5 "Mode4_BackwardWipingOn" 6 "Mode4_OutwardWipingOn" 7 "Mode4_InwardWipingOn" 8 "Mode4_ForwardWipingOff" 9 "Mode4_BackwardWipingOff" 10 "Mode4_OutwardWipingOff" 11 "Mode4_InwardWipingOff" 12 "Mode4_ForwardScanning" 13 "Mode4_BackwardScanning" 14 "Mode4_BreathOn" 15 "Mode4_BreathOff" 16 "Mode4_1stHalfONand2ndHalfOFF" 17 "Mode4_HalfOFFHalfON" 18 "Mode4_HalfDimmingONHalfOFF" 19 "Mode4_HalfDimmingONHalfON" 20 "Mode4_HalfOFFHalfDimmingON" 21 "Mode4_HalfONHalfDimmingON" 22 "Mode4_HalfDimmingOFFHalfOFF" 23 "Mode4_HalfDimmingOFFHalfON" 24 "Mode4_HalfOFFHalfDimmingOFF" 25 "Mode4_HalfONHalfDimmingOFF" 26 "Mode4_SingleOn1" 27 "Mode4_SingleOn2" 28 "Mode4_SingleOn3" 29 "Mode4_SingleOn4" 30 "Mode4_SingleOn5" 31 "Mode4_SingleOn6" 32 "Mode4_SingleOn7" 33 "Mode4_SingleOn8" 34 "Mode4_SingleOn9" 35 "Mode4_SingleOn10" 36 "Mode4_SingleOn11" 37 "Mode4_SingleOn12" 38 "Mode4_SingleOff1" 39 "Mode4_SingleOff2" 40 "Mode4_SingleOff3" 41 "Mode4_SingleOff4" 42 "Mode4_SingleOff5" 43 "Mode4_SingleOff6" 44 "Mode4_SingleOff7" 45 "Mode4_SingleOff8" 46 "Mode4_SingleOff9" 47 "Mode4_SingleOff10" 48 "Mode4_SingleOff11" 49 "Mode4_SingleOff12";
VAL_ 85 DwnLoadDynLtgPrmForFrntLeGrp3Mode1 0 "Mode4_Off" 1 "Mode4_On" 2 "Mode4_GradualOn" 3 "Mode4_GradualOff" 4 "Mode4_ForwardWipingOn" 5 "Mode4_BackwardWipingOn" 6 "Mode4_OutwardWipingOn" 7 "Mode4_InwardWipingOn" 8 "Mode4_ForwardWipingOff" 9 "Mode4_BackwardWipingOff" 10 "Mode4_OutwardWipingOff" 11 "Mode4_InwardWipingOff" 12 "Mode4_ForwardScanning" 13 "Mode4_BackwardScanning" 14 "Mode4_BreathOn" 15 "Mode4_BreathOff" 16 "Mode4_1stHalfONand2ndHalfOFF" 17 "Mode4_HalfOFFHalfON" 18 "Mode4_HalfDimmingONHalfOFF" 19 "Mode4_HalfDimmingONHalfON" 20 "Mode4_HalfOFFHalfDimmingON" 21 "Mode4_HalfONHalfDimmingON" 22 "Mode4_HalfDimmingOFFHalfOFF" 23 "Mode4_HalfDimmingOFFHalfON" 24 "Mode4_HalfOFFHalfDimmingOFF" 25 "Mode4_HalfONHalfDimmingOFF" 26 "Mode4_SingleOn1" 27 "Mode4_SingleOn2" 28 "Mode4_SingleOn3" 29 "Mode4_SingleOn4" 30 "Mode4_SingleOn5" 31 "Mode4_SingleOn6" 32 "Mode4_SingleOn7" 33 "Mode4_SingleOn8" 34 "Mode4_SingleOn9" 35 "Mode4_SingleOn10" 36 "Mode4_SingleOn11" 37 "Mode4_SingleOn12" 38 "Mode4_SingleOff1" 39 "Mode4_SingleOff2" 40 "Mode4_SingleOff3" 41 "Mode4_SingleOff4" 42 "Mode4_SingleOff5" 43 "Mode4_SingleOff6" 44 "Mode4_SingleOff7" 45 "Mode4_SingleOff8" 46 "Mode4_SingleOff9" 47 "Mode4_SingleOff10" 48 "Mode4_SingleOff11" 49 "Mode4_SingleOff12";
VAL_ 85 DwnLoadDynLtgPrmForFrntLeGrp4Mode1 0 "Mode4_Off" 1 "Mode4_On" 2 "Mode4_GradualOn" 3 "Mode4_GradualOff" 4 "Mode4_ForwardWipingOn" 5 "Mode4_BackwardWipingOn" 6 "Mode4_OutwardWipingOn" 7 "Mode4_InwardWipingOn" 8 "Mode4_ForwardWipingOff" 9 "Mode4_BackwardWipingOff" 10 "Mode4_OutwardWipingOff" 11 "Mode4_InwardWipingOff" 12 "Mode4_ForwardScanning" 13 "Mode4_BackwardScanning" 14 "Mode4_BreathOn" 15 "Mode4_BreathOff" 16 "Mode4_1stHalfONand2ndHalfOFF" 17 "Mode4_HalfOFFHalfON" 18 "Mode4_HalfDimmingONHalfOFF" 19 "Mode4_HalfDimmingONHalfON" 20 "Mode4_HalfOFFHalfDimmingON" 21 "Mode4_HalfONHalfDimmingON" 22 "Mode4_HalfDimmingOFFHalfOFF" 23 "Mode4_HalfDimmingOFFHalfON" 24 "Mode4_HalfOFFHalfDimmingOFF" 25 "Mode4_HalfONHalfDimmingOFF" 26 "Mode4_SingleOn1" 27 "Mode4_SingleOn2" 28 "Mode4_SingleOn3" 29 "Mode4_SingleOn4" 30 "Mode4_SingleOn5" 31 "Mode4_SingleOn6" 32 "Mode4_SingleOn7" 33 "Mode4_SingleOn8" 34 "Mode4_SingleOn9" 35 "Mode4_SingleOn10" 36 "Mode4_SingleOn11" 37 "Mode4_SingleOn12" 38 "Mode4_SingleOff1" 39 "Mode4_SingleOff2" 40 "Mode4_SingleOff3" 41 "Mode4_SingleOff4" 42 "Mode4_SingleOff5" 43 "Mode4_SingleOff6" 44 "Mode4_SingleOff7" 45 "Mode4_SingleOff8" 46 "Mode4_SingleOff9" 47 "Mode4_SingleOff10" 48 "Mode4_SingleOff11" 49 "Mode4_SingleOff12";
VAL_ 85 DwnLoadDynLtgPrmForFrntLeGrp5Mode1 0 "Mode4_Off" 1 "Mode4_On" 2 "Mode4_GradualOn" 3 "Mode4_GradualOff" 4 "Mode4_ForwardWipingOn" 5 "Mode4_BackwardWipingOn" 6 "Mode4_OutwardWipingOn" 7 "Mode4_InwardWipingOn" 8 "Mode4_ForwardWipingOff" 9 "Mode4_BackwardWipingOff" 10 "Mode4_OutwardWipingOff" 11 "Mode4_InwardWipingOff" 12 "Mode4_ForwardScanning" 13 "Mode4_BackwardScanning" 14 "Mode4_BreathOn" 15 "Mode4_BreathOff" 16 "Mode4_1stHalfONand2ndHalfOFF" 17 "Mode4_HalfOFFHalfON" 18 "Mode4_HalfDimmingONHalfOFF" 19 "Mode4_HalfDimmingONHalfON" 20 "Mode4_HalfOFFHalfDimmingON" 21 "Mode4_HalfONHalfDimmingON" 22 "Mode4_HalfDimmingOFFHalfOFF" 23 "Mode4_HalfDimmingOFFHalfON" 24 "Mode4_HalfOFFHalfDimmingOFF" 25 "Mode4_HalfONHalfDimmingOFF" 26 "Mode4_SingleOn1" 27 "Mode4_SingleOn2" 28 "Mode4_SingleOn3" 29 "Mode4_SingleOn4" 30 "Mode4_SingleOn5" 31 "Mode4_SingleOn6" 32 "Mode4_SingleOn7" 33 "Mode4_SingleOn8" 34 "Mode4_SingleOn9" 35 "Mode4_SingleOn10" 36 "Mode4_SingleOn11" 37 "Mode4_SingleOn12" 38 "Mode4_SingleOff1" 39 "Mode4_SingleOff2" 40 "Mode4_SingleOff3" 41 "Mode4_SingleOff4" 42 "Mode4_SingleOff5" 43 "Mode4_SingleOff6" 44 "Mode4_SingleOff7" 45 "Mode4_SingleOff8" 46 "Mode4_SingleOff9" 47 "Mode4_SingleOff10" 48 "Mode4_SingleOff11" 49 "Mode4_SingleOff12";
VAL_ 85 DwnLoadDynLtgPrmForFrntLeGrp6Mode1 0 "Mode4_Off" 1 "Mode4_On" 2 "Mode4_GradualOn" 3 "Mode4_GradualOff" 4 "Mode4_ForwardWipingOn" 5 "Mode4_BackwardWipingOn" 6 "Mode4_OutwardWipingOn" 7 "Mode4_InwardWipingOn" 8 "Mode4_ForwardWipingOff" 9 "Mode4_BackwardWipingOff" 10 "Mode4_OutwardWipingOff" 11 "Mode4_InwardWipingOff" 12 "Mode4_ForwardScanning" 13 "Mode4_BackwardScanning" 14 "Mode4_BreathOn" 15 "Mode4_BreathOff" 16 "Mode4_1stHalfONand2ndHalfOFF" 17 "Mode4_HalfOFFHalfON" 18 "Mode4_HalfDimmingONHalfOFF" 19 "Mode4_HalfDimmingONHalfON" 20 "Mode4_HalfOFFHalfDimmingON" 21 "Mode4_HalfONHalfDimmingON" 22 "Mode4_HalfDimmingOFFHalfOFF" 23 "Mode4_HalfDimmingOFFHalfON" 24 "Mode4_HalfOFFHalfDimmingOFF" 25 "Mode4_HalfONHalfDimmingOFF" 26 "Mode4_SingleOn1" 27 "Mode4_SingleOn2" 28 "Mode4_SingleOn3" 29 "Mode4_SingleOn4" 30 "Mode4_SingleOn5" 31 "Mode4_SingleOn6" 32 "Mode4_SingleOn7" 33 "Mode4_SingleOn8" 34 "Mode4_SingleOn9" 35 "Mode4_SingleOn10" 36 "Mode4_SingleOn11" 37 "Mode4_SingleOn12" 38 "Mode4_SingleOff1" 39 "Mode4_SingleOff2" 40 "Mode4_SingleOff3" 41 "Mode4_SingleOff4" 42 "Mode4_SingleOff5" 43 "Mode4_SingleOff6" 44 "Mode4_SingleOff7" 45 "Mode4_SingleOff8" 46 "Mode4_SingleOff9" 47 "Mode4_SingleOff10" 48 "Mode4_SingleOff11" 49 "Mode4_SingleOff12";
VAL_ 85 DwnLoadDynLtgPrmForFrntLeGrp7Mode1 0 "Mode4_Off" 1 "Mode4_On" 2 "Mode4_GradualOn" 3 "Mode4_GradualOff" 4 "Mode4_ForwardWipingOn" 5 "Mode4_BackwardWipingOn" 6 "Mode4_OutwardWipingOn" 7 "Mode4_InwardWipingOn" 8 "Mode4_ForwardWipingOff" 9 "Mode4_BackwardWipingOff" 10 "Mode4_OutwardWipingOff" 11 "Mode4_InwardWipingOff" 12 "Mode4_ForwardScanning" 13 "Mode4_BackwardScanning" 14 "Mode4_BreathOn" 15 "Mode4_BreathOff" 16 "Mode4_1stHalfONand2ndHalfOFF" 17 "Mode4_HalfOFFHalfON" 18 "Mode4_HalfDimmingONHalfOFF" 19 "Mode4_HalfDimmingONHalfON" 20 "Mode4_HalfOFFHalfDimmingON" 21 "Mode4_HalfONHalfDimmingON" 22 "Mode4_HalfDimmingOFFHalfOFF" 23 "Mode4_HalfDimmingOFFHalfON" 24 "Mode4_HalfOFFHalfDimmingOFF" 25 "Mode4_HalfONHalfDimmingOFF" 26 "Mode4_SingleOn1" 27 "Mode4_SingleOn2" 28 "Mode4_SingleOn3" 29 "Mode4_SingleOn4" 30 "Mode4_SingleOn5" 31 "Mode4_SingleOn6" 32 "Mode4_SingleOn7" 33 "Mode4_SingleOn8" 34 "Mode4_SingleOn9" 35 "Mode4_SingleOn10" 36 "Mode4_SingleOn11" 37 "Mode4_SingleOn12" 38 "Mode4_SingleOff1" 39 "Mode4_SingleOff2" 40 "Mode4_SingleOff3" 41 "Mode4_SingleOff4" 42 "Mode4_SingleOff5" 43 "Mode4_SingleOff6" 44 "Mode4_SingleOff7" 45 "Mode4_SingleOff8" 46 "Mode4_SingleOff9" 47 "Mode4_SingleOff10" 48 "Mode4_SingleOff11" 49 "Mode4_SingleOff12";
VAL_ 85 DwnLoadDynLtgPrmForFrntLeGrp8Mode1 0 "Mode4_Off" 1 "Mode4_On" 2 "Mode4_GradualOn" 3 "Mode4_GradualOff" 4 "Mode4_ForwardWipingOn" 5 "Mode4_BackwardWipingOn" 6 "Mode4_OutwardWipingOn" 7 "Mode4_InwardWipingOn" 8 "Mode4_ForwardWipingOff" 9 "Mode4_BackwardWipingOff" 10 "Mode4_OutwardWipingOff" 11 "Mode4_InwardWipingOff" 12 "Mode4_ForwardScanning" 13 "Mode4_BackwardScanning" 14 "Mode4_BreathOn" 15 "Mode4_BreathOff" 16 "Mode4_1stHalfONand2ndHalfOFF" 17 "Mode4_HalfOFFHalfON" 18 "Mode4_HalfDimmingONHalfOFF" 19 "Mode4_HalfDimmingONHalfON" 20 "Mode4_HalfOFFHalfDimmingON" 21 "Mode4_HalfONHalfDimmingON" 22 "Mode4_HalfDimmingOFFHalfOFF" 23 "Mode4_HalfDimmingOFFHalfON" 24 "Mode4_HalfOFFHalfDimmingOFF" 25 "Mode4_HalfONHalfDimmingOFF" 26 "Mode4_SingleOn1" 27 "Mode4_SingleOn2" 28 "Mode4_SingleOn3" 29 "Mode4_SingleOn4" 30 "Mode4_SingleOn5" 31 "Mode4_SingleOn6" 32 "Mode4_SingleOn7" 33 "Mode4_SingleOn8" 34 "Mode4_SingleOn9" 35 "Mode4_SingleOn10" 36 "Mode4_SingleOn11" 37 "Mode4_SingleOn12" 38 "Mode4_SingleOff1" 39 "Mode4_SingleOff2" 40 "Mode4_SingleOff3" 41 "Mode4_SingleOff4" 42 "Mode4_SingleOff5" 43 "Mode4_SingleOff6" 44 "Mode4_SingleOff7" 45 "Mode4_SingleOff8" 46 "Mode4_SingleOff9" 47 "Mode4_SingleOff10" 48 "Mode4_SingleOff11" 49 "Mode4_SingleOff12";
VAL_ 85 DwnLoadDynLtgPrmForFrntLeGrp9Mode1 0 "Mode4_Off" 1 "Mode4_On" 2 "Mode4_GradualOn" 3 "Mode4_GradualOff" 4 "Mode4_ForwardWipingOn" 5 "Mode4_BackwardWipingOn" 6 "Mode4_OutwardWipingOn" 7 "Mode4_InwardWipingOn" 8 "Mode4_ForwardWipingOff" 9 "Mode4_BackwardWipingOff" 10 "Mode4_OutwardWipingOff" 11 "Mode4_InwardWipingOff" 12 "Mode4_ForwardScanning" 13 "Mode4_BackwardScanning" 14 "Mode4_BreathOn" 15 "Mode4_BreathOff" 16 "Mode4_1stHalfONand2ndHalfOFF" 17 "Mode4_HalfOFFHalfON" 18 "Mode4_HalfDimmingONHalfOFF" 19 "Mode4_HalfDimmingONHalfON" 20 "Mode4_HalfOFFHalfDimmingON" 21 "Mode4_HalfONHalfDimmingON" 22 "Mode4_HalfDimmingOFFHalfOFF" 23 "Mode4_HalfDimmingOFFHalfON" 24 "Mode4_HalfOFFHalfDimmingOFF" 25 "Mode4_HalfONHalfDimmingOFF" 26 "Mode4_SingleOn1" 27 "Mode4_SingleOn2" 28 "Mode4_SingleOn3" 29 "Mode4_SingleOn4" 30 "Mode4_SingleOn5" 31 "Mode4_SingleOn6" 32 "Mode4_SingleOn7" 33 "Mode4_SingleOn8" 34 "Mode4_SingleOn9" 35 "Mode4_SingleOn10" 36 "Mode4_SingleOn11" 37 "Mode4_SingleOn12" 38 "Mode4_SingleOff1" 39 "Mode4_SingleOff2" 40 "Mode4_SingleOff3" 41 "Mode4_SingleOff4" 42 "Mode4_SingleOff5" 43 "Mode4_SingleOff6" 44 "Mode4_SingleOff7" 45 "Mode4_SingleOff8" 46 "Mode4_SingleOff9" 47 "Mode4_SingleOff10" 48 "Mode4_SingleOff11" 49 "Mode4_SingleOff12";
VAL_ 85 RemACChrgLidTelmReq 0 "OnOffNoReq_NoReq" 1 "OnOffNoReq_On" 2 "OnOffNoReq_Off";
VAL_ 85 RemChkTInVeh 0 "ReqSts1_NotReqd" 1 "ReqSts1_Reqd";
VAL_ 85 RemDCChrgLidTelmReq 0 "OnOffNoReq_NoReq" 1 "OnOffNoReq_On" 2 "OnOffNoReq_Off";
VAL_ 85 RemStrtHvCtrlReqErsCmd 0 "ErsCmd_ErsCmdNotSet" 1 "ErsCmd_ErsCmdOn" 2 "ErsCmd_ErsCmdOff";
VAL_ 85 RemVentReq 0 "OnOffNoReq_NoReq" 1 "OnOffNoReq_On" 2 "OnOffNoReq_Off";
VAL_ 85 ReqFragLvlTelm 0 "ReqFragLvl_OFF" 1 "ReqFragLvl_Level1" 2 "ReqFragLvl_Level2" 3 "ReqFragLvl_Level3";
VAL_ 85 SeatHeatDurgClimaEnadFromTelm 0 "SeatHeatDurgClimaEnad2_SeatHeatOff" 1 "SeatHeatDurgClimaEnad2_SeatDrvOn" 2 "SeatHeatDurgClimaEnad2_SeatPassOn" 3 "SeatHeatDurgClimaEnad2_SeatDrvrAndPass" 4 "SeatHeatDurgClimaEnad2_SeatLeftRearOn" 5 "SeatHeatDurgClimaEnad2_SeatRightRearOn";
VAL_ 85 SiteOfcommCharn 0 "Boolean_FALSE" 1 "Boolean_TRUE";
VAL_ 85 SocInFoOfCommChargn 0 "SocInFoOfCommChargnsts_UnDefined" 1 "SocInFoOfCommChargnsts_10perc" 2 "SocInFoOfCommChargnsts_30perc" 3 "SocInFoOfCommChargnsts_50perc" 4 "SocInFoOfCommChargnsts_70perc" 5 "SocInFoOfCommChargnsts_90perc";
VAL_ 85 SocOfCommChargn 0 "Boolean_FALSE" 1 "Boolean_TRUE";
VAL_ 85 SteerWhlHeatgDurgClimaEnadFromTelm 0 "OnOff1_Off" 1 "OnOff1_On";
VAL_ 85 SunRoofAndCurtCmdTelm 0 "SunRoofAndCurtCmdExt_Idle" 1 "SunRoofAndCurtCmdExt_OpenCurtain" 2 "SunRoofAndCurtCmdExt_CloseCurtain" 3 "SunRoofAndCurtCmdExt_OpenPanel" 4 "SunRoofAndCurtCmdExt_ClosePanel" 5 "SunRoofAndCurtCmdExt_OpenManual" 6 "SunRoofAndCurtCmdExt_CloseManual" 7 "SunRoofAndCurtCmdExt_OpenTilt";
VAL_ 85 TankFlapTelmLockgReq 0 "LockActvn2_LockActvnOff" 1 "LockActvn2_LockActvnUnlck" 2 "LockActvn2_LockActvnLock" 3 "LockActvn2_LockActvnSafe" 4 "LockActvn2_LockActvnUnlckByCrash";
VAL_ 85 TelmBookSteerWhlHeatClimalReq 0 "OnOff1_Off" 1 "OnOff1_On";
VAL_ 85 TelmFctReq 0 "Boolean_FALSE" 1 "Boolean_TRUE";
SIG_GROUP_ 448 AmbientLiEffectStatus 1 : AmbientLiEffectStatusBreathingEffectStatus AmbientLiEffectStatusTransitionEffectStatus;
SIG_GROUP_ 304 AmbLiBreathColor 1 : AmbLiBreathColorBlue AmbLiBreathColorGreen AmbLiBreathColorRed;
SIG_GROUP_ 304 AmbLiBreathColor2 1 : AmbLiBreathColor2Blue AmbLiBreathColor2Green AmbLiBreathColor2Red;
SIG_GROUP_ 304 AmbLiBreathColor3 1 : AmbLiBreathColor3Blue AmbLiBreathColor3Green AmbLiBreathColor3Red;
SIG_GROUP_ 304 AmbLiTransColor1 1 : AmbLiTransColor1Blue AmbLiTransColor1Green AmbLiTransColor1Red;
SIG_GROUP_ 304 AmbLiTransColor2 1 : AmbLiTransColor2Blue AmbLiTransColor2Green AmbLiTransColor2Red;
SIG_GROUP_ 432 ChrgLidCtrlHmiReq 1 : ChrgLidCtrlHmiReqACandDCchargelid ChrgLidCtrlHmiReqACchargelid ChrgLidCtrlHmiReqDCchargelid;
SIG_GROUP_ 304 ColrOfSreenZone1 1 : ColrOfSreenZone1Blue ColrOfSreenZone1Green ColrOfSreenZone1Red;
SIG_GROUP_ 304 ColrOfSreenZone2 1 : ColrOfSreenZone2Blue ColrOfSreenZone2Green ColrOfSreenZone2Red;
SIG_GROUP_ 304 DestinationPOI 1 : DestinationPOIPosnLat DestinationPOIPosnLgt;
SIG_GROUP_ 448 DrvrSeatTarPosnCmdReq 1 : DrvrSeatTarPosnCmdReqSeatBackrTargPosAg DrvrSeatTarPosnCmdReqSeatFrntHeiTargPosPerc DrvrSeatTarPosnCmdReqSeatHeiTargPosPerc DrvrSeatTarPosnCmdReqSeatLenTargPosPerc DrvrSeatTarPosnCmdReqTarPosnCmd;
SIG_GROUP_ 85 DwnLoadDynLtgPrmForFrntLeGrp1 1 : DwnLoadDynLtgPrmForFrntLeGrp1ContinueTime DwnLoadDynLtgPrmForFrntLeGrp1HighBrightness DwnLoadDynLtgPrmForFrntLeGrp1LowBrightness DwnLoadDynLtgPrmForFrntLeGrp1Mode1 DwnLoadDynLtgPrmForFrntLeGrp1OffsetTime DwnLoadDynLtgPrmForFrntLeGrp1Timestamp;
SIG_GROUP_ 85 DwnLoadDynLtgPrmForFrntLeGrp10 1 : DwnLoadDynLtgPrmForFrntLeGrp10ContinueTime DwnLoadDynLtgPrmForFrntLeGrp10HighBrightness DwnLoadDynLtgPrmForFrntLeGrp10LowBrightness DwnLoadDynLtgPrmForFrntLeGrp10Mode1 DwnLoadDynLtgPrmForFrntLeGrp10OffsetTime DwnLoadDynLtgPrmForFrntLeGrp10Timestamp;
SIG_GROUP_ 85 DwnLoadDynLtgPrmForFrntLeGrp11 1 : DwnLoadDynLtgPrmForFrntLeGrp11ContinueTime DwnLoadDynLtgPrmForFrntLeGrp11HighBrightness DwnLoadDynLtgPrmForFrntLeGrp11LowBrightness DwnLoadDynLtgPrmForFrntLeGrp11Mode1 DwnLoadDynLtgPrmForFrntLeGrp11OffsetTime DwnLoadDynLtgPrmForFrntLeGrp11Timestamp;
SIG_GROUP_ 85 DwnLoadDynLtgPrmForFrntLeGrp12 1 : DwnLoadDynLtgPrmForFrntLeGrp12ContinueTime DwnLoadDynLtgPrmForFrntLeGrp12HighBrightness DwnLoadDynLtgPrmForFrntLeGrp12LowBrightness DwnLoadDynLtgPrmForFrntLeGrp12Mode1 DwnLoadDynLtgPrmForFrntLeGrp12OffsetTime DwnLoadDynLtgPrmForFrntLeGrp12Timestamp;
SIG_GROUP_ 85 DwnLoadDynLtgPrmForFrntLeGrp2 1 : DwnLoadDynLtgPrmForFrntLeGrp2ContinueTime DwnLoadDynLtgPrmForFrntLeGrp2HighBrightness DwnLoadDynLtgPrmForFrntLeGrp2LowBrightness DwnLoadDynLtgPrmForFrntLeGrp2Mode1 DwnLoadDynLtgPrmForFrntLeGrp2OffsetTime DwnLoadDynLtgPrmForFrntLeGrp2Timestamp;
SIG_GROUP_ 85 DwnLoadDynLtgPrmForFrntLeGrp3 1 : DwnLoadDynLtgPrmForFrntLeGrp3ContinueTime DwnLoadDynLtgPrmForFrntLeGrp3HighBrightness DwnLoadDynLtgPrmForFrntLeGrp3LowBrightness DwnLoadDynLtgPrmForFrntLeGrp3Mode1 DwnLoadDynLtgPrmForFrntLeGrp3OffsetTime DwnLoadDynLtgPrmForFrntLeGrp3Timestamp;
SIG_GROUP_ 85 DwnLoadDynLtgPrmForFrntLeGrp4 1 : DwnLoadDynLtgPrmForFrntLeGrp4ContinueTime DwnLoadDynLtgPrmForFrntLeGrp4HighBrightness DwnLoadDynLtgPrmForFrntLeGrp4LowBrightness DwnLoadDynLtgPrmForFrntLeGrp4Mode1 DwnLoadDynLtgPrmForFrntLeGrp4OffsetTime DwnLoadDynLtgPrmForFrntLeGrp4Timestamp;
SIG_GROUP_ 85 DwnLoadDynLtgPrmForFrntLeGrp5 1 : DwnLoadDynLtgPrmForFrntLeGrp5ContinueTime DwnLoadDynLtgPrmForFrntLeGrp5HighBrightness DwnLoadDynLtgPrmForFrntLeGrp5LowBrightness DwnLoadDynLtgPrmForFrntLeGrp5Mode1 DwnLoadDynLtgPrmForFrntLeGrp5OffsetTime DwnLoadDynLtgPrmForFrntLeGrp5Timestamp;
SIG_GROUP_ 85 DwnLoadDynLtgPrmForFrntLeGrp6 1 : DwnLoadDynLtgPrmForFrntLeGrp6ContinueTime DwnLoadDynLtgPrmForFrntLeGrp6HighBrightness DwnLoadDynLtgPrmForFrntLeGrp6LowBrightness DwnLoadDynLtgPrmForFrntLeGrp6Mode1 DwnLoadDynLtgPrmForFrntLeGrp6OffsetTime DwnLoadDynLtgPrmForFrntLeGrp6Timestamp;
SIG_GROUP_ 85 DwnLoadDynLtgPrmForFrntLeGrp7 1 : DwnLoadDynLtgPrmForFrntLeGrp7ContinueTime DwnLoadDynLtgPrmForFrntLeGrp7HighBrightness DwnLoadDynLtgPrmForFrntLeGrp7LowBrightness DwnLoadDynLtgPrmForFrntLeGrp7Mode1 DwnLoadDynLtgPrmForFrntLeGrp7OffsetTime DwnLoadDynLtgPrmForFrntLeGrp7Timestamp;
SIG_GROUP_ 85 DwnLoadDynLtgPrmForFrntLeGrp8 1 : DwnLoadDynLtgPrmForFrntLeGrp8ContinueTime DwnLoadDynLtgPrmForFrntLeGrp8HighBrightness DwnLoadDynLtgPrmForFrntLeGrp8LowBrightness DwnLoadDynLtgPrmForFrntLeGrp8Mode1 DwnLoadDynLtgPrmForFrntLeGrp8OffsetTime DwnLoadDynLtgPrmForFrntLeGrp8Timestamp;
SIG_GROUP_ 85 DwnLoadDynLtgPrmForFrntLeGrp9 1 : DwnLoadDynLtgPrmForFrntLeGrp9ContinueTime DwnLoadDynLtgPrmForFrntLeGrp9HighBrightness DwnLoadDynLtgPrmForFrntLeGrp9LowBrightness DwnLoadDynLtgPrmForFrntLeGrp9Mode1 DwnLoadDynLtgPrmForFrntLeGrp9OffsetTime DwnLoadDynLtgPrmForFrntLeGrp9Timestamp;
SIG_GROUP_ 448 ExtrMirrFoldSetg 1 : ExtrMirrFoldSetgMirrDrvr ExtrMirrFoldSetgMirrPass;
SIG_GROUP_ 448 ExtrMirrTiltSetg 1 : ExtrMirrTiltSetgMirrDrvr ExtrMirrTiltSetgMirrPass;
SIG_GROUP_ 448 HmiCmptmtTSp 1 : HmiCmptmtTSpForRowFirstLe HmiCmptmtTSpForRowFirstRi HmiCmptmtTSpForRowSecLe HmiCmptmtTSpForRowSecRi HmiCmptmtTSpSpclForRowFirstLe HmiCmptmtTSpSpclForRowFirstRi HmiCmptmtTSpSpclForRowSecLe HmiCmptmtTSpSpclForRowSecRi;
SIG_GROUP_ 448 HmiElecAirAdpvReq 1 : HmiElecAirAdpvReqDrvrAdpv HmiElecAirAdpvReqPassAdpv;
SIG_GROUP_ 448 HmiElecAirDirCrtlReq 1 : HmiElecAirDirCrtlReqDrvrLePosX HmiElecAirDirCrtlReqDrvrLePosY HmiElecAirDirCrtlReqDrvrRiPosX HmiElecAirDirCrtlReqDrvrRiPosY HmiElecAirDirCrtlReqPassLePosX HmiElecAirDirCrtlReqPassLePosY HmiElecAirDirCrtlReqPassRiPosX HmiElecAirDirCrtlReqPassRiPosY;
SIG_GROUP_ 448 HmiElecAirDirModReq 1 : HmiElecAirDirModReqDrvrMod HmiElecAirDirModReqPassMod;
SIG_GROUP_ 448 HmiElecAirFrntSwtReq 1 : HmiElecAirFrntSwtReqHmiElecAirDrvrLeSwtReq HmiElecAirFrntSwtReqHmiElecAirDrvrRiSwtReq HmiElecAirFrntSwtReqHmiElecAirPassLeSwtReq HmiElecAirFrntSwtReqHmiElecAirPassRiSwtReq;
SIG_GROUP_ 448 HmiElecAirSwngReq 1 : HmiElecAirSwngReqDrvrLeRiSwng HmiElecAirSwngReqDrvrUpOnSwng HmiElecAirSwngReqPassLeRiSwng HmiElecAirSwngReqPassUpOnSwng;
SIG_GROUP_ 432 HMIToVMMSet 1 : HMIToVMMSetSetting1 HMIToVMMSetSetting2 HMIToVMMSetSetting3 HMIToVMMSetSetting4 HMIToVMMSetSetting5 HMIToVMMSetSetting6 HMIToVMMSetSetting7 HMIToVMMSetSetting8;
SIG_GROUP_ 304 ImobVehRemReqAndResp 1 : ImobVehRemReqAndRespImobVehDataRemReq0 ImobVehRemReqAndRespImobVehDataRemReq1 ImobVehRemReqAndRespImobVehDataRemReq2 ImobVehRemReqAndRespImobVehDataRemReq3 ImobVehRemReqAndRespImobVehDataRemReq4 ImobVehRemReqAndRespImobVehRemReqCmd ImobVehRemReqAndRespImobVehRemTmrOrSpdLim;
SIG_GROUP_ 304 MobDevRCVReq1 1 : MobDevRCVReq1Chks MobDevRCVReq1Cntr MobDevRCVReq1MobDevSts MobDevRCVReq1RCVCtrl MobDevRCVReq1Steertrim;
SIG_GROUP_ 432 PassSeatTarPosnCmdReq 1 : PassSeatTarPosnCmdReqSeatBackrTargPosAg PassSeatTarPosnCmdReqSeatFrntHeiTargPosPerc PassSeatTarPosnCmdReqSeatHeiTargPosPerc PassSeatTarPosnCmdReqSeatLenTargPosPerc PassSeatTarPosnCmdReqSeatPosFrntExtPerc PassSeatTarPosnCmdReqTarPosnCmd;
SIG_GROUP_ 85 RemStrtHvCtrlReq 1 : RemStrtHvCtrlReqErsCmd RemStrtHvCtrlReqErsRunTime;
SIG_GROUP_ 432 SecRowLeSeatDispMassgFct 1 : SecRowLeSeatDispMassgFctMassgInten SecRowLeSeatDispMassgFctMassgProg SecRowLeSeatDispMassgFctOnOffl2;
SIG_GROUP_ 432 SecRowRiSeatDispMassgFct 1 : SecRowRiSeatDispMassgFctMassgInten SecRowRiSeatDispMassgFctMassgProg SecRowRiSeatDispMassgFctOnOffl2;
SIG_GROUP_ 448 SetTiAndDate 1 : SetTiAndDateDateOrTi SetTiAndDateDay SetTiAndDateHour SetTiAndDateMinute SetTiAndDateMonth SetTiAndDateSecond SetTiAndDateYear;
SIG_GROUP_ 432 SoftLiBtnSwtSetReq 1 : SoftLiBtnSwtSetReqChks SoftLiBtnSwtSetReqCntr SoftLiBtnSwtSetReqLiExtFctReq1;
SIG_GROUP_ 448 SteerTarPosnCmdReq 1 : SteerTarPosnCmdReqSteerWhlPosnAng SteerTarPosnCmdReqSteerWhlPosnX SteerTarPosnCmdReqTarPosnCmd;
SIG_GROUP_ 432 ThrdRowLeSeatDispMassgFct 1 : ThrdRowLeSeatDispMassgFctMassgInten ThrdRowLeSeatDispMassgFctMassgProg ThrdRowLeSeatDispMassgFctOnOffl2;
SIG_GROUP_ 432 ThrdRowRiSeatDispMassgFct 1 : ThrdRowRiSeatDispMassgFctMassgInten ThrdRowRiSeatDispMassgFctMassgProg ThrdRowRiSeatDispMassgFctOnOffl2;
SIG_GROUP_ 448 TiAndDateGNSS 1 : TiAndDateGNSSDataValid TiAndDateGNSSDay TiAndDateGNSSHr1 TiAndDateGNSSMins1 TiAndDateGNSSMth1 TiAndDateGNSSSec1 TiAndDateGNSSYr1;
SIG_GROUP_ 432 TiToDestNavRoute 1 : TiToDestNavRouteDay2 TiToDestNavRouteHr1 TiToDestNavRouteMins1;
