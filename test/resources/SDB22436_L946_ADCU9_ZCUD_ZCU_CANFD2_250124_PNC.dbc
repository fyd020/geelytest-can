// *************************************************************************** *
// *                                                                           *
// * Description:         CANDB File                                           *
// * Generated at:        2025-01-24 14:38                                     *
// * System:              SDB22436                                             *
// * Variant:             L946_ADCU9_ZCUD                                      *
// * Network:             ZCU_CANFD2                                           *
// *                                                                           *
// *************************************************************************** *
VERSION "ZCU_CANFD2"

NS_ :

BS_ :

BU_ :  ETC IHU ZCUD ZCUP

BO_ 89 DhuZCUCANFD2Fr05 : 64 IHU
 SG_ DwnLoadDynLtgPrmForFrntLeGrp13_UB : 36|1@0+ (1,0) [0|1] "" ZCUD
 SG_ DwnLoadDynLtgPrmForFrntLeGrp13ContinueTime : 7|8@0+ (1.0,0.0) [0.0|255.0] "Unitless" ZCUD
 SG_ DwnLoadDynLtgPrmForFrntLeGrp13HighBrightness : 15|4@0+ (1.0,0.0) [0.0|10.0] "Unitless" ZCUD
 SG_ DwnLoadDynLtgPrmForFrntLeGrp13LowBrightness : 11|4@0+ (1.0,0.0) [0.0|10.0] "Unitless" ZCUD
 SG_ DwnLoadDynLtgPrmForFrntLeGrp13Mode1 : 23|6@0+ (1,0) [0|63] "" ZCUD
 SG_ DwnLoadDynLtgPrmForFrntLeGrp13OffsetTime : 31|6@0+ (1.0,0.0) [0.0|63.0] "Unitless" ZCUD
 SG_ DwnLoadDynLtgPrmForFrntLeGrp13Timestamp : 39|3@0+ (1.0,0.0) [0.0|7.0] "Unitless" ZCUD
 SG_ DwnLoadDynLtgPrmForFrntLeGrp14_UB : 76|1@0+ (1,0) [0|1] "" ZCUD
 SG_ DwnLoadDynLtgPrmForFrntLeGrp14ContinueTime : 47|8@0+ (1.0,0.0) [0.0|255.0] "Unitless" ZCUD
 SG_ DwnLoadDynLtgPrmForFrntLeGrp14HighBrightness : 55|4@0+ (1.0,0.0) [0.0|10.0] "Unitless" ZCUD
 SG_ DwnLoadDynLtgPrmForFrntLeGrp14LowBrightness : 51|4@0+ (1.0,0.0) [0.0|10.0] "Unitless" ZCUD
 SG_ DwnLoadDynLtgPrmForFrntLeGrp14Mode1 : 63|6@0+ (1,0) [0|63] "" ZCUD
 SG_ DwnLoadDynLtgPrmForFrntLeGrp14OffsetTime : 71|6@0+ (1.0,0.0) [0.0|63.0] "Unitless" ZCUD
 SG_ DwnLoadDynLtgPrmForFrntLeGrp14Timestamp : 79|3@0+ (1.0,0.0) [0.0|7.0] "Unitless" ZCUD
 SG_ DwnLoadDynLtgPrmForFrntLeGrp15_UB : 116|1@0+ (1,0) [0|1] "" ZCUD
 SG_ DwnLoadDynLtgPrmForFrntLeGrp15ContinueTime : 87|8@0+ (1.0,0.0) [0.0|255.0] "Unitless" ZCUD
 SG_ DwnLoadDynLtgPrmForFrntLeGrp15HighBrightness : 95|4@0+ (1.0,0.0) [0.0|10.0] "Unitless" ZCUD
 SG_ DwnLoadDynLtgPrmForFrntLeGrp15LowBrightness : 91|4@0+ (1.0,0.0) [0.0|10.0] "Unitless" ZCUD
 SG_ DwnLoadDynLtgPrmForFrntLeGrp15Mode1 : 103|6@0+ (1,0) [0|63] "" ZCUD
 SG_ DwnLoadDynLtgPrmForFrntLeGrp15OffsetTime : 111|6@0+ (1.0,0.0) [0.0|63.0] "Unitless" ZCUD
 SG_ DwnLoadDynLtgPrmForFrntLeGrp15Timestamp : 119|3@0+ (1.0,0.0) [0.0|7.0] "Unitless" ZCUD
 SG_ DwnLoadDynLtgPrmForFrntLeGrp16_UB : 156|1@0+ (1,0) [0|1] "" ZCUD
 SG_ DwnLoadDynLtgPrmForFrntLeGrp16ContinueTime : 127|8@0+ (1.0,0.0) [0.0|255.0] "Unitless" ZCUD
 SG_ DwnLoadDynLtgPrmForFrntLeGrp16HighBrightness : 135|4@0+ (1.0,0.0) [0.0|10.0] "Unitless" ZCUD
 SG_ DwnLoadDynLtgPrmForFrntLeGrp16LowBrightness : 131|4@0+ (1.0,0.0) [0.0|10.0] "Unitless" ZCUD
 SG_ DwnLoadDynLtgPrmForFrntLeGrp16Mode1 : 143|6@0+ (1,0) [0|63] "" ZCUD
 SG_ DwnLoadDynLtgPrmForFrntLeGrp16OffsetTime : 151|6@0+ (1.0,0.0) [0.0|63.0] "Unitless" ZCUD
 SG_ DwnLoadDynLtgPrmForFrntLeGrp16Timestamp : 159|3@0+ (1.0,0.0) [0.0|7.0] "Unitless" ZCUD
 SG_ DwnLoadDynLtgPrmForFrntLeGrp17_UB : 196|1@0+ (1,0) [0|1] "" ZCUD
 SG_ DwnLoadDynLtgPrmForFrntLeGrp17ContinueTime : 167|8@0+ (1.0,0.0) [0.0|255.0] "Unitless" ZCUD
 SG_ DwnLoadDynLtgPrmForFrntLeGrp17HighBrightness : 175|4@0+ (1.0,0.0) [0.0|10.0] "Unitless" ZCUD
 SG_ DwnLoadDynLtgPrmForFrntLeGrp17LowBrightness : 171|4@0+ (1.0,0.0) [0.0|10.0] "Unitless" ZCUD
 SG_ DwnLoadDynLtgPrmForFrntLeGrp17Mode1 : 183|6@0+ (1,0) [0|63] "" ZCUD
 SG_ DwnLoadDynLtgPrmForFrntLeGrp17OffsetTime : 191|6@0+ (1.0,0.0) [0.0|63.0] "Unitless" ZCUD
 SG_ DwnLoadDynLtgPrmForFrntLeGrp17Timestamp : 199|3@0+ (1.0,0.0) [0.0|7.0] "Unitless" ZCUD
 SG_ DwnLoadDynLtgPrmForFrntLeGrp18_UB : 236|1@0+ (1,0) [0|1] "" ZCUD
 SG_ DwnLoadDynLtgPrmForFrntLeGrp18ContinueTime : 207|8@0+ (1.0,0.0) [0.0|255.0] "Unitless" ZCUD
 SG_ DwnLoadDynLtgPrmForFrntLeGrp18HighBrightness : 215|4@0+ (1.0,0.0) [0.0|10.0] "Unitless" ZCUD
 SG_ DwnLoadDynLtgPrmForFrntLeGrp18LowBrightness : 211|4@0+ (1.0,0.0) [0.0|10.0] "Unitless" ZCUD
 SG_ DwnLoadDynLtgPrmForFrntLeGrp18Mode1 : 223|6@0+ (1,0) [0|63] "" ZCUD
 SG_ DwnLoadDynLtgPrmForFrntLeGrp18OffsetTime : 231|6@0+ (1.0,0.0) [0.0|63.0] "Unitless" ZCUD
 SG_ DwnLoadDynLtgPrmForFrntLeGrp18Timestamp : 239|3@0+ (1.0,0.0) [0.0|7.0] "Unitless" ZCUD
 SG_ DwnLoadDynLtgPrmForFrntLeGrp19_UB : 276|1@0+ (1,0) [0|1] "" ZCUD
 SG_ DwnLoadDynLtgPrmForFrntLeGrp19ContinueTime : 247|8@0+ (1.0,0.0) [0.0|255.0] "Unitless" ZCUD
 SG_ DwnLoadDynLtgPrmForFrntLeGrp19HighBrightness : 255|4@0+ (1.0,0.0) [0.0|10.0] "Unitless" ZCUD
 SG_ DwnLoadDynLtgPrmForFrntLeGrp19LowBrightness : 251|4@0+ (1.0,0.0) [0.0|10.0] "Unitless" ZCUD
 SG_ DwnLoadDynLtgPrmForFrntLeGrp19Mode1 : 263|6@0+ (1,0) [0|63] "" ZCUD
 SG_ DwnLoadDynLtgPrmForFrntLeGrp19OffsetTime : 271|6@0+ (1.0,0.0) [0.0|63.0] "Unitless" ZCUD
 SG_ DwnLoadDynLtgPrmForFrntLeGrp19Timestamp : 279|3@0+ (1.0,0.0) [0.0|7.0] "Unitless" ZCUD
 SG_ DwnLoadDynLtgPrmForFrntLeGrp20_UB : 316|1@0+ (1,0) [0|1] "" ZCUD
 SG_ DwnLoadDynLtgPrmForFrntLeGrp20ContinueTime : 287|8@0+ (1.0,0.0) [0.0|255.0] "Unitless" ZCUD
 SG_ DwnLoadDynLtgPrmForFrntLeGrp20HighBrightness : 295|4@0+ (1.0,0.0) [0.0|10.0] "Unitless" ZCUD
 SG_ DwnLoadDynLtgPrmForFrntLeGrp20LowBrightness : 291|4@0+ (1.0,0.0) [0.0|10.0] "Unitless" ZCUD
 SG_ DwnLoadDynLtgPrmForFrntLeGrp20Mode1 : 303|6@0+ (1,0) [0|63] "" ZCUD
 SG_ DwnLoadDynLtgPrmForFrntLeGrp20OffsetTime : 311|6@0+ (1.0,0.0) [0.0|63.0] "Unitless" ZCUD
 SG_ DwnLoadDynLtgPrmForFrntLeGrp20Timestamp : 319|3@0+ (1.0,0.0) [0.0|7.0] "Unitless" ZCUD
 SG_ DwnLoadDynLtgPrmForFrntLeGrp21_UB : 356|1@0+ (1,0) [0|1] "" ZCUD
 SG_ DwnLoadDynLtgPrmForFrntLeGrp21ContinueTime : 327|8@0+ (1.0,0.0) [0.0|255.0] "Unitless" ZCUD
 SG_ DwnLoadDynLtgPrmForFrntLeGrp21HighBrightness : 335|4@0+ (1.0,0.0) [0.0|10.0] "Unitless" ZCUD
 SG_ DwnLoadDynLtgPrmForFrntLeGrp21LowBrightness : 331|4@0+ (1.0,0.0) [0.0|10.0] "Unitless" ZCUD
 SG_ DwnLoadDynLtgPrmForFrntLeGrp21Mode1 : 343|6@0+ (1,0) [0|63] "" ZCUD
 SG_ DwnLoadDynLtgPrmForFrntLeGrp21OffsetTime : 351|6@0+ (1.0,0.0) [0.0|63.0] "Unitless" ZCUD
 SG_ DwnLoadDynLtgPrmForFrntLeGrp21Timestamp : 359|3@0+ (1.0,0.0) [0.0|7.0] "Unitless" ZCUD
 SG_ DwnLoadDynLtgPrmForFrntLeGrp22_UB : 396|1@0+ (1,0) [0|1] "" ZCUD
 SG_ DwnLoadDynLtgPrmForFrntLeGrp22ContinueTime : 367|8@0+ (1.0,0.0) [0.0|255.0] "Unitless" ZCUD
 SG_ DwnLoadDynLtgPrmForFrntLeGrp22HighBrightness : 375|4@0+ (1.0,0.0) [0.0|10.0] "Unitless" ZCUD
 SG_ DwnLoadDynLtgPrmForFrntLeGrp22LowBrightness : 371|4@0+ (1.0,0.0) [0.0|10.0] "Unitless" ZCUD
 SG_ DwnLoadDynLtgPrmForFrntLeGrp22Mode1 : 383|6@0+ (1,0) [0|63] "" ZCUD
 SG_ DwnLoadDynLtgPrmForFrntLeGrp22OffsetTime : 391|6@0+ (1.0,0.0) [0.0|63.0] "Unitless" ZCUD
 SG_ DwnLoadDynLtgPrmForFrntLeGrp22Timestamp : 399|3@0+ (1.0,0.0) [0.0|7.0] "Unitless" ZCUD
 SG_ DwnLoadDynLtgPrmForFrntLeGrp23_UB : 436|1@0+ (1,0) [0|1] "" ZCUD
 SG_ DwnLoadDynLtgPrmForFrntLeGrp23ContinueTime : 407|8@0+ (1.0,0.0) [0.0|255.0] "Unitless" ZCUD
 SG_ DwnLoadDynLtgPrmForFrntLeGrp23HighBrightness : 415|4@0+ (1.0,0.0) [0.0|10.0] "Unitless" ZCUD
 SG_ DwnLoadDynLtgPrmForFrntLeGrp23LowBrightness : 411|4@0+ (1.0,0.0) [0.0|10.0] "Unitless" ZCUD
 SG_ DwnLoadDynLtgPrmForFrntLeGrp23Mode1 : 423|6@0+ (1,0) [0|63] "" ZCUD
 SG_ DwnLoadDynLtgPrmForFrntLeGrp23OffsetTime : 431|6@0+ (1.0,0.0) [0.0|63.0] "Unitless" ZCUD
 SG_ DwnLoadDynLtgPrmForFrntLeGrp23Timestamp : 439|3@0+ (1.0,0.0) [0.0|7.0] "Unitless" ZCUD
 SG_ DwnLoadDynLtgPrmForFrntLeGrp24_UB : 476|1@0+ (1,0) [0|1] "" ZCUD
 SG_ DwnLoadDynLtgPrmForFrntLeGrp24ContinueTime : 447|8@0+ (1.0,0.0) [0.0|255.0] "Unitless" ZCUD
 SG_ DwnLoadDynLtgPrmForFrntLeGrp24HighBrightness : 455|4@0+ (1.0,0.0) [0.0|10.0] "Unitless" ZCUD
 SG_ DwnLoadDynLtgPrmForFrntLeGrp24LowBrightness : 451|4@0+ (1.0,0.0) [0.0|10.0] "Unitless" ZCUD
 SG_ DwnLoadDynLtgPrmForFrntLeGrp24Mode1 : 463|6@0+ (1,0) [0|63] "" ZCUD
 SG_ DwnLoadDynLtgPrmForFrntLeGrp24OffsetTime : 471|6@0+ (1.0,0.0) [0.0|63.0] "Unitless" ZCUD
 SG_ DwnLoadDynLtgPrmForFrntLeGrp24Timestamp : 479|3@0+ (1.0,0.0) [0.0|7.0] "Unitless" ZCUD
 SG_ TelmAirFragTasteReq : 35|3@0+ (1,0) [0|7] "" ZCUP
 SG_ TelmAirFragTasteReq_UB : 32|1@0+ (1,0) [0|1] "" ZCUP
 SG_ TelmBookClimaTmr : 487|16@0+ (1.0,0.0) [0.0|65535.0] "s" ZCUP
 SG_ TelmBookClimaTmr_UB : 434|1@0+ (1,0) [0|1] "" ZCUP
 SG_ TelmClimaReq : 73|2@0+ (1,0) [0|3] "" ZCUP
 SG_ TelmClimaReq_UB : 433|1@0+ (1,0) [0|1] "" ZCUP
 SG_ TelmDefrostReq : 115|2@0+ (1,0) [0|3] "" ZCUP
 SG_ TelmDefrostReq_UB : 432|1@0+ (1,0) [0|1] "" ZCUP
 SG_ TelmLockgCenReq_UB : 393|1@0+ (1,0) [0|1] "" ZCUD
 SG_ TelmLockgCenReqReqTyp : 507|2@0+ (1,0) [0|3] "" ZCUD
 SG_ TelmLockgCenReqTiVld : 511|4@0+ (1.0,0.0) [0.0|15.0] "Unitless" ZCUD
 SG_ TelmPM25Req : 392|1@0+ (1,0) [0|1] "" ZCUP
 SG_ TelmPM25Req_UB : 475|1@0+ (1,0) [0|1] "" ZCUP
 SG_ TelmPreClimaPrio : 113|2@0+ (1,0) [0|3] "" ZCUD
 SG_ TelmPreClimaPrio_UB : 474|1@0+ (1,0) [0|1] "" ZCUD
 SG_ TelmSeatDrvHeatClimaLvl : 155|2@0+ (1,0) [0|3] "" ZCUP
 SG_ TelmSeatDrvHeatClimaLvl_UB : 473|1@0+ (1,0) [0|1] "" ZCUP
 SG_ TelmSeatDrvVentnClimaLvl : 153|2@0+ (1,0) [0|3] "" ZCUP
 SG_ TelmSeatDrvVentnClimaLvl_UB : 472|1@0+ (1,0) [0|1] "" ZCUP
 SG_ TelmSeatPassHeatClimaLvl : 195|2@0+ (1,0) [0|3] "" ZCUP
 SG_ TelmSeatPassHeatClimaLvl_UB : 496|1@0+ (1,0) [0|1] "" ZCUP
 SG_ TelmSeatPassVentnClimaLvl : 193|2@0+ (1,0) [0|3] "" ZCUP
 SG_ TelmSeatPassVentnClimaLvl_UB : 497|1@0+ (1,0) [0|1] "" ZCUP
 SG_ TelmSeatSecLeHeatClimaLvl : 235|2@0+ (1,0) [0|3] "" ZCUP
 SG_ TelmSeatSecLeHeatClimaLvl_UB : 498|1@0+ (1,0) [0|1] "" ZCUP
 SG_ TelmSeatSecLeVentnClimaLvl : 233|2@0+ (1,0) [0|3] "" ZCUP
 SG_ TelmSeatSecLeVentnClimaLvl_UB : 499|1@0+ (1,0) [0|1] "" ZCUP
 SG_ TelmSeatSecRiHeatClimaLvl : 275|2@0+ (1,0) [0|3] "" ZCUP
 SG_ TelmSeatSecRiHeatClimaLvl_UB : 500|1@0+ (1,0) [0|1] "" ZCUP
 SG_ TelmSeatSecRiVentnClimaLvl : 273|2@0+ (1,0) [0|3] "" ZCUP
 SG_ TelmSeatSecRiVentnClimaLvl_UB : 501|1@0+ (1,0) [0|1] "" ZCUP
 SG_ TelmSeatThrdLeHeatClimaLvl : 315|2@0+ (1,0) [0|3] "" ZCUP
 SG_ TelmSeatThrdLeHeatClimaLvl_UB : 502|1@0+ (1,0) [0|1] "" ZCUP
 SG_ TelmSeatThrdLeVentnClimaLvl : 313|2@0+ (1,0) [0|3] "" ZCUP
 SG_ TelmSeatThrdLeVentnClimaLvl_UB : 503|1@0+ (1,0) [0|1] "" ZCUP
 SG_ TelmSeatThrdRiHeatClimaLvl : 355|2@0+ (1,0) [0|3] "" ZCUP
 SG_ TelmSeatThrdRiHeatClimaLvl_UB : 504|1@0+ (1,0) [0|1] "" ZCUP
 SG_ TelmSeatThrdRiVentnClimaLvl : 353|2@0+ (1,0) [0|3] "" ZCUP
 SG_ TelmSeatThrdRiVentnClimaLvl_UB : 505|1@0+ (1,0) [0|1] "" ZCUP

BO_ 99 DhuZCUCANFD2Fr06 : 64 IHU
 SG_ DwnLoadDynLtgPrmForFrntRIGrp1_UB : 36|1@0+ (1,0) [0|1] "" ZCUD
 SG_ DwnLoadDynLtgPrmForFrntRIGrp10_UB : 396|1@0+ (1,0) [0|1] "" ZCUD
 SG_ DwnLoadDynLtgPrmForFrntRIGrp10ContinueTime : 367|8@0+ (1.0,0.0) [0.0|255.0] "Unitless" ZCUD
 SG_ DwnLoadDynLtgPrmForFrntRIGrp10HighBrightness : 375|4@0+ (1.0,0.0) [0.0|10.0] "Unitless" ZCUD
 SG_ DwnLoadDynLtgPrmForFrntRIGrp10LowBrightness : 371|4@0+ (1.0,0.0) [0.0|10.0] "Unitless" ZCUD
 SG_ DwnLoadDynLtgPrmForFrntRIGrp10Mode1 : 383|6@0+ (1,0) [0|63] "" ZCUD
 SG_ DwnLoadDynLtgPrmForFrntRIGrp10OffsetTime : 391|6@0+ (1.0,0.0) [0.0|63.0] "Unitless" ZCUD
 SG_ DwnLoadDynLtgPrmForFrntRIGrp10Timestamp : 399|3@0+ (1.0,0.0) [0.0|7.0] "Unitless" ZCUD
 SG_ DwnLoadDynLtgPrmForFrntRIGrp11_UB : 436|1@0+ (1,0) [0|1] "" ZCUD
 SG_ DwnLoadDynLtgPrmForFrntRIGrp11ContinueTime : 407|8@0+ (1.0,0.0) [0.0|255.0] "Unitless" ZCUD
 SG_ DwnLoadDynLtgPrmForFrntRIGrp11HighBrightness : 415|4@0+ (1.0,0.0) [0.0|10.0] "Unitless" ZCUD
 SG_ DwnLoadDynLtgPrmForFrntRIGrp11LowBrightness : 411|4@0+ (1.0,0.0) [0.0|10.0] "Unitless" ZCUD
 SG_ DwnLoadDynLtgPrmForFrntRIGrp11Mode1 : 423|6@0+ (1,0) [0|63] "" ZCUD
 SG_ DwnLoadDynLtgPrmForFrntRIGrp11OffsetTime : 431|6@0+ (1.0,0.0) [0.0|63.0] "Unitless" ZCUD
 SG_ DwnLoadDynLtgPrmForFrntRIGrp11Timestamp : 439|3@0+ (1.0,0.0) [0.0|7.0] "Unitless" ZCUD
 SG_ DwnLoadDynLtgPrmForFrntRIGrp12_UB : 476|1@0+ (1,0) [0|1] "" ZCUD
 SG_ DwnLoadDynLtgPrmForFrntRIGrp12ContinueTime : 447|8@0+ (1.0,0.0) [0.0|255.0] "Unitless" ZCUD
 SG_ DwnLoadDynLtgPrmForFrntRIGrp12HighBrightness : 455|4@0+ (1.0,0.0) [0.0|10.0] "Unitless" ZCUD
 SG_ DwnLoadDynLtgPrmForFrntRIGrp12LowBrightness : 451|4@0+ (1.0,0.0) [0.0|10.0] "Unitless" ZCUD
 SG_ DwnLoadDynLtgPrmForFrntRIGrp12Mode1 : 463|6@0+ (1,0) [0|63] "" ZCUD
 SG_ DwnLoadDynLtgPrmForFrntRIGrp12OffsetTime : 471|6@0+ (1.0,0.0) [0.0|63.0] "Unitless" ZCUD
 SG_ DwnLoadDynLtgPrmForFrntRIGrp12Timestamp : 479|3@0+ (1.0,0.0) [0.0|7.0] "Unitless" ZCUD
 SG_ DwnLoadDynLtgPrmForFrntRIGrp1ContinueTime : 7|8@0+ (1.0,0.0) [0.0|255.0] "Unitless" ZCUD
 SG_ DwnLoadDynLtgPrmForFrntRIGrp1HighBrightness : 15|4@0+ (1.0,0.0) [0.0|10.0] "Unitless" ZCUD
 SG_ DwnLoadDynLtgPrmForFrntRIGrp1LowBrightness : 11|4@0+ (1.0,0.0) [0.0|10.0] "Unitless" ZCUD
 SG_ DwnLoadDynLtgPrmForFrntRIGrp1Mode1 : 23|6@0+ (1,0) [0|63] "" ZCUD
 SG_ DwnLoadDynLtgPrmForFrntRIGrp1OffsetTime : 31|6@0+ (1.0,0.0) [0.0|63.0] "Unitless" ZCUD
 SG_ DwnLoadDynLtgPrmForFrntRIGrp1Timestamp : 39|3@0+ (1.0,0.0) [0.0|7.0] "Unitless" ZCUD
 SG_ DwnLoadDynLtgPrmForFrntRIGrp2_UB : 76|1@0+ (1,0) [0|1] "" ZCUD
 SG_ DwnLoadDynLtgPrmForFrntRIGrp2ContinueTime : 47|8@0+ (1.0,0.0) [0.0|255.0] "Unitless" ZCUD
 SG_ DwnLoadDynLtgPrmForFrntRIGrp2HighBrightness : 55|4@0+ (1.0,0.0) [0.0|10.0] "Unitless" ZCUD
 SG_ DwnLoadDynLtgPrmForFrntRIGrp2LowBrightness : 51|4@0+ (1.0,0.0) [0.0|10.0] "Unitless" ZCUD
 SG_ DwnLoadDynLtgPrmForFrntRIGrp2Mode1 : 63|6@0+ (1,0) [0|63] "" ZCUD
 SG_ DwnLoadDynLtgPrmForFrntRIGrp2OffsetTime : 71|6@0+ (1.0,0.0) [0.0|63.0] "Unitless" ZCUD
 SG_ DwnLoadDynLtgPrmForFrntRIGrp2Timestamp : 79|3@0+ (1.0,0.0) [0.0|7.0] "Unitless" ZCUD
 SG_ DwnLoadDynLtgPrmForFrntRIGrp3_UB : 116|1@0+ (1,0) [0|1] "" ZCUD
 SG_ DwnLoadDynLtgPrmForFrntRIGrp3ContinueTime : 87|8@0+ (1.0,0.0) [0.0|255.0] "Unitless" ZCUD
 SG_ DwnLoadDynLtgPrmForFrntRIGrp3HighBrightness : 95|4@0+ (1.0,0.0) [0.0|10.0] "Unitless" ZCUD
 SG_ DwnLoadDynLtgPrmForFrntRIGrp3LowBrightness : 91|4@0+ (1.0,0.0) [0.0|10.0] "Unitless" ZCUD
 SG_ DwnLoadDynLtgPrmForFrntRIGrp3Mode1 : 103|6@0+ (1,0) [0|63] "" ZCUD
 SG_ DwnLoadDynLtgPrmForFrntRIGrp3OffsetTime : 111|6@0+ (1.0,0.0) [0.0|63.0] "Unitless" ZCUD
 SG_ DwnLoadDynLtgPrmForFrntRIGrp3Timestamp : 119|3@0+ (1.0,0.0) [0.0|7.0] "Unitless" ZCUD
 SG_ DwnLoadDynLtgPrmForFrntRIGrp4_UB : 156|1@0+ (1,0) [0|1] "" ZCUD
 SG_ DwnLoadDynLtgPrmForFrntRIGrp4ContinueTime : 127|8@0+ (1.0,0.0) [0.0|255.0] "Unitless" ZCUD
 SG_ DwnLoadDynLtgPrmForFrntRIGrp4HighBrightness : 135|4@0+ (1.0,0.0) [0.0|10.0] "Unitless" ZCUD
 SG_ DwnLoadDynLtgPrmForFrntRIGrp4LowBrightness : 131|4@0+ (1.0,0.0) [0.0|10.0] "Unitless" ZCUD
 SG_ DwnLoadDynLtgPrmForFrntRIGrp4Mode1 : 143|6@0+ (1,0) [0|63] "" ZCUD
 SG_ DwnLoadDynLtgPrmForFrntRIGrp4OffsetTime : 151|6@0+ (1.0,0.0) [0.0|63.0] "Unitless" ZCUD
 SG_ DwnLoadDynLtgPrmForFrntRIGrp4Timestamp : 159|3@0+ (1.0,0.0) [0.0|7.0] "Unitless" ZCUD
 SG_ DwnLoadDynLtgPrmForFrntRIGrp5_UB : 196|1@0+ (1,0) [0|1] "" ZCUD
 SG_ DwnLoadDynLtgPrmForFrntRIGrp5ContinueTime : 167|8@0+ (1.0,0.0) [0.0|255.0] "Unitless" ZCUD
 SG_ DwnLoadDynLtgPrmForFrntRIGrp5HighBrightness : 175|4@0+ (1.0,0.0) [0.0|10.0] "Unitless" ZCUD
 SG_ DwnLoadDynLtgPrmForFrntRIGrp5LowBrightness : 171|4@0+ (1.0,0.0) [0.0|10.0] "Unitless" ZCUD
 SG_ DwnLoadDynLtgPrmForFrntRIGrp5Mode1 : 183|6@0+ (1,0) [0|63] "" ZCUD
 SG_ DwnLoadDynLtgPrmForFrntRIGrp5OffsetTime : 191|6@0+ (1.0,0.0) [0.0|63.0] "Unitless" ZCUD
 SG_ DwnLoadDynLtgPrmForFrntRIGrp5Timestamp : 199|3@0+ (1.0,0.0) [0.0|7.0] "Unitless" ZCUD
 SG_ DwnLoadDynLtgPrmForFrntRIGrp6_UB : 236|1@0+ (1,0) [0|1] "" ZCUD
 SG_ DwnLoadDynLtgPrmForFrntRIGrp6ContinueTime : 207|8@0+ (1.0,0.0) [0.0|255.0] "Unitless" ZCUD
 SG_ DwnLoadDynLtgPrmForFrntRIGrp6HighBrightness : 215|4@0+ (1.0,0.0) [0.0|10.0] "Unitless" ZCUD
 SG_ DwnLoadDynLtgPrmForFrntRIGrp6LowBrightness : 211|4@0+ (1.0,0.0) [0.0|10.0] "Unitless" ZCUD
 SG_ DwnLoadDynLtgPrmForFrntRIGrp6Mode1 : 223|6@0+ (1,0) [0|63] "" ZCUD
 SG_ DwnLoadDynLtgPrmForFrntRIGrp6OffsetTime : 231|6@0+ (1.0,0.0) [0.0|63.0] "Unitless" ZCUD
 SG_ DwnLoadDynLtgPrmForFrntRIGrp6Timestamp : 239|3@0+ (1.0,0.0) [0.0|7.0] "Unitless" ZCUD
 SG_ DwnLoadDynLtgPrmForFrntRIGrp7_UB : 276|1@0+ (1,0) [0|1] "" ZCUD
 SG_ DwnLoadDynLtgPrmForFrntRIGrp7ContinueTime : 247|8@0+ (1.0,0.0) [0.0|255.0] "Unitless" ZCUD
 SG_ DwnLoadDynLtgPrmForFrntRIGrp7HighBrightness : 255|4@0+ (1.0,0.0) [0.0|10.0] "Unitless" ZCUD
 SG_ DwnLoadDynLtgPrmForFrntRIGrp7LowBrightness : 251|4@0+ (1.0,0.0) [0.0|10.0] "Unitless" ZCUD
 SG_ DwnLoadDynLtgPrmForFrntRIGrp7Mode1 : 263|6@0+ (1,0) [0|63] "" ZCUD
 SG_ DwnLoadDynLtgPrmForFrntRIGrp7OffsetTime : 271|6@0+ (1.0,0.0) [0.0|63.0] "Unitless" ZCUD
 SG_ DwnLoadDynLtgPrmForFrntRIGrp7Timestamp : 279|3@0+ (1.0,0.0) [0.0|7.0] "Unitless" ZCUD
 SG_ DwnLoadDynLtgPrmForFrntRIGrp8_UB : 316|1@0+ (1,0) [0|1] "" ZCUD
 SG_ DwnLoadDynLtgPrmForFrntRIGrp8ContinueTime : 287|8@0+ (1.0,0.0) [0.0|255.0] "Unitless" ZCUD
 SG_ DwnLoadDynLtgPrmForFrntRIGrp8HighBrightness : 295|4@0+ (1.0,0.0) [0.0|10.0] "Unitless" ZCUD
 SG_ DwnLoadDynLtgPrmForFrntRIGrp8LowBrightness : 291|4@0+ (1.0,0.0) [0.0|10.0] "Unitless" ZCUD
 SG_ DwnLoadDynLtgPrmForFrntRIGrp8Mode1 : 303|6@0+ (1,0) [0|63] "" ZCUD
 SG_ DwnLoadDynLtgPrmForFrntRIGrp8OffsetTime : 311|6@0+ (1.0,0.0) [0.0|63.0] "Unitless" ZCUD
 SG_ DwnLoadDynLtgPrmForFrntRIGrp8Timestamp : 319|3@0+ (1.0,0.0) [0.0|7.0] "Unitless" ZCUD
 SG_ DwnLoadDynLtgPrmForFrntRIGrp9_UB : 356|1@0+ (1,0) [0|1] "" ZCUD
 SG_ DwnLoadDynLtgPrmForFrntRIGrp9ContinueTime : 327|8@0+ (1.0,0.0) [0.0|255.0] "Unitless" ZCUD
 SG_ DwnLoadDynLtgPrmForFrntRIGrp9HighBrightness : 335|4@0+ (1.0,0.0) [0.0|10.0] "Unitless" ZCUD
 SG_ DwnLoadDynLtgPrmForFrntRIGrp9LowBrightness : 331|4@0+ (1.0,0.0) [0.0|10.0] "Unitless" ZCUD
 SG_ DwnLoadDynLtgPrmForFrntRIGrp9Mode1 : 343|6@0+ (1,0) [0|63] "" ZCUD
 SG_ DwnLoadDynLtgPrmForFrntRIGrp9OffsetTime : 351|6@0+ (1.0,0.0) [0.0|63.0] "Unitless" ZCUD
 SG_ DwnLoadDynLtgPrmForFrntRIGrp9Timestamp : 359|3@0+ (1.0,0.0) [0.0|7.0] "Unitless" ZCUD
 SG_ TelmBookSeatHeatClimalReq_UB : 475|1@0+ (1,0) [0|1] "" ZCUP
 SG_ TelmBookSeatHeatClimalReqDrvHeatClimaLvl : 487|2@0+ (1,0) [0|3] "" ZCUP
 SG_ TelmBookSeatHeatClimalReqPassHeatClimaLvl : 485|2@0+ (1,0) [0|3] "" ZCUP
 SG_ TelmBookSeatHeatClimalReqSecLeHeatClimaLvl : 483|2@0+ (1,0) [0|3] "" ZCUP
 SG_ TelmBookSeatHeatClimalReqSecRiHeatClimaLvl : 481|2@0+ (1,0) [0|3] "" ZCUP
 SG_ TelmBookSeatHeatClimalReqThrdLeHeatClimaLvl : 495|2@0+ (1,0) [0|3] "" ZCUP
 SG_ TelmBookSeatHeatClimalReqThrdRiHeatClimaLvl : 493|2@0+ (1,0) [0|3] "" ZCUP
 SG_ TelmBookSeatVentnClimalReq_UB : 474|1@0+ (1,0) [0|1] "" ZCUP
 SG_ TelmBookSeatVentnClimalReqDrvVentnClimaLvl : 491|2@0+ (1,0) [0|3] "" ZCUP
 SG_ TelmBookSeatVentnClimalReqPassVentnClimaLvl : 489|2@0+ (1,0) [0|3] "" ZCUP
 SG_ TelmBookSeatVentnClimalReqSecLeVentnClimaLvl : 503|2@0+ (1,0) [0|3] "" ZCUP
 SG_ TelmBookSeatVentnClimalReqSecRiVentnClimaLvl : 501|2@0+ (1,0) [0|3] "" ZCUP
 SG_ TelmBookSeatVentnClimalReqThrdLeVentnClimaLvl : 499|2@0+ (1,0) [0|3] "" ZCUP
 SG_ TelmBookSeatVentnClimalReqThrdRiVentnClimaL : 497|2@0+ (1,0) [0|3] "" ZCUP
 SG_ TelmClimaTSet_UB : 504|1@0+ (1,0) [0|1] "" ZCUP
 SG_ TelmClimaTSetHmiCmptmtTSpSpcl : 506|2@0+ (1,0) [0|3] "" ZCUP
 SG_ TelmClimaTSetTempRange : 511|5@0+ (0.5,15.5) [15.5|28.5] "degC" ZCUP
 SG_ TelmStrtEngForChrgnReq : 35|2@0+ (1,0) [0|3] "" ZCUD
 SG_ TelmStrtEngForChrgnReq_UB : 33|1@0+ (1,0) [0|1] "" ZCUD
 SG_ TimeOfcommCharn : 75|1@0+ (1,0) [0|1] "" ZCUD
 SG_ TimeOfcommCharn_UB : 32|1@0+ (1,0) [0|1] "" ZCUD

BO_ 103 DhuZCUCANFD2Fr07 : 64 IHU
 SG_ DwnLoadDynLtgPrmForFrntRIGrp13_UB : 36|1@0+ (1,0) [0|1] "" ZCUD
 SG_ DwnLoadDynLtgPrmForFrntRIGrp13ContinueTime : 7|8@0+ (1.0,0.0) [0.0|255.0] "Unitless" ZCUD
 SG_ DwnLoadDynLtgPrmForFrntRIGrp13HighBrightness : 15|4@0+ (1.0,0.0) [0.0|10.0] "Unitless" ZCUD
 SG_ DwnLoadDynLtgPrmForFrntRIGrp13LowBrightness : 11|4@0+ (1.0,0.0) [0.0|10.0] "Unitless" ZCUD
 SG_ DwnLoadDynLtgPrmForFrntRIGrp13Mode1 : 23|6@0+ (1,0) [0|63] "" ZCUD
 SG_ DwnLoadDynLtgPrmForFrntRIGrp13OffsetTime : 31|6@0+ (1.0,0.0) [0.0|63.0] "Unitless" ZCUD
 SG_ DwnLoadDynLtgPrmForFrntRIGrp13Timestamp : 39|3@0+ (1.0,0.0) [0.0|7.0] "Unitless" ZCUD
 SG_ DwnLoadDynLtgPrmForFrntRIGrp14_UB : 76|1@0+ (1,0) [0|1] "" ZCUD
 SG_ DwnLoadDynLtgPrmForFrntRIGrp14ContinueTime : 47|8@0+ (1.0,0.0) [0.0|255.0] "Unitless" ZCUD
 SG_ DwnLoadDynLtgPrmForFrntRIGrp14HighBrightness : 55|4@0+ (1.0,0.0) [0.0|10.0] "Unitless" ZCUD
 SG_ DwnLoadDynLtgPrmForFrntRIGrp14LowBrightness : 51|4@0+ (1.0,0.0) [0.0|10.0] "Unitless" ZCUD
 SG_ DwnLoadDynLtgPrmForFrntRIGrp14Mode1 : 63|6@0+ (1,0) [0|63] "" ZCUD
 SG_ DwnLoadDynLtgPrmForFrntRIGrp14OffsetTime : 71|6@0+ (1.0,0.0) [0.0|63.0] "Unitless" ZCUD
 SG_ DwnLoadDynLtgPrmForFrntRIGrp14Timestamp : 79|3@0+ (1.0,0.0) [0.0|7.0] "Unitless" ZCUD
 SG_ DwnLoadDynLtgPrmForFrntRIGrp15_UB : 116|1@0+ (1,0) [0|1] "" ZCUD
 SG_ DwnLoadDynLtgPrmForFrntRIGrp15ContinueTime : 87|8@0+ (1.0,0.0) [0.0|255.0] "Unitless" ZCUD
 SG_ DwnLoadDynLtgPrmForFrntRIGrp15HighBrightness : 95|4@0+ (1.0,0.0) [0.0|10.0] "Unitless" ZCUD
 SG_ DwnLoadDynLtgPrmForFrntRIGrp15LowBrightness : 91|4@0+ (1.0,0.0) [0.0|10.0] "Unitless" ZCUD
 SG_ DwnLoadDynLtgPrmForFrntRIGrp15Mode1 : 103|6@0+ (1,0) [0|63] "" ZCUD
 SG_ DwnLoadDynLtgPrmForFrntRIGrp15OffsetTime : 111|6@0+ (1.0,0.0) [0.0|63.0] "Unitless" ZCUD
 SG_ DwnLoadDynLtgPrmForFrntRIGrp15Timestamp : 119|3@0+ (1.0,0.0) [0.0|7.0] "Unitless" ZCUD
 SG_ DwnLoadDynLtgPrmForFrntRIGrp16_UB : 156|1@0+ (1,0) [0|1] "" ZCUD
 SG_ DwnLoadDynLtgPrmForFrntRIGrp16ContinueTime : 127|8@0+ (1.0,0.0) [0.0|255.0] "Unitless" ZCUD
 SG_ DwnLoadDynLtgPrmForFrntRIGrp16HighBrightness : 135|4@0+ (1.0,0.0) [0.0|10.0] "Unitless" ZCUD
 SG_ DwnLoadDynLtgPrmForFrntRIGrp16LowBrightness : 131|4@0+ (1.0,0.0) [0.0|10.0] "Unitless" ZCUD
 SG_ DwnLoadDynLtgPrmForFrntRIGrp16Mode1 : 143|6@0+ (1,0) [0|63] "" ZCUD
 SG_ DwnLoadDynLtgPrmForFrntRIGrp16OffsetTime : 151|6@0+ (1.0,0.0) [0.0|63.0] "Unitless" ZCUD
 SG_ DwnLoadDynLtgPrmForFrntRIGrp16Timestamp : 159|3@0+ (1.0,0.0) [0.0|7.0] "Unitless" ZCUD
 SG_ DwnLoadDynLtgPrmForFrntRIGrp17_UB : 196|1@0+ (1,0) [0|1] "" ZCUD
 SG_ DwnLoadDynLtgPrmForFrntRIGrp17ContinueTime : 167|8@0+ (1.0,0.0) [0.0|255.0] "Unitless" ZCUD
 SG_ DwnLoadDynLtgPrmForFrntRIGrp17HighBrightness : 175|4@0+ (1.0,0.0) [0.0|10.0] "Unitless" ZCUD
 SG_ DwnLoadDynLtgPrmForFrntRIGrp17LowBrightness : 171|4@0+ (1.0,0.0) [0.0|10.0] "Unitless" ZCUD
 SG_ DwnLoadDynLtgPrmForFrntRIGrp17Mode1 : 183|6@0+ (1,0) [0|63] "" ZCUD
 SG_ DwnLoadDynLtgPrmForFrntRIGrp17OffsetTime : 191|6@0+ (1.0,0.0) [0.0|63.0] "Unitless" ZCUD
 SG_ DwnLoadDynLtgPrmForFrntRIGrp17Timestamp : 199|3@0+ (1.0,0.0) [0.0|7.0] "Unitless" ZCUD
 SG_ DwnLoadDynLtgPrmForFrntRIGrp18_UB : 236|1@0+ (1,0) [0|1] "" ZCUD
 SG_ DwnLoadDynLtgPrmForFrntRIGrp18ContinueTime : 207|8@0+ (1.0,0.0) [0.0|255.0] "Unitless" ZCUD
 SG_ DwnLoadDynLtgPrmForFrntRIGrp18HighBrightness : 215|4@0+ (1.0,0.0) [0.0|10.0] "Unitless" ZCUD
 SG_ DwnLoadDynLtgPrmForFrntRIGrp18LowBrightness : 211|4@0+ (1.0,0.0) [0.0|10.0] "Unitless" ZCUD
 SG_ DwnLoadDynLtgPrmForFrntRIGrp18Mode1 : 223|6@0+ (1,0) [0|63] "" ZCUD
 SG_ DwnLoadDynLtgPrmForFrntRIGrp18OffsetTime : 231|6@0+ (1.0,0.0) [0.0|63.0] "Unitless" ZCUD
 SG_ DwnLoadDynLtgPrmForFrntRIGrp18Timestamp : 239|3@0+ (1.0,0.0) [0.0|7.0] "Unitless" ZCUD
 SG_ DwnLoadDynLtgPrmForFrntRIGrp19_UB : 276|1@0+ (1,0) [0|1] "" ZCUD
 SG_ DwnLoadDynLtgPrmForFrntRIGrp19ContinueTime : 247|8@0+ (1.0,0.0) [0.0|255.0] "Unitless" ZCUD
 SG_ DwnLoadDynLtgPrmForFrntRIGrp19HighBrightness : 255|4@0+ (1.0,0.0) [0.0|10.0] "Unitless" ZCUD
 SG_ DwnLoadDynLtgPrmForFrntRIGrp19LowBrightness : 251|4@0+ (1.0,0.0) [0.0|10.0] "Unitless" ZCUD
 SG_ DwnLoadDynLtgPrmForFrntRIGrp19Mode1 : 263|6@0+ (1,0) [0|63] "" ZCUD
 SG_ DwnLoadDynLtgPrmForFrntRIGrp19OffsetTime : 271|6@0+ (1.0,0.0) [0.0|63.0] "Unitless" ZCUD
 SG_ DwnLoadDynLtgPrmForFrntRIGrp19Timestamp : 279|3@0+ (1.0,0.0) [0.0|7.0] "Unitless" ZCUD
 SG_ DwnLoadDynLtgPrmForFrntRIGrp20_UB : 316|1@0+ (1,0) [0|1] "" ZCUD
 SG_ DwnLoadDynLtgPrmForFrntRIGrp20ContinueTime : 287|8@0+ (1.0,0.0) [0.0|255.0] "Unitless" ZCUD
 SG_ DwnLoadDynLtgPrmForFrntRIGrp20HighBrightness : 295|4@0+ (1.0,0.0) [0.0|10.0] "Unitless" ZCUD
 SG_ DwnLoadDynLtgPrmForFrntRIGrp20LowBrightness : 291|4@0+ (1.0,0.0) [0.0|10.0] "Unitless" ZCUD
 SG_ DwnLoadDynLtgPrmForFrntRIGrp20Mode1 : 303|6@0+ (1,0) [0|63] "" ZCUD
 SG_ DwnLoadDynLtgPrmForFrntRIGrp20OffsetTime : 311|6@0+ (1.0,0.0) [0.0|63.0] "Unitless" ZCUD
 SG_ DwnLoadDynLtgPrmForFrntRIGrp20Timestamp : 319|3@0+ (1.0,0.0) [0.0|7.0] "Unitless" ZCUD
 SG_ DwnLoadDynLtgPrmForFrntRIGrp21_UB : 356|1@0+ (1,0) [0|1] "" ZCUD
 SG_ DwnLoadDynLtgPrmForFrntRIGrp21ContinueTime : 327|8@0+ (1.0,0.0) [0.0|255.0] "Unitless" ZCUD
 SG_ DwnLoadDynLtgPrmForFrntRIGrp21HighBrightness : 335|4@0+ (1.0,0.0) [0.0|10.0] "Unitless" ZCUD
 SG_ DwnLoadDynLtgPrmForFrntRIGrp21LowBrightness : 331|4@0+ (1.0,0.0) [0.0|10.0] "Unitless" ZCUD
 SG_ DwnLoadDynLtgPrmForFrntRIGrp21Mode1 : 343|6@0+ (1,0) [0|63] "" ZCUD
 SG_ DwnLoadDynLtgPrmForFrntRIGrp21OffsetTime : 351|6@0+ (1.0,0.0) [0.0|63.0] "Unitless" ZCUD
 SG_ DwnLoadDynLtgPrmForFrntRIGrp21Timestamp : 359|3@0+ (1.0,0.0) [0.0|7.0] "Unitless" ZCUD
 SG_ DwnLoadDynLtgPrmForFrntRIGrp22_UB : 396|1@0+ (1,0) [0|1] "" ZCUD
 SG_ DwnLoadDynLtgPrmForFrntRIGrp22ContinueTime : 367|8@0+ (1.0,0.0) [0.0|255.0] "Unitless" ZCUD
 SG_ DwnLoadDynLtgPrmForFrntRIGrp22HighBrightness : 375|4@0+ (1.0,0.0) [0.0|10.0] "Unitless" ZCUD
 SG_ DwnLoadDynLtgPrmForFrntRIGrp22LowBrightness : 371|4@0+ (1.0,0.0) [0.0|10.0] "Unitless" ZCUD
 SG_ DwnLoadDynLtgPrmForFrntRIGrp22Mode1 : 383|6@0+ (1,0) [0|63] "" ZCUD
 SG_ DwnLoadDynLtgPrmForFrntRIGrp22OffsetTime : 391|6@0+ (1.0,0.0) [0.0|63.0] "Unitless" ZCUD
 SG_ DwnLoadDynLtgPrmForFrntRIGrp22Timestamp : 399|3@0+ (1.0,0.0) [0.0|7.0] "Unitless" ZCUD
 SG_ DwnLoadDynLtgPrmForFrntRIGrp23_UB : 436|1@0+ (1,0) [0|1] "" ZCUD
 SG_ DwnLoadDynLtgPrmForFrntRIGrp23ContinueTime : 407|8@0+ (1.0,0.0) [0.0|255.0] "Unitless" ZCUD
 SG_ DwnLoadDynLtgPrmForFrntRIGrp23HighBrightness : 415|4@0+ (1.0,0.0) [0.0|10.0] "Unitless" ZCUD
 SG_ DwnLoadDynLtgPrmForFrntRIGrp23LowBrightness : 411|4@0+ (1.0,0.0) [0.0|10.0] "Unitless" ZCUD
 SG_ DwnLoadDynLtgPrmForFrntRIGrp23Mode1 : 423|6@0+ (1,0) [0|63] "" ZCUD
 SG_ DwnLoadDynLtgPrmForFrntRIGrp23OffsetTime : 431|6@0+ (1.0,0.0) [0.0|63.0] "Unitless" ZCUD
 SG_ DwnLoadDynLtgPrmForFrntRIGrp23Timestamp : 439|3@0+ (1.0,0.0) [0.0|7.0] "Unitless" ZCUD
 SG_ DwnLoadDynLtgPrmForFrntRIGrp24_UB : 476|1@0+ (1,0) [0|1] "" ZCUD
 SG_ DwnLoadDynLtgPrmForFrntRIGrp24ContinueTime : 447|8@0+ (1.0,0.0) [0.0|255.0] "Unitless" ZCUD
 SG_ DwnLoadDynLtgPrmForFrntRIGrp24HighBrightness : 455|4@0+ (1.0,0.0) [0.0|10.0] "Unitless" ZCUD
 SG_ DwnLoadDynLtgPrmForFrntRIGrp24LowBrightness : 451|4@0+ (1.0,0.0) [0.0|10.0] "Unitless" ZCUD
 SG_ DwnLoadDynLtgPrmForFrntRIGrp24Mode1 : 463|6@0+ (1,0) [0|63] "" ZCUD
 SG_ DwnLoadDynLtgPrmForFrntRIGrp24OffsetTime : 471|6@0+ (1.0,0.0) [0.0|63.0] "Unitless" ZCUD
 SG_ DwnLoadDynLtgPrmForFrntRIGrp24Timestamp : 479|3@0+ (1.0,0.0) [0.0|7.0] "Unitless" ZCUD
 SG_ TelmBookClimaReq_UB : 33|1@0+ (1,0) [0|1] "" ZCUP
 SG_ TelmBookClimaReqHmiCmptmtTSpSpcl : 475|2@0+ (1,0) [0|3] "" ZCUP
 SG_ TelmBookClimaReqOnOffNoReq : 473|2@0+ (1,0) [0|3] "" ZCUP
 SG_ TelmBookClimaReqTempRange : 487|5@0+ (0.5,15.5) [15.5|28.5] "degC" ZCUP
 SG_ TelmEngDelayTi : 503|6@0+ (1.0,0.0) [0.0|59.0] "Mins" ZCUD
 SG_ TelmEngDelayTi_UB : 34|1@0+ (1,0) [0|1] "" ZCUD
 SG_ WinOpenClsGlbReqFromTelm_UB : 35|1@0+ (1,0) [0|1] "" ZCUD,ZCUP
 SG_ WinOpenClsGlbReqFromTelmWindowOpenValue : 511|8@0+ (1.0,0.0) [0.0|100.0] "%" ZCUD,ZCUP
 SG_ WinOpenClsGlbReqFromTelmWinOpenClsGlbSts : 497|2@0+ (1,0) [0|3] "" ZCUD,ZCUP

BO_ 560 DhuZCUCANFD2Fr08 : 64 IHU
 SG_ BevPwrCtrl : 319|1@0+ (1,0) [0|1] "" ZCUD
 SG_ BevPwrCtrl_UB : 318|1@0+ (1,0) [0|1] "" ZCUD
 SG_ CopilotSeatOccupySts : 42|2@0+ (1,0) [0|3] "" ZCUD,ZCUP
 SG_ CopilotSeatOccupySts_UB : 40|1@0+ (1,0) [0|1] "" ZCUD,ZCUP
 SG_ DrvrHdPosnDetn_UB : 52|1@0+ (1,0) [0|1] "" ZCUP
 SG_ DrvrHdPosnDetnX : 4|13@0+ (1.0,0.0) [0.0|8191.0] "Unitless" ZCUP
 SG_ DrvrHdPosnDetnY : 23|13@0+ (1.0,0.0) [0.0|8191.0] "Unitless" ZCUP
 SG_ DrvrHdPosnDetnZ : 39|13@0+ (1.0,0.0) [0.0|8191.0] "Unitless" ZCUP
 SG_ DrvSeatOccupySts : 55|2@0+ (1,0) [0|3] "" ZCUP
 SG_ DrvSeatOccupySts_UB : 53|1@0+ (1,0) [0|1] "" ZCUP
 SG_ HMIAirCdnrAutDrySet : 305|1@0+ (1,0) [0|1] "" ZCUP
 SG_ HMIAirCdnrAutDrySet_UB : 304|1@0+ (1,0) [0|1] "" ZCUP
 SG_ HmiPM25PopUpSet : 187|1@0+ (1,0) [0|1] "" ZCUP
 SG_ HmiPM25PopUpSet_UB : 186|1@0+ (1,0) [0|1] "" ZCUP
 SG_ PassSideHdPosnDetn_UB : 289|1@0+ (1,0) [0|1] "" ZCUP
 SG_ PassSideHdPosnDetnX : 252|13@0+ (1.0,0.0) [0.0|8191.0] "Unitless" ZCUP
 SG_ PassSideHdPosnDetnY : 271|13@0+ (1.0,0.0) [0.0|8191.0] "Unitless" ZCUP
 SG_ PassSideHdPosnDetnZ : 287|13@0+ (1.0,0.0) [0.0|8191.0] "Unitless" ZCUP
 SG_ SteerSetg_UB : 315|1@0+ (1,0) [0|1] "" ZCUD
 SG_ SteerSetgPen : 323|4@0+ (1,0) [0|15] "" ZCUD
 SG_ SteerSetgSteerAsscLvl : 326|3@0+ (1,0) [0|7] "" ZCUD
 SG_ SteerSetgSteerMod : 314|3@0+ (1,0) [0|7] "" ZCUD
 SG_ WiprReAutReq : 331|1@0+ (1,0) [0|1] "" ZCUD
 SG_ WiprReAutReq_UB : 306|1@0+ (1,0) [0|1] "" ZCUD

BO_ 368 DhuZCUCANFD2Fr10 : 64 IHU
 SG_ AutEgyRgnLvlSet : 190|3@0+ (1,0) [0|7] "" ZCUD
 SG_ AutEgyRgnLvlSet_UB : 187|1@0+ (1,0) [0|1] "" ZCUD
 SG_ AutElecStepCtrlSwtSts_UB : 50|1@0+ (1,0) [0|1] "" ZCUD
 SG_ AutElecStepCtrlSwtStsDriver : 175|1@0+ (1,0) [0|1] "" ZCUD
 SG_ AutElecStepCtrlSwtStsPassenger : 174|1@0+ (1,0) [0|1] "" ZCUD
 SG_ AutoClsLockdFctEnaRADAR : 47|1@0+ (1,0) [0|1] "" Vector__XXX
 SG_ AutoClsLockdFctEnaRADAR_UB : 46|1@0+ (1,0) [0|1] "" Vector__XXX
 SG_ AutoClsRainFctEnaRADAR : 45|1@0+ (1,0) [0|1] "" ZCUD
 SG_ AutoClsRainFctEnaRADAR_UB : 44|1@0+ (1,0) [0|1] "" ZCUD
 SG_ BLEKeyExtLoUOutIPwrSplyCtrl_UB : 284|1@0+ (1,0) [0|1] "" Vector__XXX
 SG_ BLEKeyExtLoUOutIPwrSplyCtrlZone1 : 283|2@0+ (1,0) [0|3] "" Vector__XXX
 SG_ BLEKeyExtLoUOutIPwrSplyCtrlZone2 : 281|2@0+ (1,0) [0|3] "" Vector__XXX
 SG_ BLEKeyExtLoUOutIPwrSplyCtrlZone3 : 295|2@0+ (1,0) [0|3] "" Vector__XXX
 SG_ BLEKeyExtLoUOutIPwrSplyCtrlZone4 : 293|2@0+ (1,0) [0|3] "" Vector__XXX
 SG_ BLEKeyExtLoUOutIPwrSplyCtrlZone5 : 291|2@0+ (1,0) [0|3] "" Vector__XXX
 SG_ BLEKeyExtLoUOutIPwrSplyCtrlZone6 : 289|2@0+ (1,0) [0|3] "" Vector__XXX
 SG_ DrvrSeatCmftReq : 183|3@0+ (1,0) [0|7] "" ZCUD
 SG_ DrvrSeatCmftReq_UB : 180|1@0+ (1,0) [0|1] "" ZCUD
 SG_ DrvrSeatReturnReq : 179|2@0+ (1,0) [0|3] "" ZCUD
 SG_ DrvrSeatReturnReq_UB : 177|1@0+ (1,0) [0|1] "" ZCUD
 SG_ ElecStepReq : 161|2@0+ (1,0) [0|3] "" ZCUD
 SG_ ElecStepReq_UB : 152|1@0+ (1,0) [0|1] "" ZCUD
 SG_ FaceRecognitionIndcrFromDHU : 21|1@0+ (1,0) [0|1] "" ZCUD
 SG_ FaceRecognitionIndcrFromDHU_UB : 20|1@0+ (1,0) [0|1] "" ZCUD
 SG_ FrntSunCurtCtrlReq : 143|2@0+ (1,0) [0|3] "" ZCUD
 SG_ FrntSunCurtCtrlReq_UB : 141|1@0+ (1,0) [0|1] "" ZCUD
 SG_ FrntSunCurtIninSwt : 140|1@0+ (1,0) [0|1] "" ZCUD
 SG_ FrntSunCurtIninSwt_UB : 139|1@0+ (1,0) [0|1] "" ZCUD
 SG_ FrntSunCurtOpenPosnReq : 167|5@0+ (1,0) [0|31] "" ZCUD
 SG_ FrntSunCurtOpenPosnReq_UB : 162|1@0+ (1,0) [0|1] "" ZCUD
 SG_ GestureDetn : 55|5@0+ (1,0) [0|31] "" ZCUD
 SG_ GestureDetn_UB : 42|1@0+ (1,0) [0|1] "" ZCUD
 SG_ HmiSeatVentAutStrtRowThrdLe : 236|1@0+ (1,0) [0|1] "" ZCUD
 SG_ HmiSeatVentAutStrtRowThrdLe_UB : 235|1@0+ (1,0) [0|1] "" ZCUD
 SG_ HmiSeatVentAutStrtRowThrdRi : 238|1@0+ (1,0) [0|1] "" ZCUD
 SG_ HmiSeatVentAutStrtRowThrdRi_UB : 237|1@0+ (1,0) [0|1] "" ZCUD
 SG_ IceBreakModEnaRADAR : 43|1@0+ (1,0) [0|1] "" Vector__XXX
 SG_ IceBreakModEnaRADAR_UB : 16|1@0+ (1,0) [0|1] "" Vector__XXX
 SG_ LnchModSwt : 19|2@0+ (1,0) [0|3] "" ZCUD
 SG_ LnchModSwt_UB : 17|1@0+ (1,0) [0|1] "" ZCUD
 SG_ LvlgSwtSetReq_UB : 8|1@0+ (1,0) [0|1] "" ZCUD
 SG_ LvlgSwtSetReqChks : 7|8@0+ (1.0,0.0) [0.0|255.0] "Unitless" ZCUD
 SG_ LvlgSwtSetReqCntr : 15|4@0+ (1.0,0.0) [0.0|15.0] "Unitless" ZCUD
 SG_ LvlgSwtSetReqLvlgSwtSetReq : 11|3@0+ (1,0) [0|7] "" ZCUD
 SG_ PassSeatCmftReq : 171|3@0+ (1,0) [0|7] "" ZCUD,ZCUP
 SG_ PassSeatCmftReq_UB : 168|1@0+ (1,0) [0|1] "" ZCUD,ZCUP
 SG_ PassSeatReturnReq : 49|2@0+ (1,0) [0|3] "" ZCUD,ZCUP
 SG_ PassSeatReturnReq_UB : 144|1@0+ (1,0) [0|1] "" ZCUD,ZCUP
 SG_ PrpsnMaxEvMod : 23|1@0+ (1,0) [0|1] "" ZCUD
 SG_ PrpsnMaxEvMod_UB : 22|1@0+ (1,0) [0|1] "" ZCUD
 SG_ PwrTonneauCoverOpenPosnReqRADAR : 319|8@0+ (1.0,0.0) [0.0|100.0] "%" Vector__XXX
 SG_ PwrTonneauCoverOpenPosnReqRADAR_UB : 327|1@0+ (1,0) [0|1] "" Vector__XXX
 SG_ RainSnsrSnvtyHMIReq : 30|3@0+ (1,0) [0|7] "" ZCUD
 SG_ RainSnsrSnvtyHMIReq_UB : 27|1@0+ (1,0) [0|1] "" ZCUD
 SG_ RCcontrolForDCchargeLid : 176|1@0+ (1,0) [0|1] "" ZCUD
 SG_ RCcontrolForDCchargeLid_UB : 191|1@0+ (1,0) [0|1] "" ZCUD
 SG_ RelsEnaSwt : 287|1@0+ (1,0) [0|1] "" ZCUD
 SG_ RelsEnaSwt_UB : 286|1@0+ (1,0) [0|1] "" ZCUD
 SG_ ReSunCurtCtrlReq : 138|2@0+ (1,0) [0|3] "" ZCUD
 SG_ ReSunCurtCtrlReq_UB : 136|1@0+ (1,0) [0|1] "" ZCUD
 SG_ ReSunCurtIninSwt : 173|1@0+ (1,0) [0|1] "" ZCUD
 SG_ ReSunCurtIninSwt_UB : 172|1@0+ (1,0) [0|1] "" ZCUD
 SG_ SecLeSeatHeiTargPosPerc : 303|8@0+ (1.0,0.0) [0.0|100.0] "%" ZCUD
 SG_ SecLeSeatHeiTargPosPerc_UB : 285|1@0+ (1,0) [0|1] "" ZCUD
 SG_ SecLeSeatTarPosnCmdReq_UB : 41|1@0+ (1,0) [0|1] "" ZCUD
 SG_ SecLeSeatTarPosnCmdReqSeatBackrTargPosAg : 63|8@0+ (1.0,0.0) [0.0|180.0] "Deg" ZCUD
 SG_ SecLeSeatTarPosnCmdReqSeatFrntExtenTargPosPerc : 71|10@0+ (0.1,0.0) [0.0|100.0] "%" ZCUD
 SG_ SecLeSeatTarPosnCmdReqSeatFrntHeiTargPosPerc : 77|10@0+ (0.1,0.0) [0.0|100.0] "%" ZCUD
 SG_ SecLeSeatTarPosnCmdReqSeatLenTargPosPerc : 81|10@0+ (0.1,0.0) [0.0|100.0] "%" ZCUD
 SG_ SecLeSeatTarPosnCmdReqTarPosnCmd1 : 83|2@0+ (1,0) [0|3] "" ZCUD
 SG_ SecRiSeatHeiTargPosPerc : 311|8@0+ (1.0,0.0) [0.0|100.0] "%" ZCUD
 SG_ SecRiSeatHeiTargPosPerc_UB : 239|1@0+ (1,0) [0|1] "" ZCUD
 SG_ SecRiSeatTarPosnCmdReq_UB : 40|1@0+ (1,0) [0|1] "" ZCUD
 SG_ SecRiSeatTarPosnCmdReqSeatBackrTargPosAg : 103|8@0+ (1.0,0.0) [0.0|180.0] "Deg" ZCUD
 SG_ SecRiSeatTarPosnCmdReqSeatFrntExtenTargPosPerc : 111|10@0+ (0.1,0.0) [0.0|100.0] "%" ZCUD
 SG_ SecRiSeatTarPosnCmdReqSeatFrntHeiTargPosPerc : 117|10@0+ (0.1,0.0) [0.0|100.0] "%" ZCUD
 SG_ SecRiSeatTarPosnCmdReqSeatLenTargPosPerc : 121|10@0+ (0.1,0.0) [0.0|100.0] "%" ZCUD
 SG_ SecRiSeatTarPosnCmdReqTarPosnCmd1 : 123|2@0+ (1,0) [0|3] "" ZCUD
 SG_ SecRowLeSeatCmftReq : 151|3@0+ (1,0) [0|7] "" ZCUD,ZCUP
 SG_ SecRowLeSeatCmftReq_UB : 148|1@0+ (1,0) [0|1] "" ZCUD,ZCUP
 SG_ SecRowLeSeatFoldRaiseReq : 324|2@0+ (1,0) [0|3] "" ZCUD
 SG_ SecRowLeSeatFoldRaiseReq_UB : 322|1@0+ (1,0) [0|1] "" ZCUD
 SG_ SecRowLeSeatHeiAdjmt : 39|2@0+ (1,0) [0|3] "" ZCUD
 SG_ SecRowLeSeatHeiAdjmt_UB : 31|1@0+ (1,0) [0|1] "" ZCUD
 SG_ SecRowLeSeatReturnReq : 147|2@0+ (1,0) [0|3] "" ZCUD,ZCUP
 SG_ SecRowLeSeatReturnReq_UB : 145|1@0+ (1,0) [0|1] "" ZCUD,ZCUP
 SG_ SecRowRiSeatCmftReq : 159|3@0+ (1,0) [0|7] "" ZCUD,ZCUP
 SG_ SecRowRiSeatCmftReq_UB : 156|1@0+ (1,0) [0|1] "" ZCUD,ZCUP
 SG_ SecRowRiSeatFoldRaiseReq : 321|2@0+ (1,0) [0|3] "" ZCUD
 SG_ SecRowRiSeatFoldRaiseReq_UB : 335|1@0+ (1,0) [0|1] "" ZCUD
 SG_ SecRowRiSeatHeiAdjmt : 37|2@0+ (1,0) [0|3] "" ZCUD
 SG_ SecRowRiSeatHeiAdjmt_UB : 26|1@0+ (1,0) [0|1] "" ZCUD
 SG_ SecRowRiSeatReturnReq : 155|2@0+ (1,0) [0|3] "" ZCUD,ZCUP
 SG_ SecRowRiSeatReturnReq_UB : 153|1@0+ (1,0) [0|1] "" ZCUD,ZCUP
 SG_ SecRowSeatInhbByMod : 35|2@0+ (1,0) [0|3] "" ZCUD
 SG_ SecRowSeatInhbByMod_UB : 25|1@0+ (1,0) [0|1] "" ZCUD
 SG_ ThrdLeSeatTarPosnCmdReq_UB : 186|1@0+ (1,0) [0|1] "" ZCUD
 SG_ ThrdLeSeatTarPosnCmdReqSeatBackrTargPosAg : 207|8@0+ (1.0,0.0) [0.0|180.0] "Deg" ZCUD
 SG_ ThrdLeSeatTarPosnCmdReqSeatFrntExtenTargPosPerc : 185|10@0+ (0.1,0.0) [0.0|100.0] "%" ZCUD
 SG_ ThrdLeSeatTarPosnCmdReqSeatFrntHeiTargPosPerc : 215|10@0+ (0.1,0.0) [0.0|100.0] "%" ZCUD
 SG_ ThrdLeSeatTarPosnCmdReqSeatLenTargPosPerc : 217|10@0+ (0.1,0.0) [0.0|100.0] "%" ZCUD
 SG_ ThrdLeSeatTarPosnCmdReqTarPosnCmd1 : 221|2@0+ (1,0) [0|3] "" ZCUD
 SG_ ThrdRiSeatTarPosnCmdReq_UB : 234|1@0+ (1,0) [0|1] "" ZCUD
 SG_ ThrdRiSeatTarPosnCmdReqSeatBackrTargPosAg : 255|8@0+ (1.0,0.0) [0.0|180.0] "Deg" ZCUD
 SG_ ThrdRiSeatTarPosnCmdReqSeatFrntExtenTargPosPerc : 233|10@0+ (0.1,0.0) [0.0|100.0] "%" ZCUD
 SG_ ThrdRiSeatTarPosnCmdReqSeatFrntHeiTargPosPerc : 263|10@0+ (0.1,0.0) [0.0|100.0] "%" ZCUD
 SG_ ThrdRiSeatTarPosnCmdReqSeatLenTargPosPerc : 265|10@0+ (0.1,0.0) [0.0|100.0] "%" ZCUD
 SG_ ThrdRiSeatTarPosnCmdReqTarPosnCmd1 : 269|2@0+ (1,0) [0|3] "" ZCUD
 SG_ ThrdRowSeatInhbByMod : 33|2@0+ (1,0) [0|3] "" ZCUD
 SG_ ThrdRowSeatInhbByMod_UB : 24|1@0+ (1,0) [0|1] "" ZCUD
 SG_ UpperLowerTrSelnSwt : 326|1@0+ (1,0) [0|1] "" ZCUD
 SG_ UpperLowerTrSelnSwt_UB : 325|1@0+ (1,0) [0|1] "" ZCUD

BO_ 259 DhuZCUCANFD2Fr11 : 64 IHU
 SG_ ACEIDLightReqFromBLE : 291|1@0+ (1,0) [0|1] "" ZCUD
 SG_ ACEIDLightReqFromBLE_UB : 290|1@0+ (1,0) [0|1] "" ZCUD
 SG_ ConfCurrSpd : 3|2@0+ (1,0) [0|3] "" ZCUD
 SG_ ConfCurrSpd_UB : 8|1@0+ (1,0) [0|1] "" ZCUD
 SG_ ConfPath : 1|2@0+ (1,0) [0|3] "" ZCUD
 SG_ ConfPath_UB : 9|1@0+ (1,0) [0|1] "" ZCUD
 SG_ DCEIDLightReqFromBLE : 289|1@0+ (1,0) [0|1] "" ZCUD
 SG_ DCEIDLightReqFromBLE_UB : 288|1@0+ (1,0) [0|1] "" ZCUD
 SG_ DchrgnInSwtCtrl : 282|2@0+ (1,0) [0|3] "" ZCUD
 SG_ DchrgnInSwtCtrl_UB : 280|1@0+ (1,0) [0|1] "" ZCUD
 SG_ EPedlModCtrlSt : 13|1@0+ (1,0) [0|1] "" ZCUD
 SG_ EPedlModCtrlSt_UB : 25|1@0+ (1,0) [0|1] "" ZCUD
 SG_ ESCLvlSwt : 12|3@0+ (1,0) [0|7] "" ZCUD
 SG_ ESCLvlSwt_UB : 24|1@0+ (1,0) [0|1] "" ZCUD
 SG_ HmiMaxEvMod : 175|1@0+ (1,0) [0|1] "" ZCUD
 SG_ HmiMaxEvMod_UB : 174|1@0+ (1,0) [0|1] "" ZCUD
 SG_ HMISteplessBarPosnSetting : 55|7@0+ (1.0,0.0) [0.0|100.0] "%" ZCUD
 SG_ HMISteplessBarPosnSetting_UB : 48|1@0+ (1,0) [0|1] "" ZCUD
 SG_ HMIThermoTankChdLock : 248|1@0+ (1,0) [0|1] "" ZCUD
 SG_ HMIThermoTankChdLock_UB : 261|1@0+ (1,0) [0|1] "" ZCUD
 SG_ HMIThermoTankDlyCls : 269|1@0+ (1,0) [0|1] "" ZCUD
 SG_ HMIThermoTankDlyCls_UB : 268|1@0+ (1,0) [0|1] "" ZCUD
 SG_ HMIThermoTankDlyClsTmr : 255|5@0+ (1.0,0.0) [0.0|31.0] "hours" ZCUD
 SG_ HMIThermoTankDlyClsTmr_UB : 260|1@0+ (1,0) [0|1] "" ZCUD
 SG_ HMIThermoTankDoorOpen : 250|2@0+ (1,0) [0|3] "" ZCUD
 SG_ HMIThermoTankDoorOpen_UB : 259|1@0+ (1,0) [0|1] "" ZCUD
 SG_ HMIThermoTankSwtReq : 263|2@0+ (1,0) [0|3] "" ZCUD
 SG_ HMIThermoTankSwtReq_UB : 258|1@0+ (1,0) [0|1] "" ZCUD
 SG_ HMIThermoTankT : 239|8@0+ (1.0,-50.0) [-50.0|205.0] "degC" ZCUD
 SG_ HMIThermoTankT_UB : 257|1@0+ (1,0) [0|1] "" ZCUD
 SG_ HornWarnReq : 275|1@0+ (1,0) [0|1] "" ZCUD
 SG_ HornWarnReq_UB : 274|1@0+ (1,0) [0|1] "" ZCUD
 SG_ HvBattMntnReq : 366|2@0+ (1,0) [0|3] "" ZCUP
 SG_ HvBattMntnReq_UB : 364|1@0+ (1,0) [0|1] "" ZCUP
 SG_ IAMSMod : 173|1@0+ (1,0) [0|1] "" ZCUD
 SG_ IAMSMod_UB : 195|1@0+ (1,0) [0|1] "" ZCUD
 SG_ KickTailgateSig : 267|1@0+ (1,0) [0|1] "" ZCUD
 SG_ KickTailgateSig_UB : 266|1@0+ (1,0) [0|1] "" ZCUD
 SG_ LiFlashWarnReq : 273|1@0+ (1,0) [0|1] "" ZCUD
 SG_ LiFlashWarnReq_UB : 272|1@0+ (1,0) [0|1] "" ZCUD
 SG_ LvngCratuDetdSts : 287|2@0+ (1,0) [0|3] "" ZCUD
 SG_ LvngCratuDetdSts_UB : 285|1@0+ (1,0) [0|1] "" ZCUD
 SG_ MirrTarPosnCmdReq_UB : 302|1@0+ (1,0) [0|1] "" ZCUD,ZCUP
 SG_ MirrTarPosnCmdReqDrvrMirrAdjLeRi : 301|14@0+ (1.0,0.0) [0.0|10000.0] "Unitless" ZCUD,ZCUP
 SG_ MirrTarPosnCmdReqDrvrMirrAdjUpDown : 319|14@0+ (1.0,0.0) [0.0|10000.0] "Unitless" ZCUD,ZCUP
 SG_ MirrTarPosnCmdReqPassMirrAdjLeRi : 335|14@0+ (1.0,0.0) [0.0|10000.0] "Unitless" ZCUD,ZCUP
 SG_ MirrTarPosnCmdReqPassMirrAdjUpDown : 351|14@0+ (1.0,0.0) [0.0|10000.0] "Unitless" ZCUD,ZCUP
 SG_ MirrTarPosnCmdReqTarPosnCmd1 : 321|2@0+ (1,0) [0|3] "" ZCUD,ZCUP
 SG_ PasEntryEnaReq1 : 41|1@0+ (1,0) [0|1] "" ZCUD
 SG_ PasEntryEnaReq1_UB : 40|1@0+ (1,0) [0|1] "" ZCUD
 SG_ PtModReq : 63|2@0+ (1,0) [0|3] "" ZCUD
 SG_ PtModReq_UB : 61|1@0+ (1,0) [0|1] "" ZCUD
 SG_ ReBuctMonSts : 295|3@0+ (1,0) [0|7] "" ZCUD
 SG_ ReBuctMonSts_UB : 292|1@0+ (1,0) [0|1] "" ZCUD
 SG_ RemHvStrtActvReq : 60|2@0+ (1,0) [0|3] "" ZCUD
 SG_ RemHvStrtActvReq_UB : 58|1@0+ (1,0) [0|1] "" ZCUD
 SG_ RoadCondDis : 71|16@0+ (1.0,0.0) [0.0|65535.0] "m" ZCUD
 SG_ RoadCondDis_UB : 137|1@0+ (1,0) [0|1] "" ZCUD
 SG_ RoadCondLvl : 122|3@0+ (1,0) [0|7] "" ZCUD
 SG_ RoadCondLvl_UB : 138|1@0+ (1,0) [0|1] "" ZCUD
 SG_ RoadCondNum : 127|5@0+ (1.0,0.0) [0.0|31.0] "Unitless" ZCUD
 SG_ RoadCondNum_UB : 139|1@0+ (1,0) [0|1] "" ZCUD
 SG_ RoadCondTime : 87|16@0+ (1.0,0.0) [0.0|65535.0] "s" ZCUD
 SG_ RoadCondTime_UB : 140|1@0+ (1,0) [0|1] "" ZCUD
 SG_ RoadSlope : 135|11@0- (0.001,0.0) [0.0|1.0230000000000001] "Unitless" ZCUD
 SG_ RoadSlope_UB : 168|1@0+ (1,0) [0|1] "" ZCUD
 SG_ RoadSlopeDis : 103|16@0+ (1.0,0.0) [0.0|65535.0] "m" ZCUD
 SG_ RoadSlopeDis_UB : 169|1@0+ (1,0) [0|1] "" ZCUD
 SG_ RoadSlopeNum : 119|8@0+ (1.0,0.0) [0.0|255.0] "Unitless" ZCUD
 SG_ RoadSlopeNum_UB : 170|1@0+ (1,0) [0|1] "" ZCUD
 SG_ StealthLiSwtSts : 395|1@0+ (1,0) [0|1] "" ZCUD
 SG_ StealthLiSwtSts_UB : 394|1@0+ (1,0) [0|1] "" ZCUD
 SG_ StsOfFLWelGby : 7|1@0+ (1,0) [0|1] "" ZCUD
 SG_ StsOfFLWelGby_UB : 6|1@0+ (1,0) [0|1] "" ZCUD
 SG_ StsOfFRWelGby : 5|1@0+ (1,0) [0|1] "" ZCUD
 SG_ StsOfFRWelGby_UB : 4|1@0+ (1,0) [0|1] "" ZCUD
 SG_ StsOfRICLWelGby : 223|1@0+ (1,0) [0|1] "" ZCUD
 SG_ StsOfRICLWelGby_UB : 222|1@0+ (1,0) [0|1] "" ZCUD
 SG_ StsOfRICRWelGby : 221|1@0+ (1,0) [0|1] "" ZCUD
 SG_ StsOfRICRWelGby_UB : 220|1@0+ (1,0) [0|1] "" ZCUD
 SG_ StsOfRILLWelGby : 219|1@0+ (1,0) [0|1] "" ZCUD
 SG_ StsOfRILLWelGby_UB : 218|1@0+ (1,0) [0|1] "" ZCUD
 SG_ StsOfRILRWelGby : 217|1@0+ (1,0) [0|1] "" ZCUD
 SG_ StsOfRILRWelGby_UB : 216|1@0+ (1,0) [0|1] "" ZCUD
 SG_ TelmClimaTmr : 183|16@0+ (1.0,0.0) [0.0|65535.0] "s" ZCUP
 SG_ TelmClimaTmr_UB : 172|1@0+ (1,0) [0|1] "" ZCUP
 SG_ WadeProtnSwtReq : 57|1@0+ (1,0) [0|1] "" ZCUD
 SG_ WadeProtnSwtReq_UB : 56|1@0+ (1,0) [0|1] "" ZCUD
 SG_ WinOpenLDACReq : 284|1@0+ (1,0) [0|1] "" ZCUD,ZCUP
 SG_ WinOpenLDACReq_UB : 283|1@0+ (1,0) [0|1] "" ZCUD,ZCUP

BO_ 624 DhuZCUCANFD2Fr12 : 64 IHU
 SG_ ChrgStationPwr : 9|10@0+ (1.0,0.0) [0.0|1023.0] "kW" ZCUD
 SG_ ChrgStationPwr_UB : 39|1@0+ (1,0) [0|1] "" ZCUD
 SG_ DeactvtLvlgCtrl : 7|1@0+ (1,0) [0|1] "" ZCUD
 SG_ DeactvtLvlgCtrl_UB : 6|1@0+ (1,0) [0|1] "" ZCUD
 SG_ EstimdLeSocToDest : 31|7@0+ (1.0,0.0) [0.0|101.0] "%" ZCUD
 SG_ EstimdLeSocToDest_UB : 24|1@0+ (1,0) [0|1] "" ZCUD
 SG_ MmedHdPwrMod : 3|2@0+ (1,0) [0|3] "" ZCUD
 SG_ MmedHdPwrMod_UB : 1|1@0+ (1,0) [0|1] "" ZCUD
 SG_ MobDevBtnPanicReq : 15|2@0+ (1,0) [0|3] "" ZCUD
 SG_ MobDevBtnPanicReq_UB : 0|1@0+ (1,0) [0|1] "" ZCUD
 SG_ OIDIFctSts : 11|1@0+ (1,0) [0|1] "" ZCUD
 SG_ OIDIFctSts_UB : 10|1@0+ (1,0) [0|1] "" ZCUD
 SG_ RMLCmftFctReq : 5|1@0+ (1,0) [0|1] "" ZCUD
 SG_ RMLCmftFctReq_UB : 4|1@0+ (1,0) [0|1] "" ZCUD
 SG_ RMRCmftFctReq : 13|1@0+ (1,0) [0|1] "" ZCUD
 SG_ RMRCmftFctReq_UB : 12|1@0+ (1,0) [0|1] "" ZCUD

BO_ 80 DhuZCUCANFD2Fr13 : 64 IHU
 SG_ CnclBookTrvlReq : 490|1@0+ (1,0) [0|1] "" ZCUD
 SG_ CnclBookTrvlReq_UB : 491|1@0+ (1,0) [0|1] "" ZCUD
 SG_ DKDataFromTelm_UB : 481|1@0+ (1,0) [0|1] "" ZCUD
 SG_ DKDataFromTelmAcknowledgment : 327|8@0+ (1.0,0.0) [0.0|255.0] "Unitless" ZCUD
 SG_ DKDataFromTelmDKDataByte1 : 335|8@0+ (1.0,0.0) [0.0|255.0] "Unitless" ZCUD
 SG_ DKDataFromTelmDKDataByte2 : 343|8@0+ (1.0,0.0) [0.0|255.0] "Unitless" ZCUD
 SG_ DKDataFromTelmDKDataByte3 : 351|8@0+ (1.0,0.0) [0.0|255.0] "Unitless" ZCUD
 SG_ DKDataFromTelmDKDataByte4 : 359|8@0+ (1.0,0.0) [0.0|255.0] "Unitless" ZCUD
 SG_ DKDataFromTelmDKDataByte5 : 367|8@0+ (1.0,0.0) [0.0|255.0] "Unitless" ZCUD
 SG_ DKDataFromTelmDKDataByte6 : 375|8@0+ (1.0,0.0) [0.0|255.0] "Unitless" ZCUD
 SG_ DKDataFromTelmHeader : 383|8@0+ (1.0,0.0) [0.0|255.0] "Unitless" ZCUD
 SG_ DrvStyleCoeffCloud : 503|8@0+ (1.0,0.0) [0.0|255.0] "Unitless" ZCUD
 SG_ DrvStyleCoeffCloud_UB : 489|1@0+ (1,0) [0|1] "" ZCUD
 SG_ ErsCmdRec_UB : 488|1@0+ (1,0) [0|1] "" ZCUD
 SG_ ErsCmdRecErsCmd : 511|2@0+ (1,0) [0|3] "" ZCUD
 SG_ ErsCmdRecErsRunTime : 509|6@0+ (1.0,0.0) [0.0|59.0] "Mins" ZCUD

BO_ 1168 DhuZCUCANFD2Fr14 : 64 IHU
 SG_ CarSharingMde : 79|1@0+ (1,0) [0|1] "" ZCUD
 SG_ CarSharingMde_UB : 75|1@0+ (1,0) [0|1] "" ZCUD
 SG_ LongTiRunngMod_UB : 103|1@0+ (1,0) [0|1] "" ZCUD
 SG_ LongTiRunngModCampMod : 87|1@0+ (1,0) [0|1] "" ZCUD
 SG_ LongTiRunngModGameMod : 86|1@0+ (1,0) [0|1] "" ZCUD
 SG_ LongTiRunngModMonrbyOMS : 85|1@0+ (1,0) [0|1] "" ZCUD
 SG_ LongTiRunngModNxtCnvinc : 81|1@0+ (1,0) [0|1] "" ZCUD
 SG_ LongTiRunngModPanelTouched : 84|1@0+ (1,0) [0|1] "" ZCUD
 SG_ LongTiRunngModParkComfortMod : 83|1@0+ (1,0) [0|1] "" ZCUD
 SG_ LongTiRunngModPetMod : 82|1@0+ (1,0) [0|1] "" ZCUD
 SG_ LongTiRunngModReserved2 : 80|1@0+ (1,0) [0|1] "" ZCUD
 SG_ LongTiRunngModReserved3 : 95|1@0+ (1,0) [0|1] "" ZCUD
 SG_ LongTiRunngModReserved4 : 94|1@0+ (1,0) [0|1] "" ZCUD
 SG_ LongTiRunngModReserved5 : 93|1@0+ (1,0) [0|1] "" ZCUD
 SG_ LongTiRunngModReserved6 : 92|1@0+ (1,0) [0|1] "" ZCUD
 SG_ LongTiRunngModReserved7 : 91|1@0+ (1,0) [0|1] "" ZCUD
 SG_ LongTiRunngModReserved8 : 90|1@0+ (1,0) [0|1] "" ZCUD
 SG_ LongTiRunngModRestMod : 89|1@0+ (1,0) [0|1] "" ZCUD
 SG_ LongTiRunngModTheaterMod : 88|1@0+ (1,0) [0|1] "" ZCUD
 SG_ PosnBrief_UB : 6|1@0+ (1,0) [0|1] "" ZCUD,ZCUP
 SG_ PosnBriefPosnLat : 5|30@0- (0.000000277778,0.0) [-90.000072|90.000072] "Deg" ZCUD,ZCUP
 SG_ PosnBriefPosnLgt : 39|31@0- (0.000000277778,0.0) [-180.000144|180.000144] "Deg" ZCUD,ZCUP
 SG_ UnlckRemReq : 67|1@0+ (1,0) [0|1] "" ZCUD
 SG_ UnlckRemReq_UB : 56|1@0+ (1,0) [0|1] "" ZCUD

BO_ 435 DhuZCUCANFD2Fr15 : 64 IHU
 SG_ HznPosnLR_UB : 45|1@0+ (1,0) [0|1] "" ZCUD
 SG_ HznPosnLRCurrentLane : 214|3@0+ (1.0,0.0) [0.0|7.0] "Unitless" ZCUD
 SG_ HznPosnLRCyclicCounter : 211|2@0+ (1.0,0.0) [0.0|3.0] "Unitless" ZCUD
 SG_ HznPosnLRMessageType : 223|3@0+ (1,0) [0|7] "" ZCUD
 SG_ HznPosnLROffset : 220|13@0+ (1.0,0.0) [0.0|8191.0] "m" ZCUD
 SG_ HznPosnLRPathIndex : 247|6@0+ (1.0,0.0) [0.0|63.0] "Unitless" ZCUD
 SG_ HznPosnLRPositionAge : 184|9@0+ (1.0,0.0) [0.0|511.0] "Milliseconds" ZCUD
 SG_ HznPosnLRPositionConfidence : 255|3@0+ (1.0,0.0) [0.0|7.0] "Unitless" ZCUD
 SG_ HznPosnLRPositionIndex : 209|2@0+ (1.0,0.0) [0.0|3.0] "Unitless" ZCUD
 SG_ HznPosnLRPositionProbability : 189|5@0+ (1.0,0.0) [0.0|31.0] "%" ZCUD
 SG_ HznPosnLRRelativeHeading : 239|8@0+ (1.0,0.0) [0.0|255.0] "Unitless" ZCUD
 SG_ HznPosnLRSpeed : 207|9@0+ (1.0,0.0) [0.0|511.0] "m/s" ZCUD
 SG_ HznProfLongLR_UB : 68|1@0+ (1,0) [0|1] "" ZCUD
 SG_ HznProfLongLRControlPoint : 319|1@0+ (1,0) [0|1] "" ZCUD
 SG_ HznProfLongLRCyclicCounter : 257|2@0+ (1.0,0.0) [0.0|3.0] "Unitless" ZCUD
 SG_ HznProfLongLRMessageType : 271|3@0+ (1,0) [0|7] "" ZCUD
 SG_ HznProfLongLROffset : 268|13@0+ (1.0,0.0) [0.0|8191.0] "m" ZCUD
 SG_ HznProfLongLRPathIndex : 263|6@0+ (1.0,0.0) [0.0|63.0] "Unitless" ZCUD
 SG_ HznProfLongLRProfileType : 252|5@0+ (1.0,0.0) [0.0|31.0] "Unitless" ZCUD
 SG_ HznProfLongLRRetransmission : 318|1@0+ (1,0) [0|1] "" ZCUD
 SG_ HznProfLongLRUpdate : 317|1@0+ (1,0) [0|1] "" ZCUD
 SG_ HznProfLongLRValue : 287|32@0+ (1.0,0.0) [0.0|4294967295.0] "Unitless" ZCUD
 SG_ LocalBookChrgnTarVal : 87|10@0+ (0.1,0.0) [0.0|100.0] "%" ZCUD
 SG_ LocalBookChrgnTarVal_UB : 69|1@0+ (1,0) [0|1] "" ZCUD
 SG_ MaxAcInpCurrentSet : 327|8@0+ (1.0,0.0) [0.0|255.0] "Unitless" ZCUD
 SG_ MaxAcInpCurrentSet_UB : 90|1@0+ (1,0) [0|1] "" ZCUD
 SG_ ShowTypOfDTESet : 165|2@0+ (1,0) [0|3] "" ZCUD
 SG_ ShowTypOfDTESet_UB : 141|1@0+ (1,0) [0|1] "" ZCUD

CM_ SG_ 89 DwnLoadDynLtgPrmForFrntLeGrp13ContinueTime "Light Show Continue Time Parameter 2";
CM_ SG_ 89 DwnLoadDynLtgPrmForFrntLeGrp13HighBrightness "Light Show Upper Brightness Parameter 2";
CM_ SG_ 89 DwnLoadDynLtgPrmForFrntLeGrp13LowBrightness "Light Show Lower Brightness Parameter 2";
CM_ SG_ 89 DwnLoadDynLtgPrmForFrntLeGrp13Mode1 "Light Show Mode Parameter 2";
CM_ SG_ 89 DwnLoadDynLtgPrmForFrntLeGrp13OffsetTime "Light Show Offset Time Parameter 2";
CM_ SG_ 89 DwnLoadDynLtgPrmForFrntLeGrp13Timestamp "Light Show time stamp 2";
CM_ SG_ 89 DwnLoadDynLtgPrmForFrntLeGrp14ContinueTime "Light Show Continue Time Parameter 2";
CM_ SG_ 89 DwnLoadDynLtgPrmForFrntLeGrp14HighBrightness "Light Show Upper Brightness Parameter 2";
CM_ SG_ 89 DwnLoadDynLtgPrmForFrntLeGrp14LowBrightness "Light Show Lower Brightness Parameter 2";
CM_ SG_ 89 DwnLoadDynLtgPrmForFrntLeGrp14Mode1 "Light Show Mode Parameter 2";
CM_ SG_ 89 DwnLoadDynLtgPrmForFrntLeGrp14OffsetTime "Light Show Offset Time Parameter 2";
CM_ SG_ 89 DwnLoadDynLtgPrmForFrntLeGrp14Timestamp "Light Show time stamp 2";
CM_ SG_ 89 DwnLoadDynLtgPrmForFrntLeGrp15ContinueTime "Light Show Continue Time Parameter 2";
CM_ SG_ 89 DwnLoadDynLtgPrmForFrntLeGrp15HighBrightness "Light Show Upper Brightness Parameter 2";
CM_ SG_ 89 DwnLoadDynLtgPrmForFrntLeGrp15LowBrightness "Light Show Lower Brightness Parameter 2";
CM_ SG_ 89 DwnLoadDynLtgPrmForFrntLeGrp15Mode1 "Light Show Mode Parameter 2";
CM_ SG_ 89 DwnLoadDynLtgPrmForFrntLeGrp15OffsetTime "Light Show Offset Time Parameter 2";
CM_ SG_ 89 DwnLoadDynLtgPrmForFrntLeGrp15Timestamp "Light Show time stamp 2";
CM_ SG_ 89 DwnLoadDynLtgPrmForFrntLeGrp16ContinueTime "Light Show Continue Time Parameter 2";
CM_ SG_ 89 DwnLoadDynLtgPrmForFrntLeGrp16HighBrightness "Light Show Upper Brightness Parameter 2";
CM_ SG_ 89 DwnLoadDynLtgPrmForFrntLeGrp16LowBrightness "Light Show Lower Brightness Parameter 2";
CM_ SG_ 89 DwnLoadDynLtgPrmForFrntLeGrp16Mode1 "Light Show Mode Parameter 2";
CM_ SG_ 89 DwnLoadDynLtgPrmForFrntLeGrp16OffsetTime "Light Show Offset Time Parameter 2";
CM_ SG_ 89 DwnLoadDynLtgPrmForFrntLeGrp16Timestamp "Light Show time stamp 2";
CM_ SG_ 89 DwnLoadDynLtgPrmForFrntLeGrp17ContinueTime "Light Show Continue Time Parameter 2";
CM_ SG_ 89 DwnLoadDynLtgPrmForFrntLeGrp17HighBrightness "Light Show Upper Brightness Parameter 2";
CM_ SG_ 89 DwnLoadDynLtgPrmForFrntLeGrp17LowBrightness "Light Show Lower Brightness Parameter 2";
CM_ SG_ 89 DwnLoadDynLtgPrmForFrntLeGrp17Mode1 "Light Show Mode Parameter 2";
CM_ SG_ 89 DwnLoadDynLtgPrmForFrntLeGrp17OffsetTime "Light Show Offset Time Parameter 2";
CM_ SG_ 89 DwnLoadDynLtgPrmForFrntLeGrp17Timestamp "Light Show time stamp 2";
CM_ SG_ 89 DwnLoadDynLtgPrmForFrntLeGrp18ContinueTime "Light Show Continue Time Parameter 2";
CM_ SG_ 89 DwnLoadDynLtgPrmForFrntLeGrp18HighBrightness "Light Show Upper Brightness Parameter 2";
CM_ SG_ 89 DwnLoadDynLtgPrmForFrntLeGrp18LowBrightness "Light Show Lower Brightness Parameter 2";
CM_ SG_ 89 DwnLoadDynLtgPrmForFrntLeGrp18Mode1 "Light Show Mode Parameter 2";
CM_ SG_ 89 DwnLoadDynLtgPrmForFrntLeGrp18OffsetTime "Light Show Offset Time Parameter 2";
CM_ SG_ 89 DwnLoadDynLtgPrmForFrntLeGrp18Timestamp "Light Show time stamp 2";
CM_ SG_ 89 DwnLoadDynLtgPrmForFrntLeGrp19ContinueTime "Light Show Continue Time Parameter 2";
CM_ SG_ 89 DwnLoadDynLtgPrmForFrntLeGrp19HighBrightness "Light Show Upper Brightness Parameter 2";
CM_ SG_ 89 DwnLoadDynLtgPrmForFrntLeGrp19LowBrightness "Light Show Lower Brightness Parameter 2";
CM_ SG_ 89 DwnLoadDynLtgPrmForFrntLeGrp19Mode1 "Light Show Mode Parameter 2";
CM_ SG_ 89 DwnLoadDynLtgPrmForFrntLeGrp19OffsetTime "Light Show Offset Time Parameter 2";
CM_ SG_ 89 DwnLoadDynLtgPrmForFrntLeGrp19Timestamp "Light Show time stamp 2";
CM_ SG_ 89 DwnLoadDynLtgPrmForFrntLeGrp20ContinueTime "Light Show Continue Time Parameter 2";
CM_ SG_ 89 DwnLoadDynLtgPrmForFrntLeGrp20HighBrightness "Light Show Upper Brightness Parameter 2";
CM_ SG_ 89 DwnLoadDynLtgPrmForFrntLeGrp20LowBrightness "Light Show Lower Brightness Parameter 2";
CM_ SG_ 89 DwnLoadDynLtgPrmForFrntLeGrp20Mode1 "Light Show Mode Parameter 2";
CM_ SG_ 89 DwnLoadDynLtgPrmForFrntLeGrp20OffsetTime "Light Show Offset Time Parameter 2";
CM_ SG_ 89 DwnLoadDynLtgPrmForFrntLeGrp20Timestamp "Light Show time stamp 2";
CM_ SG_ 89 DwnLoadDynLtgPrmForFrntLeGrp21ContinueTime "Light Show Continue Time Parameter 2";
CM_ SG_ 89 DwnLoadDynLtgPrmForFrntLeGrp21HighBrightness "Light Show Upper Brightness Parameter 2";
CM_ SG_ 89 DwnLoadDynLtgPrmForFrntLeGrp21LowBrightness "Light Show Lower Brightness Parameter 2";
CM_ SG_ 89 DwnLoadDynLtgPrmForFrntLeGrp21Mode1 "Light Show Mode Parameter 2";
CM_ SG_ 89 DwnLoadDynLtgPrmForFrntLeGrp21OffsetTime "Light Show Offset Time Parameter 2";
CM_ SG_ 89 DwnLoadDynLtgPrmForFrntLeGrp21Timestamp "Light Show time stamp 2";
CM_ SG_ 89 DwnLoadDynLtgPrmForFrntLeGrp22ContinueTime "Light Show Continue Time Parameter 2";
CM_ SG_ 89 DwnLoadDynLtgPrmForFrntLeGrp22HighBrightness "Light Show Upper Brightness Parameter 2";
CM_ SG_ 89 DwnLoadDynLtgPrmForFrntLeGrp22LowBrightness "Light Show Lower Brightness Parameter 2";
CM_ SG_ 89 DwnLoadDynLtgPrmForFrntLeGrp22Mode1 "Light Show Mode Parameter 2";
CM_ SG_ 89 DwnLoadDynLtgPrmForFrntLeGrp22OffsetTime "Light Show Offset Time Parameter 2";
CM_ SG_ 89 DwnLoadDynLtgPrmForFrntLeGrp22Timestamp "Light Show time stamp 2";
CM_ SG_ 89 DwnLoadDynLtgPrmForFrntLeGrp23ContinueTime "Light Show Continue Time Parameter 2";
CM_ SG_ 89 DwnLoadDynLtgPrmForFrntLeGrp23HighBrightness "Light Show Upper Brightness Parameter 2";
CM_ SG_ 89 DwnLoadDynLtgPrmForFrntLeGrp23LowBrightness "Light Show Lower Brightness Parameter 2";
CM_ SG_ 89 DwnLoadDynLtgPrmForFrntLeGrp23Mode1 "Light Show Mode Parameter 2";
CM_ SG_ 89 DwnLoadDynLtgPrmForFrntLeGrp23OffsetTime "Light Show Offset Time Parameter 2";
CM_ SG_ 89 DwnLoadDynLtgPrmForFrntLeGrp23Timestamp "Light Show time stamp 2";
CM_ SG_ 89 DwnLoadDynLtgPrmForFrntLeGrp24ContinueTime "Light Show Continue Time Parameter 2";
CM_ SG_ 89 DwnLoadDynLtgPrmForFrntLeGrp24HighBrightness "Light Show Upper Brightness Parameter 2";
CM_ SG_ 89 DwnLoadDynLtgPrmForFrntLeGrp24LowBrightness "Light Show Lower Brightness Parameter 2";
CM_ SG_ 89 DwnLoadDynLtgPrmForFrntLeGrp24Mode1 "Light Show Mode Parameter 2";
CM_ SG_ 89 DwnLoadDynLtgPrmForFrntLeGrp24OffsetTime "Light Show Offset Time Parameter 2";
CM_ SG_ 89 DwnLoadDynLtgPrmForFrntLeGrp24Timestamp "Light Show time stamp 2";
CM_ SG_ 89 TelmAirFragTasteReq "remote Fragrance channel Taste request";
CM_ SG_ 89 TelmBookClimaTmr "Telm Book Clima Timer Set";
CM_ SG_ 89 TelmClimaReq "remote climate start request";
CM_ SG_ 89 TelmDefrostReq "Remote defrost request
";
CM_ SG_ 89 TelmLockgCenReqReqTyp "Request signal from Telematics to central lock/unlock the vehicle or to unlock via tailgate enabled. (VEH-FCT : S-83-06 Vehicle LockingUnlocking / SPA; 0) Request type";
CM_ SG_ 89 TelmLockgCenReqTiVld "Request signal from Telematics to central lock/unlock the vehicle or to unlock via tailgate enabled. (VEH-FCT : S-83-06 Vehicle LockingUnlocking / SPA; 0) Valid time";
CM_ SG_ 89 TelmPM25Req "remote PM2.5request";
CM_ SG_ 89 TelmPreClimaPrio "Energy prioritization mode for pre-climatization";
CM_ SG_ 89 TelmSeatDrvHeatClimaLvl "remote driver seat heating level";
CM_ SG_ 89 TelmSeatDrvVentnClimaLvl "remote driver seat ventilate level";
CM_ SG_ 89 TelmSeatPassHeatClimaLvl "remote Passer seat heating level";
CM_ SG_ 89 TelmSeatPassVentnClimaLvl "remote passer seat ventilate level";
CM_ SG_ 89 TelmSeatSecLeHeatClimaLvl "remote second left seat heating level";
CM_ SG_ 89 TelmSeatSecLeVentnClimaLvl "remote second left seat ventilate level";
CM_ SG_ 89 TelmSeatSecRiHeatClimaLvl "remote second right seat heating level";
CM_ SG_ 89 TelmSeatSecRiVentnClimaLvl "remote second right seat ventilate level";
CM_ SG_ 89 TelmSeatThrdLeHeatClimaLvl "remote third left seat heat level";
CM_ SG_ 89 TelmSeatThrdLeVentnClimaLvl "remote third left seat ventilate level";
CM_ SG_ 89 TelmSeatThrdRiHeatClimaLvl "remote third right seat heat level";
CM_ SG_ 89 TelmSeatThrdRiVentnClimaLvl "remote third right seat ventilate level";
CM_ SG_ 99 DwnLoadDynLtgPrmForFrntRIGrp10ContinueTime "Light Show Continue Time Parameter 2";
CM_ SG_ 99 DwnLoadDynLtgPrmForFrntRIGrp10HighBrightness "Light Show Upper Brightness Parameter 2";
CM_ SG_ 99 DwnLoadDynLtgPrmForFrntRIGrp10LowBrightness "Light Show Lower Brightness Parameter 2";
CM_ SG_ 99 DwnLoadDynLtgPrmForFrntRIGrp10Mode1 "Light Show Mode Parameter 2";
CM_ SG_ 99 DwnLoadDynLtgPrmForFrntRIGrp10OffsetTime "Light Show Offset Time Parameter 2";
CM_ SG_ 99 DwnLoadDynLtgPrmForFrntRIGrp10Timestamp "Light Show time stamp 2";
CM_ SG_ 99 DwnLoadDynLtgPrmForFrntRIGrp11ContinueTime "Light Show Continue Time Parameter 2";
CM_ SG_ 99 DwnLoadDynLtgPrmForFrntRIGrp11HighBrightness "Light Show Upper Brightness Parameter 2";
CM_ SG_ 99 DwnLoadDynLtgPrmForFrntRIGrp11LowBrightness "Light Show Lower Brightness Parameter 2";
CM_ SG_ 99 DwnLoadDynLtgPrmForFrntRIGrp11Mode1 "Light Show Mode Parameter 2";
CM_ SG_ 99 DwnLoadDynLtgPrmForFrntRIGrp11OffsetTime "Light Show Offset Time Parameter 2";
CM_ SG_ 99 DwnLoadDynLtgPrmForFrntRIGrp11Timestamp "Light Show time stamp 2";
CM_ SG_ 99 DwnLoadDynLtgPrmForFrntRIGrp12ContinueTime "Light Show Continue Time Parameter 2";
CM_ SG_ 99 DwnLoadDynLtgPrmForFrntRIGrp12HighBrightness "Light Show Upper Brightness Parameter 2";
CM_ SG_ 99 DwnLoadDynLtgPrmForFrntRIGrp12LowBrightness "Light Show Lower Brightness Parameter 2";
CM_ SG_ 99 DwnLoadDynLtgPrmForFrntRIGrp12Mode1 "Light Show Mode Parameter 2";
CM_ SG_ 99 DwnLoadDynLtgPrmForFrntRIGrp12OffsetTime "Light Show Offset Time Parameter 2";
CM_ SG_ 99 DwnLoadDynLtgPrmForFrntRIGrp12Timestamp "Light Show time stamp 2";
CM_ SG_ 99 DwnLoadDynLtgPrmForFrntRIGrp1ContinueTime "Light Show Continue Time Parameter 2";
CM_ SG_ 99 DwnLoadDynLtgPrmForFrntRIGrp1HighBrightness "Light Show Upper Brightness Parameter 2";
CM_ SG_ 99 DwnLoadDynLtgPrmForFrntRIGrp1LowBrightness "Light Show Lower Brightness Parameter 2";
CM_ SG_ 99 DwnLoadDynLtgPrmForFrntRIGrp1Mode1 "Light Show Mode Parameter 2";
CM_ SG_ 99 DwnLoadDynLtgPrmForFrntRIGrp1OffsetTime "Light Show Offset Time Parameter 2";
CM_ SG_ 99 DwnLoadDynLtgPrmForFrntRIGrp1Timestamp "Light Show time stamp 2";
CM_ SG_ 99 DwnLoadDynLtgPrmForFrntRIGrp2ContinueTime "Light Show Continue Time Parameter 2";
CM_ SG_ 99 DwnLoadDynLtgPrmForFrntRIGrp2HighBrightness "Light Show Upper Brightness Parameter 2";
CM_ SG_ 99 DwnLoadDynLtgPrmForFrntRIGrp2LowBrightness "Light Show Lower Brightness Parameter 2";
CM_ SG_ 99 DwnLoadDynLtgPrmForFrntRIGrp2Mode1 "Light Show Mode Parameter 2";
CM_ SG_ 99 DwnLoadDynLtgPrmForFrntRIGrp2OffsetTime "Light Show Offset Time Parameter 2";
CM_ SG_ 99 DwnLoadDynLtgPrmForFrntRIGrp2Timestamp "Light Show time stamp 2";
CM_ SG_ 99 DwnLoadDynLtgPrmForFrntRIGrp3ContinueTime "Light Show Continue Time Parameter 2";
CM_ SG_ 99 DwnLoadDynLtgPrmForFrntRIGrp3HighBrightness "Light Show Upper Brightness Parameter 2";
CM_ SG_ 99 DwnLoadDynLtgPrmForFrntRIGrp3LowBrightness "Light Show Lower Brightness Parameter 2";
CM_ SG_ 99 DwnLoadDynLtgPrmForFrntRIGrp3Mode1 "Light Show Mode Parameter 2";
CM_ SG_ 99 DwnLoadDynLtgPrmForFrntRIGrp3OffsetTime "Light Show Offset Time Parameter 2";
CM_ SG_ 99 DwnLoadDynLtgPrmForFrntRIGrp3Timestamp "Light Show time stamp 2";
CM_ SG_ 99 DwnLoadDynLtgPrmForFrntRIGrp4ContinueTime "Light Show Continue Time Parameter 2";
CM_ SG_ 99 DwnLoadDynLtgPrmForFrntRIGrp4HighBrightness "Light Show Upper Brightness Parameter 2";
CM_ SG_ 99 DwnLoadDynLtgPrmForFrntRIGrp4LowBrightness "Light Show Lower Brightness Parameter 2";
CM_ SG_ 99 DwnLoadDynLtgPrmForFrntRIGrp4Mode1 "Light Show Mode Parameter 2";
CM_ SG_ 99 DwnLoadDynLtgPrmForFrntRIGrp4OffsetTime "Light Show Offset Time Parameter 2";
CM_ SG_ 99 DwnLoadDynLtgPrmForFrntRIGrp4Timestamp "Light Show time stamp 2";
CM_ SG_ 99 DwnLoadDynLtgPrmForFrntRIGrp5ContinueTime "Light Show Continue Time Parameter 2";
CM_ SG_ 99 DwnLoadDynLtgPrmForFrntRIGrp5HighBrightness "Light Show Upper Brightness Parameter 2";
CM_ SG_ 99 DwnLoadDynLtgPrmForFrntRIGrp5LowBrightness "Light Show Lower Brightness Parameter 2";
CM_ SG_ 99 DwnLoadDynLtgPrmForFrntRIGrp5Mode1 "Light Show Mode Parameter 2";
CM_ SG_ 99 DwnLoadDynLtgPrmForFrntRIGrp5OffsetTime "Light Show Offset Time Parameter 2";
CM_ SG_ 99 DwnLoadDynLtgPrmForFrntRIGrp5Timestamp "Light Show time stamp 2";
CM_ SG_ 99 DwnLoadDynLtgPrmForFrntRIGrp6ContinueTime "Light Show Continue Time Parameter 2";
CM_ SG_ 99 DwnLoadDynLtgPrmForFrntRIGrp6HighBrightness "Light Show Upper Brightness Parameter 2";
CM_ SG_ 99 DwnLoadDynLtgPrmForFrntRIGrp6LowBrightness "Light Show Lower Brightness Parameter 2";
CM_ SG_ 99 DwnLoadDynLtgPrmForFrntRIGrp6Mode1 "Light Show Mode Parameter 2";
CM_ SG_ 99 DwnLoadDynLtgPrmForFrntRIGrp6OffsetTime "Light Show Offset Time Parameter 2";
CM_ SG_ 99 DwnLoadDynLtgPrmForFrntRIGrp6Timestamp "Light Show time stamp 2";
CM_ SG_ 99 DwnLoadDynLtgPrmForFrntRIGrp7ContinueTime "Light Show Continue Time Parameter 2";
CM_ SG_ 99 DwnLoadDynLtgPrmForFrntRIGrp7HighBrightness "Light Show Upper Brightness Parameter 2";
CM_ SG_ 99 DwnLoadDynLtgPrmForFrntRIGrp7LowBrightness "Light Show Lower Brightness Parameter 2";
CM_ SG_ 99 DwnLoadDynLtgPrmForFrntRIGrp7Mode1 "Light Show Mode Parameter 2";
CM_ SG_ 99 DwnLoadDynLtgPrmForFrntRIGrp7OffsetTime "Light Show Offset Time Parameter 2";
CM_ SG_ 99 DwnLoadDynLtgPrmForFrntRIGrp7Timestamp "Light Show time stamp 2";
CM_ SG_ 99 DwnLoadDynLtgPrmForFrntRIGrp8ContinueTime "Light Show Continue Time Parameter 2";
CM_ SG_ 99 DwnLoadDynLtgPrmForFrntRIGrp8HighBrightness "Light Show Upper Brightness Parameter 2";
CM_ SG_ 99 DwnLoadDynLtgPrmForFrntRIGrp8LowBrightness "Light Show Lower Brightness Parameter 2";
CM_ SG_ 99 DwnLoadDynLtgPrmForFrntRIGrp8Mode1 "Light Show Mode Parameter 2";
CM_ SG_ 99 DwnLoadDynLtgPrmForFrntRIGrp8OffsetTime "Light Show Offset Time Parameter 2";
CM_ SG_ 99 DwnLoadDynLtgPrmForFrntRIGrp8Timestamp "Light Show time stamp 2";
CM_ SG_ 99 DwnLoadDynLtgPrmForFrntRIGrp9ContinueTime "Light Show Continue Time Parameter 2";
CM_ SG_ 99 DwnLoadDynLtgPrmForFrntRIGrp9HighBrightness "Light Show Upper Brightness Parameter 2";
CM_ SG_ 99 DwnLoadDynLtgPrmForFrntRIGrp9LowBrightness "Light Show Lower Brightness Parameter 2";
CM_ SG_ 99 DwnLoadDynLtgPrmForFrntRIGrp9Mode1 "Light Show Mode Parameter 2";
CM_ SG_ 99 DwnLoadDynLtgPrmForFrntRIGrp9OffsetTime "Light Show Offset Time Parameter 2";
CM_ SG_ 99 DwnLoadDynLtgPrmForFrntRIGrp9Timestamp "Light Show time stamp 2";
CM_ SG_ 99 TelmBookSeatHeatClimalReqDrvHeatClimaLvl "driver seat heat level for booking climate";
CM_ SG_ 99 TelmBookSeatHeatClimalReqPassHeatClimaLvl "passenger seat heat level for booking climate";
CM_ SG_ 99 TelmBookSeatHeatClimalReqSecLeHeatClimaLvl "second left seat heat level for booking climate";
CM_ SG_ 99 TelmBookSeatHeatClimalReqSecRiHeatClimaLvl "second right seat heat level for booking climate";
CM_ SG_ 99 TelmBookSeatHeatClimalReqThrdLeHeatClimaLvl "third left seat heat level for booking climate";
CM_ SG_ 99 TelmBookSeatHeatClimalReqThrdRiHeatClimaLvl "third right seat heat level for booking climate";
CM_ SG_ 99 TelmBookSeatVentnClimalReqDrvVentnClimaLvl "driver seat ventilate level for booking climate";
CM_ SG_ 99 TelmBookSeatVentnClimalReqPassVentnClimaLvl "passenger seat ventilate level for booking climate";
CM_ SG_ 99 TelmBookSeatVentnClimalReqSecLeVentnClimaLvl "second left seat ventilate level for booking climate";
CM_ SG_ 99 TelmBookSeatVentnClimalReqSecRiVentnClimaLvl "second right seat ventilate level for booking climate";
CM_ SG_ 99 TelmBookSeatVentnClimalReqThrdLeVentnClimaLvl "third left seat ventilate level for booking climate";
CM_ SG_ 99 TelmBookSeatVentnClimalReqThrdRiVentnClimaL "third right seat ventilate level for booking climate";
CM_ SG_ 99 TelmClimaTSetHmiCmptmtTSpSpcl "remote climate temperature setting status";
CM_ SG_ 99 TelmClimaTSetTempRange "remote climate temperature setting";
CM_ SG_ 99 TelmStrtEngForChrgnReq "remote start engine request for discharging";
CM_ SG_ 99 TimeOfcommCharn "false or true";
CM_ SG_ 103 DwnLoadDynLtgPrmForFrntRIGrp13ContinueTime "Light Show Continue Time Parameter 2";
CM_ SG_ 103 DwnLoadDynLtgPrmForFrntRIGrp13HighBrightness "Light Show Upper Brightness Parameter 2";
CM_ SG_ 103 DwnLoadDynLtgPrmForFrntRIGrp13LowBrightness "Light Show Lower Brightness Parameter 2";
CM_ SG_ 103 DwnLoadDynLtgPrmForFrntRIGrp13Mode1 "Light Show Mode Parameter 2";
CM_ SG_ 103 DwnLoadDynLtgPrmForFrntRIGrp13OffsetTime "Light Show Offset Time Parameter 2";
CM_ SG_ 103 DwnLoadDynLtgPrmForFrntRIGrp13Timestamp "Light Show time stamp 2";
CM_ SG_ 103 DwnLoadDynLtgPrmForFrntRIGrp14ContinueTime "Light Show Continue Time Parameter 2";
CM_ SG_ 103 DwnLoadDynLtgPrmForFrntRIGrp14HighBrightness "Light Show Upper Brightness Parameter 2";
CM_ SG_ 103 DwnLoadDynLtgPrmForFrntRIGrp14LowBrightness "Light Show Lower Brightness Parameter 2";
CM_ SG_ 103 DwnLoadDynLtgPrmForFrntRIGrp14Mode1 "Light Show Mode Parameter 2";
CM_ SG_ 103 DwnLoadDynLtgPrmForFrntRIGrp14OffsetTime "Light Show Offset Time Parameter 2";
CM_ SG_ 103 DwnLoadDynLtgPrmForFrntRIGrp14Timestamp "Light Show time stamp 2";
CM_ SG_ 103 DwnLoadDynLtgPrmForFrntRIGrp15ContinueTime "Light Show Continue Time Parameter 2";
CM_ SG_ 103 DwnLoadDynLtgPrmForFrntRIGrp15HighBrightness "Light Show Upper Brightness Parameter 2";
CM_ SG_ 103 DwnLoadDynLtgPrmForFrntRIGrp15LowBrightness "Light Show Lower Brightness Parameter 2";
CM_ SG_ 103 DwnLoadDynLtgPrmForFrntRIGrp15Mode1 "Light Show Mode Parameter 2";
CM_ SG_ 103 DwnLoadDynLtgPrmForFrntRIGrp15OffsetTime "Light Show Offset Time Parameter 2";
CM_ SG_ 103 DwnLoadDynLtgPrmForFrntRIGrp15Timestamp "Light Show time stamp 2";
CM_ SG_ 103 DwnLoadDynLtgPrmForFrntRIGrp16ContinueTime "Light Show Continue Time Parameter 2";
CM_ SG_ 103 DwnLoadDynLtgPrmForFrntRIGrp16HighBrightness "Light Show Upper Brightness Parameter 2";
CM_ SG_ 103 DwnLoadDynLtgPrmForFrntRIGrp16LowBrightness "Light Show Lower Brightness Parameter 2";
CM_ SG_ 103 DwnLoadDynLtgPrmForFrntRIGrp16Mode1 "Light Show Mode Parameter 2";
CM_ SG_ 103 DwnLoadDynLtgPrmForFrntRIGrp16OffsetTime "Light Show Offset Time Parameter 2";
CM_ SG_ 103 DwnLoadDynLtgPrmForFrntRIGrp16Timestamp "Light Show time stamp 2";
CM_ SG_ 103 DwnLoadDynLtgPrmForFrntRIGrp17ContinueTime "Light Show Continue Time Parameter 2";
CM_ SG_ 103 DwnLoadDynLtgPrmForFrntRIGrp17HighBrightness "Light Show Upper Brightness Parameter 2";
CM_ SG_ 103 DwnLoadDynLtgPrmForFrntRIGrp17LowBrightness "Light Show Lower Brightness Parameter 2";
CM_ SG_ 103 DwnLoadDynLtgPrmForFrntRIGrp17Mode1 "Light Show Mode Parameter 2";
CM_ SG_ 103 DwnLoadDynLtgPrmForFrntRIGrp17OffsetTime "Light Show Offset Time Parameter 2";
CM_ SG_ 103 DwnLoadDynLtgPrmForFrntRIGrp17Timestamp "Light Show time stamp 2";
CM_ SG_ 103 DwnLoadDynLtgPrmForFrntRIGrp18ContinueTime "Light Show Continue Time Parameter 2";
CM_ SG_ 103 DwnLoadDynLtgPrmForFrntRIGrp18HighBrightness "Light Show Upper Brightness Parameter 2";
CM_ SG_ 103 DwnLoadDynLtgPrmForFrntRIGrp18LowBrightness "Light Show Lower Brightness Parameter 2";
CM_ SG_ 103 DwnLoadDynLtgPrmForFrntRIGrp18Mode1 "Light Show Mode Parameter 2";
CM_ SG_ 103 DwnLoadDynLtgPrmForFrntRIGrp18OffsetTime "Light Show Offset Time Parameter 2";
CM_ SG_ 103 DwnLoadDynLtgPrmForFrntRIGrp18Timestamp "Light Show time stamp 2";
CM_ SG_ 103 DwnLoadDynLtgPrmForFrntRIGrp19ContinueTime "Light Show Continue Time Parameter 2";
CM_ SG_ 103 DwnLoadDynLtgPrmForFrntRIGrp19HighBrightness "Light Show Upper Brightness Parameter 2";
CM_ SG_ 103 DwnLoadDynLtgPrmForFrntRIGrp19LowBrightness "Light Show Lower Brightness Parameter 2";
CM_ SG_ 103 DwnLoadDynLtgPrmForFrntRIGrp19Mode1 "Light Show Mode Parameter 2";
CM_ SG_ 103 DwnLoadDynLtgPrmForFrntRIGrp19OffsetTime "Light Show Offset Time Parameter 2";
CM_ SG_ 103 DwnLoadDynLtgPrmForFrntRIGrp19Timestamp "Light Show time stamp 2";
CM_ SG_ 103 DwnLoadDynLtgPrmForFrntRIGrp20ContinueTime "Light Show Continue Time Parameter 2";
CM_ SG_ 103 DwnLoadDynLtgPrmForFrntRIGrp20HighBrightness "Light Show Upper Brightness Parameter 2";
CM_ SG_ 103 DwnLoadDynLtgPrmForFrntRIGrp20LowBrightness "Light Show Lower Brightness Parameter 2";
CM_ SG_ 103 DwnLoadDynLtgPrmForFrntRIGrp20Mode1 "Light Show Mode Parameter 2";
CM_ SG_ 103 DwnLoadDynLtgPrmForFrntRIGrp20OffsetTime "Light Show Offset Time Parameter 2";
CM_ SG_ 103 DwnLoadDynLtgPrmForFrntRIGrp20Timestamp "Light Show time stamp 2";
CM_ SG_ 103 DwnLoadDynLtgPrmForFrntRIGrp21ContinueTime "Light Show Continue Time Parameter 2";
CM_ SG_ 103 DwnLoadDynLtgPrmForFrntRIGrp21HighBrightness "Light Show Upper Brightness Parameter 2";
CM_ SG_ 103 DwnLoadDynLtgPrmForFrntRIGrp21LowBrightness "Light Show Lower Brightness Parameter 2";
CM_ SG_ 103 DwnLoadDynLtgPrmForFrntRIGrp21Mode1 "Light Show Mode Parameter 2";
CM_ SG_ 103 DwnLoadDynLtgPrmForFrntRIGrp21OffsetTime "Light Show Offset Time Parameter 2";
CM_ SG_ 103 DwnLoadDynLtgPrmForFrntRIGrp21Timestamp "Light Show time stamp 2";
CM_ SG_ 103 DwnLoadDynLtgPrmForFrntRIGrp22ContinueTime "Light Show Continue Time Parameter 2";
CM_ SG_ 103 DwnLoadDynLtgPrmForFrntRIGrp22HighBrightness "Light Show Upper Brightness Parameter 2";
CM_ SG_ 103 DwnLoadDynLtgPrmForFrntRIGrp22LowBrightness "Light Show Lower Brightness Parameter 2";
CM_ SG_ 103 DwnLoadDynLtgPrmForFrntRIGrp22Mode1 "Light Show Mode Parameter 2";
CM_ SG_ 103 DwnLoadDynLtgPrmForFrntRIGrp22OffsetTime "Light Show Offset Time Parameter 2";
CM_ SG_ 103 DwnLoadDynLtgPrmForFrntRIGrp22Timestamp "Light Show time stamp 2";
CM_ SG_ 103 DwnLoadDynLtgPrmForFrntRIGrp23ContinueTime "Light Show Continue Time Parameter 2";
CM_ SG_ 103 DwnLoadDynLtgPrmForFrntRIGrp23HighBrightness "Light Show Upper Brightness Parameter 2";
CM_ SG_ 103 DwnLoadDynLtgPrmForFrntRIGrp23LowBrightness "Light Show Lower Brightness Parameter 2";
CM_ SG_ 103 DwnLoadDynLtgPrmForFrntRIGrp23Mode1 "Light Show Mode Parameter 2";
CM_ SG_ 103 DwnLoadDynLtgPrmForFrntRIGrp23OffsetTime "Light Show Offset Time Parameter 2";
CM_ SG_ 103 DwnLoadDynLtgPrmForFrntRIGrp23Timestamp "Light Show time stamp 2";
CM_ SG_ 103 DwnLoadDynLtgPrmForFrntRIGrp24ContinueTime "Light Show Continue Time Parameter 2";
CM_ SG_ 103 DwnLoadDynLtgPrmForFrntRIGrp24HighBrightness "Light Show Upper Brightness Parameter 2";
CM_ SG_ 103 DwnLoadDynLtgPrmForFrntRIGrp24LowBrightness "Light Show Lower Brightness Parameter 2";
CM_ SG_ 103 DwnLoadDynLtgPrmForFrntRIGrp24Mode1 "Light Show Mode Parameter 2";
CM_ SG_ 103 DwnLoadDynLtgPrmForFrntRIGrp24OffsetTime "Light Show Offset Time Parameter 2";
CM_ SG_ 103 DwnLoadDynLtgPrmForFrntRIGrp24Timestamp "Light Show time stamp 2";
CM_ SG_ 103 TelmBookClimaReqHmiCmptmtTSpSpcl "Climate mode Normal/Lo/Hi";
CM_ SG_ 103 TelmBookClimaReqOnOffNoReq "Climate request On/Off";
CM_ SG_ 103 TelmBookClimaReqTempRange "Climate temperature set";
CM_ SG_ 103 TelmEngDelayTi "remote engine delay time";
CM_ SG_ 103 WinOpenClsGlbReqFromTelmWindowOpenValue "Windows open value pec open 1-100";
CM_ SG_ 103 WinOpenClsGlbReqFromTelmWinOpenClsGlbSts "remote global windows open and closed command request from telematics";
CM_ SG_ 560 BevPwrCtrl "send the status of Bev power button";
CM_ SG_ 560 CopilotSeatOccupySts "Copilot seat Occupy status.";
CM_ SG_ 560 DrvrHdPosnDetnX "Defines the signal that monitors the X-axis of the driver's head position.";
CM_ SG_ 560 DrvrHdPosnDetnY "Defines the signal that monitors the Y-axis of the driver's head position.";
CM_ SG_ 560 DrvrHdPosnDetnZ "Defines the signal that monitors the Z-axis of the driver's head position.";
CM_ SG_ 560 DrvSeatOccupySts "Driver seat Occupy status.";
CM_ SG_ 560 HMIAirCdnrAutDrySet "Air Conditioner Automatic Dry";
CM_ SG_ 560 HmiPM25PopUpSet "PM2.5 PopUp function setting Request";
CM_ SG_ 560 PassSideHdPosnDetnX "Defines the signal that monitors the X-axis of the copilot head position.";
CM_ SG_ 560 PassSideHdPosnDetnY "Defines the signal that monitors the Y-axis of the copilot head position.";
CM_ SG_ 560 PassSideHdPosnDetnZ "Defines the signal that monitors the Z-axis of the copilot head position.";
CM_ SG_ 560 SteerSetgPen "IdPen";
CM_ SG_ 560 SteerSetgSteerAsscLvl "Steer Assistance Level";
CM_ SG_ 560 SteerSetgSteerMod "Steer Mode";
CM_ SG_ 560 WiprReAutReq "Activation of Automatic Rear Wiping";
CM_ SG_ 368 AutEgyRgnLvlSet "This signal represents the setting of the energy regeneration level which car with auto level.";
CM_ SG_ 368 AutElecStepCtrlSwtStsDriver "Auto electric retractable step enable";
CM_ SG_ 368 AutElecStepCtrlSwtStsPassenger "Auto electric retractable step enable";
CM_ SG_ 368 AutoClsLockdFctEnaRADAR "Auto close by lock mode enable switch for Pickup Tonneau Cover";
CM_ SG_ 368 AutoClsRainFctEnaRADAR "Auto close by rainy mode enable switch for Pickup Tonneau Cover";
CM_ SG_ 368 BLEKeyExtLoUOutIPwrSplyCtrlZone1 "The On/Off requirement of zone1 for External Low Voltage Outlet Power Supply";
CM_ SG_ 368 BLEKeyExtLoUOutIPwrSplyCtrlZone2 "The On/Off requirement of zone2 for External Low Voltage Outlet Power Supply";
CM_ SG_ 368 BLEKeyExtLoUOutIPwrSplyCtrlZone3 "The On/Off requirement of zone3 for External Low Voltage Outlet Power Supply";
CM_ SG_ 368 BLEKeyExtLoUOutIPwrSplyCtrlZone4 "The On/Off requirement of zone4 for External Low Voltage Outlet Power Supply";
CM_ SG_ 368 BLEKeyExtLoUOutIPwrSplyCtrlZone5 "The On/Off requirement of zone5 for External Low Voltage Outlet Power Supply";
CM_ SG_ 368 BLEKeyExtLoUOutIPwrSplyCtrlZone6 "The On/Off requirement of zone6 for External Low Voltage Outlet Power Supply";
CM_ SG_ 368 DrvrSeatCmftReq "driver seat comfort request";
CM_ SG_ 368 DrvrSeatReturnReq "driver seat return request";
CM_ SG_ 368 ElecStepReq "Auto electric retractable step control on/off";
CM_ SG_ 368 FaceRecognitionIndcrFromDHU "The indicator of face recognition successful";
CM_ SG_ 368 FrntSunCurtCtrlReq "User operate front suncurt open and close";
CM_ SG_ 368 FrntSunCurtIninSwt "Front sun curtain initialazation switch";
CM_ SG_ 368 FrntSunCurtOpenPosnReq "Front sun curtain open or close position request";
CM_ SG_ 368 GestureDetn "Define signals to monitor gesture status.";
CM_ SG_ 368 HmiSeatVentAutStrtRowThrdLe "HmiSeatVentAutStrtRowThrdLe";
CM_ SG_ 368 HmiSeatVentAutStrtRowThrdRi "HmiSeatVentAutStrtRowThrdRi";
CM_ SG_ 368 IceBreakModEnaRADAR "Ice break mode enable switch for Pickup Tonneau Cover";
CM_ SG_ 368 LnchModSwt "to switch on/off the launch mode";
CM_ SG_ 368 LvlgSwtSetReqChks "this signal is used to set the vertical level of low beam for exterior  light systerm ";
CM_ SG_ 368 LvlgSwtSetReqCntr "this signal is used to set the vertical level of low beam for exterior  light systerm ";
CM_ SG_ 368 LvlgSwtSetReqLvlgSwtSetReq "this signal is used to set the vertical level of low beam for exterior  light systerm ";
CM_ SG_ 368 PassSeatCmftReq "passenger seat comfort request";
CM_ SG_ 368 PassSeatReturnReq "passenger seat return request";
CM_ SG_ 368 PrpsnMaxEvMod "Propulsion Max EV Mod On/Off";
CM_ SG_ 368 PwrTonneauCoverOpenPosnReqRADAR "Pickup Tonneau Cover open position request";
CM_ SG_ 368 RainSnsrSnvtyHMIReq "Rain sensor sensitivity soft switch require";
CM_ SG_ 368 RCcontrolForDCchargeLid "If user not press the button on charging gun, the value should be 0, other wise, the value should be 1";
CM_ SG_ 368 RelsEnaSwt "Electrical release enable switch";
CM_ SG_ 368 ReSunCurtCtrlReq "User operate rear suncurt open and close";
CM_ SG_ 368 ReSunCurtIninSwt "Rear sun curtain initialazation switch";
CM_ SG_ 368 SecLeSeatHeiTargPosPerc "second row left seat height target position percentage request";
CM_ SG_ 368 SecLeSeatTarPosnCmdReqSeatBackrTargPosAg "Second row left seat backrest data";
CM_ SG_ 368 SecLeSeatTarPosnCmdReqSeatFrntExtenTargPosPerc "Second row left seat extension data";
CM_ SG_ 368 SecLeSeatTarPosnCmdReqSeatFrntHeiTargPosPerc "Second row left seat front height data";
CM_ SG_ 368 SecLeSeatTarPosnCmdReqSeatLenTargPosPerc "Second row left seat Length data";
CM_ SG_ 368 SecLeSeatTarPosnCmdReqTarPosnCmd1 "Request second left side seat adjusting to target position";
CM_ SG_ 368 SecRiSeatHeiTargPosPerc "second row right seat height target position percentage request";
CM_ SG_ 368 SecRiSeatTarPosnCmdReqSeatBackrTargPosAg "Second row right seat backrest data";
CM_ SG_ 368 SecRiSeatTarPosnCmdReqSeatFrntExtenTargPosPerc "Second row right seat extension data";
CM_ SG_ 368 SecRiSeatTarPosnCmdReqSeatFrntHeiTargPosPerc "Second row right seat front height data";
CM_ SG_ 368 SecRiSeatTarPosnCmdReqSeatLenTargPosPerc "Second row right seat Length data";
CM_ SG_ 368 SecRiSeatTarPosnCmdReqTarPosnCmd1 "Request second right side seat adjusting to target position";
CM_ SG_ 368 SecRowLeSeatCmftReq "second row seat left comfort request";
CM_ SG_ 368 SecRowLeSeatFoldRaiseReq "Second row left seat fold&raise request";
CM_ SG_ 368 SecRowLeSeatHeiAdjmt "second row seat left upward and downward  adjustment";
CM_ SG_ 368 SecRowLeSeatReturnReq "second row seat return request";
CM_ SG_ 368 SecRowRiSeatCmftReq "second row seat right comfort request";
CM_ SG_ 368 SecRowRiSeatFoldRaiseReq "Second row right seat fold&raise request";
CM_ SG_ 368 SecRowRiSeatHeiAdjmt "second row seat right upward and downward  adjustment";
CM_ SG_ 368 SecRowRiSeatReturnReq "second row seat right return request";
CM_ SG_ 368 SecRowSeatInhbByMod "second row seat Inhibit by seat mode";
CM_ SG_ 368 ThrdLeSeatTarPosnCmdReqSeatBackrTargPosAg "Third row left seat backrest data";
CM_ SG_ 368 ThrdLeSeatTarPosnCmdReqSeatFrntExtenTargPosPerc "Third row left seat extension data";
CM_ SG_ 368 ThrdLeSeatTarPosnCmdReqSeatFrntHeiTargPosPerc "Third row left seat front height data";
CM_ SG_ 368 ThrdLeSeatTarPosnCmdReqSeatLenTargPosPerc "third row left seat Length data";
CM_ SG_ 368 ThrdLeSeatTarPosnCmdReqTarPosnCmd1 "Request third left side seat adjusting to target position";
CM_ SG_ 368 ThrdRiSeatTarPosnCmdReqSeatBackrTargPosAg "Third row right seat backrest data";
CM_ SG_ 368 ThrdRiSeatTarPosnCmdReqSeatFrntExtenTargPosPerc "Third row right seat extension data";
CM_ SG_ 368 ThrdRiSeatTarPosnCmdReqSeatFrntHeiTargPosPerc "Third row right seat front height data";
CM_ SG_ 368 ThrdRiSeatTarPosnCmdReqSeatLenTargPosPerc "third row right seat Length data";
CM_ SG_ 368 ThrdRiSeatTarPosnCmdReqTarPosnCmd1 "Request third right side seat adjusting to target position";
CM_ SG_ 368 ThrdRowSeatInhbByMod "third row seat Inhibit by seat mode";
CM_ SG_ 368 UpperLowerTrSelnSwt "To select open upper tailgate only or open upper and lower tailgate together";
CM_ SG_ 259 ACEIDLightReqFromBLE "Request to light EID when AC charging and detecting a BLE/UWB key";
CM_ SG_ 259 ConfCurrSpd "Configure paths Speed Status";
CM_ SG_ 259 ConfPath "Configure paths  Status";
CM_ SG_ 259 DCEIDLightReqFromBLE "Request to light EID when DC charging and detecting a BLE/UWB key";
CM_ SG_ 259 DchrgnInSwtCtrl "Define whether the internal discharge function is turned on";
CM_ SG_ 259 EPedlModCtrlSt "e-Pedal mode activation soft button signal";
CM_ SG_ 259 ESCLvlSwt "ESC level switch";
CM_ SG_ 259 HmiMaxEvMod "HMI MAX EV mode";
CM_ SG_ 259 HMISteplessBarPosnSetting "HMISteplessBarPosnSetting";
CM_ SG_ 259 HMIThermoTankChdLock "HMIThermoTankChdLock";
CM_ SG_ 259 HMIThermoTankDlyCls "HMIThermoTankDly";
CM_ SG_ 259 HMIThermoTankDlyClsTmr "HMIThermoTankDlyClsTmr";
CM_ SG_ 259 HMIThermoTankDoorOpen "HMIThermoTankDoorOpen";
CM_ SG_ 259 HMIThermoTankSwtReq "HMIThermoTankSwtReq";
CM_ SG_ 259 HMIThermoTankT "HMIThermoTankTCoolg";
CM_ SG_ 259 HornWarnReq "Horn warning request";
CM_ SG_ 259 HvBattMntnReq "State request for HV Battery Maintenance.";
CM_ SG_ 259 IAMSMod "Intelligen tAnti Motion Sickness Mode";
CM_ SG_ 259 KickTailgateSig "UWB kick tailgate signal";
CM_ SG_ 259 LiFlashWarnReq "Light flash warning raquest";
CM_ SG_ 259 LvngCratuDetdSts "Living creature detected status";
CM_ SG_ 259 MirrTarPosnCmdReqDrvrMirrAdjLeRi "Driver side left-right data";
CM_ SG_ 259 MirrTarPosnCmdReqDrvrMirrAdjUpDown "Driver side up-down data";
CM_ SG_ 259 MirrTarPosnCmdReqPassMirrAdjLeRi "Passenger side left-right data";
CM_ SG_ 259 MirrTarPosnCmdReqPassMirrAdjUpDown "Passenger side up-down data";
CM_ SG_ 259 MirrTarPosnCmdReqTarPosnCmd1 "request mirrir module adjusting to target position";
CM_ SG_ 259 PasEntryEnaReq1 "Request locking to enable passive entry function";
CM_ SG_ 259 PtModReq "abbr: PtModReq
full name: Powertrain Mode Request";
CM_ SG_ 259 ReBuctMonSts "Indicates the current status of the rear bucket monitoring.
";
CM_ SG_ 259 RemHvStrtActvReq "remote High volage power start request for remote real time video function";
CM_ SG_ 259 RoadCondDis "Current traffic distance";
CM_ SG_ 259 RoadCondLvl "Road Congestion level";
CM_ SG_ 259 RoadCondNum "Current road condition data element";
CM_ SG_ 259 RoadCondTime "Current traffic time";
CM_ SG_ 259 RoadSlope "Current road Slope";
CM_ SG_ 259 RoadSlopeDis "Road Slope Distance";
CM_ SG_ 259 RoadSlopeNum "Current road slope condition data element";
CM_ SG_ 259 StealthLiSwtSts "Click button to turn off all lights";
CM_ SG_ 259 StsOfFLWelGby "Front Technology welcome/goodbye status";
CM_ SG_ 259 StsOfFRWelGby "Front Technology welcome/goodbye status";
CM_ SG_ 259 StsOfRICLWelGby "Rear Technology welcome/goodbye status";
CM_ SG_ 259 StsOfRICRWelGby "Rear Technology welcome/goodbye status";
CM_ SG_ 259 StsOfRILLWelGby "Rear Technology welcome/goodbye status";
CM_ SG_ 259 StsOfRILRWelGby "Rear Technology welcome/goodbye status";
CM_ SG_ 259 TelmClimaTmr "Pre-climatization activated timer from telematics.";
CM_ SG_ 259 WadeProtnSwtReq "Wading Protection soft switch.";
CM_ SG_ 259 WinOpenLDACReq "Lower windows request from LDAC";
CM_ SG_ 624 ChrgStationPwr "Max power of navigation charging station";
CM_ SG_ 624 DeactvtLvlgCtrl "Deactivate Leveling Control";
CM_ SG_ 624 EstimdLeSocToDest "Estimated remained Soc to destination";
CM_ SG_ 624 MmedHdPwrMod "IHU power mode";
CM_ SG_ 624 MobDevBtnPanicReq "Panic  alarm  active request on the Mobile Device ";
CM_ SG_ 624 OIDIFctSts "OIDI function status indicate:
0x0: default value
0x1: SOC low
0x2: HV engergy fault
0x3: reserved
OIDI: Outdoor Intellgent Device Interconnection";
CM_ SG_ 624 RMLCmftFctReq "Whether the electrical seatbelt comfort functions is turned ON or OFF by the driver";
CM_ SG_ 624 RMRCmftFctReq "Whether the electrical seatbelt comfort functions is turned ON or OFF by the passenger";
CM_ SG_ 80 CnclBookTrvlReq "A cancel request of the reservation departure function";
CM_ SG_ 80 DKDataFromTelmAcknowledgment "Packet received acknowledgement";
CM_ SG_ 80 DKDataFromTelmDKDataByte1 "Byte number 1";
CM_ SG_ 80 DKDataFromTelmDKDataByte2 "Byte number 2";
CM_ SG_ 80 DKDataFromTelmDKDataByte3 "Byte number 3";
CM_ SG_ 80 DKDataFromTelmDKDataByte4 "Byte number 4";
CM_ SG_ 80 DKDataFromTelmDKDataByte5 "Byte number 5";
CM_ SG_ 80 DKDataFromTelmDKDataByte6 "Byte number 6";
CM_ SG_ 80 DKDataFromTelmHeader "Packet Header";
CM_ SG_ 80 DrvStyleCoeffCloud "int";
CM_ SG_ 80 ErsCmdRecErsCmd "Ers command signal";
CM_ SG_ 80 ErsCmdRecErsRunTime "How long time to run ERS";
CM_ SG_ 1168 CarSharingMde "Car sharing mode";
CM_ SG_ 1168 LongTiRunngModCampMod "Camping mode on/off";
CM_ SG_ 1168 LongTiRunngModGameMod "Game mode on/off";
CM_ SG_ 1168 LongTiRunngModMonrbyOMS "User inside or not monitored by OMS";
CM_ SG_ 1168 LongTiRunngModNxtCnvinc "Reserved";
CM_ SG_ 1168 LongTiRunngModPanelTouched "Panel Touched or not";
CM_ SG_ 1168 LongTiRunngModParkComfortMod "Park comfort mode on/off";
CM_ SG_ 1168 LongTiRunngModPetMod "Pet mode on/off";
CM_ SG_ 1168 LongTiRunngModReserved2 "Reserved";
CM_ SG_ 1168 LongTiRunngModReserved3 "Reserved";
CM_ SG_ 1168 LongTiRunngModReserved4 "Reserved";
CM_ SG_ 1168 LongTiRunngModReserved5 "Reserved";
CM_ SG_ 1168 LongTiRunngModReserved6 "Reserved";
CM_ SG_ 1168 LongTiRunngModReserved7 "Reserved";
CM_ SG_ 1168 LongTiRunngModReserved8 "Reserved";
CM_ SG_ 1168 LongTiRunngModRestMod "Refresh mode on/off";
CM_ SG_ 1168 LongTiRunngModTheaterMod "Theater mode on/off";
CM_ SG_ 1168 PosnBriefPosnLat "Latitude";
CM_ SG_ 1168 PosnBriefPosnLgt "Longitude";
CM_ SG_ 1168 UnlckRemReq "Enable or disable two step unlock";
CM_ SG_ 435 HznPosnLRCurrentLane "0x0 Unknown 0x1 Emergency lane 0x2 Single-lane road 0x3 Left-most lane 0x4 Right-most lane 0x5 One of middle lanes on road with three or more lanes 0x6 Reserved0x7 N/A";
CM_ SG_ 435 HznPosnLRCyclicCounter "Cyclic counter of this message type: Reconstructor can use this value to detect missing messages";
CM_ SG_ 435 HznPosnLRMessageType "Type of a CAN message in the scope of the ADASISv2 protocol. ";
CM_ SG_ 435 HznPosnLROffset "Offset of current position from the current path start point modulo 8191.";
CM_ SG_ 435 HznPosnLRPathIndex "[0x0: Unknown][0x1: Position not in Digitized Area][0x2: Position not on-road][0x3:  Vehicle Positioning sub-system not calibrated][0x4:the current vehicle position segment][0x5: the existence of a crossroad branch]...";
CM_ SG_ 435 HznPosnLRPositionAge "Time difference between the moment the message is sent and the moment the vehicle position is calculated by the positioning sub-system.";
CM_ SG_ 435 HznPosnLRPositionConfidence "Position confidence: this field contains Av2HP implementation specific values. Use 0 for highest confidence, 6 for lowest confidence. Value 7 means N/A";
CM_ SG_ 435 HznPosnLRPositionIndex "If Av2HP supports positioning alternatives, contains index of this Position Candidate. Candidate 0 is always most probable position candidate, candidate 1 second etc. If Av2HP does not support positioning alternatives, it will be always 0.";
CM_ SG_ 435 HznPosnLRPositionProbability "Position Probability is calculated by Positioning module of ADASIS v2 Horizon Provider. Different Av2HPs will use different algorithms to calculate this value. 0x0:unknown 0x1F: N/A";
CM_ SG_ 435 HznPosnLRRelativeHeading "[0x0:In path direction][0x1:1.417 degrees right][0x2..0x7E:Right from path direction][0x7E:178.583 degrees right][0x7F:Opposite direction][0x80:178.583 degrees left (181.417 degrees right)][0x80..0xFC:Left from path direction][0xFD:1.417 degrees left (358.583 degrees right)][0xFE:Unknown][0xFF:N/A]";
CM_ SG_ 435 HznPosnLRSpeed "Speed of the vehicle projected to the path ";
CM_ SG_ 435 HznProfLongLRControlPoint "If true, values in this message specifies additional control points required for the interpolation of this profile; If false, actual profile values are specified. ";
CM_ SG_ 435 HznProfLongLRCyclicCounter "Cyclic counter of this message type and profile type: Reconstructor can use this value to detect missing messages.";
CM_ SG_ 435 HznProfLongLRMessageType "Type of a CAN message in the scope of the ADASISv2 protocol.";
CM_ SG_ 435 HznProfLongLROffset "Offset of position of the first profile spot from start position modulo 8191. Offset 8191 is invalid. 0X0-0X1FFE: 0-8190m 0X1FFF: Invalid";
CM_ SG_ 435 HznProfLongLRPathIndex "Index of the path where this profile(s) is located";
CM_ SG_ 435 HznProfLongLRProfileType "Standard PROFILE LONG Types  0:N/A 8:Traffic Sign 10:Extended Lane 19:Traffic event 20:Weather Info";
CM_ SG_ 435 HznProfLongLRRetransmission "If true, this message was sent already at least once before. 0x0:false 0x1:true";
CM_ SG_ 435 HznProfLongLRUpdate "Value true indicates that this message contains updated information of already transmitted PROFILE LONG. 0x0:false 0x1:true";
CM_ SG_ 435 HznProfLongLRValue "Profile value at Offset.";
CM_ SG_ 435 LocalBookChrgnTarVal "Battery SOC Value";
CM_ SG_ 435 MaxAcInpCurrentSet "set the input current";
CM_ SG_ 435 ShowTypOfDTESet "selected status of DTE show type set";
BA_DEF_ BO_ "CANFD_BRS" ENUM "0","1";
BA_DEF_ BO_ "GenMsgCycleTime" INT 0 65536; // [ms]
BA_DEF_ BO_ "GenMsgDelayTime" INT 0 65536; // [ms]
BA_DEF_ BO_ "GenMsgSendType" ENUM "cyclic", "spontaneous", "not-used", "not-used", "not-used", "cyclicAndSpontaneous", "not-used", "cyclicIfActive", "NoMsgSendType"; // [us]
BA_DEF_ BO_ "GenMsgStartDelayTime" INT 0 65536; // [ms]
BA_DEF_ BO_ "VFrameFormat" ENUM "StandardCAN","ExtendedCAN","reserved","J1939PG","reserved","reserved","reserved","reserved","reserved","reserved","reserved","reserved","reserved","reserved","StandardCAN_FD","ExtendedCAN_FD";
BA_DEF_ SG_ "GenSigSendType" ENUM "Cyclic","OnWrite","OnWriteWithRepetition","OnChange","OnChangeWithRepetition","IfActive","IfActiveWithRepetition","NoSigSendType";
BA_DEF_ SG_ "GenSigStartValue" HEX 0 80000000;
BA_DEF_ BO_ "GenMsgILSupport" ENUM "No","Yes";
BA_DEF_ BO_ "NmAsrMessage" ENUM "No","Yes";
BA_DEF_ SG_ "GenSigFuncType" ENUM "NoFunction","n/a","n/a","n/a","n/a","n/a","n/a","n/a","n/a","n/a","n/a","n/a","n/a","n/a","n/a","CHK","CNTR","n/a","n/a","n/a","CNTR_AR_01","CRC_AR_01_BOTH","CRC_AR_01_ALT","CRC_AR_01_LOW","CRC_AR_01_NIBBLE","CNTR_AR_04","CRC_AR_04A","CNTR_AR_05","CRC_AR_05";
BA_DEF_ SG_ "GenSigDataID" STRING;
BA_DEF_DEF_ "CANFD_BRS" "1";
BA_DEF_DEF_ "GenSigStartValue" 0;
BA_DEF_DEF_ "VFrameFormat" "J1939PG";
BA_DEF_DEF_ "GenSigSendType" "NoSigSendType";
BA_DEF_DEF_ "GenMsgCycleTime" 0;
BA_DEF_DEF_ "GenMsgDelayTime" 0;
BA_DEF_DEF_ "GenMsgStartDelayTime" 0;
BA_DEF_DEF_ "GenMsgSendType" "NoMsgSendType";
BA_DEF_DEF_ "GenMsgILSupport" "Yes";
BA_DEF_DEF_ "NmAsrMessage" "No";
BA_DEF_DEF_ "GenSigFuncType" "NoFunction";
BA_DEF_DEF_ "GenSigDataID" "";
// Frame: DhuZCUCANFD2Fr05
BA_ "GenMsgDelayTime" BO_ 89 30.000;
BA_ "GenMsgSendType" BO_ 89 1;
BA_ "VFrameFormat" BO_ 89 14;
// Frame: DhuZCUCANFD2Fr06
BA_ "GenMsgDelayTime" BO_ 99 30.000;
BA_ "GenMsgSendType" BO_ 99 1;
BA_ "VFrameFormat" BO_ 99 14;
// Frame: DhuZCUCANFD2Fr07
BA_ "GenMsgDelayTime" BO_ 103 30.000;
BA_ "GenMsgSendType" BO_ 103 1;
BA_ "VFrameFormat" BO_ 103 14;
// Frame: DhuZCUCANFD2Fr08
BA_ "GenMsgCycleTime" BO_ 560 300.000;
BA_ "GenMsgSendType" BO_ 560 0;
BA_ "VFrameFormat" BO_ 560 14;
// Frame: DhuZCUCANFD2Fr10
BA_ "GenMsgCycleTime" BO_ 368 80.000;
BA_ "GenMsgSendType" BO_ 368 0;
BA_ "VFrameFormat" BO_ 368 14;
// Frame: DhuZCUCANFD2Fr11
BA_ "GenMsgCycleTime" BO_ 259 15.000;
BA_ "GenMsgSendType" BO_ 259 0;
BA_ "VFrameFormat" BO_ 259 14;
// Frame: DhuZCUCANFD2Fr12
BA_ "GenMsgCycleTime" BO_ 624 450.000;
BA_ "GenMsgSendType" BO_ 624 0;
BA_ "VFrameFormat" BO_ 624 14;
// Frame: DhuZCUCANFD2Fr13
BA_ "GenMsgDelayTime" BO_ 80 20.000;
BA_ "GenMsgSendType" BO_ 80 1;
BA_ "VFrameFormat" BO_ 80 14;
// Frame: DhuZCUCANFD2Fr14
BA_ "GenMsgCycleTime" BO_ 1168 1000.000;
BA_ "GenMsgSendType" BO_ 1168 0;
BA_ "VFrameFormat" BO_ 1168 14;
// Frame: DhuZCUCANFD2Fr15
BA_ "GenMsgDelayTime" BO_ 435 100.000;
BA_ "GenMsgSendType" BO_ 435 1;
BA_ "VFrameFormat" BO_ 435 14;
BA_ "GenSigSendType" SG_ 259 ACEIDLightReqFromBLE 0;
BA_ "GenSigSendType" SG_ 368 AutEgyRgnLvlSet 0;
BA_ "GenSigStartValue" SG_ 368 AutEgyRgnLvlSet 3;
BA_ "GenSigSendType" SG_ 368 AutElecStepCtrlSwtStsDriver 0;
BA_ "GenSigSendType" SG_ 368 AutElecStepCtrlSwtStsPassenger 0;
BA_ "GenSigSendType" SG_ 368 AutoClsLockdFctEnaRADAR 0;
BA_ "GenSigSendType" SG_ 368 AutoClsRainFctEnaRADAR 0;
BA_ "GenSigSendType" SG_ 368 BLEKeyExtLoUOutIPwrSplyCtrlZone1 0;
BA_ "GenSigSendType" SG_ 368 BLEKeyExtLoUOutIPwrSplyCtrlZone2 0;
BA_ "GenSigSendType" SG_ 368 BLEKeyExtLoUOutIPwrSplyCtrlZone3 0;
BA_ "GenSigSendType" SG_ 368 BLEKeyExtLoUOutIPwrSplyCtrlZone4 0;
BA_ "GenSigSendType" SG_ 368 BLEKeyExtLoUOutIPwrSplyCtrlZone5 0;
BA_ "GenSigSendType" SG_ 368 BLEKeyExtLoUOutIPwrSplyCtrlZone6 0;
BA_ "GenSigSendType" SG_ 560 BevPwrCtrl 0;
BA_ "GenSigSendType" SG_ 1168 CarSharingMde 0;
BA_ "GenSigSendType" SG_ 624 ChrgStationPwr 0;
BA_ "GenSigSendType" SG_ 80 CnclBookTrvlReq 1;
BA_ "GenSigSendType" SG_ 259 ConfCurrSpd 0;
BA_ "GenSigSendType" SG_ 259 ConfPath 0;
BA_ "GenSigSendType" SG_ 560 CopilotSeatOccupySts 0;
BA_ "GenSigSendType" SG_ 259 DCEIDLightReqFromBLE 0;
BA_ "GenSigSendType" SG_ 80 DKDataFromTelmAcknowledgment 1;
BA_ "GenSigSendType" SG_ 80 DKDataFromTelmDKDataByte1 1;
BA_ "GenSigSendType" SG_ 80 DKDataFromTelmDKDataByte2 1;
BA_ "GenSigSendType" SG_ 80 DKDataFromTelmDKDataByte3 1;
BA_ "GenSigSendType" SG_ 80 DKDataFromTelmDKDataByte4 1;
BA_ "GenSigSendType" SG_ 80 DKDataFromTelmDKDataByte5 1;
BA_ "GenSigSendType" SG_ 80 DKDataFromTelmDKDataByte6 1;
BA_ "GenSigSendType" SG_ 80 DKDataFromTelmHeader 1;
BA_ "GenSigSendType" SG_ 259 DchrgnInSwtCtrl 0;
BA_ "GenSigSendType" SG_ 624 DeactvtLvlgCtrl 0;
BA_ "GenSigSendType" SG_ 560 DrvSeatOccupySts 0;
BA_ "GenSigSendType" SG_ 80 DrvStyleCoeffCloud 1;
BA_ "GenSigSendType" SG_ 560 DrvrHdPosnDetnX 0;
BA_ "GenSigSendType" SG_ 560 DrvrHdPosnDetnY 0;
BA_ "GenSigSendType" SG_ 560 DrvrHdPosnDetnZ 0;
BA_ "GenSigSendType" SG_ 368 DrvrSeatCmftReq 0;
BA_ "GenSigSendType" SG_ 368 DrvrSeatReturnReq 0;
BA_ "GenSigSendType" SG_ 89 DwnLoadDynLtgPrmForFrntLeGrp13ContinueTime 1;
BA_ "GenSigSendType" SG_ 89 DwnLoadDynLtgPrmForFrntLeGrp13HighBrightness 1;
BA_ "GenSigSendType" SG_ 89 DwnLoadDynLtgPrmForFrntLeGrp13LowBrightness 1;
BA_ "GenSigSendType" SG_ 89 DwnLoadDynLtgPrmForFrntLeGrp13Mode1 1;
BA_ "GenSigSendType" SG_ 89 DwnLoadDynLtgPrmForFrntLeGrp13OffsetTime 1;
BA_ "GenSigSendType" SG_ 89 DwnLoadDynLtgPrmForFrntLeGrp13Timestamp 1;
BA_ "GenSigSendType" SG_ 89 DwnLoadDynLtgPrmForFrntLeGrp14ContinueTime 1;
BA_ "GenSigSendType" SG_ 89 DwnLoadDynLtgPrmForFrntLeGrp14HighBrightness 1;
BA_ "GenSigSendType" SG_ 89 DwnLoadDynLtgPrmForFrntLeGrp14LowBrightness 1;
BA_ "GenSigSendType" SG_ 89 DwnLoadDynLtgPrmForFrntLeGrp14Mode1 1;
BA_ "GenSigSendType" SG_ 89 DwnLoadDynLtgPrmForFrntLeGrp14OffsetTime 1;
BA_ "GenSigSendType" SG_ 89 DwnLoadDynLtgPrmForFrntLeGrp14Timestamp 1;
BA_ "GenSigSendType" SG_ 89 DwnLoadDynLtgPrmForFrntLeGrp15ContinueTime 1;
BA_ "GenSigSendType" SG_ 89 DwnLoadDynLtgPrmForFrntLeGrp15HighBrightness 1;
BA_ "GenSigSendType" SG_ 89 DwnLoadDynLtgPrmForFrntLeGrp15LowBrightness 1;
BA_ "GenSigSendType" SG_ 89 DwnLoadDynLtgPrmForFrntLeGrp15Mode1 1;
BA_ "GenSigSendType" SG_ 89 DwnLoadDynLtgPrmForFrntLeGrp15OffsetTime 1;
BA_ "GenSigSendType" SG_ 89 DwnLoadDynLtgPrmForFrntLeGrp15Timestamp 1;
BA_ "GenSigSendType" SG_ 89 DwnLoadDynLtgPrmForFrntLeGrp16ContinueTime 1;
BA_ "GenSigSendType" SG_ 89 DwnLoadDynLtgPrmForFrntLeGrp16HighBrightness 1;
BA_ "GenSigSendType" SG_ 89 DwnLoadDynLtgPrmForFrntLeGrp16LowBrightness 1;
BA_ "GenSigSendType" SG_ 89 DwnLoadDynLtgPrmForFrntLeGrp16Mode1 1;
BA_ "GenSigSendType" SG_ 89 DwnLoadDynLtgPrmForFrntLeGrp16OffsetTime 1;
BA_ "GenSigSendType" SG_ 89 DwnLoadDynLtgPrmForFrntLeGrp16Timestamp 1;
BA_ "GenSigSendType" SG_ 89 DwnLoadDynLtgPrmForFrntLeGrp17ContinueTime 1;
BA_ "GenSigSendType" SG_ 89 DwnLoadDynLtgPrmForFrntLeGrp17HighBrightness 1;
BA_ "GenSigSendType" SG_ 89 DwnLoadDynLtgPrmForFrntLeGrp17LowBrightness 1;
BA_ "GenSigSendType" SG_ 89 DwnLoadDynLtgPrmForFrntLeGrp17Mode1 1;
BA_ "GenSigSendType" SG_ 89 DwnLoadDynLtgPrmForFrntLeGrp17OffsetTime 1;
BA_ "GenSigSendType" SG_ 89 DwnLoadDynLtgPrmForFrntLeGrp17Timestamp 1;
BA_ "GenSigSendType" SG_ 89 DwnLoadDynLtgPrmForFrntLeGrp18ContinueTime 1;
BA_ "GenSigSendType" SG_ 89 DwnLoadDynLtgPrmForFrntLeGrp18HighBrightness 1;
BA_ "GenSigSendType" SG_ 89 DwnLoadDynLtgPrmForFrntLeGrp18LowBrightness 1;
BA_ "GenSigSendType" SG_ 89 DwnLoadDynLtgPrmForFrntLeGrp18Mode1 1;
BA_ "GenSigSendType" SG_ 89 DwnLoadDynLtgPrmForFrntLeGrp18OffsetTime 1;
BA_ "GenSigSendType" SG_ 89 DwnLoadDynLtgPrmForFrntLeGrp18Timestamp 1;
BA_ "GenSigSendType" SG_ 89 DwnLoadDynLtgPrmForFrntLeGrp19ContinueTime 1;
BA_ "GenSigSendType" SG_ 89 DwnLoadDynLtgPrmForFrntLeGrp19HighBrightness 1;
BA_ "GenSigSendType" SG_ 89 DwnLoadDynLtgPrmForFrntLeGrp19LowBrightness 1;
BA_ "GenSigSendType" SG_ 89 DwnLoadDynLtgPrmForFrntLeGrp19Mode1 1;
BA_ "GenSigSendType" SG_ 89 DwnLoadDynLtgPrmForFrntLeGrp19OffsetTime 1;
BA_ "GenSigSendType" SG_ 89 DwnLoadDynLtgPrmForFrntLeGrp19Timestamp 1;
BA_ "GenSigSendType" SG_ 89 DwnLoadDynLtgPrmForFrntLeGrp20ContinueTime 1;
BA_ "GenSigSendType" SG_ 89 DwnLoadDynLtgPrmForFrntLeGrp20HighBrightness 1;
BA_ "GenSigSendType" SG_ 89 DwnLoadDynLtgPrmForFrntLeGrp20LowBrightness 1;
BA_ "GenSigSendType" SG_ 89 DwnLoadDynLtgPrmForFrntLeGrp20Mode1 1;
BA_ "GenSigSendType" SG_ 89 DwnLoadDynLtgPrmForFrntLeGrp20OffsetTime 1;
BA_ "GenSigSendType" SG_ 89 DwnLoadDynLtgPrmForFrntLeGrp20Timestamp 1;
BA_ "GenSigSendType" SG_ 89 DwnLoadDynLtgPrmForFrntLeGrp21ContinueTime 1;
BA_ "GenSigSendType" SG_ 89 DwnLoadDynLtgPrmForFrntLeGrp21HighBrightness 1;
BA_ "GenSigSendType" SG_ 89 DwnLoadDynLtgPrmForFrntLeGrp21LowBrightness 1;
BA_ "GenSigSendType" SG_ 89 DwnLoadDynLtgPrmForFrntLeGrp21Mode1 1;
BA_ "GenSigSendType" SG_ 89 DwnLoadDynLtgPrmForFrntLeGrp21OffsetTime 1;
BA_ "GenSigSendType" SG_ 89 DwnLoadDynLtgPrmForFrntLeGrp21Timestamp 1;
BA_ "GenSigSendType" SG_ 89 DwnLoadDynLtgPrmForFrntLeGrp22ContinueTime 1;
BA_ "GenSigSendType" SG_ 89 DwnLoadDynLtgPrmForFrntLeGrp22HighBrightness 1;
BA_ "GenSigSendType" SG_ 89 DwnLoadDynLtgPrmForFrntLeGrp22LowBrightness 1;
BA_ "GenSigSendType" SG_ 89 DwnLoadDynLtgPrmForFrntLeGrp22Mode1 1;
BA_ "GenSigSendType" SG_ 89 DwnLoadDynLtgPrmForFrntLeGrp22OffsetTime 1;
BA_ "GenSigSendType" SG_ 89 DwnLoadDynLtgPrmForFrntLeGrp22Timestamp 1;
BA_ "GenSigSendType" SG_ 89 DwnLoadDynLtgPrmForFrntLeGrp23ContinueTime 1;
BA_ "GenSigSendType" SG_ 89 DwnLoadDynLtgPrmForFrntLeGrp23HighBrightness 1;
BA_ "GenSigSendType" SG_ 89 DwnLoadDynLtgPrmForFrntLeGrp23LowBrightness 1;
BA_ "GenSigSendType" SG_ 89 DwnLoadDynLtgPrmForFrntLeGrp23Mode1 1;
BA_ "GenSigSendType" SG_ 89 DwnLoadDynLtgPrmForFrntLeGrp23OffsetTime 1;
BA_ "GenSigSendType" SG_ 89 DwnLoadDynLtgPrmForFrntLeGrp23Timestamp 1;
BA_ "GenSigSendType" SG_ 89 DwnLoadDynLtgPrmForFrntLeGrp24ContinueTime 1;
BA_ "GenSigSendType" SG_ 89 DwnLoadDynLtgPrmForFrntLeGrp24HighBrightness 1;
BA_ "GenSigSendType" SG_ 89 DwnLoadDynLtgPrmForFrntLeGrp24LowBrightness 1;
BA_ "GenSigSendType" SG_ 89 DwnLoadDynLtgPrmForFrntLeGrp24Mode1 1;
BA_ "GenSigSendType" SG_ 89 DwnLoadDynLtgPrmForFrntLeGrp24OffsetTime 1;
BA_ "GenSigSendType" SG_ 89 DwnLoadDynLtgPrmForFrntLeGrp24Timestamp 1;
BA_ "GenSigSendType" SG_ 99 DwnLoadDynLtgPrmForFrntRIGrp10ContinueTime 1;
BA_ "GenSigSendType" SG_ 99 DwnLoadDynLtgPrmForFrntRIGrp10HighBrightness 1;
BA_ "GenSigSendType" SG_ 99 DwnLoadDynLtgPrmForFrntRIGrp10LowBrightness 1;
BA_ "GenSigSendType" SG_ 99 DwnLoadDynLtgPrmForFrntRIGrp10Mode1 1;
BA_ "GenSigSendType" SG_ 99 DwnLoadDynLtgPrmForFrntRIGrp10OffsetTime 1;
BA_ "GenSigSendType" SG_ 99 DwnLoadDynLtgPrmForFrntRIGrp10Timestamp 1;
BA_ "GenSigSendType" SG_ 99 DwnLoadDynLtgPrmForFrntRIGrp11ContinueTime 1;
BA_ "GenSigSendType" SG_ 99 DwnLoadDynLtgPrmForFrntRIGrp11HighBrightness 1;
BA_ "GenSigSendType" SG_ 99 DwnLoadDynLtgPrmForFrntRIGrp11LowBrightness 1;
BA_ "GenSigSendType" SG_ 99 DwnLoadDynLtgPrmForFrntRIGrp11Mode1 1;
BA_ "GenSigSendType" SG_ 99 DwnLoadDynLtgPrmForFrntRIGrp11OffsetTime 1;
BA_ "GenSigSendType" SG_ 99 DwnLoadDynLtgPrmForFrntRIGrp11Timestamp 1;
BA_ "GenSigSendType" SG_ 99 DwnLoadDynLtgPrmForFrntRIGrp12ContinueTime 1;
BA_ "GenSigSendType" SG_ 99 DwnLoadDynLtgPrmForFrntRIGrp12HighBrightness 1;
BA_ "GenSigSendType" SG_ 99 DwnLoadDynLtgPrmForFrntRIGrp12LowBrightness 1;
BA_ "GenSigSendType" SG_ 99 DwnLoadDynLtgPrmForFrntRIGrp12Mode1 1;
BA_ "GenSigSendType" SG_ 99 DwnLoadDynLtgPrmForFrntRIGrp12OffsetTime 1;
BA_ "GenSigSendType" SG_ 99 DwnLoadDynLtgPrmForFrntRIGrp12Timestamp 1;
BA_ "GenSigSendType" SG_ 103 DwnLoadDynLtgPrmForFrntRIGrp13ContinueTime 1;
BA_ "GenSigSendType" SG_ 103 DwnLoadDynLtgPrmForFrntRIGrp13HighBrightness 1;
BA_ "GenSigSendType" SG_ 103 DwnLoadDynLtgPrmForFrntRIGrp13LowBrightness 1;
BA_ "GenSigSendType" SG_ 103 DwnLoadDynLtgPrmForFrntRIGrp13Mode1 1;
BA_ "GenSigSendType" SG_ 103 DwnLoadDynLtgPrmForFrntRIGrp13OffsetTime 1;
BA_ "GenSigSendType" SG_ 103 DwnLoadDynLtgPrmForFrntRIGrp13Timestamp 1;
BA_ "GenSigSendType" SG_ 103 DwnLoadDynLtgPrmForFrntRIGrp14ContinueTime 1;
BA_ "GenSigSendType" SG_ 103 DwnLoadDynLtgPrmForFrntRIGrp14HighBrightness 1;
BA_ "GenSigSendType" SG_ 103 DwnLoadDynLtgPrmForFrntRIGrp14LowBrightness 1;
BA_ "GenSigSendType" SG_ 103 DwnLoadDynLtgPrmForFrntRIGrp14Mode1 1;
BA_ "GenSigSendType" SG_ 103 DwnLoadDynLtgPrmForFrntRIGrp14OffsetTime 1;
BA_ "GenSigSendType" SG_ 103 DwnLoadDynLtgPrmForFrntRIGrp14Timestamp 1;
BA_ "GenSigSendType" SG_ 103 DwnLoadDynLtgPrmForFrntRIGrp15ContinueTime 1;
BA_ "GenSigSendType" SG_ 103 DwnLoadDynLtgPrmForFrntRIGrp15HighBrightness 1;
BA_ "GenSigSendType" SG_ 103 DwnLoadDynLtgPrmForFrntRIGrp15LowBrightness 1;
BA_ "GenSigSendType" SG_ 103 DwnLoadDynLtgPrmForFrntRIGrp15Mode1 1;
BA_ "GenSigSendType" SG_ 103 DwnLoadDynLtgPrmForFrntRIGrp15OffsetTime 1;
BA_ "GenSigSendType" SG_ 103 DwnLoadDynLtgPrmForFrntRIGrp15Timestamp 1;
BA_ "GenSigSendType" SG_ 103 DwnLoadDynLtgPrmForFrntRIGrp16ContinueTime 1;
BA_ "GenSigSendType" SG_ 103 DwnLoadDynLtgPrmForFrntRIGrp16HighBrightness 1;
BA_ "GenSigSendType" SG_ 103 DwnLoadDynLtgPrmForFrntRIGrp16LowBrightness 1;
BA_ "GenSigSendType" SG_ 103 DwnLoadDynLtgPrmForFrntRIGrp16Mode1 1;
BA_ "GenSigSendType" SG_ 103 DwnLoadDynLtgPrmForFrntRIGrp16OffsetTime 1;
BA_ "GenSigSendType" SG_ 103 DwnLoadDynLtgPrmForFrntRIGrp16Timestamp 1;
BA_ "GenSigSendType" SG_ 103 DwnLoadDynLtgPrmForFrntRIGrp17ContinueTime 1;
BA_ "GenSigSendType" SG_ 103 DwnLoadDynLtgPrmForFrntRIGrp17HighBrightness 1;
BA_ "GenSigSendType" SG_ 103 DwnLoadDynLtgPrmForFrntRIGrp17LowBrightness 1;
BA_ "GenSigSendType" SG_ 103 DwnLoadDynLtgPrmForFrntRIGrp17Mode1 1;
BA_ "GenSigSendType" SG_ 103 DwnLoadDynLtgPrmForFrntRIGrp17OffsetTime 1;
BA_ "GenSigSendType" SG_ 103 DwnLoadDynLtgPrmForFrntRIGrp17Timestamp 1;
BA_ "GenSigSendType" SG_ 103 DwnLoadDynLtgPrmForFrntRIGrp18ContinueTime 1;
BA_ "GenSigSendType" SG_ 103 DwnLoadDynLtgPrmForFrntRIGrp18HighBrightness 1;
BA_ "GenSigSendType" SG_ 103 DwnLoadDynLtgPrmForFrntRIGrp18LowBrightness 1;
BA_ "GenSigSendType" SG_ 103 DwnLoadDynLtgPrmForFrntRIGrp18Mode1 1;
BA_ "GenSigSendType" SG_ 103 DwnLoadDynLtgPrmForFrntRIGrp18OffsetTime 1;
BA_ "GenSigSendType" SG_ 103 DwnLoadDynLtgPrmForFrntRIGrp18Timestamp 1;
BA_ "GenSigSendType" SG_ 103 DwnLoadDynLtgPrmForFrntRIGrp19ContinueTime 1;
BA_ "GenSigSendType" SG_ 103 DwnLoadDynLtgPrmForFrntRIGrp19HighBrightness 1;
BA_ "GenSigSendType" SG_ 103 DwnLoadDynLtgPrmForFrntRIGrp19LowBrightness 1;
BA_ "GenSigSendType" SG_ 103 DwnLoadDynLtgPrmForFrntRIGrp19Mode1 1;
BA_ "GenSigSendType" SG_ 103 DwnLoadDynLtgPrmForFrntRIGrp19OffsetTime 1;
BA_ "GenSigSendType" SG_ 103 DwnLoadDynLtgPrmForFrntRIGrp19Timestamp 1;
BA_ "GenSigSendType" SG_ 99 DwnLoadDynLtgPrmForFrntRIGrp1ContinueTime 1;
BA_ "GenSigSendType" SG_ 99 DwnLoadDynLtgPrmForFrntRIGrp1HighBrightness 1;
BA_ "GenSigSendType" SG_ 99 DwnLoadDynLtgPrmForFrntRIGrp1LowBrightness 1;
BA_ "GenSigSendType" SG_ 99 DwnLoadDynLtgPrmForFrntRIGrp1Mode1 1;
BA_ "GenSigSendType" SG_ 99 DwnLoadDynLtgPrmForFrntRIGrp1OffsetTime 1;
BA_ "GenSigSendType" SG_ 99 DwnLoadDynLtgPrmForFrntRIGrp1Timestamp 1;
BA_ "GenSigSendType" SG_ 103 DwnLoadDynLtgPrmForFrntRIGrp20ContinueTime 1;
BA_ "GenSigSendType" SG_ 103 DwnLoadDynLtgPrmForFrntRIGrp20HighBrightness 1;
BA_ "GenSigSendType" SG_ 103 DwnLoadDynLtgPrmForFrntRIGrp20LowBrightness 1;
BA_ "GenSigSendType" SG_ 103 DwnLoadDynLtgPrmForFrntRIGrp20Mode1 1;
BA_ "GenSigSendType" SG_ 103 DwnLoadDynLtgPrmForFrntRIGrp20OffsetTime 1;
BA_ "GenSigSendType" SG_ 103 DwnLoadDynLtgPrmForFrntRIGrp20Timestamp 1;
BA_ "GenSigSendType" SG_ 103 DwnLoadDynLtgPrmForFrntRIGrp21ContinueTime 1;
BA_ "GenSigSendType" SG_ 103 DwnLoadDynLtgPrmForFrntRIGrp21HighBrightness 1;
BA_ "GenSigSendType" SG_ 103 DwnLoadDynLtgPrmForFrntRIGrp21LowBrightness 1;
BA_ "GenSigSendType" SG_ 103 DwnLoadDynLtgPrmForFrntRIGrp21Mode1 1;
BA_ "GenSigSendType" SG_ 103 DwnLoadDynLtgPrmForFrntRIGrp21OffsetTime 1;
BA_ "GenSigSendType" SG_ 103 DwnLoadDynLtgPrmForFrntRIGrp21Timestamp 1;
BA_ "GenSigSendType" SG_ 103 DwnLoadDynLtgPrmForFrntRIGrp22ContinueTime 1;
BA_ "GenSigSendType" SG_ 103 DwnLoadDynLtgPrmForFrntRIGrp22HighBrightness 1;
BA_ "GenSigSendType" SG_ 103 DwnLoadDynLtgPrmForFrntRIGrp22LowBrightness 1;
BA_ "GenSigSendType" SG_ 103 DwnLoadDynLtgPrmForFrntRIGrp22Mode1 1;
BA_ "GenSigSendType" SG_ 103 DwnLoadDynLtgPrmForFrntRIGrp22OffsetTime 1;
BA_ "GenSigSendType" SG_ 103 DwnLoadDynLtgPrmForFrntRIGrp22Timestamp 1;
BA_ "GenSigSendType" SG_ 103 DwnLoadDynLtgPrmForFrntRIGrp23ContinueTime 1;
BA_ "GenSigSendType" SG_ 103 DwnLoadDynLtgPrmForFrntRIGrp23HighBrightness 1;
BA_ "GenSigSendType" SG_ 103 DwnLoadDynLtgPrmForFrntRIGrp23LowBrightness 1;
BA_ "GenSigSendType" SG_ 103 DwnLoadDynLtgPrmForFrntRIGrp23Mode1 1;
BA_ "GenSigSendType" SG_ 103 DwnLoadDynLtgPrmForFrntRIGrp23OffsetTime 1;
BA_ "GenSigSendType" SG_ 103 DwnLoadDynLtgPrmForFrntRIGrp23Timestamp 1;
BA_ "GenSigSendType" SG_ 103 DwnLoadDynLtgPrmForFrntRIGrp24ContinueTime 1;
BA_ "GenSigSendType" SG_ 103 DwnLoadDynLtgPrmForFrntRIGrp24HighBrightness 1;
BA_ "GenSigSendType" SG_ 103 DwnLoadDynLtgPrmForFrntRIGrp24LowBrightness 1;
BA_ "GenSigSendType" SG_ 103 DwnLoadDynLtgPrmForFrntRIGrp24Mode1 1;
BA_ "GenSigSendType" SG_ 103 DwnLoadDynLtgPrmForFrntRIGrp24OffsetTime 1;
BA_ "GenSigSendType" SG_ 103 DwnLoadDynLtgPrmForFrntRIGrp24Timestamp 1;
BA_ "GenSigSendType" SG_ 99 DwnLoadDynLtgPrmForFrntRIGrp2ContinueTime 1;
BA_ "GenSigSendType" SG_ 99 DwnLoadDynLtgPrmForFrntRIGrp2HighBrightness 1;
BA_ "GenSigSendType" SG_ 99 DwnLoadDynLtgPrmForFrntRIGrp2LowBrightness 1;
BA_ "GenSigSendType" SG_ 99 DwnLoadDynLtgPrmForFrntRIGrp2Mode1 1;
BA_ "GenSigSendType" SG_ 99 DwnLoadDynLtgPrmForFrntRIGrp2OffsetTime 1;
BA_ "GenSigSendType" SG_ 99 DwnLoadDynLtgPrmForFrntRIGrp2Timestamp 1;
BA_ "GenSigSendType" SG_ 99 DwnLoadDynLtgPrmForFrntRIGrp3ContinueTime 1;
BA_ "GenSigSendType" SG_ 99 DwnLoadDynLtgPrmForFrntRIGrp3HighBrightness 1;
BA_ "GenSigSendType" SG_ 99 DwnLoadDynLtgPrmForFrntRIGrp3LowBrightness 1;
BA_ "GenSigSendType" SG_ 99 DwnLoadDynLtgPrmForFrntRIGrp3Mode1 1;
BA_ "GenSigSendType" SG_ 99 DwnLoadDynLtgPrmForFrntRIGrp3OffsetTime 1;
BA_ "GenSigSendType" SG_ 99 DwnLoadDynLtgPrmForFrntRIGrp3Timestamp 1;
BA_ "GenSigSendType" SG_ 99 DwnLoadDynLtgPrmForFrntRIGrp4ContinueTime 1;
BA_ "GenSigSendType" SG_ 99 DwnLoadDynLtgPrmForFrntRIGrp4HighBrightness 1;
BA_ "GenSigSendType" SG_ 99 DwnLoadDynLtgPrmForFrntRIGrp4LowBrightness 1;
BA_ "GenSigSendType" SG_ 99 DwnLoadDynLtgPrmForFrntRIGrp4Mode1 1;
BA_ "GenSigSendType" SG_ 99 DwnLoadDynLtgPrmForFrntRIGrp4OffsetTime 1;
BA_ "GenSigSendType" SG_ 99 DwnLoadDynLtgPrmForFrntRIGrp4Timestamp 1;
BA_ "GenSigSendType" SG_ 99 DwnLoadDynLtgPrmForFrntRIGrp5ContinueTime 1;
BA_ "GenSigSendType" SG_ 99 DwnLoadDynLtgPrmForFrntRIGrp5HighBrightness 1;
BA_ "GenSigSendType" SG_ 99 DwnLoadDynLtgPrmForFrntRIGrp5LowBrightness 1;
BA_ "GenSigSendType" SG_ 99 DwnLoadDynLtgPrmForFrntRIGrp5Mode1 1;
BA_ "GenSigSendType" SG_ 99 DwnLoadDynLtgPrmForFrntRIGrp5OffsetTime 1;
BA_ "GenSigSendType" SG_ 99 DwnLoadDynLtgPrmForFrntRIGrp5Timestamp 1;
BA_ "GenSigSendType" SG_ 99 DwnLoadDynLtgPrmForFrntRIGrp6ContinueTime 1;
BA_ "GenSigSendType" SG_ 99 DwnLoadDynLtgPrmForFrntRIGrp6HighBrightness 1;
BA_ "GenSigSendType" SG_ 99 DwnLoadDynLtgPrmForFrntRIGrp6LowBrightness 1;
BA_ "GenSigSendType" SG_ 99 DwnLoadDynLtgPrmForFrntRIGrp6Mode1 1;
BA_ "GenSigSendType" SG_ 99 DwnLoadDynLtgPrmForFrntRIGrp6OffsetTime 1;
BA_ "GenSigSendType" SG_ 99 DwnLoadDynLtgPrmForFrntRIGrp6Timestamp 1;
BA_ "GenSigSendType" SG_ 99 DwnLoadDynLtgPrmForFrntRIGrp7ContinueTime 1;
BA_ "GenSigSendType" SG_ 99 DwnLoadDynLtgPrmForFrntRIGrp7HighBrightness 1;
BA_ "GenSigSendType" SG_ 99 DwnLoadDynLtgPrmForFrntRIGrp7LowBrightness 1;
BA_ "GenSigSendType" SG_ 99 DwnLoadDynLtgPrmForFrntRIGrp7Mode1 1;
BA_ "GenSigSendType" SG_ 99 DwnLoadDynLtgPrmForFrntRIGrp7OffsetTime 1;
BA_ "GenSigSendType" SG_ 99 DwnLoadDynLtgPrmForFrntRIGrp7Timestamp 1;
BA_ "GenSigSendType" SG_ 99 DwnLoadDynLtgPrmForFrntRIGrp8ContinueTime 1;
BA_ "GenSigSendType" SG_ 99 DwnLoadDynLtgPrmForFrntRIGrp8HighBrightness 1;
BA_ "GenSigSendType" SG_ 99 DwnLoadDynLtgPrmForFrntRIGrp8LowBrightness 1;
BA_ "GenSigSendType" SG_ 99 DwnLoadDynLtgPrmForFrntRIGrp8Mode1 1;
BA_ "GenSigSendType" SG_ 99 DwnLoadDynLtgPrmForFrntRIGrp8OffsetTime 1;
BA_ "GenSigSendType" SG_ 99 DwnLoadDynLtgPrmForFrntRIGrp8Timestamp 1;
BA_ "GenSigSendType" SG_ 99 DwnLoadDynLtgPrmForFrntRIGrp9ContinueTime 1;
BA_ "GenSigSendType" SG_ 99 DwnLoadDynLtgPrmForFrntRIGrp9HighBrightness 1;
BA_ "GenSigSendType" SG_ 99 DwnLoadDynLtgPrmForFrntRIGrp9LowBrightness 1;
BA_ "GenSigSendType" SG_ 99 DwnLoadDynLtgPrmForFrntRIGrp9Mode1 1;
BA_ "GenSigSendType" SG_ 99 DwnLoadDynLtgPrmForFrntRIGrp9OffsetTime 1;
BA_ "GenSigSendType" SG_ 99 DwnLoadDynLtgPrmForFrntRIGrp9Timestamp 1;
BA_ "GenSigSendType" SG_ 259 EPedlModCtrlSt 0;
BA_ "GenSigSendType" SG_ 259 ESCLvlSwt 0;
BA_ "GenSigSendType" SG_ 368 ElecStepReq 0;
BA_ "GenSigSendType" SG_ 80 ErsCmdRecErsCmd 1;
BA_ "GenSigSendType" SG_ 80 ErsCmdRecErsRunTime 1;
BA_ "GenSigSendType" SG_ 624 EstimdLeSocToDest 0;
BA_ "GenSigStartValue" SG_ 624 EstimdLeSocToDest 101;
BA_ "GenSigSendType" SG_ 368 FaceRecognitionIndcrFromDHU 0;
BA_ "GenSigSendType" SG_ 368 FrntSunCurtCtrlReq 0;
BA_ "GenSigSendType" SG_ 368 FrntSunCurtIninSwt 0;
BA_ "GenSigSendType" SG_ 368 FrntSunCurtOpenPosnReq 0;
BA_ "GenSigSendType" SG_ 368 GestureDetn 0;
BA_ "GenSigSendType" SG_ 560 HMIAirCdnrAutDrySet 0;
BA_ "GenSigStartValue" SG_ 560 HMIAirCdnrAutDrySet 1;
BA_ "GenSigSendType" SG_ 259 HMISteplessBarPosnSetting 0;
BA_ "GenSigStartValue" SG_ 259 HMISteplessBarPosnSetting 50;
BA_ "GenSigSendType" SG_ 259 HMIThermoTankChdLock 0;
BA_ "GenSigSendType" SG_ 259 HMIThermoTankDlyCls 0;
BA_ "GenSigSendType" SG_ 259 HMIThermoTankDlyClsTmr 0;
BA_ "GenSigSendType" SG_ 259 HMIThermoTankDoorOpen 0;
BA_ "GenSigSendType" SG_ 259 HMIThermoTankSwtReq 0;
BA_ "GenSigSendType" SG_ 259 HMIThermoTankT 0;
BA_ "GenSigStartValue" SG_ 259 HMIThermoTankT 255;
BA_ "GenSigSendType" SG_ 259 HmiMaxEvMod 0;
BA_ "GenSigSendType" SG_ 560 HmiPM25PopUpSet 0;
BA_ "GenSigStartValue" SG_ 560 HmiPM25PopUpSet 1;
BA_ "GenSigSendType" SG_ 368 HmiSeatVentAutStrtRowThrdLe 0;
BA_ "GenSigSendType" SG_ 368 HmiSeatVentAutStrtRowThrdRi 0;
BA_ "GenSigSendType" SG_ 259 HornWarnReq 0;
BA_ "GenSigSendType" SG_ 259 HvBattMntnReq 0;
BA_ "GenSigSendType" SG_ 435 HznPosnLRCurrentLane 1;
BA_ "GenSigSendType" SG_ 435 HznPosnLRCyclicCounter 1;
BA_ "GenSigSendType" SG_ 435 HznPosnLRMessageType 1;
BA_ "GenSigStartValue" SG_ 435 HznPosnLRMessageType 1;
BA_ "GenSigSendType" SG_ 435 HznPosnLROffset 1;
BA_ "GenSigSendType" SG_ 435 HznPosnLRPathIndex 1;
BA_ "GenSigSendType" SG_ 435 HznPosnLRPositionAge 1;
BA_ "GenSigSendType" SG_ 435 HznPosnLRPositionConfidence 1;
BA_ "GenSigSendType" SG_ 435 HznPosnLRPositionIndex 1;
BA_ "GenSigSendType" SG_ 435 HznPosnLRPositionProbability 1;
BA_ "GenSigSendType" SG_ 435 HznPosnLRRelativeHeading 1;
BA_ "GenSigSendType" SG_ 435 HznPosnLRSpeed 1;
BA_ "GenSigSendType" SG_ 435 HznProfLongLRControlPoint 1;
BA_ "GenSigSendType" SG_ 435 HznProfLongLRCyclicCounter 1;
BA_ "GenSigSendType" SG_ 435 HznProfLongLRMessageType 1;
BA_ "GenSigStartValue" SG_ 435 HznProfLongLRMessageType 5;
BA_ "GenSigSendType" SG_ 435 HznProfLongLROffset 1;
BA_ "GenSigSendType" SG_ 435 HznProfLongLRPathIndex 1;
BA_ "GenSigSendType" SG_ 435 HznProfLongLRProfileType 1;
BA_ "GenSigSendType" SG_ 435 HznProfLongLRRetransmission 1;
BA_ "GenSigSendType" SG_ 435 HznProfLongLRUpdate 1;
BA_ "GenSigSendType" SG_ 435 HznProfLongLRValue 1;
BA_ "GenSigSendType" SG_ 259 IAMSMod 0;
BA_ "GenSigSendType" SG_ 368 IceBreakModEnaRADAR 0;
BA_ "GenSigSendType" SG_ 259 LiFlashWarnReq 0;
BA_ "GenSigSendType" SG_ 368 LnchModSwt 0;
BA_ "GenSigSendType" SG_ 435 LocalBookChrgnTarVal 1;
BA_ "GenSigSendType" SG_ 1168 LongTiRunngModCampMod 0;
BA_ "GenSigSendType" SG_ 1168 LongTiRunngModGameMod 0;
BA_ "GenSigSendType" SG_ 1168 LongTiRunngModMonrbyOMS 0;
BA_ "GenSigSendType" SG_ 1168 LongTiRunngModNxtCnvinc 0;
BA_ "GenSigSendType" SG_ 1168 LongTiRunngModPanelTouched 0;
BA_ "GenSigSendType" SG_ 1168 LongTiRunngModParkComfortMod 0;
BA_ "GenSigSendType" SG_ 1168 LongTiRunngModPetMod 0;
BA_ "GenSigSendType" SG_ 1168 LongTiRunngModReserved2 0;
BA_ "GenSigSendType" SG_ 1168 LongTiRunngModReserved3 0;
BA_ "GenSigSendType" SG_ 1168 LongTiRunngModReserved4 0;
BA_ "GenSigSendType" SG_ 1168 LongTiRunngModReserved5 0;
BA_ "GenSigSendType" SG_ 1168 LongTiRunngModReserved6 0;
BA_ "GenSigSendType" SG_ 1168 LongTiRunngModReserved7 0;
BA_ "GenSigSendType" SG_ 1168 LongTiRunngModReserved8 0;
BA_ "GenSigSendType" SG_ 1168 LongTiRunngModRestMod 0;
BA_ "GenSigSendType" SG_ 1168 LongTiRunngModTheaterMod 0;
BA_ "GenSigSendType" SG_ 368 LvlgSwtSetReqChks 0;
BA_ "GenSigSendType" SG_ 368 LvlgSwtSetReqCntr 0;
BA_ "GenSigSendType" SG_ 368 LvlgSwtSetReqLvlgSwtSetReq 0;
BA_ "GenSigSendType" SG_ 259 LvngCratuDetdSts 0;
BA_ "GenSigSendType" SG_ 435 MaxAcInpCurrentSet 1;
BA_ "GenSigSendType" SG_ 259 MirrTarPosnCmdReqDrvrMirrAdjLeRi 0;
BA_ "GenSigSendType" SG_ 259 MirrTarPosnCmdReqDrvrMirrAdjUpDown 0;
BA_ "GenSigSendType" SG_ 259 MirrTarPosnCmdReqPassMirrAdjLeRi 0;
BA_ "GenSigSendType" SG_ 259 MirrTarPosnCmdReqPassMirrAdjUpDown 0;
BA_ "GenSigSendType" SG_ 259 MirrTarPosnCmdReqTarPosnCmd1 0;
BA_ "GenSigSendType" SG_ 624 MmedHdPwrMod 0;
BA_ "GenSigSendType" SG_ 624 MobDevBtnPanicReq 0;
BA_ "GenSigSendType" SG_ 624 OIDIFctSts 0;
BA_ "GenSigSendType" SG_ 259 PasEntryEnaReq1 0;
BA_ "GenSigSendType" SG_ 368 PassSeatCmftReq 0;
BA_ "GenSigSendType" SG_ 368 PassSeatReturnReq 0;
BA_ "GenSigSendType" SG_ 560 PassSideHdPosnDetnX 0;
BA_ "GenSigSendType" SG_ 560 PassSideHdPosnDetnY 0;
BA_ "GenSigSendType" SG_ 560 PassSideHdPosnDetnZ 0;
BA_ "GenSigSendType" SG_ 1168 PosnBriefPosnLat 0;
BA_ "GenSigStartValue" SG_ 1168 PosnBriefPosnLat 323999740.8002074;
BA_ "GenSigSendType" SG_ 1168 PosnBriefPosnLgt 0;
BA_ "GenSigStartValue" SG_ 1168 PosnBriefPosnLgt 647999481.6004148;
BA_ "GenSigSendType" SG_ 368 PrpsnMaxEvMod 0;
BA_ "GenSigSendType" SG_ 259 PtModReq 0;
BA_ "GenSigSendType" SG_ 368 PwrTonneauCoverOpenPosnReqRADAR 0;
BA_ "GenSigSendType" SG_ 624 RMLCmftFctReq 0;
BA_ "GenSigSendType" SG_ 624 RMRCmftFctReq 0;
BA_ "GenSigSendType" SG_ 368 RainSnsrSnvtyHMIReq 0;
BA_ "GenSigStartValue" SG_ 368 RainSnsrSnvtyHMIReq 2;
BA_ "GenSigSendType" SG_ 259 ReBuctMonSts 0;
BA_ "GenSigSendType" SG_ 368 ReSunCurtCtrlReq 0;
BA_ "GenSigSendType" SG_ 368 ReSunCurtIninSwt 0;
BA_ "GenSigSendType" SG_ 368 RelsEnaSwt 0;
BA_ "GenSigSendType" SG_ 259 RemHvStrtActvReq 0;
BA_ "GenSigSendType" SG_ 259 RoadCondDis 0;
BA_ "GenSigSendType" SG_ 259 RoadCondLvl 0;
BA_ "GenSigSendType" SG_ 259 RoadCondNum 0;
BA_ "GenSigSendType" SG_ 259 RoadCondTime 0;
BA_ "GenSigSendType" SG_ 259 RoadSlope 0;
BA_ "GenSigSendType" SG_ 259 RoadSlopeDis 0;
BA_ "GenSigSendType" SG_ 259 RoadSlopeNum 0;
BA_ "GenSigSendType" SG_ 368 SecLeSeatHeiTargPosPerc 0;
BA_ "GenSigSendType" SG_ 368 SecLeSeatTarPosnCmdReqSeatBackrTargPosAg 0;
BA_ "GenSigStartValue" SG_ 368 SecLeSeatTarPosnCmdReqSeatBackrTargPosAg 115;
BA_ "GenSigSendType" SG_ 368 SecLeSeatTarPosnCmdReqSeatFrntExtenTargPosPerc 0;
BA_ "GenSigSendType" SG_ 368 SecLeSeatTarPosnCmdReqSeatFrntHeiTargPosPerc 0;
BA_ "GenSigSendType" SG_ 368 SecLeSeatTarPosnCmdReqSeatLenTargPosPerc 0;
BA_ "GenSigStartValue" SG_ 368 SecLeSeatTarPosnCmdReqSeatLenTargPosPerc 300;
BA_ "GenSigSendType" SG_ 368 SecLeSeatTarPosnCmdReqTarPosnCmd1 0;
BA_ "GenSigSendType" SG_ 368 SecRiSeatHeiTargPosPerc 0;
BA_ "GenSigSendType" SG_ 368 SecRiSeatTarPosnCmdReqSeatBackrTargPosAg 0;
BA_ "GenSigStartValue" SG_ 368 SecRiSeatTarPosnCmdReqSeatBackrTargPosAg 115;
BA_ "GenSigSendType" SG_ 368 SecRiSeatTarPosnCmdReqSeatFrntExtenTargPosPerc 0;
BA_ "GenSigSendType" SG_ 368 SecRiSeatTarPosnCmdReqSeatFrntHeiTargPosPerc 0;
BA_ "GenSigSendType" SG_ 368 SecRiSeatTarPosnCmdReqSeatLenTargPosPerc 0;
BA_ "GenSigStartValue" SG_ 368 SecRiSeatTarPosnCmdReqSeatLenTargPosPerc 300;
BA_ "GenSigSendType" SG_ 368 SecRiSeatTarPosnCmdReqTarPosnCmd1 0;
BA_ "GenSigSendType" SG_ 368 SecRowLeSeatCmftReq 0;
BA_ "GenSigSendType" SG_ 368 SecRowLeSeatFoldRaiseReq 0;
BA_ "GenSigSendType" SG_ 368 SecRowLeSeatHeiAdjmt 0;
BA_ "GenSigSendType" SG_ 368 SecRowLeSeatReturnReq 0;
BA_ "GenSigSendType" SG_ 368 SecRowRiSeatCmftReq 0;
BA_ "GenSigSendType" SG_ 368 SecRowRiSeatFoldRaiseReq 0;
BA_ "GenSigSendType" SG_ 368 SecRowRiSeatHeiAdjmt 0;
BA_ "GenSigSendType" SG_ 368 SecRowRiSeatReturnReq 0;
BA_ "GenSigSendType" SG_ 368 SecRowSeatInhbByMod 0;
BA_ "GenSigSendType" SG_ 435 ShowTypOfDTESet 1;
BA_ "GenSigSendType" SG_ 259 StealthLiSwtSts 0;
BA_ "GenSigSendType" SG_ 560 SteerSetgPen 0;
BA_ "GenSigSendType" SG_ 560 SteerSetgSteerAsscLvl 0;
BA_ "GenSigSendType" SG_ 560 SteerSetgSteerMod 0;
BA_ "GenSigSendType" SG_ 259 StsOfFLWelGby 0;
BA_ "GenSigSendType" SG_ 259 StsOfFRWelGby 0;
BA_ "GenSigSendType" SG_ 259 StsOfRICLWelGby 0;
BA_ "GenSigSendType" SG_ 259 StsOfRICRWelGby 0;
BA_ "GenSigSendType" SG_ 259 StsOfRILLWelGby 0;
BA_ "GenSigSendType" SG_ 259 StsOfRILRWelGby 0;
BA_ "GenSigSendType" SG_ 89 TelmAirFragTasteReq 1;
BA_ "GenSigSendType" SG_ 103 TelmBookClimaReqHmiCmptmtTSpSpcl 1;
BA_ "GenSigSendType" SG_ 103 TelmBookClimaReqOnOffNoReq 1;
BA_ "GenSigSendType" SG_ 103 TelmBookClimaReqTempRange 1;
BA_ "GenSigSendType" SG_ 89 TelmBookClimaTmr 1;
BA_ "GenSigSendType" SG_ 99 TelmBookSeatHeatClimalReqDrvHeatClimaLvl 1;
BA_ "GenSigSendType" SG_ 99 TelmBookSeatHeatClimalReqPassHeatClimaLvl 1;
BA_ "GenSigSendType" SG_ 99 TelmBookSeatHeatClimalReqSecLeHeatClimaLvl 1;
BA_ "GenSigSendType" SG_ 99 TelmBookSeatHeatClimalReqSecRiHeatClimaLvl 1;
BA_ "GenSigSendType" SG_ 99 TelmBookSeatHeatClimalReqThrdLeHeatClimaLvl 1;
BA_ "GenSigSendType" SG_ 99 TelmBookSeatHeatClimalReqThrdRiHeatClimaLvl 1;
BA_ "GenSigSendType" SG_ 99 TelmBookSeatVentnClimalReqDrvVentnClimaLvl 1;
BA_ "GenSigSendType" SG_ 99 TelmBookSeatVentnClimalReqPassVentnClimaLvl 1;
BA_ "GenSigSendType" SG_ 99 TelmBookSeatVentnClimalReqSecLeVentnClimaLvl 1;
BA_ "GenSigSendType" SG_ 99 TelmBookSeatVentnClimalReqSecRiVentnClimaLvl 1;
BA_ "GenSigSendType" SG_ 99 TelmBookSeatVentnClimalReqThrdLeVentnClimaLvl 1;
BA_ "GenSigSendType" SG_ 99 TelmBookSeatVentnClimalReqThrdRiVentnClimaL 1;
BA_ "GenSigSendType" SG_ 89 TelmClimaReq 1;
BA_ "GenSigSendType" SG_ 99 TelmClimaTSetHmiCmptmtTSpSpcl 1;
BA_ "GenSigSendType" SG_ 99 TelmClimaTSetTempRange 1;
BA_ "GenSigSendType" SG_ 259 TelmClimaTmr 1;
BA_ "GenSigSendType" SG_ 89 TelmDefrostReq 1;
BA_ "GenSigSendType" SG_ 103 TelmEngDelayTi 1;
BA_ "GenSigSendType" SG_ 89 TelmLockgCenReqReqTyp 1;
BA_ "GenSigSendType" SG_ 89 TelmLockgCenReqTiVld 1;
BA_ "GenSigSendType" SG_ 89 TelmPM25Req 1;
BA_ "GenSigSendType" SG_ 89 TelmPreClimaPrio 1;
BA_ "GenSigStartValue" SG_ 89 TelmPreClimaPrio 2;
BA_ "GenSigSendType" SG_ 89 TelmSeatDrvHeatClimaLvl 1;
BA_ "GenSigSendType" SG_ 89 TelmSeatDrvVentnClimaLvl 1;
BA_ "GenSigSendType" SG_ 89 TelmSeatPassHeatClimaLvl 1;
BA_ "GenSigSendType" SG_ 89 TelmSeatPassVentnClimaLvl 1;
BA_ "GenSigSendType" SG_ 89 TelmSeatSecLeHeatClimaLvl 1;
BA_ "GenSigSendType" SG_ 89 TelmSeatSecLeVentnClimaLvl 1;
BA_ "GenSigSendType" SG_ 89 TelmSeatSecRiHeatClimaLvl 1;
BA_ "GenSigSendType" SG_ 89 TelmSeatSecRiVentnClimaLvl 1;
BA_ "GenSigSendType" SG_ 89 TelmSeatThrdLeHeatClimaLvl 1;
BA_ "GenSigSendType" SG_ 89 TelmSeatThrdLeVentnClimaLvl 1;
BA_ "GenSigSendType" SG_ 89 TelmSeatThrdRiHeatClimaLvl 1;
BA_ "GenSigSendType" SG_ 89 TelmSeatThrdRiVentnClimaLvl 1;
BA_ "GenSigSendType" SG_ 99 TelmStrtEngForChrgnReq 1;
BA_ "GenSigSendType" SG_ 368 ThrdLeSeatTarPosnCmdReqSeatBackrTargPosAg 0;
BA_ "GenSigStartValue" SG_ 368 ThrdLeSeatTarPosnCmdReqSeatBackrTargPosAg 115;
BA_ "GenSigSendType" SG_ 368 ThrdLeSeatTarPosnCmdReqSeatFrntExtenTargPosPerc 0;
BA_ "GenSigSendType" SG_ 368 ThrdLeSeatTarPosnCmdReqSeatFrntHeiTargPosPerc 0;
BA_ "GenSigSendType" SG_ 368 ThrdLeSeatTarPosnCmdReqSeatLenTargPosPerc 0;
BA_ "GenSigStartValue" SG_ 368 ThrdLeSeatTarPosnCmdReqSeatLenTargPosPerc 300;
BA_ "GenSigSendType" SG_ 368 ThrdLeSeatTarPosnCmdReqTarPosnCmd1 0;
BA_ "GenSigSendType" SG_ 368 ThrdRiSeatTarPosnCmdReqSeatBackrTargPosAg 0;
BA_ "GenSigStartValue" SG_ 368 ThrdRiSeatTarPosnCmdReqSeatBackrTargPosAg 115;
BA_ "GenSigSendType" SG_ 368 ThrdRiSeatTarPosnCmdReqSeatFrntExtenTargPosPerc 0;
BA_ "GenSigSendType" SG_ 368 ThrdRiSeatTarPosnCmdReqSeatFrntHeiTargPosPerc 0;
BA_ "GenSigSendType" SG_ 368 ThrdRiSeatTarPosnCmdReqSeatLenTargPosPerc 0;
BA_ "GenSigStartValue" SG_ 368 ThrdRiSeatTarPosnCmdReqSeatLenTargPosPerc 300;
BA_ "GenSigSendType" SG_ 368 ThrdRiSeatTarPosnCmdReqTarPosnCmd1 0;
BA_ "GenSigSendType" SG_ 368 ThrdRowSeatInhbByMod 0;
BA_ "GenSigSendType" SG_ 99 TimeOfcommCharn 1;
BA_ "GenSigSendType" SG_ 1168 UnlckRemReq 0;
BA_ "GenSigSendType" SG_ 368 UpperLowerTrSelnSwt 0;
BA_ "GenSigSendType" SG_ 259 WadeProtnSwtReq 0;
BA_ "GenSigSendType" SG_ 103 WinOpenClsGlbReqFromTelmWinOpenClsGlbSts 1;
BA_ "GenSigSendType" SG_ 103 WinOpenClsGlbReqFromTelmWindowOpenValue 1;
BA_ "GenSigSendType" SG_ 259 WinOpenLDACReq 0;
BA_ "GenSigSendType" SG_ 560 WiprReAutReq 0;
VAL_ 89 DwnLoadDynLtgPrmForFrntLeGrp13Mode1 0 "Mode4_Off" 1 "Mode4_On" 2 "Mode4_GradualOn" 3 "Mode4_GradualOff" 4 "Mode4_ForwardWipingOn" 5 "Mode4_BackwardWipingOn" 6 "Mode4_OutwardWipingOn" 7 "Mode4_InwardWipingOn" 8 "Mode4_ForwardWipingOff" 9 "Mode4_BackwardWipingOff" 10 "Mode4_OutwardWipingOff" 11 "Mode4_InwardWipingOff" 12 "Mode4_ForwardScanning" 13 "Mode4_BackwardScanning" 14 "Mode4_BreathOn" 15 "Mode4_BreathOff" 16 "Mode4_1stHalfONand2ndHalfOFF" 17 "Mode4_HalfOFFHalfON" 18 "Mode4_HalfDimmingONHalfOFF" 19 "Mode4_HalfDimmingONHalfON" 20 "Mode4_HalfOFFHalfDimmingON" 21 "Mode4_HalfONHalfDimmingON" 22 "Mode4_HalfDimmingOFFHalfOFF" 23 "Mode4_HalfDimmingOFFHalfON" 24 "Mode4_HalfOFFHalfDimmingOFF" 25 "Mode4_HalfONHalfDimmingOFF" 26 "Mode4_SingleOn1" 27 "Mode4_SingleOn2" 28 "Mode4_SingleOn3" 29 "Mode4_SingleOn4" 30 "Mode4_SingleOn5" 31 "Mode4_SingleOn6" 32 "Mode4_SingleOn7" 33 "Mode4_SingleOn8" 34 "Mode4_SingleOn9" 35 "Mode4_SingleOn10" 36 "Mode4_SingleOn11" 37 "Mode4_SingleOn12" 38 "Mode4_SingleOff1" 39 "Mode4_SingleOff2" 40 "Mode4_SingleOff3" 41 "Mode4_SingleOff4" 42 "Mode4_SingleOff5" 43 "Mode4_SingleOff6" 44 "Mode4_SingleOff7" 45 "Mode4_SingleOff8" 46 "Mode4_SingleOff9" 47 "Mode4_SingleOff10" 48 "Mode4_SingleOff11" 49 "Mode4_SingleOff12";
VAL_ 89 DwnLoadDynLtgPrmForFrntLeGrp14Mode1 0 "Mode4_Off" 1 "Mode4_On" 2 "Mode4_GradualOn" 3 "Mode4_GradualOff" 4 "Mode4_ForwardWipingOn" 5 "Mode4_BackwardWipingOn" 6 "Mode4_OutwardWipingOn" 7 "Mode4_InwardWipingOn" 8 "Mode4_ForwardWipingOff" 9 "Mode4_BackwardWipingOff" 10 "Mode4_OutwardWipingOff" 11 "Mode4_InwardWipingOff" 12 "Mode4_ForwardScanning" 13 "Mode4_BackwardScanning" 14 "Mode4_BreathOn" 15 "Mode4_BreathOff" 16 "Mode4_1stHalfONand2ndHalfOFF" 17 "Mode4_HalfOFFHalfON" 18 "Mode4_HalfDimmingONHalfOFF" 19 "Mode4_HalfDimmingONHalfON" 20 "Mode4_HalfOFFHalfDimmingON" 21 "Mode4_HalfONHalfDimmingON" 22 "Mode4_HalfDimmingOFFHalfOFF" 23 "Mode4_HalfDimmingOFFHalfON" 24 "Mode4_HalfOFFHalfDimmingOFF" 25 "Mode4_HalfONHalfDimmingOFF" 26 "Mode4_SingleOn1" 27 "Mode4_SingleOn2" 28 "Mode4_SingleOn3" 29 "Mode4_SingleOn4" 30 "Mode4_SingleOn5" 31 "Mode4_SingleOn6" 32 "Mode4_SingleOn7" 33 "Mode4_SingleOn8" 34 "Mode4_SingleOn9" 35 "Mode4_SingleOn10" 36 "Mode4_SingleOn11" 37 "Mode4_SingleOn12" 38 "Mode4_SingleOff1" 39 "Mode4_SingleOff2" 40 "Mode4_SingleOff3" 41 "Mode4_SingleOff4" 42 "Mode4_SingleOff5" 43 "Mode4_SingleOff6" 44 "Mode4_SingleOff7" 45 "Mode4_SingleOff8" 46 "Mode4_SingleOff9" 47 "Mode4_SingleOff10" 48 "Mode4_SingleOff11" 49 "Mode4_SingleOff12";
VAL_ 89 DwnLoadDynLtgPrmForFrntLeGrp15Mode1 0 "Mode4_Off" 1 "Mode4_On" 2 "Mode4_GradualOn" 3 "Mode4_GradualOff" 4 "Mode4_ForwardWipingOn" 5 "Mode4_BackwardWipingOn" 6 "Mode4_OutwardWipingOn" 7 "Mode4_InwardWipingOn" 8 "Mode4_ForwardWipingOff" 9 "Mode4_BackwardWipingOff" 10 "Mode4_OutwardWipingOff" 11 "Mode4_InwardWipingOff" 12 "Mode4_ForwardScanning" 13 "Mode4_BackwardScanning" 14 "Mode4_BreathOn" 15 "Mode4_BreathOff" 16 "Mode4_1stHalfONand2ndHalfOFF" 17 "Mode4_HalfOFFHalfON" 18 "Mode4_HalfDimmingONHalfOFF" 19 "Mode4_HalfDimmingONHalfON" 20 "Mode4_HalfOFFHalfDimmingON" 21 "Mode4_HalfONHalfDimmingON" 22 "Mode4_HalfDimmingOFFHalfOFF" 23 "Mode4_HalfDimmingOFFHalfON" 24 "Mode4_HalfOFFHalfDimmingOFF" 25 "Mode4_HalfONHalfDimmingOFF" 26 "Mode4_SingleOn1" 27 "Mode4_SingleOn2" 28 "Mode4_SingleOn3" 29 "Mode4_SingleOn4" 30 "Mode4_SingleOn5" 31 "Mode4_SingleOn6" 32 "Mode4_SingleOn7" 33 "Mode4_SingleOn8" 34 "Mode4_SingleOn9" 35 "Mode4_SingleOn10" 36 "Mode4_SingleOn11" 37 "Mode4_SingleOn12" 38 "Mode4_SingleOff1" 39 "Mode4_SingleOff2" 40 "Mode4_SingleOff3" 41 "Mode4_SingleOff4" 42 "Mode4_SingleOff5" 43 "Mode4_SingleOff6" 44 "Mode4_SingleOff7" 45 "Mode4_SingleOff8" 46 "Mode4_SingleOff9" 47 "Mode4_SingleOff10" 48 "Mode4_SingleOff11" 49 "Mode4_SingleOff12";
VAL_ 89 DwnLoadDynLtgPrmForFrntLeGrp16Mode1 0 "Mode4_Off" 1 "Mode4_On" 2 "Mode4_GradualOn" 3 "Mode4_GradualOff" 4 "Mode4_ForwardWipingOn" 5 "Mode4_BackwardWipingOn" 6 "Mode4_OutwardWipingOn" 7 "Mode4_InwardWipingOn" 8 "Mode4_ForwardWipingOff" 9 "Mode4_BackwardWipingOff" 10 "Mode4_OutwardWipingOff" 11 "Mode4_InwardWipingOff" 12 "Mode4_ForwardScanning" 13 "Mode4_BackwardScanning" 14 "Mode4_BreathOn" 15 "Mode4_BreathOff" 16 "Mode4_1stHalfONand2ndHalfOFF" 17 "Mode4_HalfOFFHalfON" 18 "Mode4_HalfDimmingONHalfOFF" 19 "Mode4_HalfDimmingONHalfON" 20 "Mode4_HalfOFFHalfDimmingON" 21 "Mode4_HalfONHalfDimmingON" 22 "Mode4_HalfDimmingOFFHalfOFF" 23 "Mode4_HalfDimmingOFFHalfON" 24 "Mode4_HalfOFFHalfDimmingOFF" 25 "Mode4_HalfONHalfDimmingOFF" 26 "Mode4_SingleOn1" 27 "Mode4_SingleOn2" 28 "Mode4_SingleOn3" 29 "Mode4_SingleOn4" 30 "Mode4_SingleOn5" 31 "Mode4_SingleOn6" 32 "Mode4_SingleOn7" 33 "Mode4_SingleOn8" 34 "Mode4_SingleOn9" 35 "Mode4_SingleOn10" 36 "Mode4_SingleOn11" 37 "Mode4_SingleOn12" 38 "Mode4_SingleOff1" 39 "Mode4_SingleOff2" 40 "Mode4_SingleOff3" 41 "Mode4_SingleOff4" 42 "Mode4_SingleOff5" 43 "Mode4_SingleOff6" 44 "Mode4_SingleOff7" 45 "Mode4_SingleOff8" 46 "Mode4_SingleOff9" 47 "Mode4_SingleOff10" 48 "Mode4_SingleOff11" 49 "Mode4_SingleOff12";
VAL_ 89 DwnLoadDynLtgPrmForFrntLeGrp17Mode1 0 "Mode4_Off" 1 "Mode4_On" 2 "Mode4_GradualOn" 3 "Mode4_GradualOff" 4 "Mode4_ForwardWipingOn" 5 "Mode4_BackwardWipingOn" 6 "Mode4_OutwardWipingOn" 7 "Mode4_InwardWipingOn" 8 "Mode4_ForwardWipingOff" 9 "Mode4_BackwardWipingOff" 10 "Mode4_OutwardWipingOff" 11 "Mode4_InwardWipingOff" 12 "Mode4_ForwardScanning" 13 "Mode4_BackwardScanning" 14 "Mode4_BreathOn" 15 "Mode4_BreathOff" 16 "Mode4_1stHalfONand2ndHalfOFF" 17 "Mode4_HalfOFFHalfON" 18 "Mode4_HalfDimmingONHalfOFF" 19 "Mode4_HalfDimmingONHalfON" 20 "Mode4_HalfOFFHalfDimmingON" 21 "Mode4_HalfONHalfDimmingON" 22 "Mode4_HalfDimmingOFFHalfOFF" 23 "Mode4_HalfDimmingOFFHalfON" 24 "Mode4_HalfOFFHalfDimmingOFF" 25 "Mode4_HalfONHalfDimmingOFF" 26 "Mode4_SingleOn1" 27 "Mode4_SingleOn2" 28 "Mode4_SingleOn3" 29 "Mode4_SingleOn4" 30 "Mode4_SingleOn5" 31 "Mode4_SingleOn6" 32 "Mode4_SingleOn7" 33 "Mode4_SingleOn8" 34 "Mode4_SingleOn9" 35 "Mode4_SingleOn10" 36 "Mode4_SingleOn11" 37 "Mode4_SingleOn12" 38 "Mode4_SingleOff1" 39 "Mode4_SingleOff2" 40 "Mode4_SingleOff3" 41 "Mode4_SingleOff4" 42 "Mode4_SingleOff5" 43 "Mode4_SingleOff6" 44 "Mode4_SingleOff7" 45 "Mode4_SingleOff8" 46 "Mode4_SingleOff9" 47 "Mode4_SingleOff10" 48 "Mode4_SingleOff11" 49 "Mode4_SingleOff12";
VAL_ 89 DwnLoadDynLtgPrmForFrntLeGrp18Mode1 0 "Mode4_Off" 1 "Mode4_On" 2 "Mode4_GradualOn" 3 "Mode4_GradualOff" 4 "Mode4_ForwardWipingOn" 5 "Mode4_BackwardWipingOn" 6 "Mode4_OutwardWipingOn" 7 "Mode4_InwardWipingOn" 8 "Mode4_ForwardWipingOff" 9 "Mode4_BackwardWipingOff" 10 "Mode4_OutwardWipingOff" 11 "Mode4_InwardWipingOff" 12 "Mode4_ForwardScanning" 13 "Mode4_BackwardScanning" 14 "Mode4_BreathOn" 15 "Mode4_BreathOff" 16 "Mode4_1stHalfONand2ndHalfOFF" 17 "Mode4_HalfOFFHalfON" 18 "Mode4_HalfDimmingONHalfOFF" 19 "Mode4_HalfDimmingONHalfON" 20 "Mode4_HalfOFFHalfDimmingON" 21 "Mode4_HalfONHalfDimmingON" 22 "Mode4_HalfDimmingOFFHalfOFF" 23 "Mode4_HalfDimmingOFFHalfON" 24 "Mode4_HalfOFFHalfDimmingOFF" 25 "Mode4_HalfONHalfDimmingOFF" 26 "Mode4_SingleOn1" 27 "Mode4_SingleOn2" 28 "Mode4_SingleOn3" 29 "Mode4_SingleOn4" 30 "Mode4_SingleOn5" 31 "Mode4_SingleOn6" 32 "Mode4_SingleOn7" 33 "Mode4_SingleOn8" 34 "Mode4_SingleOn9" 35 "Mode4_SingleOn10" 36 "Mode4_SingleOn11" 37 "Mode4_SingleOn12" 38 "Mode4_SingleOff1" 39 "Mode4_SingleOff2" 40 "Mode4_SingleOff3" 41 "Mode4_SingleOff4" 42 "Mode4_SingleOff5" 43 "Mode4_SingleOff6" 44 "Mode4_SingleOff7" 45 "Mode4_SingleOff8" 46 "Mode4_SingleOff9" 47 "Mode4_SingleOff10" 48 "Mode4_SingleOff11" 49 "Mode4_SingleOff12";
VAL_ 89 DwnLoadDynLtgPrmForFrntLeGrp19Mode1 0 "Mode4_Off" 1 "Mode4_On" 2 "Mode4_GradualOn" 3 "Mode4_GradualOff" 4 "Mode4_ForwardWipingOn" 5 "Mode4_BackwardWipingOn" 6 "Mode4_OutwardWipingOn" 7 "Mode4_InwardWipingOn" 8 "Mode4_ForwardWipingOff" 9 "Mode4_BackwardWipingOff" 10 "Mode4_OutwardWipingOff" 11 "Mode4_InwardWipingOff" 12 "Mode4_ForwardScanning" 13 "Mode4_BackwardScanning" 14 "Mode4_BreathOn" 15 "Mode4_BreathOff" 16 "Mode4_1stHalfONand2ndHalfOFF" 17 "Mode4_HalfOFFHalfON" 18 "Mode4_HalfDimmingONHalfOFF" 19 "Mode4_HalfDimmingONHalfON" 20 "Mode4_HalfOFFHalfDimmingON" 21 "Mode4_HalfONHalfDimmingON" 22 "Mode4_HalfDimmingOFFHalfOFF" 23 "Mode4_HalfDimmingOFFHalfON" 24 "Mode4_HalfOFFHalfDimmingOFF" 25 "Mode4_HalfONHalfDimmingOFF" 26 "Mode4_SingleOn1" 27 "Mode4_SingleOn2" 28 "Mode4_SingleOn3" 29 "Mode4_SingleOn4" 30 "Mode4_SingleOn5" 31 "Mode4_SingleOn6" 32 "Mode4_SingleOn7" 33 "Mode4_SingleOn8" 34 "Mode4_SingleOn9" 35 "Mode4_SingleOn10" 36 "Mode4_SingleOn11" 37 "Mode4_SingleOn12" 38 "Mode4_SingleOff1" 39 "Mode4_SingleOff2" 40 "Mode4_SingleOff3" 41 "Mode4_SingleOff4" 42 "Mode4_SingleOff5" 43 "Mode4_SingleOff6" 44 "Mode4_SingleOff7" 45 "Mode4_SingleOff8" 46 "Mode4_SingleOff9" 47 "Mode4_SingleOff10" 48 "Mode4_SingleOff11" 49 "Mode4_SingleOff12";
VAL_ 89 DwnLoadDynLtgPrmForFrntLeGrp20Mode1 0 "Mode4_Off" 1 "Mode4_On" 2 "Mode4_GradualOn" 3 "Mode4_GradualOff" 4 "Mode4_ForwardWipingOn" 5 "Mode4_BackwardWipingOn" 6 "Mode4_OutwardWipingOn" 7 "Mode4_InwardWipingOn" 8 "Mode4_ForwardWipingOff" 9 "Mode4_BackwardWipingOff" 10 "Mode4_OutwardWipingOff" 11 "Mode4_InwardWipingOff" 12 "Mode4_ForwardScanning" 13 "Mode4_BackwardScanning" 14 "Mode4_BreathOn" 15 "Mode4_BreathOff" 16 "Mode4_1stHalfONand2ndHalfOFF" 17 "Mode4_HalfOFFHalfON" 18 "Mode4_HalfDimmingONHalfOFF" 19 "Mode4_HalfDimmingONHalfON" 20 "Mode4_HalfOFFHalfDimmingON" 21 "Mode4_HalfONHalfDimmingON" 22 "Mode4_HalfDimmingOFFHalfOFF" 23 "Mode4_HalfDimmingOFFHalfON" 24 "Mode4_HalfOFFHalfDimmingOFF" 25 "Mode4_HalfONHalfDimmingOFF" 26 "Mode4_SingleOn1" 27 "Mode4_SingleOn2" 28 "Mode4_SingleOn3" 29 "Mode4_SingleOn4" 30 "Mode4_SingleOn5" 31 "Mode4_SingleOn6" 32 "Mode4_SingleOn7" 33 "Mode4_SingleOn8" 34 "Mode4_SingleOn9" 35 "Mode4_SingleOn10" 36 "Mode4_SingleOn11" 37 "Mode4_SingleOn12" 38 "Mode4_SingleOff1" 39 "Mode4_SingleOff2" 40 "Mode4_SingleOff3" 41 "Mode4_SingleOff4" 42 "Mode4_SingleOff5" 43 "Mode4_SingleOff6" 44 "Mode4_SingleOff7" 45 "Mode4_SingleOff8" 46 "Mode4_SingleOff9" 47 "Mode4_SingleOff10" 48 "Mode4_SingleOff11" 49 "Mode4_SingleOff12";
VAL_ 89 DwnLoadDynLtgPrmForFrntLeGrp21Mode1 0 "Mode4_Off" 1 "Mode4_On" 2 "Mode4_GradualOn" 3 "Mode4_GradualOff" 4 "Mode4_ForwardWipingOn" 5 "Mode4_BackwardWipingOn" 6 "Mode4_OutwardWipingOn" 7 "Mode4_InwardWipingOn" 8 "Mode4_ForwardWipingOff" 9 "Mode4_BackwardWipingOff" 10 "Mode4_OutwardWipingOff" 11 "Mode4_InwardWipingOff" 12 "Mode4_ForwardScanning" 13 "Mode4_BackwardScanning" 14 "Mode4_BreathOn" 15 "Mode4_BreathOff" 16 "Mode4_1stHalfONand2ndHalfOFF" 17 "Mode4_HalfOFFHalfON" 18 "Mode4_HalfDimmingONHalfOFF" 19 "Mode4_HalfDimmingONHalfON" 20 "Mode4_HalfOFFHalfDimmingON" 21 "Mode4_HalfONHalfDimmingON" 22 "Mode4_HalfDimmingOFFHalfOFF" 23 "Mode4_HalfDimmingOFFHalfON" 24 "Mode4_HalfOFFHalfDimmingOFF" 25 "Mode4_HalfONHalfDimmingOFF" 26 "Mode4_SingleOn1" 27 "Mode4_SingleOn2" 28 "Mode4_SingleOn3" 29 "Mode4_SingleOn4" 30 "Mode4_SingleOn5" 31 "Mode4_SingleOn6" 32 "Mode4_SingleOn7" 33 "Mode4_SingleOn8" 34 "Mode4_SingleOn9" 35 "Mode4_SingleOn10" 36 "Mode4_SingleOn11" 37 "Mode4_SingleOn12" 38 "Mode4_SingleOff1" 39 "Mode4_SingleOff2" 40 "Mode4_SingleOff3" 41 "Mode4_SingleOff4" 42 "Mode4_SingleOff5" 43 "Mode4_SingleOff6" 44 "Mode4_SingleOff7" 45 "Mode4_SingleOff8" 46 "Mode4_SingleOff9" 47 "Mode4_SingleOff10" 48 "Mode4_SingleOff11" 49 "Mode4_SingleOff12";
VAL_ 89 DwnLoadDynLtgPrmForFrntLeGrp22Mode1 0 "Mode4_Off" 1 "Mode4_On" 2 "Mode4_GradualOn" 3 "Mode4_GradualOff" 4 "Mode4_ForwardWipingOn" 5 "Mode4_BackwardWipingOn" 6 "Mode4_OutwardWipingOn" 7 "Mode4_InwardWipingOn" 8 "Mode4_ForwardWipingOff" 9 "Mode4_BackwardWipingOff" 10 "Mode4_OutwardWipingOff" 11 "Mode4_InwardWipingOff" 12 "Mode4_ForwardScanning" 13 "Mode4_BackwardScanning" 14 "Mode4_BreathOn" 15 "Mode4_BreathOff" 16 "Mode4_1stHalfONand2ndHalfOFF" 17 "Mode4_HalfOFFHalfON" 18 "Mode4_HalfDimmingONHalfOFF" 19 "Mode4_HalfDimmingONHalfON" 20 "Mode4_HalfOFFHalfDimmingON" 21 "Mode4_HalfONHalfDimmingON" 22 "Mode4_HalfDimmingOFFHalfOFF" 23 "Mode4_HalfDimmingOFFHalfON" 24 "Mode4_HalfOFFHalfDimmingOFF" 25 "Mode4_HalfONHalfDimmingOFF" 26 "Mode4_SingleOn1" 27 "Mode4_SingleOn2" 28 "Mode4_SingleOn3" 29 "Mode4_SingleOn4" 30 "Mode4_SingleOn5" 31 "Mode4_SingleOn6" 32 "Mode4_SingleOn7" 33 "Mode4_SingleOn8" 34 "Mode4_SingleOn9" 35 "Mode4_SingleOn10" 36 "Mode4_SingleOn11" 37 "Mode4_SingleOn12" 38 "Mode4_SingleOff1" 39 "Mode4_SingleOff2" 40 "Mode4_SingleOff3" 41 "Mode4_SingleOff4" 42 "Mode4_SingleOff5" 43 "Mode4_SingleOff6" 44 "Mode4_SingleOff7" 45 "Mode4_SingleOff8" 46 "Mode4_SingleOff9" 47 "Mode4_SingleOff10" 48 "Mode4_SingleOff11" 49 "Mode4_SingleOff12";
VAL_ 89 DwnLoadDynLtgPrmForFrntLeGrp23Mode1 0 "Mode4_Off" 1 "Mode4_On" 2 "Mode4_GradualOn" 3 "Mode4_GradualOff" 4 "Mode4_ForwardWipingOn" 5 "Mode4_BackwardWipingOn" 6 "Mode4_OutwardWipingOn" 7 "Mode4_InwardWipingOn" 8 "Mode4_ForwardWipingOff" 9 "Mode4_BackwardWipingOff" 10 "Mode4_OutwardWipingOff" 11 "Mode4_InwardWipingOff" 12 "Mode4_ForwardScanning" 13 "Mode4_BackwardScanning" 14 "Mode4_BreathOn" 15 "Mode4_BreathOff" 16 "Mode4_1stHalfONand2ndHalfOFF" 17 "Mode4_HalfOFFHalfON" 18 "Mode4_HalfDimmingONHalfOFF" 19 "Mode4_HalfDimmingONHalfON" 20 "Mode4_HalfOFFHalfDimmingON" 21 "Mode4_HalfONHalfDimmingON" 22 "Mode4_HalfDimmingOFFHalfOFF" 23 "Mode4_HalfDimmingOFFHalfON" 24 "Mode4_HalfOFFHalfDimmingOFF" 25 "Mode4_HalfONHalfDimmingOFF" 26 "Mode4_SingleOn1" 27 "Mode4_SingleOn2" 28 "Mode4_SingleOn3" 29 "Mode4_SingleOn4" 30 "Mode4_SingleOn5" 31 "Mode4_SingleOn6" 32 "Mode4_SingleOn7" 33 "Mode4_SingleOn8" 34 "Mode4_SingleOn9" 35 "Mode4_SingleOn10" 36 "Mode4_SingleOn11" 37 "Mode4_SingleOn12" 38 "Mode4_SingleOff1" 39 "Mode4_SingleOff2" 40 "Mode4_SingleOff3" 41 "Mode4_SingleOff4" 42 "Mode4_SingleOff5" 43 "Mode4_SingleOff6" 44 "Mode4_SingleOff7" 45 "Mode4_SingleOff8" 46 "Mode4_SingleOff9" 47 "Mode4_SingleOff10" 48 "Mode4_SingleOff11" 49 "Mode4_SingleOff12";
VAL_ 89 DwnLoadDynLtgPrmForFrntLeGrp24Mode1 0 "Mode4_Off" 1 "Mode4_On" 2 "Mode4_GradualOn" 3 "Mode4_GradualOff" 4 "Mode4_ForwardWipingOn" 5 "Mode4_BackwardWipingOn" 6 "Mode4_OutwardWipingOn" 7 "Mode4_InwardWipingOn" 8 "Mode4_ForwardWipingOff" 9 "Mode4_BackwardWipingOff" 10 "Mode4_OutwardWipingOff" 11 "Mode4_InwardWipingOff" 12 "Mode4_ForwardScanning" 13 "Mode4_BackwardScanning" 14 "Mode4_BreathOn" 15 "Mode4_BreathOff" 16 "Mode4_1stHalfONand2ndHalfOFF" 17 "Mode4_HalfOFFHalfON" 18 "Mode4_HalfDimmingONHalfOFF" 19 "Mode4_HalfDimmingONHalfON" 20 "Mode4_HalfOFFHalfDimmingON" 21 "Mode4_HalfONHalfDimmingON" 22 "Mode4_HalfDimmingOFFHalfOFF" 23 "Mode4_HalfDimmingOFFHalfON" 24 "Mode4_HalfOFFHalfDimmingOFF" 25 "Mode4_HalfONHalfDimmingOFF" 26 "Mode4_SingleOn1" 27 "Mode4_SingleOn2" 28 "Mode4_SingleOn3" 29 "Mode4_SingleOn4" 30 "Mode4_SingleOn5" 31 "Mode4_SingleOn6" 32 "Mode4_SingleOn7" 33 "Mode4_SingleOn8" 34 "Mode4_SingleOn9" 35 "Mode4_SingleOn10" 36 "Mode4_SingleOn11" 37 "Mode4_SingleOn12" 38 "Mode4_SingleOff1" 39 "Mode4_SingleOff2" 40 "Mode4_SingleOff3" 41 "Mode4_SingleOff4" 42 "Mode4_SingleOff5" 43 "Mode4_SingleOff6" 44 "Mode4_SingleOff7" 45 "Mode4_SingleOff8" 46 "Mode4_SingleOff9" 47 "Mode4_SingleOff10" 48 "Mode4_SingleOff11" 49 "Mode4_SingleOff12";
VAL_ 89 TelmAirFragTasteReq 0 "TelmAirFragChReq_NoReq" 1 "TelmAirFragChReq_Ch1" 2 "TelmAirFragChReq_Ch2" 3 "TelmAirFragChReq_Ch3" 4 "TelmAirFragChReq_Ch4" 5 "TelmAirFragChReq_Ch5";
VAL_ 89 TelmClimaReq 0 "OnOffNoReq_NoReq" 1 "OnOffNoReq_On" 2 "OnOffNoReq_Off";
VAL_ 89 TelmDefrostReq 0 "OnOffNoReq_NoReq" 1 "OnOffNoReq_On" 2 "OnOffNoReq_Off";
VAL_ 89 TelmLockgCenReqReqTyp 0 "TelmLockgCenReq2_TelmNoReq" 1 "TelmLockgCenReq2_TelmLock" 2 "TelmLockgCenReq2_TelmUnlck" 3 "TelmLockgCenReq2_TelmUnlckByTrSwtEna";
VAL_ 89 TelmPM25Req 0 "ReqSts1_NotReqd" 1 "ReqSts1_Reqd";
VAL_ 89 TelmPreClimaPrio 0 "PreClimaPrio_Range" 1 "PreClimaPrio_KeepSOC" 2 "PreClimaPrio_Comfort" 3 "PreClimaPrio_Reserved";
VAL_ 89 TelmSeatDrvHeatClimaLvl 0 "TelmSeatClimaLvl_off" 1 "TelmSeatClimaLvl_Lvl1" 2 "TelmSeatClimaLvl_Lvl2" 3 "TelmSeatClimaLvl_Lvl3";
VAL_ 89 TelmSeatDrvVentnClimaLvl 0 "TelmSeatClimaLvl_off" 1 "TelmSeatClimaLvl_Lvl1" 2 "TelmSeatClimaLvl_Lvl2" 3 "TelmSeatClimaLvl_Lvl3";
VAL_ 89 TelmSeatPassHeatClimaLvl 0 "TelmSeatClimaLvl_off" 1 "TelmSeatClimaLvl_Lvl1" 2 "TelmSeatClimaLvl_Lvl2" 3 "TelmSeatClimaLvl_Lvl3";
VAL_ 89 TelmSeatPassVentnClimaLvl 0 "TelmSeatClimaLvl_off" 1 "TelmSeatClimaLvl_Lvl1" 2 "TelmSeatClimaLvl_Lvl2" 3 "TelmSeatClimaLvl_Lvl3";
VAL_ 89 TelmSeatSecLeHeatClimaLvl 0 "TelmSeatClimaLvl_off" 1 "TelmSeatClimaLvl_Lvl1" 2 "TelmSeatClimaLvl_Lvl2" 3 "TelmSeatClimaLvl_Lvl3";
VAL_ 89 TelmSeatSecLeVentnClimaLvl 0 "TelmSeatClimaLvl_off" 1 "TelmSeatClimaLvl_Lvl1" 2 "TelmSeatClimaLvl_Lvl2" 3 "TelmSeatClimaLvl_Lvl3";
VAL_ 89 TelmSeatSecRiHeatClimaLvl 0 "TelmSeatClimaLvl_off" 1 "TelmSeatClimaLvl_Lvl1" 2 "TelmSeatClimaLvl_Lvl2" 3 "TelmSeatClimaLvl_Lvl3";
VAL_ 89 TelmSeatSecRiVentnClimaLvl 0 "TelmSeatClimaLvl_off" 1 "TelmSeatClimaLvl_Lvl1" 2 "TelmSeatClimaLvl_Lvl2" 3 "TelmSeatClimaLvl_Lvl3";
VAL_ 89 TelmSeatThrdLeHeatClimaLvl 0 "TelmSeatClimaLvl_off" 1 "TelmSeatClimaLvl_Lvl1" 2 "TelmSeatClimaLvl_Lvl2" 3 "TelmSeatClimaLvl_Lvl3";
VAL_ 89 TelmSeatThrdLeVentnClimaLvl 0 "TelmSeatClimaLvl_off" 1 "TelmSeatClimaLvl_Lvl1" 2 "TelmSeatClimaLvl_Lvl2" 3 "TelmSeatClimaLvl_Lvl3";
VAL_ 89 TelmSeatThrdRiHeatClimaLvl 0 "TelmSeatClimaLvl_off" 1 "TelmSeatClimaLvl_Lvl1" 2 "TelmSeatClimaLvl_Lvl2" 3 "TelmSeatClimaLvl_Lvl3";
VAL_ 89 TelmSeatThrdRiVentnClimaLvl 0 "TelmSeatClimaLvl_off" 1 "TelmSeatClimaLvl_Lvl1" 2 "TelmSeatClimaLvl_Lvl2" 3 "TelmSeatClimaLvl_Lvl3";
VAL_ 99 DwnLoadDynLtgPrmForFrntRIGrp10Mode1 0 "Mode4_Off" 1 "Mode4_On" 2 "Mode4_GradualOn" 3 "Mode4_GradualOff" 4 "Mode4_ForwardWipingOn" 5 "Mode4_BackwardWipingOn" 6 "Mode4_OutwardWipingOn" 7 "Mode4_InwardWipingOn" 8 "Mode4_ForwardWipingOff" 9 "Mode4_BackwardWipingOff" 10 "Mode4_OutwardWipingOff" 11 "Mode4_InwardWipingOff" 12 "Mode4_ForwardScanning" 13 "Mode4_BackwardScanning" 14 "Mode4_BreathOn" 15 "Mode4_BreathOff" 16 "Mode4_1stHalfONand2ndHalfOFF" 17 "Mode4_HalfOFFHalfON" 18 "Mode4_HalfDimmingONHalfOFF" 19 "Mode4_HalfDimmingONHalfON" 20 "Mode4_HalfOFFHalfDimmingON" 21 "Mode4_HalfONHalfDimmingON" 22 "Mode4_HalfDimmingOFFHalfOFF" 23 "Mode4_HalfDimmingOFFHalfON" 24 "Mode4_HalfOFFHalfDimmingOFF" 25 "Mode4_HalfONHalfDimmingOFF" 26 "Mode4_SingleOn1" 27 "Mode4_SingleOn2" 28 "Mode4_SingleOn3" 29 "Mode4_SingleOn4" 30 "Mode4_SingleOn5" 31 "Mode4_SingleOn6" 32 "Mode4_SingleOn7" 33 "Mode4_SingleOn8" 34 "Mode4_SingleOn9" 35 "Mode4_SingleOn10" 36 "Mode4_SingleOn11" 37 "Mode4_SingleOn12" 38 "Mode4_SingleOff1" 39 "Mode4_SingleOff2" 40 "Mode4_SingleOff3" 41 "Mode4_SingleOff4" 42 "Mode4_SingleOff5" 43 "Mode4_SingleOff6" 44 "Mode4_SingleOff7" 45 "Mode4_SingleOff8" 46 "Mode4_SingleOff9" 47 "Mode4_SingleOff10" 48 "Mode4_SingleOff11" 49 "Mode4_SingleOff12";
VAL_ 99 DwnLoadDynLtgPrmForFrntRIGrp11Mode1 0 "Mode4_Off" 1 "Mode4_On" 2 "Mode4_GradualOn" 3 "Mode4_GradualOff" 4 "Mode4_ForwardWipingOn" 5 "Mode4_BackwardWipingOn" 6 "Mode4_OutwardWipingOn" 7 "Mode4_InwardWipingOn" 8 "Mode4_ForwardWipingOff" 9 "Mode4_BackwardWipingOff" 10 "Mode4_OutwardWipingOff" 11 "Mode4_InwardWipingOff" 12 "Mode4_ForwardScanning" 13 "Mode4_BackwardScanning" 14 "Mode4_BreathOn" 15 "Mode4_BreathOff" 16 "Mode4_1stHalfONand2ndHalfOFF" 17 "Mode4_HalfOFFHalfON" 18 "Mode4_HalfDimmingONHalfOFF" 19 "Mode4_HalfDimmingONHalfON" 20 "Mode4_HalfOFFHalfDimmingON" 21 "Mode4_HalfONHalfDimmingON" 22 "Mode4_HalfDimmingOFFHalfOFF" 23 "Mode4_HalfDimmingOFFHalfON" 24 "Mode4_HalfOFFHalfDimmingOFF" 25 "Mode4_HalfONHalfDimmingOFF" 26 "Mode4_SingleOn1" 27 "Mode4_SingleOn2" 28 "Mode4_SingleOn3" 29 "Mode4_SingleOn4" 30 "Mode4_SingleOn5" 31 "Mode4_SingleOn6" 32 "Mode4_SingleOn7" 33 "Mode4_SingleOn8" 34 "Mode4_SingleOn9" 35 "Mode4_SingleOn10" 36 "Mode4_SingleOn11" 37 "Mode4_SingleOn12" 38 "Mode4_SingleOff1" 39 "Mode4_SingleOff2" 40 "Mode4_SingleOff3" 41 "Mode4_SingleOff4" 42 "Mode4_SingleOff5" 43 "Mode4_SingleOff6" 44 "Mode4_SingleOff7" 45 "Mode4_SingleOff8" 46 "Mode4_SingleOff9" 47 "Mode4_SingleOff10" 48 "Mode4_SingleOff11" 49 "Mode4_SingleOff12";
VAL_ 99 DwnLoadDynLtgPrmForFrntRIGrp12Mode1 0 "Mode4_Off" 1 "Mode4_On" 2 "Mode4_GradualOn" 3 "Mode4_GradualOff" 4 "Mode4_ForwardWipingOn" 5 "Mode4_BackwardWipingOn" 6 "Mode4_OutwardWipingOn" 7 "Mode4_InwardWipingOn" 8 "Mode4_ForwardWipingOff" 9 "Mode4_BackwardWipingOff" 10 "Mode4_OutwardWipingOff" 11 "Mode4_InwardWipingOff" 12 "Mode4_ForwardScanning" 13 "Mode4_BackwardScanning" 14 "Mode4_BreathOn" 15 "Mode4_BreathOff" 16 "Mode4_1stHalfONand2ndHalfOFF" 17 "Mode4_HalfOFFHalfON" 18 "Mode4_HalfDimmingONHalfOFF" 19 "Mode4_HalfDimmingONHalfON" 20 "Mode4_HalfOFFHalfDimmingON" 21 "Mode4_HalfONHalfDimmingON" 22 "Mode4_HalfDimmingOFFHalfOFF" 23 "Mode4_HalfDimmingOFFHalfON" 24 "Mode4_HalfOFFHalfDimmingOFF" 25 "Mode4_HalfONHalfDimmingOFF" 26 "Mode4_SingleOn1" 27 "Mode4_SingleOn2" 28 "Mode4_SingleOn3" 29 "Mode4_SingleOn4" 30 "Mode4_SingleOn5" 31 "Mode4_SingleOn6" 32 "Mode4_SingleOn7" 33 "Mode4_SingleOn8" 34 "Mode4_SingleOn9" 35 "Mode4_SingleOn10" 36 "Mode4_SingleOn11" 37 "Mode4_SingleOn12" 38 "Mode4_SingleOff1" 39 "Mode4_SingleOff2" 40 "Mode4_SingleOff3" 41 "Mode4_SingleOff4" 42 "Mode4_SingleOff5" 43 "Mode4_SingleOff6" 44 "Mode4_SingleOff7" 45 "Mode4_SingleOff8" 46 "Mode4_SingleOff9" 47 "Mode4_SingleOff10" 48 "Mode4_SingleOff11" 49 "Mode4_SingleOff12";
VAL_ 99 DwnLoadDynLtgPrmForFrntRIGrp1Mode1 0 "Mode4_Off" 1 "Mode4_On" 2 "Mode4_GradualOn" 3 "Mode4_GradualOff" 4 "Mode4_ForwardWipingOn" 5 "Mode4_BackwardWipingOn" 6 "Mode4_OutwardWipingOn" 7 "Mode4_InwardWipingOn" 8 "Mode4_ForwardWipingOff" 9 "Mode4_BackwardWipingOff" 10 "Mode4_OutwardWipingOff" 11 "Mode4_InwardWipingOff" 12 "Mode4_ForwardScanning" 13 "Mode4_BackwardScanning" 14 "Mode4_BreathOn" 15 "Mode4_BreathOff" 16 "Mode4_1stHalfONand2ndHalfOFF" 17 "Mode4_HalfOFFHalfON" 18 "Mode4_HalfDimmingONHalfOFF" 19 "Mode4_HalfDimmingONHalfON" 20 "Mode4_HalfOFFHalfDimmingON" 21 "Mode4_HalfONHalfDimmingON" 22 "Mode4_HalfDimmingOFFHalfOFF" 23 "Mode4_HalfDimmingOFFHalfON" 24 "Mode4_HalfOFFHalfDimmingOFF" 25 "Mode4_HalfONHalfDimmingOFF" 26 "Mode4_SingleOn1" 27 "Mode4_SingleOn2" 28 "Mode4_SingleOn3" 29 "Mode4_SingleOn4" 30 "Mode4_SingleOn5" 31 "Mode4_SingleOn6" 32 "Mode4_SingleOn7" 33 "Mode4_SingleOn8" 34 "Mode4_SingleOn9" 35 "Mode4_SingleOn10" 36 "Mode4_SingleOn11" 37 "Mode4_SingleOn12" 38 "Mode4_SingleOff1" 39 "Mode4_SingleOff2" 40 "Mode4_SingleOff3" 41 "Mode4_SingleOff4" 42 "Mode4_SingleOff5" 43 "Mode4_SingleOff6" 44 "Mode4_SingleOff7" 45 "Mode4_SingleOff8" 46 "Mode4_SingleOff9" 47 "Mode4_SingleOff10" 48 "Mode4_SingleOff11" 49 "Mode4_SingleOff12";
VAL_ 99 DwnLoadDynLtgPrmForFrntRIGrp2Mode1 0 "Mode4_Off" 1 "Mode4_On" 2 "Mode4_GradualOn" 3 "Mode4_GradualOff" 4 "Mode4_ForwardWipingOn" 5 "Mode4_BackwardWipingOn" 6 "Mode4_OutwardWipingOn" 7 "Mode4_InwardWipingOn" 8 "Mode4_ForwardWipingOff" 9 "Mode4_BackwardWipingOff" 10 "Mode4_OutwardWipingOff" 11 "Mode4_InwardWipingOff" 12 "Mode4_ForwardScanning" 13 "Mode4_BackwardScanning" 14 "Mode4_BreathOn" 15 "Mode4_BreathOff" 16 "Mode4_1stHalfONand2ndHalfOFF" 17 "Mode4_HalfOFFHalfON" 18 "Mode4_HalfDimmingONHalfOFF" 19 "Mode4_HalfDimmingONHalfON" 20 "Mode4_HalfOFFHalfDimmingON" 21 "Mode4_HalfONHalfDimmingON" 22 "Mode4_HalfDimmingOFFHalfOFF" 23 "Mode4_HalfDimmingOFFHalfON" 24 "Mode4_HalfOFFHalfDimmingOFF" 25 "Mode4_HalfONHalfDimmingOFF" 26 "Mode4_SingleOn1" 27 "Mode4_SingleOn2" 28 "Mode4_SingleOn3" 29 "Mode4_SingleOn4" 30 "Mode4_SingleOn5" 31 "Mode4_SingleOn6" 32 "Mode4_SingleOn7" 33 "Mode4_SingleOn8" 34 "Mode4_SingleOn9" 35 "Mode4_SingleOn10" 36 "Mode4_SingleOn11" 37 "Mode4_SingleOn12" 38 "Mode4_SingleOff1" 39 "Mode4_SingleOff2" 40 "Mode4_SingleOff3" 41 "Mode4_SingleOff4" 42 "Mode4_SingleOff5" 43 "Mode4_SingleOff6" 44 "Mode4_SingleOff7" 45 "Mode4_SingleOff8" 46 "Mode4_SingleOff9" 47 "Mode4_SingleOff10" 48 "Mode4_SingleOff11" 49 "Mode4_SingleOff12";
VAL_ 99 DwnLoadDynLtgPrmForFrntRIGrp3Mode1 0 "Mode4_Off" 1 "Mode4_On" 2 "Mode4_GradualOn" 3 "Mode4_GradualOff" 4 "Mode4_ForwardWipingOn" 5 "Mode4_BackwardWipingOn" 6 "Mode4_OutwardWipingOn" 7 "Mode4_InwardWipingOn" 8 "Mode4_ForwardWipingOff" 9 "Mode4_BackwardWipingOff" 10 "Mode4_OutwardWipingOff" 11 "Mode4_InwardWipingOff" 12 "Mode4_ForwardScanning" 13 "Mode4_BackwardScanning" 14 "Mode4_BreathOn" 15 "Mode4_BreathOff" 16 "Mode4_1stHalfONand2ndHalfOFF" 17 "Mode4_HalfOFFHalfON" 18 "Mode4_HalfDimmingONHalfOFF" 19 "Mode4_HalfDimmingONHalfON" 20 "Mode4_HalfOFFHalfDimmingON" 21 "Mode4_HalfONHalfDimmingON" 22 "Mode4_HalfDimmingOFFHalfOFF" 23 "Mode4_HalfDimmingOFFHalfON" 24 "Mode4_HalfOFFHalfDimmingOFF" 25 "Mode4_HalfONHalfDimmingOFF" 26 "Mode4_SingleOn1" 27 "Mode4_SingleOn2" 28 "Mode4_SingleOn3" 29 "Mode4_SingleOn4" 30 "Mode4_SingleOn5" 31 "Mode4_SingleOn6" 32 "Mode4_SingleOn7" 33 "Mode4_SingleOn8" 34 "Mode4_SingleOn9" 35 "Mode4_SingleOn10" 36 "Mode4_SingleOn11" 37 "Mode4_SingleOn12" 38 "Mode4_SingleOff1" 39 "Mode4_SingleOff2" 40 "Mode4_SingleOff3" 41 "Mode4_SingleOff4" 42 "Mode4_SingleOff5" 43 "Mode4_SingleOff6" 44 "Mode4_SingleOff7" 45 "Mode4_SingleOff8" 46 "Mode4_SingleOff9" 47 "Mode4_SingleOff10" 48 "Mode4_SingleOff11" 49 "Mode4_SingleOff12";
VAL_ 99 DwnLoadDynLtgPrmForFrntRIGrp4Mode1 0 "Mode4_Off" 1 "Mode4_On" 2 "Mode4_GradualOn" 3 "Mode4_GradualOff" 4 "Mode4_ForwardWipingOn" 5 "Mode4_BackwardWipingOn" 6 "Mode4_OutwardWipingOn" 7 "Mode4_InwardWipingOn" 8 "Mode4_ForwardWipingOff" 9 "Mode4_BackwardWipingOff" 10 "Mode4_OutwardWipingOff" 11 "Mode4_InwardWipingOff" 12 "Mode4_ForwardScanning" 13 "Mode4_BackwardScanning" 14 "Mode4_BreathOn" 15 "Mode4_BreathOff" 16 "Mode4_1stHalfONand2ndHalfOFF" 17 "Mode4_HalfOFFHalfON" 18 "Mode4_HalfDimmingONHalfOFF" 19 "Mode4_HalfDimmingONHalfON" 20 "Mode4_HalfOFFHalfDimmingON" 21 "Mode4_HalfONHalfDimmingON" 22 "Mode4_HalfDimmingOFFHalfOFF" 23 "Mode4_HalfDimmingOFFHalfON" 24 "Mode4_HalfOFFHalfDimmingOFF" 25 "Mode4_HalfONHalfDimmingOFF" 26 "Mode4_SingleOn1" 27 "Mode4_SingleOn2" 28 "Mode4_SingleOn3" 29 "Mode4_SingleOn4" 30 "Mode4_SingleOn5" 31 "Mode4_SingleOn6" 32 "Mode4_SingleOn7" 33 "Mode4_SingleOn8" 34 "Mode4_SingleOn9" 35 "Mode4_SingleOn10" 36 "Mode4_SingleOn11" 37 "Mode4_SingleOn12" 38 "Mode4_SingleOff1" 39 "Mode4_SingleOff2" 40 "Mode4_SingleOff3" 41 "Mode4_SingleOff4" 42 "Mode4_SingleOff5" 43 "Mode4_SingleOff6" 44 "Mode4_SingleOff7" 45 "Mode4_SingleOff8" 46 "Mode4_SingleOff9" 47 "Mode4_SingleOff10" 48 "Mode4_SingleOff11" 49 "Mode4_SingleOff12";
VAL_ 99 DwnLoadDynLtgPrmForFrntRIGrp5Mode1 0 "Mode4_Off" 1 "Mode4_On" 2 "Mode4_GradualOn" 3 "Mode4_GradualOff" 4 "Mode4_ForwardWipingOn" 5 "Mode4_BackwardWipingOn" 6 "Mode4_OutwardWipingOn" 7 "Mode4_InwardWipingOn" 8 "Mode4_ForwardWipingOff" 9 "Mode4_BackwardWipingOff" 10 "Mode4_OutwardWipingOff" 11 "Mode4_InwardWipingOff" 12 "Mode4_ForwardScanning" 13 "Mode4_BackwardScanning" 14 "Mode4_BreathOn" 15 "Mode4_BreathOff" 16 "Mode4_1stHalfONand2ndHalfOFF" 17 "Mode4_HalfOFFHalfON" 18 "Mode4_HalfDimmingONHalfOFF" 19 "Mode4_HalfDimmingONHalfON" 20 "Mode4_HalfOFFHalfDimmingON" 21 "Mode4_HalfONHalfDimmingON" 22 "Mode4_HalfDimmingOFFHalfOFF" 23 "Mode4_HalfDimmingOFFHalfON" 24 "Mode4_HalfOFFHalfDimmingOFF" 25 "Mode4_HalfONHalfDimmingOFF" 26 "Mode4_SingleOn1" 27 "Mode4_SingleOn2" 28 "Mode4_SingleOn3" 29 "Mode4_SingleOn4" 30 "Mode4_SingleOn5" 31 "Mode4_SingleOn6" 32 "Mode4_SingleOn7" 33 "Mode4_SingleOn8" 34 "Mode4_SingleOn9" 35 "Mode4_SingleOn10" 36 "Mode4_SingleOn11" 37 "Mode4_SingleOn12" 38 "Mode4_SingleOff1" 39 "Mode4_SingleOff2" 40 "Mode4_SingleOff3" 41 "Mode4_SingleOff4" 42 "Mode4_SingleOff5" 43 "Mode4_SingleOff6" 44 "Mode4_SingleOff7" 45 "Mode4_SingleOff8" 46 "Mode4_SingleOff9" 47 "Mode4_SingleOff10" 48 "Mode4_SingleOff11" 49 "Mode4_SingleOff12";
VAL_ 99 DwnLoadDynLtgPrmForFrntRIGrp6Mode1 0 "Mode4_Off" 1 "Mode4_On" 2 "Mode4_GradualOn" 3 "Mode4_GradualOff" 4 "Mode4_ForwardWipingOn" 5 "Mode4_BackwardWipingOn" 6 "Mode4_OutwardWipingOn" 7 "Mode4_InwardWipingOn" 8 "Mode4_ForwardWipingOff" 9 "Mode4_BackwardWipingOff" 10 "Mode4_OutwardWipingOff" 11 "Mode4_InwardWipingOff" 12 "Mode4_ForwardScanning" 13 "Mode4_BackwardScanning" 14 "Mode4_BreathOn" 15 "Mode4_BreathOff" 16 "Mode4_1stHalfONand2ndHalfOFF" 17 "Mode4_HalfOFFHalfON" 18 "Mode4_HalfDimmingONHalfOFF" 19 "Mode4_HalfDimmingONHalfON" 20 "Mode4_HalfOFFHalfDimmingON" 21 "Mode4_HalfONHalfDimmingON" 22 "Mode4_HalfDimmingOFFHalfOFF" 23 "Mode4_HalfDimmingOFFHalfON" 24 "Mode4_HalfOFFHalfDimmingOFF" 25 "Mode4_HalfONHalfDimmingOFF" 26 "Mode4_SingleOn1" 27 "Mode4_SingleOn2" 28 "Mode4_SingleOn3" 29 "Mode4_SingleOn4" 30 "Mode4_SingleOn5" 31 "Mode4_SingleOn6" 32 "Mode4_SingleOn7" 33 "Mode4_SingleOn8" 34 "Mode4_SingleOn9" 35 "Mode4_SingleOn10" 36 "Mode4_SingleOn11" 37 "Mode4_SingleOn12" 38 "Mode4_SingleOff1" 39 "Mode4_SingleOff2" 40 "Mode4_SingleOff3" 41 "Mode4_SingleOff4" 42 "Mode4_SingleOff5" 43 "Mode4_SingleOff6" 44 "Mode4_SingleOff7" 45 "Mode4_SingleOff8" 46 "Mode4_SingleOff9" 47 "Mode4_SingleOff10" 48 "Mode4_SingleOff11" 49 "Mode4_SingleOff12";
VAL_ 99 DwnLoadDynLtgPrmForFrntRIGrp7Mode1 0 "Mode4_Off" 1 "Mode4_On" 2 "Mode4_GradualOn" 3 "Mode4_GradualOff" 4 "Mode4_ForwardWipingOn" 5 "Mode4_BackwardWipingOn" 6 "Mode4_OutwardWipingOn" 7 "Mode4_InwardWipingOn" 8 "Mode4_ForwardWipingOff" 9 "Mode4_BackwardWipingOff" 10 "Mode4_OutwardWipingOff" 11 "Mode4_InwardWipingOff" 12 "Mode4_ForwardScanning" 13 "Mode4_BackwardScanning" 14 "Mode4_BreathOn" 15 "Mode4_BreathOff" 16 "Mode4_1stHalfONand2ndHalfOFF" 17 "Mode4_HalfOFFHalfON" 18 "Mode4_HalfDimmingONHalfOFF" 19 "Mode4_HalfDimmingONHalfON" 20 "Mode4_HalfOFFHalfDimmingON" 21 "Mode4_HalfONHalfDimmingON" 22 "Mode4_HalfDimmingOFFHalfOFF" 23 "Mode4_HalfDimmingOFFHalfON" 24 "Mode4_HalfOFFHalfDimmingOFF" 25 "Mode4_HalfONHalfDimmingOFF" 26 "Mode4_SingleOn1" 27 "Mode4_SingleOn2" 28 "Mode4_SingleOn3" 29 "Mode4_SingleOn4" 30 "Mode4_SingleOn5" 31 "Mode4_SingleOn6" 32 "Mode4_SingleOn7" 33 "Mode4_SingleOn8" 34 "Mode4_SingleOn9" 35 "Mode4_SingleOn10" 36 "Mode4_SingleOn11" 37 "Mode4_SingleOn12" 38 "Mode4_SingleOff1" 39 "Mode4_SingleOff2" 40 "Mode4_SingleOff3" 41 "Mode4_SingleOff4" 42 "Mode4_SingleOff5" 43 "Mode4_SingleOff6" 44 "Mode4_SingleOff7" 45 "Mode4_SingleOff8" 46 "Mode4_SingleOff9" 47 "Mode4_SingleOff10" 48 "Mode4_SingleOff11" 49 "Mode4_SingleOff12";
VAL_ 99 DwnLoadDynLtgPrmForFrntRIGrp8Mode1 0 "Mode4_Off" 1 "Mode4_On" 2 "Mode4_GradualOn" 3 "Mode4_GradualOff" 4 "Mode4_ForwardWipingOn" 5 "Mode4_BackwardWipingOn" 6 "Mode4_OutwardWipingOn" 7 "Mode4_InwardWipingOn" 8 "Mode4_ForwardWipingOff" 9 "Mode4_BackwardWipingOff" 10 "Mode4_OutwardWipingOff" 11 "Mode4_InwardWipingOff" 12 "Mode4_ForwardScanning" 13 "Mode4_BackwardScanning" 14 "Mode4_BreathOn" 15 "Mode4_BreathOff" 16 "Mode4_1stHalfONand2ndHalfOFF" 17 "Mode4_HalfOFFHalfON" 18 "Mode4_HalfDimmingONHalfOFF" 19 "Mode4_HalfDimmingONHalfON" 20 "Mode4_HalfOFFHalfDimmingON" 21 "Mode4_HalfONHalfDimmingON" 22 "Mode4_HalfDimmingOFFHalfOFF" 23 "Mode4_HalfDimmingOFFHalfON" 24 "Mode4_HalfOFFHalfDimmingOFF" 25 "Mode4_HalfONHalfDimmingOFF" 26 "Mode4_SingleOn1" 27 "Mode4_SingleOn2" 28 "Mode4_SingleOn3" 29 "Mode4_SingleOn4" 30 "Mode4_SingleOn5" 31 "Mode4_SingleOn6" 32 "Mode4_SingleOn7" 33 "Mode4_SingleOn8" 34 "Mode4_SingleOn9" 35 "Mode4_SingleOn10" 36 "Mode4_SingleOn11" 37 "Mode4_SingleOn12" 38 "Mode4_SingleOff1" 39 "Mode4_SingleOff2" 40 "Mode4_SingleOff3" 41 "Mode4_SingleOff4" 42 "Mode4_SingleOff5" 43 "Mode4_SingleOff6" 44 "Mode4_SingleOff7" 45 "Mode4_SingleOff8" 46 "Mode4_SingleOff9" 47 "Mode4_SingleOff10" 48 "Mode4_SingleOff11" 49 "Mode4_SingleOff12";
VAL_ 99 DwnLoadDynLtgPrmForFrntRIGrp9Mode1 0 "Mode4_Off" 1 "Mode4_On" 2 "Mode4_GradualOn" 3 "Mode4_GradualOff" 4 "Mode4_ForwardWipingOn" 5 "Mode4_BackwardWipingOn" 6 "Mode4_OutwardWipingOn" 7 "Mode4_InwardWipingOn" 8 "Mode4_ForwardWipingOff" 9 "Mode4_BackwardWipingOff" 10 "Mode4_OutwardWipingOff" 11 "Mode4_InwardWipingOff" 12 "Mode4_ForwardScanning" 13 "Mode4_BackwardScanning" 14 "Mode4_BreathOn" 15 "Mode4_BreathOff" 16 "Mode4_1stHalfONand2ndHalfOFF" 17 "Mode4_HalfOFFHalfON" 18 "Mode4_HalfDimmingONHalfOFF" 19 "Mode4_HalfDimmingONHalfON" 20 "Mode4_HalfOFFHalfDimmingON" 21 "Mode4_HalfONHalfDimmingON" 22 "Mode4_HalfDimmingOFFHalfOFF" 23 "Mode4_HalfDimmingOFFHalfON" 24 "Mode4_HalfOFFHalfDimmingOFF" 25 "Mode4_HalfONHalfDimmingOFF" 26 "Mode4_SingleOn1" 27 "Mode4_SingleOn2" 28 "Mode4_SingleOn3" 29 "Mode4_SingleOn4" 30 "Mode4_SingleOn5" 31 "Mode4_SingleOn6" 32 "Mode4_SingleOn7" 33 "Mode4_SingleOn8" 34 "Mode4_SingleOn9" 35 "Mode4_SingleOn10" 36 "Mode4_SingleOn11" 37 "Mode4_SingleOn12" 38 "Mode4_SingleOff1" 39 "Mode4_SingleOff2" 40 "Mode4_SingleOff3" 41 "Mode4_SingleOff4" 42 "Mode4_SingleOff5" 43 "Mode4_SingleOff6" 44 "Mode4_SingleOff7" 45 "Mode4_SingleOff8" 46 "Mode4_SingleOff9" 47 "Mode4_SingleOff10" 48 "Mode4_SingleOff11" 49 "Mode4_SingleOff12";
VAL_ 99 TelmBookSeatHeatClimalReqDrvHeatClimaLvl 0 "TelmSeatClimaLvl_off" 1 "TelmSeatClimaLvl_Lvl1" 2 "TelmSeatClimaLvl_Lvl2" 3 "TelmSeatClimaLvl_Lvl3";
VAL_ 99 TelmBookSeatHeatClimalReqPassHeatClimaLvl 0 "TelmSeatClimaLvl_off" 1 "TelmSeatClimaLvl_Lvl1" 2 "TelmSeatClimaLvl_Lvl2" 3 "TelmSeatClimaLvl_Lvl3";
VAL_ 99 TelmBookSeatHeatClimalReqSecLeHeatClimaLvl 0 "TelmSeatClimaLvl_off" 1 "TelmSeatClimaLvl_Lvl1" 2 "TelmSeatClimaLvl_Lvl2" 3 "TelmSeatClimaLvl_Lvl3";
VAL_ 99 TelmBookSeatHeatClimalReqSecRiHeatClimaLvl 0 "TelmSeatClimaLvl_off" 1 "TelmSeatClimaLvl_Lvl1" 2 "TelmSeatClimaLvl_Lvl2" 3 "TelmSeatClimaLvl_Lvl3";
VAL_ 99 TelmBookSeatHeatClimalReqThrdLeHeatClimaLvl 0 "TelmSeatClimaLvl_off" 1 "TelmSeatClimaLvl_Lvl1" 2 "TelmSeatClimaLvl_Lvl2" 3 "TelmSeatClimaLvl_Lvl3";
VAL_ 99 TelmBookSeatHeatClimalReqThrdRiHeatClimaLvl 0 "TelmSeatClimaLvl_off" 1 "TelmSeatClimaLvl_Lvl1" 2 "TelmSeatClimaLvl_Lvl2" 3 "TelmSeatClimaLvl_Lvl3";
VAL_ 99 TelmBookSeatVentnClimalReqDrvVentnClimaLvl 0 "TelmSeatClimaLvl_off" 1 "TelmSeatClimaLvl_Lvl1" 2 "TelmSeatClimaLvl_Lvl2" 3 "TelmSeatClimaLvl_Lvl3";
VAL_ 99 TelmBookSeatVentnClimalReqPassVentnClimaLvl 0 "TelmSeatClimaLvl_off" 1 "TelmSeatClimaLvl_Lvl1" 2 "TelmSeatClimaLvl_Lvl2" 3 "TelmSeatClimaLvl_Lvl3";
VAL_ 99 TelmBookSeatVentnClimalReqSecLeVentnClimaLvl 0 "TelmSeatClimaLvl_off" 1 "TelmSeatClimaLvl_Lvl1" 2 "TelmSeatClimaLvl_Lvl2" 3 "TelmSeatClimaLvl_Lvl3";
VAL_ 99 TelmBookSeatVentnClimalReqSecRiVentnClimaLvl 0 "TelmSeatClimaLvl_off" 1 "TelmSeatClimaLvl_Lvl1" 2 "TelmSeatClimaLvl_Lvl2" 3 "TelmSeatClimaLvl_Lvl3";
VAL_ 99 TelmBookSeatVentnClimalReqThrdLeVentnClimaLvl 0 "TelmSeatClimaLvl_off" 1 "TelmSeatClimaLvl_Lvl1" 2 "TelmSeatClimaLvl_Lvl2" 3 "TelmSeatClimaLvl_Lvl3";
VAL_ 99 TelmBookSeatVentnClimalReqThrdRiVentnClimaL 0 "TelmSeatClimaLvl_off" 1 "TelmSeatClimaLvl_Lvl1" 2 "TelmSeatClimaLvl_Lvl2" 3 "TelmSeatClimaLvl_Lvl3";
VAL_ 99 TelmClimaTSetHmiCmptmtTSpSpcl 0 "HmiCmptmtTSpSpcl_Norm" 1 "HmiCmptmtTSpSpcl_Lo" 2 "HmiCmptmtTSpSpcl_Hi";
VAL_ 99 TelmStrtEngForChrgnReq 0 "ErsCmd_ErsCmdNotSet" 1 "ErsCmd_ErsCmdOn" 2 "ErsCmd_ErsCmdOff";
VAL_ 99 TimeOfcommCharn 0 "Boolean_FALSE" 1 "Boolean_TRUE";
VAL_ 103 DwnLoadDynLtgPrmForFrntRIGrp13Mode1 0 "Mode4_Off" 1 "Mode4_On" 2 "Mode4_GradualOn" 3 "Mode4_GradualOff" 4 "Mode4_ForwardWipingOn" 5 "Mode4_BackwardWipingOn" 6 "Mode4_OutwardWipingOn" 7 "Mode4_InwardWipingOn" 8 "Mode4_ForwardWipingOff" 9 "Mode4_BackwardWipingOff" 10 "Mode4_OutwardWipingOff" 11 "Mode4_InwardWipingOff" 12 "Mode4_ForwardScanning" 13 "Mode4_BackwardScanning" 14 "Mode4_BreathOn" 15 "Mode4_BreathOff" 16 "Mode4_1stHalfONand2ndHalfOFF" 17 "Mode4_HalfOFFHalfON" 18 "Mode4_HalfDimmingONHalfOFF" 19 "Mode4_HalfDimmingONHalfON" 20 "Mode4_HalfOFFHalfDimmingON" 21 "Mode4_HalfONHalfDimmingON" 22 "Mode4_HalfDimmingOFFHalfOFF" 23 "Mode4_HalfDimmingOFFHalfON" 24 "Mode4_HalfOFFHalfDimmingOFF" 25 "Mode4_HalfONHalfDimmingOFF" 26 "Mode4_SingleOn1" 27 "Mode4_SingleOn2" 28 "Mode4_SingleOn3" 29 "Mode4_SingleOn4" 30 "Mode4_SingleOn5" 31 "Mode4_SingleOn6" 32 "Mode4_SingleOn7" 33 "Mode4_SingleOn8" 34 "Mode4_SingleOn9" 35 "Mode4_SingleOn10" 36 "Mode4_SingleOn11" 37 "Mode4_SingleOn12" 38 "Mode4_SingleOff1" 39 "Mode4_SingleOff2" 40 "Mode4_SingleOff3" 41 "Mode4_SingleOff4" 42 "Mode4_SingleOff5" 43 "Mode4_SingleOff6" 44 "Mode4_SingleOff7" 45 "Mode4_SingleOff8" 46 "Mode4_SingleOff9" 47 "Mode4_SingleOff10" 48 "Mode4_SingleOff11" 49 "Mode4_SingleOff12";
VAL_ 103 DwnLoadDynLtgPrmForFrntRIGrp14Mode1 0 "Mode4_Off" 1 "Mode4_On" 2 "Mode4_GradualOn" 3 "Mode4_GradualOff" 4 "Mode4_ForwardWipingOn" 5 "Mode4_BackwardWipingOn" 6 "Mode4_OutwardWipingOn" 7 "Mode4_InwardWipingOn" 8 "Mode4_ForwardWipingOff" 9 "Mode4_BackwardWipingOff" 10 "Mode4_OutwardWipingOff" 11 "Mode4_InwardWipingOff" 12 "Mode4_ForwardScanning" 13 "Mode4_BackwardScanning" 14 "Mode4_BreathOn" 15 "Mode4_BreathOff" 16 "Mode4_1stHalfONand2ndHalfOFF" 17 "Mode4_HalfOFFHalfON" 18 "Mode4_HalfDimmingONHalfOFF" 19 "Mode4_HalfDimmingONHalfON" 20 "Mode4_HalfOFFHalfDimmingON" 21 "Mode4_HalfONHalfDimmingON" 22 "Mode4_HalfDimmingOFFHalfOFF" 23 "Mode4_HalfDimmingOFFHalfON" 24 "Mode4_HalfOFFHalfDimmingOFF" 25 "Mode4_HalfONHalfDimmingOFF" 26 "Mode4_SingleOn1" 27 "Mode4_SingleOn2" 28 "Mode4_SingleOn3" 29 "Mode4_SingleOn4" 30 "Mode4_SingleOn5" 31 "Mode4_SingleOn6" 32 "Mode4_SingleOn7" 33 "Mode4_SingleOn8" 34 "Mode4_SingleOn9" 35 "Mode4_SingleOn10" 36 "Mode4_SingleOn11" 37 "Mode4_SingleOn12" 38 "Mode4_SingleOff1" 39 "Mode4_SingleOff2" 40 "Mode4_SingleOff3" 41 "Mode4_SingleOff4" 42 "Mode4_SingleOff5" 43 "Mode4_SingleOff6" 44 "Mode4_SingleOff7" 45 "Mode4_SingleOff8" 46 "Mode4_SingleOff9" 47 "Mode4_SingleOff10" 48 "Mode4_SingleOff11" 49 "Mode4_SingleOff12";
VAL_ 103 DwnLoadDynLtgPrmForFrntRIGrp15Mode1 0 "Mode4_Off" 1 "Mode4_On" 2 "Mode4_GradualOn" 3 "Mode4_GradualOff" 4 "Mode4_ForwardWipingOn" 5 "Mode4_BackwardWipingOn" 6 "Mode4_OutwardWipingOn" 7 "Mode4_InwardWipingOn" 8 "Mode4_ForwardWipingOff" 9 "Mode4_BackwardWipingOff" 10 "Mode4_OutwardWipingOff" 11 "Mode4_InwardWipingOff" 12 "Mode4_ForwardScanning" 13 "Mode4_BackwardScanning" 14 "Mode4_BreathOn" 15 "Mode4_BreathOff" 16 "Mode4_1stHalfONand2ndHalfOFF" 17 "Mode4_HalfOFFHalfON" 18 "Mode4_HalfDimmingONHalfOFF" 19 "Mode4_HalfDimmingONHalfON" 20 "Mode4_HalfOFFHalfDimmingON" 21 "Mode4_HalfONHalfDimmingON" 22 "Mode4_HalfDimmingOFFHalfOFF" 23 "Mode4_HalfDimmingOFFHalfON" 24 "Mode4_HalfOFFHalfDimmingOFF" 25 "Mode4_HalfONHalfDimmingOFF" 26 "Mode4_SingleOn1" 27 "Mode4_SingleOn2" 28 "Mode4_SingleOn3" 29 "Mode4_SingleOn4" 30 "Mode4_SingleOn5" 31 "Mode4_SingleOn6" 32 "Mode4_SingleOn7" 33 "Mode4_SingleOn8" 34 "Mode4_SingleOn9" 35 "Mode4_SingleOn10" 36 "Mode4_SingleOn11" 37 "Mode4_SingleOn12" 38 "Mode4_SingleOff1" 39 "Mode4_SingleOff2" 40 "Mode4_SingleOff3" 41 "Mode4_SingleOff4" 42 "Mode4_SingleOff5" 43 "Mode4_SingleOff6" 44 "Mode4_SingleOff7" 45 "Mode4_SingleOff8" 46 "Mode4_SingleOff9" 47 "Mode4_SingleOff10" 48 "Mode4_SingleOff11" 49 "Mode4_SingleOff12";
VAL_ 103 DwnLoadDynLtgPrmForFrntRIGrp16Mode1 0 "Mode4_Off" 1 "Mode4_On" 2 "Mode4_GradualOn" 3 "Mode4_GradualOff" 4 "Mode4_ForwardWipingOn" 5 "Mode4_BackwardWipingOn" 6 "Mode4_OutwardWipingOn" 7 "Mode4_InwardWipingOn" 8 "Mode4_ForwardWipingOff" 9 "Mode4_BackwardWipingOff" 10 "Mode4_OutwardWipingOff" 11 "Mode4_InwardWipingOff" 12 "Mode4_ForwardScanning" 13 "Mode4_BackwardScanning" 14 "Mode4_BreathOn" 15 "Mode4_BreathOff" 16 "Mode4_1stHalfONand2ndHalfOFF" 17 "Mode4_HalfOFFHalfON" 18 "Mode4_HalfDimmingONHalfOFF" 19 "Mode4_HalfDimmingONHalfON" 20 "Mode4_HalfOFFHalfDimmingON" 21 "Mode4_HalfONHalfDimmingON" 22 "Mode4_HalfDimmingOFFHalfOFF" 23 "Mode4_HalfDimmingOFFHalfON" 24 "Mode4_HalfOFFHalfDimmingOFF" 25 "Mode4_HalfONHalfDimmingOFF" 26 "Mode4_SingleOn1" 27 "Mode4_SingleOn2" 28 "Mode4_SingleOn3" 29 "Mode4_SingleOn4" 30 "Mode4_SingleOn5" 31 "Mode4_SingleOn6" 32 "Mode4_SingleOn7" 33 "Mode4_SingleOn8" 34 "Mode4_SingleOn9" 35 "Mode4_SingleOn10" 36 "Mode4_SingleOn11" 37 "Mode4_SingleOn12" 38 "Mode4_SingleOff1" 39 "Mode4_SingleOff2" 40 "Mode4_SingleOff3" 41 "Mode4_SingleOff4" 42 "Mode4_SingleOff5" 43 "Mode4_SingleOff6" 44 "Mode4_SingleOff7" 45 "Mode4_SingleOff8" 46 "Mode4_SingleOff9" 47 "Mode4_SingleOff10" 48 "Mode4_SingleOff11" 49 "Mode4_SingleOff12";
VAL_ 103 DwnLoadDynLtgPrmForFrntRIGrp17Mode1 0 "Mode4_Off" 1 "Mode4_On" 2 "Mode4_GradualOn" 3 "Mode4_GradualOff" 4 "Mode4_ForwardWipingOn" 5 "Mode4_BackwardWipingOn" 6 "Mode4_OutwardWipingOn" 7 "Mode4_InwardWipingOn" 8 "Mode4_ForwardWipingOff" 9 "Mode4_BackwardWipingOff" 10 "Mode4_OutwardWipingOff" 11 "Mode4_InwardWipingOff" 12 "Mode4_ForwardScanning" 13 "Mode4_BackwardScanning" 14 "Mode4_BreathOn" 15 "Mode4_BreathOff" 16 "Mode4_1stHalfONand2ndHalfOFF" 17 "Mode4_HalfOFFHalfON" 18 "Mode4_HalfDimmingONHalfOFF" 19 "Mode4_HalfDimmingONHalfON" 20 "Mode4_HalfOFFHalfDimmingON" 21 "Mode4_HalfONHalfDimmingON" 22 "Mode4_HalfDimmingOFFHalfOFF" 23 "Mode4_HalfDimmingOFFHalfON" 24 "Mode4_HalfOFFHalfDimmingOFF" 25 "Mode4_HalfONHalfDimmingOFF" 26 "Mode4_SingleOn1" 27 "Mode4_SingleOn2" 28 "Mode4_SingleOn3" 29 "Mode4_SingleOn4" 30 "Mode4_SingleOn5" 31 "Mode4_SingleOn6" 32 "Mode4_SingleOn7" 33 "Mode4_SingleOn8" 34 "Mode4_SingleOn9" 35 "Mode4_SingleOn10" 36 "Mode4_SingleOn11" 37 "Mode4_SingleOn12" 38 "Mode4_SingleOff1" 39 "Mode4_SingleOff2" 40 "Mode4_SingleOff3" 41 "Mode4_SingleOff4" 42 "Mode4_SingleOff5" 43 "Mode4_SingleOff6" 44 "Mode4_SingleOff7" 45 "Mode4_SingleOff8" 46 "Mode4_SingleOff9" 47 "Mode4_SingleOff10" 48 "Mode4_SingleOff11" 49 "Mode4_SingleOff12";
VAL_ 103 DwnLoadDynLtgPrmForFrntRIGrp18Mode1 0 "Mode4_Off" 1 "Mode4_On" 2 "Mode4_GradualOn" 3 "Mode4_GradualOff" 4 "Mode4_ForwardWipingOn" 5 "Mode4_BackwardWipingOn" 6 "Mode4_OutwardWipingOn" 7 "Mode4_InwardWipingOn" 8 "Mode4_ForwardWipingOff" 9 "Mode4_BackwardWipingOff" 10 "Mode4_OutwardWipingOff" 11 "Mode4_InwardWipingOff" 12 "Mode4_ForwardScanning" 13 "Mode4_BackwardScanning" 14 "Mode4_BreathOn" 15 "Mode4_BreathOff" 16 "Mode4_1stHalfONand2ndHalfOFF" 17 "Mode4_HalfOFFHalfON" 18 "Mode4_HalfDimmingONHalfOFF" 19 "Mode4_HalfDimmingONHalfON" 20 "Mode4_HalfOFFHalfDimmingON" 21 "Mode4_HalfONHalfDimmingON" 22 "Mode4_HalfDimmingOFFHalfOFF" 23 "Mode4_HalfDimmingOFFHalfON" 24 "Mode4_HalfOFFHalfDimmingOFF" 25 "Mode4_HalfONHalfDimmingOFF" 26 "Mode4_SingleOn1" 27 "Mode4_SingleOn2" 28 "Mode4_SingleOn3" 29 "Mode4_SingleOn4" 30 "Mode4_SingleOn5" 31 "Mode4_SingleOn6" 32 "Mode4_SingleOn7" 33 "Mode4_SingleOn8" 34 "Mode4_SingleOn9" 35 "Mode4_SingleOn10" 36 "Mode4_SingleOn11" 37 "Mode4_SingleOn12" 38 "Mode4_SingleOff1" 39 "Mode4_SingleOff2" 40 "Mode4_SingleOff3" 41 "Mode4_SingleOff4" 42 "Mode4_SingleOff5" 43 "Mode4_SingleOff6" 44 "Mode4_SingleOff7" 45 "Mode4_SingleOff8" 46 "Mode4_SingleOff9" 47 "Mode4_SingleOff10" 48 "Mode4_SingleOff11" 49 "Mode4_SingleOff12";
VAL_ 103 DwnLoadDynLtgPrmForFrntRIGrp19Mode1 0 "Mode4_Off" 1 "Mode4_On" 2 "Mode4_GradualOn" 3 "Mode4_GradualOff" 4 "Mode4_ForwardWipingOn" 5 "Mode4_BackwardWipingOn" 6 "Mode4_OutwardWipingOn" 7 "Mode4_InwardWipingOn" 8 "Mode4_ForwardWipingOff" 9 "Mode4_BackwardWipingOff" 10 "Mode4_OutwardWipingOff" 11 "Mode4_InwardWipingOff" 12 "Mode4_ForwardScanning" 13 "Mode4_BackwardScanning" 14 "Mode4_BreathOn" 15 "Mode4_BreathOff" 16 "Mode4_1stHalfONand2ndHalfOFF" 17 "Mode4_HalfOFFHalfON" 18 "Mode4_HalfDimmingONHalfOFF" 19 "Mode4_HalfDimmingONHalfON" 20 "Mode4_HalfOFFHalfDimmingON" 21 "Mode4_HalfONHalfDimmingON" 22 "Mode4_HalfDimmingOFFHalfOFF" 23 "Mode4_HalfDimmingOFFHalfON" 24 "Mode4_HalfOFFHalfDimmingOFF" 25 "Mode4_HalfONHalfDimmingOFF" 26 "Mode4_SingleOn1" 27 "Mode4_SingleOn2" 28 "Mode4_SingleOn3" 29 "Mode4_SingleOn4" 30 "Mode4_SingleOn5" 31 "Mode4_SingleOn6" 32 "Mode4_SingleOn7" 33 "Mode4_SingleOn8" 34 "Mode4_SingleOn9" 35 "Mode4_SingleOn10" 36 "Mode4_SingleOn11" 37 "Mode4_SingleOn12" 38 "Mode4_SingleOff1" 39 "Mode4_SingleOff2" 40 "Mode4_SingleOff3" 41 "Mode4_SingleOff4" 42 "Mode4_SingleOff5" 43 "Mode4_SingleOff6" 44 "Mode4_SingleOff7" 45 "Mode4_SingleOff8" 46 "Mode4_SingleOff9" 47 "Mode4_SingleOff10" 48 "Mode4_SingleOff11" 49 "Mode4_SingleOff12";
VAL_ 103 DwnLoadDynLtgPrmForFrntRIGrp20Mode1 0 "Mode4_Off" 1 "Mode4_On" 2 "Mode4_GradualOn" 3 "Mode4_GradualOff" 4 "Mode4_ForwardWipingOn" 5 "Mode4_BackwardWipingOn" 6 "Mode4_OutwardWipingOn" 7 "Mode4_InwardWipingOn" 8 "Mode4_ForwardWipingOff" 9 "Mode4_BackwardWipingOff" 10 "Mode4_OutwardWipingOff" 11 "Mode4_InwardWipingOff" 12 "Mode4_ForwardScanning" 13 "Mode4_BackwardScanning" 14 "Mode4_BreathOn" 15 "Mode4_BreathOff" 16 "Mode4_1stHalfONand2ndHalfOFF" 17 "Mode4_HalfOFFHalfON" 18 "Mode4_HalfDimmingONHalfOFF" 19 "Mode4_HalfDimmingONHalfON" 20 "Mode4_HalfOFFHalfDimmingON" 21 "Mode4_HalfONHalfDimmingON" 22 "Mode4_HalfDimmingOFFHalfOFF" 23 "Mode4_HalfDimmingOFFHalfON" 24 "Mode4_HalfOFFHalfDimmingOFF" 25 "Mode4_HalfONHalfDimmingOFF" 26 "Mode4_SingleOn1" 27 "Mode4_SingleOn2" 28 "Mode4_SingleOn3" 29 "Mode4_SingleOn4" 30 "Mode4_SingleOn5" 31 "Mode4_SingleOn6" 32 "Mode4_SingleOn7" 33 "Mode4_SingleOn8" 34 "Mode4_SingleOn9" 35 "Mode4_SingleOn10" 36 "Mode4_SingleOn11" 37 "Mode4_SingleOn12" 38 "Mode4_SingleOff1" 39 "Mode4_SingleOff2" 40 "Mode4_SingleOff3" 41 "Mode4_SingleOff4" 42 "Mode4_SingleOff5" 43 "Mode4_SingleOff6" 44 "Mode4_SingleOff7" 45 "Mode4_SingleOff8" 46 "Mode4_SingleOff9" 47 "Mode4_SingleOff10" 48 "Mode4_SingleOff11" 49 "Mode4_SingleOff12";
VAL_ 103 DwnLoadDynLtgPrmForFrntRIGrp21Mode1 0 "Mode4_Off" 1 "Mode4_On" 2 "Mode4_GradualOn" 3 "Mode4_GradualOff" 4 "Mode4_ForwardWipingOn" 5 "Mode4_BackwardWipingOn" 6 "Mode4_OutwardWipingOn" 7 "Mode4_InwardWipingOn" 8 "Mode4_ForwardWipingOff" 9 "Mode4_BackwardWipingOff" 10 "Mode4_OutwardWipingOff" 11 "Mode4_InwardWipingOff" 12 "Mode4_ForwardScanning" 13 "Mode4_BackwardScanning" 14 "Mode4_BreathOn" 15 "Mode4_BreathOff" 16 "Mode4_1stHalfONand2ndHalfOFF" 17 "Mode4_HalfOFFHalfON" 18 "Mode4_HalfDimmingONHalfOFF" 19 "Mode4_HalfDimmingONHalfON" 20 "Mode4_HalfOFFHalfDimmingON" 21 "Mode4_HalfONHalfDimmingON" 22 "Mode4_HalfDimmingOFFHalfOFF" 23 "Mode4_HalfDimmingOFFHalfON" 24 "Mode4_HalfOFFHalfDimmingOFF" 25 "Mode4_HalfONHalfDimmingOFF" 26 "Mode4_SingleOn1" 27 "Mode4_SingleOn2" 28 "Mode4_SingleOn3" 29 "Mode4_SingleOn4" 30 "Mode4_SingleOn5" 31 "Mode4_SingleOn6" 32 "Mode4_SingleOn7" 33 "Mode4_SingleOn8" 34 "Mode4_SingleOn9" 35 "Mode4_SingleOn10" 36 "Mode4_SingleOn11" 37 "Mode4_SingleOn12" 38 "Mode4_SingleOff1" 39 "Mode4_SingleOff2" 40 "Mode4_SingleOff3" 41 "Mode4_SingleOff4" 42 "Mode4_SingleOff5" 43 "Mode4_SingleOff6" 44 "Mode4_SingleOff7" 45 "Mode4_SingleOff8" 46 "Mode4_SingleOff9" 47 "Mode4_SingleOff10" 48 "Mode4_SingleOff11" 49 "Mode4_SingleOff12";
VAL_ 103 DwnLoadDynLtgPrmForFrntRIGrp22Mode1 0 "Mode4_Off" 1 "Mode4_On" 2 "Mode4_GradualOn" 3 "Mode4_GradualOff" 4 "Mode4_ForwardWipingOn" 5 "Mode4_BackwardWipingOn" 6 "Mode4_OutwardWipingOn" 7 "Mode4_InwardWipingOn" 8 "Mode4_ForwardWipingOff" 9 "Mode4_BackwardWipingOff" 10 "Mode4_OutwardWipingOff" 11 "Mode4_InwardWipingOff" 12 "Mode4_ForwardScanning" 13 "Mode4_BackwardScanning" 14 "Mode4_BreathOn" 15 "Mode4_BreathOff" 16 "Mode4_1stHalfONand2ndHalfOFF" 17 "Mode4_HalfOFFHalfON" 18 "Mode4_HalfDimmingONHalfOFF" 19 "Mode4_HalfDimmingONHalfON" 20 "Mode4_HalfOFFHalfDimmingON" 21 "Mode4_HalfONHalfDimmingON" 22 "Mode4_HalfDimmingOFFHalfOFF" 23 "Mode4_HalfDimmingOFFHalfON" 24 "Mode4_HalfOFFHalfDimmingOFF" 25 "Mode4_HalfONHalfDimmingOFF" 26 "Mode4_SingleOn1" 27 "Mode4_SingleOn2" 28 "Mode4_SingleOn3" 29 "Mode4_SingleOn4" 30 "Mode4_SingleOn5" 31 "Mode4_SingleOn6" 32 "Mode4_SingleOn7" 33 "Mode4_SingleOn8" 34 "Mode4_SingleOn9" 35 "Mode4_SingleOn10" 36 "Mode4_SingleOn11" 37 "Mode4_SingleOn12" 38 "Mode4_SingleOff1" 39 "Mode4_SingleOff2" 40 "Mode4_SingleOff3" 41 "Mode4_SingleOff4" 42 "Mode4_SingleOff5" 43 "Mode4_SingleOff6" 44 "Mode4_SingleOff7" 45 "Mode4_SingleOff8" 46 "Mode4_SingleOff9" 47 "Mode4_SingleOff10" 48 "Mode4_SingleOff11" 49 "Mode4_SingleOff12";
VAL_ 103 DwnLoadDynLtgPrmForFrntRIGrp23Mode1 0 "Mode4_Off" 1 "Mode4_On" 2 "Mode4_GradualOn" 3 "Mode4_GradualOff" 4 "Mode4_ForwardWipingOn" 5 "Mode4_BackwardWipingOn" 6 "Mode4_OutwardWipingOn" 7 "Mode4_InwardWipingOn" 8 "Mode4_ForwardWipingOff" 9 "Mode4_BackwardWipingOff" 10 "Mode4_OutwardWipingOff" 11 "Mode4_InwardWipingOff" 12 "Mode4_ForwardScanning" 13 "Mode4_BackwardScanning" 14 "Mode4_BreathOn" 15 "Mode4_BreathOff" 16 "Mode4_1stHalfONand2ndHalfOFF" 17 "Mode4_HalfOFFHalfON" 18 "Mode4_HalfDimmingONHalfOFF" 19 "Mode4_HalfDimmingONHalfON" 20 "Mode4_HalfOFFHalfDimmingON" 21 "Mode4_HalfONHalfDimmingON" 22 "Mode4_HalfDimmingOFFHalfOFF" 23 "Mode4_HalfDimmingOFFHalfON" 24 "Mode4_HalfOFFHalfDimmingOFF" 25 "Mode4_HalfONHalfDimmingOFF" 26 "Mode4_SingleOn1" 27 "Mode4_SingleOn2" 28 "Mode4_SingleOn3" 29 "Mode4_SingleOn4" 30 "Mode4_SingleOn5" 31 "Mode4_SingleOn6" 32 "Mode4_SingleOn7" 33 "Mode4_SingleOn8" 34 "Mode4_SingleOn9" 35 "Mode4_SingleOn10" 36 "Mode4_SingleOn11" 37 "Mode4_SingleOn12" 38 "Mode4_SingleOff1" 39 "Mode4_SingleOff2" 40 "Mode4_SingleOff3" 41 "Mode4_SingleOff4" 42 "Mode4_SingleOff5" 43 "Mode4_SingleOff6" 44 "Mode4_SingleOff7" 45 "Mode4_SingleOff8" 46 "Mode4_SingleOff9" 47 "Mode4_SingleOff10" 48 "Mode4_SingleOff11" 49 "Mode4_SingleOff12";
VAL_ 103 DwnLoadDynLtgPrmForFrntRIGrp24Mode1 0 "Mode4_Off" 1 "Mode4_On" 2 "Mode4_GradualOn" 3 "Mode4_GradualOff" 4 "Mode4_ForwardWipingOn" 5 "Mode4_BackwardWipingOn" 6 "Mode4_OutwardWipingOn" 7 "Mode4_InwardWipingOn" 8 "Mode4_ForwardWipingOff" 9 "Mode4_BackwardWipingOff" 10 "Mode4_OutwardWipingOff" 11 "Mode4_InwardWipingOff" 12 "Mode4_ForwardScanning" 13 "Mode4_BackwardScanning" 14 "Mode4_BreathOn" 15 "Mode4_BreathOff" 16 "Mode4_1stHalfONand2ndHalfOFF" 17 "Mode4_HalfOFFHalfON" 18 "Mode4_HalfDimmingONHalfOFF" 19 "Mode4_HalfDimmingONHalfON" 20 "Mode4_HalfOFFHalfDimmingON" 21 "Mode4_HalfONHalfDimmingON" 22 "Mode4_HalfDimmingOFFHalfOFF" 23 "Mode4_HalfDimmingOFFHalfON" 24 "Mode4_HalfOFFHalfDimmingOFF" 25 "Mode4_HalfONHalfDimmingOFF" 26 "Mode4_SingleOn1" 27 "Mode4_SingleOn2" 28 "Mode4_SingleOn3" 29 "Mode4_SingleOn4" 30 "Mode4_SingleOn5" 31 "Mode4_SingleOn6" 32 "Mode4_SingleOn7" 33 "Mode4_SingleOn8" 34 "Mode4_SingleOn9" 35 "Mode4_SingleOn10" 36 "Mode4_SingleOn11" 37 "Mode4_SingleOn12" 38 "Mode4_SingleOff1" 39 "Mode4_SingleOff2" 40 "Mode4_SingleOff3" 41 "Mode4_SingleOff4" 42 "Mode4_SingleOff5" 43 "Mode4_SingleOff6" 44 "Mode4_SingleOff7" 45 "Mode4_SingleOff8" 46 "Mode4_SingleOff9" 47 "Mode4_SingleOff10" 48 "Mode4_SingleOff11" 49 "Mode4_SingleOff12";
VAL_ 103 TelmBookClimaReqHmiCmptmtTSpSpcl 0 "NormalLowHigh_Normal" 1 "NormalLowHigh_Low" 2 "NormalLowHigh_High";
VAL_ 103 TelmBookClimaReqOnOffNoReq 0 "NoReqOnOff_Norequest" 1 "NoReqOnOff_On" 2 "NoReqOnOff_Off";
VAL_ 103 WinOpenClsGlbReqFromTelmWinOpenClsGlbSts 0 "WinOpenClsGlbReqFromTelm_Idle" 1 "WinOpenClsGlbReqFromTelm_Open" 2 "WinOpenClsGlbReqFromTelm_Close";
VAL_ 560 BevPwrCtrl 0 "Boolean_FALSE" 1 "Boolean_TRUE";
VAL_ 560 CopilotSeatOccupySts 0 "ActvnAvl3_Idle" 1 "ActvnAvl3_Actvn" 2 "ActvnAvl3_Deactvn";
VAL_ 560 DrvSeatOccupySts 0 "ActvnAvl3_Idle" 1 "ActvnAvl3_Actvn" 2 "ActvnAvl3_Deactvn";
VAL_ 560 HMIAirCdnrAutDrySet 0 "OnOff1_Off" 1 "OnOff1_On";
VAL_ 560 HmiPM25PopUpSet 0 "OnOff1_Off" 1 "OnOff1_On";
VAL_ 560 SteerSetgPen 0 "IdPen_ProfUkwn" 1 "IdPen_Prof1" 2 "IdPen_Prof2" 3 "IdPen_Prof3" 4 "IdPen_Prof4" 5 "IdPen_Prof5" 6 "IdPen_Prof6" 7 "IdPen_Prof7" 8 "IdPen_Prof8" 9 "IdPen_Prof9" 10 "IdPen_Prof10" 11 "IdPen_Prof11" 12 "IdPen_Prof12" 13 "IdPen_Prof13" 14 "IdPen_Resd14" 15 "IdPen_ProfAll";
VAL_ 560 SteerSetgSteerAsscLvl 0 "SteerAsscLvl_Ukwn" 1 "SteerAsscLvl_Lvl1" 2 "SteerAsscLvl_Lvl2" 3 "SteerAsscLvl_Lvl3" 4 "SteerAsscLvl_Lvl4" 5 "SteerAsscLvl_Resd5" 6 "SteerAsscLvl_Resd6" 7 "SteerAsscLvl_Resd7";
VAL_ 560 SteerSetgSteerMod 0 "SteerMod_Ukwn" 1 "SteerMod_Mod1" 2 "SteerMod_Mod2" 3 "SteerMod_Mod3" 4 "SteerMod_Mod4" 5 "SteerMod_Resd5" 6 "SteerMod_Resd6" 7 "SteerMod_Resd7";
VAL_ 560 WiprReAutReq 0 "OnOff1_Off" 1 "OnOff1_On";
VAL_ 368 AutEgyRgnLvlSet 0 "EgyRgnLvlAct_Low" 1 "EgyRgnLvlAct_Mid" 2 "EgyRgnLvlAct_High" 3 "EgyRgnLvlAct_Reserved1" 4 "EgyRgnLvlAct_Reserved2" 5 "EgyRgnLvlAct_Auto" 6 "EgyRgnLvlAct_Off" 7 "EgyRgnLvlAct_NoReq";
VAL_ 368 AutElecStepCtrlSwtStsDriver 0 "OnOff1_Off" 1 "OnOff1_On";
VAL_ 368 AutElecStepCtrlSwtStsPassenger 0 "OnOff1_Off" 1 "OnOff1_On";
VAL_ 368 AutoClsLockdFctEnaRADAR 0 "OnOff1_Off" 1 "OnOff1_On";
VAL_ 368 AutoClsRainFctEnaRADAR 0 "OnOff1_Off" 1 "OnOff1_On";
VAL_ 368 BLEKeyExtLoUOutIPwrSplyCtrlZone1 0 "Swt1_Idle" 1 "Swt1_ON" 2 "Swt1_Off" 3 "Swt1_NotUsed";
VAL_ 368 BLEKeyExtLoUOutIPwrSplyCtrlZone2 0 "Swt1_Idle" 1 "Swt1_ON" 2 "Swt1_Off" 3 "Swt1_NotUsed";
VAL_ 368 BLEKeyExtLoUOutIPwrSplyCtrlZone3 0 "Swt1_Idle" 1 "Swt1_ON" 2 "Swt1_Off" 3 "Swt1_NotUsed";
VAL_ 368 BLEKeyExtLoUOutIPwrSplyCtrlZone4 0 "Swt1_Idle" 1 "Swt1_ON" 2 "Swt1_Off" 3 "Swt1_NotUsed";
VAL_ 368 BLEKeyExtLoUOutIPwrSplyCtrlZone5 0 "Swt1_Idle" 1 "Swt1_ON" 2 "Swt1_Off" 3 "Swt1_NotUsed";
VAL_ 368 BLEKeyExtLoUOutIPwrSplyCtrlZone6 0 "Swt1_Idle" 1 "Swt1_ON" 2 "Swt1_Off" 3 "Swt1_NotUsed";
VAL_ 368 DrvrSeatCmftReq 0 "TarPosnCmd_Idle" 1 "TarPosnCmd_MoveReq" 2 "TarPosnCmd_StopReq" 3 "TarPosnCmd_MemPosnSet" 4 "TarPosnCmd_MemPosnClr";
VAL_ 368 DrvrSeatReturnReq 0 "TarPosnCmd1_Idle" 1 "TarPosnCmd1_MoveReq" 2 "TarPosnCmd1_StopReq";
VAL_ 368 ElecStepReq 0 "OnOffNoReq_NoReq" 1 "OnOffNoReq_On" 2 "OnOffNoReq_Off";
VAL_ 368 FaceRecognitionIndcrFromDHU 0 "OnOff1_Off" 1 "OnOff1_On";
VAL_ 368 FrntSunCurtCtrlReq 0 "OnOffNoReq_NoReq" 1 "OnOffNoReq_On" 2 "OnOffNoReq_Off";
VAL_ 368 FrntSunCurtIninSwt 0 "PsdNotPsd1_NotPsd" 1 "PsdNotPsd1_Psd";
VAL_ 368 FrntSunCurtOpenPosnReq 0 "WinAndRoofAndCurtPosnTyp_PosnUkwn" 1 "WinAndRoofAndCurtPosnTyp_ClsFull" 2 "WinAndRoofAndCurtPosnTyp_PercOpen4" 3 "WinAndRoofAndCurtPosnTyp_PercOpen8" 4 "WinAndRoofAndCurtPosnTyp_PercOpen12" 5 "WinAndRoofAndCurtPosnTyp_PercOpen16" 6 "WinAndRoofAndCurtPosnTyp_PercOpen20" 7 "WinAndRoofAndCurtPosnTyp_PercOpen24" 8 "WinAndRoofAndCurtPosnTyp_PercOpen28" 9 "WinAndRoofAndCurtPosnTyp_PercOpen32" 10 "WinAndRoofAndCurtPosnTyp_PercOpen36" 11 "WinAndRoofAndCurtPosnTyp_PercOpen40" 12 "WinAndRoofAndCurtPosnTyp_PercOpen44" 13 "WinAndRoofAndCurtPosnTyp_PercOpen48" 14 "WinAndRoofAndCurtPosnTyp_PercOpen52" 15 "WinAndRoofAndCurtPosnTyp_PercOpen56" 16 "WinAndRoofAndCurtPosnTyp_PercOpen60" 17 "WinAndRoofAndCurtPosnTyp_PercOpen64" 18 "WinAndRoofAndCurtPosnTyp_PercOpen68" 19 "WinAndRoofAndCurtPosnTyp_PercOpen72" 20 "WinAndRoofAndCurtPosnTyp_PercOpen76" 21 "WinAndRoofAndCurtPosnTyp_PercOpen80" 22 "WinAndRoofAndCurtPosnTyp_PercOpen84" 23 "WinAndRoofAndCurtPosnTyp_PercOpen88" 24 "WinAndRoofAndCurtPosnTyp_PercOpen92" 25 "WinAndRoofAndCurtPosnTyp_PercOpen96" 26 "WinAndRoofAndCurtPosnTyp_OpenFull" 27 "WinAndRoofAndCurtPosnTyp_Resd1" 28 "WinAndRoofAndCurtPosnTyp_Resd2" 29 "WinAndRoofAndCurtPosnTyp_Resd3" 30 "WinAndRoofAndCurtPosnTyp_Resd4" 31 "WinAndRoofAndCurtPosnTyp_Movg";
VAL_ 368 GestureDetn 0 "Detn10_Unknown" 1 "Detn10_OpenSunroof" 2 "Detn10_closeSunroof" 3 "Detn10_LiUpFrntPassReadLamp" 4 "Detn10_TurnOffFrntPassReadLamp" 5 "Detn10_LstOne_AnswerPhone" 6 "Detn10_NexOnet_RfusePhone" 7 "Detn10_VolUp" 8 "Detn10_VolDwn" 9 "Detn10_MapZoom" 10 "Detn10_GlbPreview";
VAL_ 368 HmiSeatVentAutStrtRowThrdLe 0 "OnOff1_Off" 1 "OnOff1_On";
VAL_ 368 HmiSeatVentAutStrtRowThrdRi 0 "OnOff1_Off" 1 "OnOff1_On";
VAL_ 368 IceBreakModEnaRADAR 0 "OnOff1_Off" 1 "OnOff1_On";
VAL_ 368 LnchModSwt 0 "OnOffNoReq_NoReq" 1 "OnOffNoReq_On" 2 "OnOffNoReq_Off";
VAL_ 368 LvlgSwtSetReqLvlgSwtSetReq 0 "LvlgSwtSetReq_Level0" 1 "LvlgSwtSetReq_Level1" 2 "LvlgSwtSetReq_Level2" 3 "LvlgSwtSetReq_Level3" 4 "LvlgSwtSetReq_Level4" 5 "LvlgSwtSetReq_Level5";
VAL_ 368 PassSeatCmftReq 0 "TarPosnCmd_Idle" 1 "TarPosnCmd_MoveReq" 2 "TarPosnCmd_StopReq" 3 "TarPosnCmd_MemPosnSet" 4 "TarPosnCmd_MemPosnClr";
VAL_ 368 PassSeatReturnReq 0 "TarPosnCmd1_Idle" 1 "TarPosnCmd1_MoveReq" 2 "TarPosnCmd1_StopReq";
VAL_ 368 PrpsnMaxEvMod 0 "OnOff1_Off" 1 "OnOff1_On";
VAL_ 368 RainSnsrSnvtyHMIReq 0 "WipgSpdIntlFromHmi_Posn0" 1 "WipgSpdIntlFromHmi_Posn1" 2 "WipgSpdIntlFromHmi_Posn2" 3 "WipgSpdIntlFromHmi_Posn3" 4 "WipgSpdIntlFromHmi_Posn4" 5 "WipgSpdIntlFromHmi_Posn5" 6 "WipgSpdIntlFromHmi_Posn6" 7 "WipgSpdIntlFromHmi_Posn7";
VAL_ 368 RCcontrolForDCchargeLid 0 "PsdNotPsd1_NotPsd" 1 "PsdNotPsd1_Psd";
VAL_ 368 RelsEnaSwt 0 "OnOff1_Off" 1 "OnOff1_On";
VAL_ 368 ReSunCurtCtrlReq 0 "OnOffNoReq_NoReq" 1 "OnOffNoReq_On" 2 "OnOffNoReq_Off";
VAL_ 368 ReSunCurtIninSwt 0 "PsdNotPsd1_NotPsd" 1 "PsdNotPsd1_Psd";
VAL_ 368 SecLeSeatTarPosnCmdReqTarPosnCmd1 0 "TarPosnCmd1_Idle" 1 "TarPosnCmd1_MoveReq" 2 "TarPosnCmd1_StopReq";
VAL_ 368 SecRiSeatTarPosnCmdReqTarPosnCmd1 0 "TarPosnCmd1_Idle" 1 "TarPosnCmd1_MoveReq" 2 "TarPosnCmd1_StopReq";
VAL_ 368 SecRowLeSeatCmftReq 0 "TarPosnCmd_Idle" 1 "TarPosnCmd_MoveReq" 2 "TarPosnCmd_StopReq" 3 "TarPosnCmd_MemPosnSet" 4 "TarPosnCmd_MemPosnClr";
VAL_ 368 SecRowLeSeatFoldRaiseReq 0 "SeatFoldRaiseReq_Idle" 1 "SeatFoldRaiseReq_Fold" 2 "SeatFoldRaiseReq_Raise" 3 "SeatFoldRaiseReq_Stop";
VAL_ 368 SecRowLeSeatHeiAdjmt 0 "SwtVertSts1_Idle" 1 "SwtVertSts1_Up" 2 "SwtVertSts1_Dwn";
VAL_ 368 SecRowLeSeatReturnReq 0 "TarPosnCmd1_Idle" 1 "TarPosnCmd1_MoveReq" 2 "TarPosnCmd1_StopReq";
VAL_ 368 SecRowRiSeatCmftReq 0 "TarPosnCmd_Idle" 1 "TarPosnCmd_MoveReq" 2 "TarPosnCmd_StopReq" 3 "TarPosnCmd_MemPosnSet" 4 "TarPosnCmd_MemPosnClr";
VAL_ 368 SecRowRiSeatFoldRaiseReq 0 "SeatFoldRaiseReq_Idle" 1 "SeatFoldRaiseReq_Fold" 2 "SeatFoldRaiseReq_Raise" 3 "SeatFoldRaiseReq_Stop";
VAL_ 368 SecRowRiSeatHeiAdjmt 0 "SwtVertSts1_Idle" 1 "SwtVertSts1_Up" 2 "SwtVertSts1_Dwn";
VAL_ 368 SecRowRiSeatReturnReq 0 "TarPosnCmd1_Idle" 1 "TarPosnCmd1_MoveReq" 2 "TarPosnCmd1_StopReq";
VAL_ 368 SecRowSeatInhbByMod 0 "ParkAssiLeRi1_None" 1 "ParkAssiLeRi1_Left" 2 "ParkAssiLeRi1_Right" 3 "ParkAssiLeRi1_LeftAndRight";
VAL_ 368 ThrdLeSeatTarPosnCmdReqTarPosnCmd1 0 "TarPosnCmd1_Idle" 1 "TarPosnCmd1_MoveReq" 2 "TarPosnCmd1_StopReq";
VAL_ 368 ThrdRiSeatTarPosnCmdReqTarPosnCmd1 0 "TarPosnCmd1_Idle" 1 "TarPosnCmd1_MoveReq" 2 "TarPosnCmd1_StopReq";
VAL_ 368 ThrdRowSeatInhbByMod 0 "ParkAssiLeRi1_None" 1 "ParkAssiLeRi1_Left" 2 "ParkAssiLeRi1_Right" 3 "ParkAssiLeRi1_LeftAndRight";
VAL_ 368 UpperLowerTrSelnSwt 0 "HmiLiSetReq_Single" 1 "HmiLiSetReq_Multiple";
VAL_ 259 ACEIDLightReqFromBLE 0 "ReqSts1_NotReqd" 1 "ReqSts1_Reqd";
VAL_ 259 ConfCurrSpd 0 "ConfPath_init" 1 "ConfPath_valid" 2 "ConfPath_invalid" 3 "ConfPath_reserved";
VAL_ 259 ConfPath 0 "ConfPath_init" 1 "ConfPath_valid" 2 "ConfPath_invalid" 3 "ConfPath_reserved";
VAL_ 259 DCEIDLightReqFromBLE 0 "ReqSts1_NotReqd" 1 "ReqSts1_Reqd";
VAL_ 259 DchrgnInSwtCtrl 0 "OnOffNoReq_NoReq" 1 "OnOffNoReq_On" 2 "OnOffNoReq_Off";
VAL_ 259 EPedlModCtrlSt 0 "OnOff1_Off" 1 "OnOff1_On";
VAL_ 259 ESCLvlSwt 0 "DrvrPfmncLvl2_Ukwn" 1 "DrvrPfmncLvl2_DrvrLvl1" 2 "DrvrPfmncLvl2_DrvrLvl2" 3 "DrvrPfmncLvl2_DrvrLvl3" 4 "DrvrPfmncLvl2_DrvrLvl4" 5 "DrvrPfmncLvl2_DrvrLvl5";
VAL_ 259 HmiMaxEvMod 0 "OnOff1_Off" 1 "OnOff1_On";
VAL_ 259 HMIThermoTankChdLock 0 "OnOff1_Off" 1 "OnOff1_On";
VAL_ 259 HMIThermoTankDlyCls 0 "OnOff1_Off" 1 "OnOff1_On";
VAL_ 259 HMIThermoTankDoorOpen 0 "OnOffNoReq_NoReq" 1 "OnOffNoReq_On" 2 "OnOffNoReq_Off";
VAL_ 259 HMIThermoTankSwtReq 0 "Req_NoReq" 1 "Req_off" 2 "Req_Coolg" 3 "Req_Heatlg";
VAL_ 259 HornWarnReq 0 "OnOff1_Off" 1 "OnOff1_On";
VAL_ 259 HvBattMntnReq 0 "HvBattMntnReq_Default" 1 "HvBattMntnReq_DchaReq" 2 "HvBattMntnReq_SlpReq" 3 "HvBattMntnReq_ChrgReq";
VAL_ 259 IAMSMod 0 "OnOff1_Off" 1 "OnOff1_On";
VAL_ 259 KickTailgateSig 0 "Boolean_FALSE" 1 "Boolean_TRUE";
VAL_ 259 LiFlashWarnReq 0 "OnOff1_Off" 1 "OnOff1_On";
VAL_ 259 LvngCratuDetdSts 0 "Detected_Unknown" 1 "Detected_Undetected" 2 "Detected_Detected" 3 "Detected_Reserved";
VAL_ 259 MirrTarPosnCmdReqTarPosnCmd1 0 "TarPosnCmd1_Idle" 1 "TarPosnCmd1_MoveReq" 2 "TarPosnCmd1_StopReq";
VAL_ 259 PasEntryEnaReq1 0 "OnOff1_Off" 1 "OnOff1_On";
VAL_ 259 PtModReq 0 "PtModReqEV_NoRequest" 1 "PtModReqEV_EVmode" 2 "PtModReqEV_HEVmode" 3 "PtModReqEV_EV_PlusMode";
VAL_ 259 ReBuctMonSts 0 "SysSts3_Invalid" 1 "SysSts3_Sleep" 2 "SysSts3_Standby" 3 "SysSts3_Active" 4 "SysSts3_Failure" 5 "SysSts3_SelfInspection" 6 "SysSts3_Reserved1" 7 "SysSts3_Reserved2";
VAL_ 259 RemHvStrtActvReq 0 "OnOffNoReq_NoReq" 1 "OnOffNoReq_On" 2 "OnOffNoReq_Off";
VAL_ 259 RoadCondLvl 0 "RoadCondLvl_Invalid" 1 "RoadCondLvl_light" 2 "RoadCondLvl_slightly_heavy" 3 "RoadCondLvl_very_heay" 4 "RoadCondLvl_extremly_heavy";
VAL_ 259 StealthLiSwtSts 0 "OnOff1_Off" 1 "OnOff1_On";
VAL_ 259 StsOfFLWelGby 0 "OnOff1_Off" 1 "OnOff1_On";
VAL_ 259 StsOfFRWelGby 0 "OnOff1_Off" 1 "OnOff1_On";
VAL_ 259 StsOfRICLWelGby 0 "OnOff1_Off" 1 "OnOff1_On";
VAL_ 259 StsOfRICRWelGby 0 "OnOff1_Off" 1 "OnOff1_On";
VAL_ 259 StsOfRILLWelGby 0 "OnOff1_Off" 1 "OnOff1_On";
VAL_ 259 StsOfRILRWelGby 0 "OnOff1_Off" 1 "OnOff1_On";
VAL_ 259 WadeProtnSwtReq 0 "PsdNotPsd_NotPsd" 1 "PsdNotPsd_Psd";
VAL_ 259 WinOpenLDACReq 0 "OnOff1_Off" 1 "OnOff1_On";
VAL_ 624 DeactvtLvlgCtrl 0 "Boolean_FALSE" 1 "Boolean_TRUE";
VAL_ 624 MmedHdPwrMod 0 "MmedMaiPwrMod_IHUStateSleep" 1 "MmedMaiPwrMod_IHUStateStandby" 2 "MmedMaiPwrMod_IHUStatePartial" 3 "MmedMaiPwrMod_IHUStateOn";
VAL_ 624 MobDevBtnPanicReq 0 "OnOffNoReq_NoReq" 1 "OnOffNoReq_On" 2 "OnOffNoReq_Off";
VAL_ 624 OIDIFctSts 0 "OnOff1_Off" 1 "OnOff1_On";
VAL_ 624 RMLCmftFctReq 0 "OnOff1_Off" 1 "OnOff1_On";
VAL_ 624 RMRCmftFctReq 0 "OnOff1_Off" 1 "OnOff1_On";
VAL_ 80 CnclBookTrvlReq 0 "ReqSts1_NotReqd" 1 "ReqSts1_Reqd";
VAL_ 80 ErsCmdRecErsCmd 0 "ErsCmd_ErsCmdNotSet" 1 "ErsCmd_ErsCmdOn" 2 "ErsCmd_ErsCmdOff";
VAL_ 1168 CarSharingMde 0 "Boolean_FALSE" 1 "Boolean_TRUE";
VAL_ 1168 LongTiRunngModCampMod 0 "OnOff1_Off" 1 "OnOff1_On";
VAL_ 1168 LongTiRunngModGameMod 0 "OnOff1_Off" 1 "OnOff1_On";
VAL_ 1168 LongTiRunngModMonrbyOMS 0 "MonrbyOMS_NoUserInside" 1 "MonrbyOMS_UserInside";
VAL_ 1168 LongTiRunngModNxtCnvinc 0 "OnOff1_Off" 1 "OnOff1_On";
VAL_ 1168 LongTiRunngModPanelTouched 0 "PanelTouched_NoTouch" 1 "PanelTouched_Touched";
VAL_ 1168 LongTiRunngModParkComfortMod 0 "OnOff1_Off" 1 "OnOff1_On";
VAL_ 1168 LongTiRunngModPetMod 0 "OnOff1_Off" 1 "OnOff1_On";
VAL_ 1168 LongTiRunngModReserved2 0 "OnOff1_Off" 1 "OnOff1_On";
VAL_ 1168 LongTiRunngModReserved3 0 "OnOff1_Off" 1 "OnOff1_On";
VAL_ 1168 LongTiRunngModReserved4 0 "OnOff1_Off" 1 "OnOff1_On";
VAL_ 1168 LongTiRunngModReserved5 0 "OnOff1_Off" 1 "OnOff1_On";
VAL_ 1168 LongTiRunngModReserved6 0 "OnOff1_Off" 1 "OnOff1_On";
VAL_ 1168 LongTiRunngModReserved7 0 "OnOff1_Off" 1 "OnOff1_On";
VAL_ 1168 LongTiRunngModReserved8 0 "OnOff1_Off" 1 "OnOff1_On";
VAL_ 1168 LongTiRunngModRestMod 0 "OnOff1_Off" 1 "OnOff1_On";
VAL_ 1168 LongTiRunngModTheaterMod 0 "OnOff1_Off" 1 "OnOff1_On";
VAL_ 1168 UnlckRemReq 0 "UnlckRemCfg1_UnlckCen" 1 "UnlckRemCfg1_UnlckStep2";
VAL_ 435 HznPosnLRMessageType 0 "MessageType_SystemSpecific" 1 "MessageType_POSITION" 2 "MessageType_SEGMENT" 3 "MessageType_STUB" 4 "MessageType_PROFILESHORT" 5 "MessageType_PROFILELONG" 6 "MessageType_METADATA" 7 "MessageType_Reserved";
VAL_ 435 HznProfLongLRControlPoint 0 "Boolean_FALSE" 1 "Boolean_TRUE";
VAL_ 435 HznProfLongLRMessageType 0 "MessageType_SystemSpecific" 1 "MessageType_POSITION" 2 "MessageType_SEGMENT" 3 "MessageType_STUB" 4 "MessageType_PROFILESHORT" 5 "MessageType_PROFILELONG" 6 "MessageType_METADATA" 7 "MessageType_Reserved";
VAL_ 435 HznProfLongLRRetransmission 0 "Boolean_FALSE" 1 "Boolean_TRUE";
VAL_ 435 HznProfLongLRUpdate 0 "Boolean_FALSE" 1 "Boolean_TRUE";
VAL_ 435 ShowTypOfDTESet 0 "ShowTyp1_NoReq" 1 "ShowTyp1_NormalType" 2 "ShowTyp1_DynamicType";
SIG_GROUP_ 368 AutElecStepCtrlSwtSts 1 : AutElecStepCtrlSwtStsDriver AutElecStepCtrlSwtStsPassenger;
SIG_GROUP_ 368 BLEKeyExtLoUOutIPwrSplyCtrl 1 : BLEKeyExtLoUOutIPwrSplyCtrlZone1 BLEKeyExtLoUOutIPwrSplyCtrlZone2 BLEKeyExtLoUOutIPwrSplyCtrlZone3 BLEKeyExtLoUOutIPwrSplyCtrlZone4 BLEKeyExtLoUOutIPwrSplyCtrlZone5 BLEKeyExtLoUOutIPwrSplyCtrlZone6;
SIG_GROUP_ 80 DKDataFromTelm 1 : DKDataFromTelmAcknowledgment DKDataFromTelmDKDataByte1 DKDataFromTelmDKDataByte2 DKDataFromTelmDKDataByte3 DKDataFromTelmDKDataByte4 DKDataFromTelmDKDataByte5 DKDataFromTelmDKDataByte6 DKDataFromTelmHeader;
SIG_GROUP_ 560 DrvrHdPosnDetn 1 : DrvrHdPosnDetnX DrvrHdPosnDetnY DrvrHdPosnDetnZ;
SIG_GROUP_ 89 DwnLoadDynLtgPrmForFrntLeGrp13 1 : DwnLoadDynLtgPrmForFrntLeGrp13ContinueTime DwnLoadDynLtgPrmForFrntLeGrp13HighBrightness DwnLoadDynLtgPrmForFrntLeGrp13LowBrightness DwnLoadDynLtgPrmForFrntLeGrp13Mode1 DwnLoadDynLtgPrmForFrntLeGrp13OffsetTime DwnLoadDynLtgPrmForFrntLeGrp13Timestamp;
SIG_GROUP_ 89 DwnLoadDynLtgPrmForFrntLeGrp14 1 : DwnLoadDynLtgPrmForFrntLeGrp14ContinueTime DwnLoadDynLtgPrmForFrntLeGrp14HighBrightness DwnLoadDynLtgPrmForFrntLeGrp14LowBrightness DwnLoadDynLtgPrmForFrntLeGrp14Mode1 DwnLoadDynLtgPrmForFrntLeGrp14OffsetTime DwnLoadDynLtgPrmForFrntLeGrp14Timestamp;
SIG_GROUP_ 89 DwnLoadDynLtgPrmForFrntLeGrp15 1 : DwnLoadDynLtgPrmForFrntLeGrp15ContinueTime DwnLoadDynLtgPrmForFrntLeGrp15HighBrightness DwnLoadDynLtgPrmForFrntLeGrp15LowBrightness DwnLoadDynLtgPrmForFrntLeGrp15Mode1 DwnLoadDynLtgPrmForFrntLeGrp15OffsetTime DwnLoadDynLtgPrmForFrntLeGrp15Timestamp;
SIG_GROUP_ 89 DwnLoadDynLtgPrmForFrntLeGrp16 1 : DwnLoadDynLtgPrmForFrntLeGrp16ContinueTime DwnLoadDynLtgPrmForFrntLeGrp16HighBrightness DwnLoadDynLtgPrmForFrntLeGrp16LowBrightness DwnLoadDynLtgPrmForFrntLeGrp16Mode1 DwnLoadDynLtgPrmForFrntLeGrp16OffsetTime DwnLoadDynLtgPrmForFrntLeGrp16Timestamp;
SIG_GROUP_ 89 DwnLoadDynLtgPrmForFrntLeGrp17 1 : DwnLoadDynLtgPrmForFrntLeGrp17ContinueTime DwnLoadDynLtgPrmForFrntLeGrp17HighBrightness DwnLoadDynLtgPrmForFrntLeGrp17LowBrightness DwnLoadDynLtgPrmForFrntLeGrp17Mode1 DwnLoadDynLtgPrmForFrntLeGrp17OffsetTime DwnLoadDynLtgPrmForFrntLeGrp17Timestamp;
SIG_GROUP_ 89 DwnLoadDynLtgPrmForFrntLeGrp18 1 : DwnLoadDynLtgPrmForFrntLeGrp18ContinueTime DwnLoadDynLtgPrmForFrntLeGrp18HighBrightness DwnLoadDynLtgPrmForFrntLeGrp18LowBrightness DwnLoadDynLtgPrmForFrntLeGrp18Mode1 DwnLoadDynLtgPrmForFrntLeGrp18OffsetTime DwnLoadDynLtgPrmForFrntLeGrp18Timestamp;
SIG_GROUP_ 89 DwnLoadDynLtgPrmForFrntLeGrp19 1 : DwnLoadDynLtgPrmForFrntLeGrp19ContinueTime DwnLoadDynLtgPrmForFrntLeGrp19HighBrightness DwnLoadDynLtgPrmForFrntLeGrp19LowBrightness DwnLoadDynLtgPrmForFrntLeGrp19Mode1 DwnLoadDynLtgPrmForFrntLeGrp19OffsetTime DwnLoadDynLtgPrmForFrntLeGrp19Timestamp;
SIG_GROUP_ 89 DwnLoadDynLtgPrmForFrntLeGrp20 1 : DwnLoadDynLtgPrmForFrntLeGrp20ContinueTime DwnLoadDynLtgPrmForFrntLeGrp20HighBrightness DwnLoadDynLtgPrmForFrntLeGrp20LowBrightness DwnLoadDynLtgPrmForFrntLeGrp20Mode1 DwnLoadDynLtgPrmForFrntLeGrp20OffsetTime DwnLoadDynLtgPrmForFrntLeGrp20Timestamp;
SIG_GROUP_ 89 DwnLoadDynLtgPrmForFrntLeGrp21 1 : DwnLoadDynLtgPrmForFrntLeGrp21ContinueTime DwnLoadDynLtgPrmForFrntLeGrp21HighBrightness DwnLoadDynLtgPrmForFrntLeGrp21LowBrightness DwnLoadDynLtgPrmForFrntLeGrp21Mode1 DwnLoadDynLtgPrmForFrntLeGrp21OffsetTime DwnLoadDynLtgPrmForFrntLeGrp21Timestamp;
SIG_GROUP_ 89 DwnLoadDynLtgPrmForFrntLeGrp22 1 : DwnLoadDynLtgPrmForFrntLeGrp22ContinueTime DwnLoadDynLtgPrmForFrntLeGrp22HighBrightness DwnLoadDynLtgPrmForFrntLeGrp22LowBrightness DwnLoadDynLtgPrmForFrntLeGrp22Mode1 DwnLoadDynLtgPrmForFrntLeGrp22OffsetTime DwnLoadDynLtgPrmForFrntLeGrp22Timestamp;
SIG_GROUP_ 89 DwnLoadDynLtgPrmForFrntLeGrp23 1 : DwnLoadDynLtgPrmForFrntLeGrp23ContinueTime DwnLoadDynLtgPrmForFrntLeGrp23HighBrightness DwnLoadDynLtgPrmForFrntLeGrp23LowBrightness DwnLoadDynLtgPrmForFrntLeGrp23Mode1 DwnLoadDynLtgPrmForFrntLeGrp23OffsetTime DwnLoadDynLtgPrmForFrntLeGrp23Timestamp;
SIG_GROUP_ 89 DwnLoadDynLtgPrmForFrntLeGrp24 1 : DwnLoadDynLtgPrmForFrntLeGrp24ContinueTime DwnLoadDynLtgPrmForFrntLeGrp24HighBrightness DwnLoadDynLtgPrmForFrntLeGrp24LowBrightness DwnLoadDynLtgPrmForFrntLeGrp24Mode1 DwnLoadDynLtgPrmForFrntLeGrp24OffsetTime DwnLoadDynLtgPrmForFrntLeGrp24Timestamp;
SIG_GROUP_ 99 DwnLoadDynLtgPrmForFrntRIGrp1 1 : DwnLoadDynLtgPrmForFrntRIGrp1ContinueTime DwnLoadDynLtgPrmForFrntRIGrp1HighBrightness DwnLoadDynLtgPrmForFrntRIGrp1LowBrightness DwnLoadDynLtgPrmForFrntRIGrp1Mode1 DwnLoadDynLtgPrmForFrntRIGrp1OffsetTime DwnLoadDynLtgPrmForFrntRIGrp1Timestamp;
SIG_GROUP_ 99 DwnLoadDynLtgPrmForFrntRIGrp10 1 : DwnLoadDynLtgPrmForFrntRIGrp10ContinueTime DwnLoadDynLtgPrmForFrntRIGrp10HighBrightness DwnLoadDynLtgPrmForFrntRIGrp10LowBrightness DwnLoadDynLtgPrmForFrntRIGrp10Mode1 DwnLoadDynLtgPrmForFrntRIGrp10OffsetTime DwnLoadDynLtgPrmForFrntRIGrp10Timestamp;
SIG_GROUP_ 99 DwnLoadDynLtgPrmForFrntRIGrp11 1 : DwnLoadDynLtgPrmForFrntRIGrp11ContinueTime DwnLoadDynLtgPrmForFrntRIGrp11HighBrightness DwnLoadDynLtgPrmForFrntRIGrp11LowBrightness DwnLoadDynLtgPrmForFrntRIGrp11Mode1 DwnLoadDynLtgPrmForFrntRIGrp11OffsetTime DwnLoadDynLtgPrmForFrntRIGrp11Timestamp;
SIG_GROUP_ 99 DwnLoadDynLtgPrmForFrntRIGrp12 1 : DwnLoadDynLtgPrmForFrntRIGrp12ContinueTime DwnLoadDynLtgPrmForFrntRIGrp12HighBrightness DwnLoadDynLtgPrmForFrntRIGrp12LowBrightness DwnLoadDynLtgPrmForFrntRIGrp12Mode1 DwnLoadDynLtgPrmForFrntRIGrp12OffsetTime DwnLoadDynLtgPrmForFrntRIGrp12Timestamp;
SIG_GROUP_ 103 DwnLoadDynLtgPrmForFrntRIGrp13 1 : DwnLoadDynLtgPrmForFrntRIGrp13ContinueTime DwnLoadDynLtgPrmForFrntRIGrp13HighBrightness DwnLoadDynLtgPrmForFrntRIGrp13LowBrightness DwnLoadDynLtgPrmForFrntRIGrp13Mode1 DwnLoadDynLtgPrmForFrntRIGrp13OffsetTime DwnLoadDynLtgPrmForFrntRIGrp13Timestamp;
SIG_GROUP_ 103 DwnLoadDynLtgPrmForFrntRIGrp14 1 : DwnLoadDynLtgPrmForFrntRIGrp14ContinueTime DwnLoadDynLtgPrmForFrntRIGrp14HighBrightness DwnLoadDynLtgPrmForFrntRIGrp14LowBrightness DwnLoadDynLtgPrmForFrntRIGrp14Mode1 DwnLoadDynLtgPrmForFrntRIGrp14OffsetTime DwnLoadDynLtgPrmForFrntRIGrp14Timestamp;
SIG_GROUP_ 103 DwnLoadDynLtgPrmForFrntRIGrp15 1 : DwnLoadDynLtgPrmForFrntRIGrp15ContinueTime DwnLoadDynLtgPrmForFrntRIGrp15HighBrightness DwnLoadDynLtgPrmForFrntRIGrp15LowBrightness DwnLoadDynLtgPrmForFrntRIGrp15Mode1 DwnLoadDynLtgPrmForFrntRIGrp15OffsetTime DwnLoadDynLtgPrmForFrntRIGrp15Timestamp;
SIG_GROUP_ 103 DwnLoadDynLtgPrmForFrntRIGrp16 1 : DwnLoadDynLtgPrmForFrntRIGrp16ContinueTime DwnLoadDynLtgPrmForFrntRIGrp16HighBrightness DwnLoadDynLtgPrmForFrntRIGrp16LowBrightness DwnLoadDynLtgPrmForFrntRIGrp16Mode1 DwnLoadDynLtgPrmForFrntRIGrp16OffsetTime DwnLoadDynLtgPrmForFrntRIGrp16Timestamp;
SIG_GROUP_ 103 DwnLoadDynLtgPrmForFrntRIGrp17 1 : DwnLoadDynLtgPrmForFrntRIGrp17ContinueTime DwnLoadDynLtgPrmForFrntRIGrp17HighBrightness DwnLoadDynLtgPrmForFrntRIGrp17LowBrightness DwnLoadDynLtgPrmForFrntRIGrp17Mode1 DwnLoadDynLtgPrmForFrntRIGrp17OffsetTime DwnLoadDynLtgPrmForFrntRIGrp17Timestamp;
SIG_GROUP_ 103 DwnLoadDynLtgPrmForFrntRIGrp18 1 : DwnLoadDynLtgPrmForFrntRIGrp18ContinueTime DwnLoadDynLtgPrmForFrntRIGrp18HighBrightness DwnLoadDynLtgPrmForFrntRIGrp18LowBrightness DwnLoadDynLtgPrmForFrntRIGrp18Mode1 DwnLoadDynLtgPrmForFrntRIGrp18OffsetTime DwnLoadDynLtgPrmForFrntRIGrp18Timestamp;
SIG_GROUP_ 103 DwnLoadDynLtgPrmForFrntRIGrp19 1 : DwnLoadDynLtgPrmForFrntRIGrp19ContinueTime DwnLoadDynLtgPrmForFrntRIGrp19HighBrightness DwnLoadDynLtgPrmForFrntRIGrp19LowBrightness DwnLoadDynLtgPrmForFrntRIGrp19Mode1 DwnLoadDynLtgPrmForFrntRIGrp19OffsetTime DwnLoadDynLtgPrmForFrntRIGrp19Timestamp;
SIG_GROUP_ 99 DwnLoadDynLtgPrmForFrntRIGrp2 1 : DwnLoadDynLtgPrmForFrntRIGrp2ContinueTime DwnLoadDynLtgPrmForFrntRIGrp2HighBrightness DwnLoadDynLtgPrmForFrntRIGrp2LowBrightness DwnLoadDynLtgPrmForFrntRIGrp2Mode1 DwnLoadDynLtgPrmForFrntRIGrp2OffsetTime DwnLoadDynLtgPrmForFrntRIGrp2Timestamp;
SIG_GROUP_ 103 DwnLoadDynLtgPrmForFrntRIGrp20 1 : DwnLoadDynLtgPrmForFrntRIGrp20ContinueTime DwnLoadDynLtgPrmForFrntRIGrp20HighBrightness DwnLoadDynLtgPrmForFrntRIGrp20LowBrightness DwnLoadDynLtgPrmForFrntRIGrp20Mode1 DwnLoadDynLtgPrmForFrntRIGrp20OffsetTime DwnLoadDynLtgPrmForFrntRIGrp20Timestamp;
SIG_GROUP_ 103 DwnLoadDynLtgPrmForFrntRIGrp21 1 : DwnLoadDynLtgPrmForFrntRIGrp21ContinueTime DwnLoadDynLtgPrmForFrntRIGrp21HighBrightness DwnLoadDynLtgPrmForFrntRIGrp21LowBrightness DwnLoadDynLtgPrmForFrntRIGrp21Mode1 DwnLoadDynLtgPrmForFrntRIGrp21OffsetTime DwnLoadDynLtgPrmForFrntRIGrp21Timestamp;
SIG_GROUP_ 103 DwnLoadDynLtgPrmForFrntRIGrp22 1 : DwnLoadDynLtgPrmForFrntRIGrp22ContinueTime DwnLoadDynLtgPrmForFrntRIGrp22HighBrightness DwnLoadDynLtgPrmForFrntRIGrp22LowBrightness DwnLoadDynLtgPrmForFrntRIGrp22Mode1 DwnLoadDynLtgPrmForFrntRIGrp22OffsetTime DwnLoadDynLtgPrmForFrntRIGrp22Timestamp;
SIG_GROUP_ 103 DwnLoadDynLtgPrmForFrntRIGrp23 1 : DwnLoadDynLtgPrmForFrntRIGrp23ContinueTime DwnLoadDynLtgPrmForFrntRIGrp23HighBrightness DwnLoadDynLtgPrmForFrntRIGrp23LowBrightness DwnLoadDynLtgPrmForFrntRIGrp23Mode1 DwnLoadDynLtgPrmForFrntRIGrp23OffsetTime DwnLoadDynLtgPrmForFrntRIGrp23Timestamp;
SIG_GROUP_ 103 DwnLoadDynLtgPrmForFrntRIGrp24 1 : DwnLoadDynLtgPrmForFrntRIGrp24ContinueTime DwnLoadDynLtgPrmForFrntRIGrp24HighBrightness DwnLoadDynLtgPrmForFrntRIGrp24LowBrightness DwnLoadDynLtgPrmForFrntRIGrp24Mode1 DwnLoadDynLtgPrmForFrntRIGrp24OffsetTime DwnLoadDynLtgPrmForFrntRIGrp24Timestamp;
SIG_GROUP_ 99 DwnLoadDynLtgPrmForFrntRIGrp3 1 : DwnLoadDynLtgPrmForFrntRIGrp3ContinueTime DwnLoadDynLtgPrmForFrntRIGrp3HighBrightness DwnLoadDynLtgPrmForFrntRIGrp3LowBrightness DwnLoadDynLtgPrmForFrntRIGrp3Mode1 DwnLoadDynLtgPrmForFrntRIGrp3OffsetTime DwnLoadDynLtgPrmForFrntRIGrp3Timestamp;
SIG_GROUP_ 99 DwnLoadDynLtgPrmForFrntRIGrp4 1 : DwnLoadDynLtgPrmForFrntRIGrp4ContinueTime DwnLoadDynLtgPrmForFrntRIGrp4HighBrightness DwnLoadDynLtgPrmForFrntRIGrp4LowBrightness DwnLoadDynLtgPrmForFrntRIGrp4Mode1 DwnLoadDynLtgPrmForFrntRIGrp4OffsetTime DwnLoadDynLtgPrmForFrntRIGrp4Timestamp;
SIG_GROUP_ 99 DwnLoadDynLtgPrmForFrntRIGrp5 1 : DwnLoadDynLtgPrmForFrntRIGrp5ContinueTime DwnLoadDynLtgPrmForFrntRIGrp5HighBrightness DwnLoadDynLtgPrmForFrntRIGrp5LowBrightness DwnLoadDynLtgPrmForFrntRIGrp5Mode1 DwnLoadDynLtgPrmForFrntRIGrp5OffsetTime DwnLoadDynLtgPrmForFrntRIGrp5Timestamp;
SIG_GROUP_ 99 DwnLoadDynLtgPrmForFrntRIGrp6 1 : DwnLoadDynLtgPrmForFrntRIGrp6ContinueTime DwnLoadDynLtgPrmForFrntRIGrp6HighBrightness DwnLoadDynLtgPrmForFrntRIGrp6LowBrightness DwnLoadDynLtgPrmForFrntRIGrp6Mode1 DwnLoadDynLtgPrmForFrntRIGrp6OffsetTime DwnLoadDynLtgPrmForFrntRIGrp6Timestamp;
SIG_GROUP_ 99 DwnLoadDynLtgPrmForFrntRIGrp7 1 : DwnLoadDynLtgPrmForFrntRIGrp7ContinueTime DwnLoadDynLtgPrmForFrntRIGrp7HighBrightness DwnLoadDynLtgPrmForFrntRIGrp7LowBrightness DwnLoadDynLtgPrmForFrntRIGrp7Mode1 DwnLoadDynLtgPrmForFrntRIGrp7OffsetTime DwnLoadDynLtgPrmForFrntRIGrp7Timestamp;
SIG_GROUP_ 99 DwnLoadDynLtgPrmForFrntRIGrp8 1 : DwnLoadDynLtgPrmForFrntRIGrp8ContinueTime DwnLoadDynLtgPrmForFrntRIGrp8HighBrightness DwnLoadDynLtgPrmForFrntRIGrp8LowBrightness DwnLoadDynLtgPrmForFrntRIGrp8Mode1 DwnLoadDynLtgPrmForFrntRIGrp8OffsetTime DwnLoadDynLtgPrmForFrntRIGrp8Timestamp;
SIG_GROUP_ 99 DwnLoadDynLtgPrmForFrntRIGrp9 1 : DwnLoadDynLtgPrmForFrntRIGrp9ContinueTime DwnLoadDynLtgPrmForFrntRIGrp9HighBrightness DwnLoadDynLtgPrmForFrntRIGrp9LowBrightness DwnLoadDynLtgPrmForFrntRIGrp9Mode1 DwnLoadDynLtgPrmForFrntRIGrp9OffsetTime DwnLoadDynLtgPrmForFrntRIGrp9Timestamp;
SIG_GROUP_ 80 ErsCmdRec 1 : ErsCmdRecErsCmd ErsCmdRecErsRunTime;
SIG_GROUP_ 435 HznPosnLR 1 : HznPosnLRCurrentLane HznPosnLRCyclicCounter HznPosnLRMessageType HznPosnLROffset HznPosnLRPathIndex HznPosnLRPositionAge HznPosnLRPositionConfidence HznPosnLRPositionIndex HznPosnLRPositionProbability HznPosnLRRelativeHeading HznPosnLRSpeed;
SIG_GROUP_ 435 HznProfLongLR 1 : HznProfLongLRControlPoint HznProfLongLRCyclicCounter HznProfLongLRMessageType HznProfLongLROffset HznProfLongLRPathIndex HznProfLongLRProfileType HznProfLongLRRetransmission HznProfLongLRUpdate HznProfLongLRValue;
SIG_GROUP_ 1168 LongTiRunngMod 1 : LongTiRunngModCampMod LongTiRunngModGameMod LongTiRunngModMonrbyOMS LongTiRunngModNxtCnvinc LongTiRunngModPanelTouched LongTiRunngModParkComfortMod LongTiRunngModPetMod LongTiRunngModReserved2 LongTiRunngModReserved3 LongTiRunngModReserved4 LongTiRunngModReserved5 LongTiRunngModReserved6 LongTiRunngModReserved7 LongTiRunngModReserved8 LongTiRunngModRestMod LongTiRunngModTheaterMod;
SIG_GROUP_ 368 LvlgSwtSetReq 1 : LvlgSwtSetReqChks LvlgSwtSetReqCntr LvlgSwtSetReqLvlgSwtSetReq;
SIG_GROUP_ 259 MirrTarPosnCmdReq 1 : MirrTarPosnCmdReqDrvrMirrAdjLeRi MirrTarPosnCmdReqDrvrMirrAdjUpDown MirrTarPosnCmdReqPassMirrAdjLeRi MirrTarPosnCmdReqPassMirrAdjUpDown MirrTarPosnCmdReqTarPosnCmd1;
SIG_GROUP_ 560 PassSideHdPosnDetn 1 : PassSideHdPosnDetnX PassSideHdPosnDetnY PassSideHdPosnDetnZ;
SIG_GROUP_ 1168 PosnBrief 1 : PosnBriefPosnLat PosnBriefPosnLgt;
SIG_GROUP_ 368 SecLeSeatTarPosnCmdReq 1 : SecLeSeatTarPosnCmdReqSeatBackrTargPosAg SecLeSeatTarPosnCmdReqSeatFrntExtenTargPosPerc SecLeSeatTarPosnCmdReqSeatFrntHeiTargPosPerc SecLeSeatTarPosnCmdReqSeatLenTargPosPerc SecLeSeatTarPosnCmdReqTarPosnCmd1;
SIG_GROUP_ 368 SecRiSeatTarPosnCmdReq 1 : SecRiSeatTarPosnCmdReqSeatBackrTargPosAg SecRiSeatTarPosnCmdReqSeatFrntExtenTargPosPerc SecRiSeatTarPosnCmdReqSeatFrntHeiTargPosPerc SecRiSeatTarPosnCmdReqSeatLenTargPosPerc SecRiSeatTarPosnCmdReqTarPosnCmd1;
SIG_GROUP_ 560 SteerSetg 1 : SteerSetgPen SteerSetgSteerAsscLvl SteerSetgSteerMod;
SIG_GROUP_ 103 TelmBookClimaReq 1 : TelmBookClimaReqHmiCmptmtTSpSpcl TelmBookClimaReqOnOffNoReq TelmBookClimaReqTempRange;
SIG_GROUP_ 99 TelmBookSeatHeatClimalReq 1 : TelmBookSeatHeatClimalReqDrvHeatClimaLvl TelmBookSeatHeatClimalReqPassHeatClimaLvl TelmBookSeatHeatClimalReqSecLeHeatClimaLvl TelmBookSeatHeatClimalReqSecRiHeatClimaLvl TelmBookSeatHeatClimalReqThrdLeHeatClimaLvl TelmBookSeatHeatClimalReqThrdRiHeatClimaLvl;
SIG_GROUP_ 99 TelmBookSeatVentnClimalReq 1 : TelmBookSeatVentnClimalReqDrvVentnClimaLvl TelmBookSeatVentnClimalReqPassVentnClimaLvl TelmBookSeatVentnClimalReqSecLeVentnClimaLvl TelmBookSeatVentnClimalReqSecRiVentnClimaLvl TelmBookSeatVentnClimalReqThrdLeVentnClimaLvl TelmBookSeatVentnClimalReqThrdRiVentnClimaL;
SIG_GROUP_ 99 TelmClimaTSet 1 : TelmClimaTSetHmiCmptmtTSpSpcl TelmClimaTSetTempRange;
SIG_GROUP_ 89 TelmLockgCenReq 1 : TelmLockgCenReqReqTyp TelmLockgCenReqTiVld;
SIG_GROUP_ 368 ThrdLeSeatTarPosnCmdReq 1 : ThrdLeSeatTarPosnCmdReqSeatBackrTargPosAg ThrdLeSeatTarPosnCmdReqSeatFrntExtenTargPosPerc ThrdLeSeatTarPosnCmdReqSeatFrntHeiTargPosPerc ThrdLeSeatTarPosnCmdReqSeatLenTargPosPerc ThrdLeSeatTarPosnCmdReqTarPosnCmd1;
SIG_GROUP_ 368 ThrdRiSeatTarPosnCmdReq 1 : ThrdRiSeatTarPosnCmdReqSeatBackrTargPosAg ThrdRiSeatTarPosnCmdReqSeatFrntExtenTargPosPerc ThrdRiSeatTarPosnCmdReqSeatFrntHeiTargPosPerc ThrdRiSeatTarPosnCmdReqSeatLenTargPosPerc ThrdRiSeatTarPosnCmdReqTarPosnCmd1;
SIG_GROUP_ 103 WinOpenClsGlbReqFromTelm 1 : WinOpenClsGlbReqFromTelmWindowOpenValue WinOpenClsGlbReqFromTelmWinOpenClsGlbSts;
