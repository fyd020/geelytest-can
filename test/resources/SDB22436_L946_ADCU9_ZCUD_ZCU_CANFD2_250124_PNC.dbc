// *************************************************************************** *
// *                                                                           *
// * Description:         CANDB File                                           *
// * Generated at:        2025-01-24 14:38                                     *
// * System:              SDB22436                                             *
// * Variant:             L946_ADCU9_ZCUD                                      *
// * Network:             ZCU_CANFD2                                           *
// *                                                                           *
// *************************************************************************** *
VERSION "ZCU_CANFD2"

NS_ :

BS_ :

BU_ :  ETC IHU ZCUD ZCUP

BO_ 464 DhuZCUCANFD2Fr16 : 64 IHU
 SG_ ActvReSplrPosnReq : 103|3@0+ (1,0) [0|7] "" ZCUD
 SG_ ActvReSplrPosnReq_UB : 100|1@0+ (1,0) [0|1] "" ZCUD
 SG_ BackRestSideSpprtAdjmtRowFirstDrvr : 7|2@0+ (1,0) [0|3] "" ZCUD
 SG_ BackRestSideSpprtAdjmtRowFirstDrvr_UB : 3|1@0+ (1,0) [0|1] "" ZCUD
 SG_ BackRestSideSpprtAdjmtRowFirstPass : 5|2@0+ (1,0) [0|3] "" ZCUP
 SG_ BackRestSideSpprtAdjmtRowFirstPass_UB : 35|1@0+ (1,0) [0|1] "" ZCUP
 SG_ CushSideSpprtAdjmtRowFirstDrvr : 39|2@0+ (1,0) [0|3] "" ZCUD
 SG_ CushSideSpprtAdjmtRowFirstDrvr_UB : 57|1@0+ (1,0) [0|1] "" ZCUD
 SG_ CushSideSpprtAdjmtRowFirstPass : 37|2@0+ (1,0) [0|3] "" ZCUP
 SG_ CushSideSpprtAdjmtRowFirstPass_UB : 56|1@0+ (1,0) [0|1] "" ZCUP
 SG_ DiagcComActv : 14|1@0+ (1,0) [0|1] "" ZCUD
 SG_ DiagcComActv_UB : 1|1@0+ (1,0) [0|1] "" ZCUD
 SG_ DiagcExtCom : 33|1@0+ (1,0) [0|1] "" ZCUD
 SG_ DiagcExtCom_UB : 32|1@0+ (1,0) [0|1] "" ZCUD
 SG_ DrvrSeatDispMassgFct_UB : 2|1@0+ (1,0) [0|1] "" ZCUD
 SG_ DrvrSeatDispMassgFctMassgInten : 71|2@0+ (1,0) [0|3] "" ZCUD
 SG_ DrvrSeatDispMassgFctMassgProg : 69|3@0+ (1,0) [0|7] "" ZCUD
 SG_ DrvrSeatDispMassgFctOnOffl2 : 66|2@0+ (1,0) [0|3] "" ZCUD
 SG_ DrvrSeatDispSpplFct : 55|3@0+ (1,0) [0|7] "" ZCUD
 SG_ DrvrSeatDispSpplFct_UB : 52|1@0+ (1,0) [0|1] "" ZCUD
 SG_ ExtLoUOutlPwrSplyReqRADAR_UB : 88|1@0+ (1,0) [0|1] "" Vector__XXX
 SG_ ExtLoUOutlPwrSplyReqRADARMaiSwt : 95|1@0+ (1,0) [0|1] "" Vector__XXX
 SG_ ExtLoUOutlPwrSplyReqRADARZone1 : 94|1@0+ (1,0) [0|1] "" Vector__XXX
 SG_ ExtLoUOutlPwrSplyReqRADARZone2 : 93|1@0+ (1,0) [0|1] "" Vector__XXX
 SG_ ExtLoUOutlPwrSplyReqRADARZone3 : 92|1@0+ (1,0) [0|1] "" Vector__XXX
 SG_ ExtLoUOutlPwrSplyReqRADARZone4 : 91|1@0+ (1,0) [0|1] "" Vector__XXX
 SG_ ExtLoUOutlPwrSplyReqRADARZone5 : 90|1@0+ (1,0) [0|1] "" Vector__XXX
 SG_ ExtLoUOutlPwrSplyReqRADARZone6 : 89|1@0+ (1,0) [0|1] "" Vector__XXX
 SG_ ExtrLtgFctSts : 59|1@0+ (1,0) [0|1] "" ZCUD
 SG_ ExtrLtgFctSts_UB : 58|1@0+ (1,0) [0|1] "" ZCUD
 SG_ HMIBluetoothCallToAdjAirVol : 63|2@0+ (1,0) [0|3] "" ZCUP
 SG_ HMIBluetoothCallToAdjAirVol_UB : 61|1@0+ (1,0) [0|1] "" ZCUP
 SG_ HMIIonizerAirCdnr : 15|1@0+ (1,0) [0|1] "" ZCUP
 SG_ HMIIonizerAirCdnr_UB : 0|1@0+ (1,0) [0|1] "" ZCUP
 SG_ HmiSmrtWindFolwSet : 99|1@0+ (1,0) [0|1] "" ZCUP
 SG_ HmiSmrtWindFolwSet_UB : 98|1@0+ (1,0) [0|1] "" ZCUP
 SG_ HMIToVMMSwt_UB : 72|1@0+ (1,0) [0|1] "" ZCUD
 SG_ HMIToVMMSwtSwitch1 : 87|1@0+ (1,0) [0|1] "" ZCUD
 SG_ HMIToVMMSwtSwitch2 : 86|1@0+ (1,0) [0|1] "" ZCUD
 SG_ HMIToVMMSwtSwitch3 : 85|1@0+ (1,0) [0|1] "" ZCUD
 SG_ HMIToVMMSwtSwitch4 : 84|1@0+ (1,0) [0|1] "" ZCUD
 SG_ HMIToVMMSwtSwitch5 : 83|1@0+ (1,0) [0|1] "" ZCUD
 SG_ HMIToVMMSwtSwitch6 : 82|1@0+ (1,0) [0|1] "" ZCUD
 SG_ HMIToVMMSwtSwitch7 : 81|1@0+ (1,0) [0|1] "" ZCUD
 SG_ HMIToVMMSwtSwitch8 : 80|1@0+ (1,0) [0|1] "" ZCUD
 SG_ HmiWinterLockCarPrevnIceSet : 97|1@0+ (1,0) [0|1] "" ZCUP
 SG_ HmiWinterLockCarPrevnIceSet_UB : 96|1@0+ (1,0) [0|1] "" ZCUP
 SG_ LumHeiAdjmtRowFirstDrvr : 47|2@0+ (1,0) [0|3] "" ZCUD
 SG_ LumHeiAdjmtRowFirstDrvr_UB : 17|1@0+ (1,0) [0|1] "" ZCUD
 SG_ LumHeiAdjmtRowFirstPass : 45|2@0+ (1,0) [0|3] "" ZCUP
 SG_ LumHeiAdjmtRowFirstPass_UB : 16|1@0+ (1,0) [0|1] "" ZCUP
 SG_ LumLenAdjmtRowFirstDrvr : 43|2@0+ (1,0) [0|3] "" ZCUD
 SG_ LumLenAdjmtRowFirstDrvr_UB : 25|1@0+ (1,0) [0|1] "" ZCUD
 SG_ LumLenAdjmtRowFirstPass : 41|2@0+ (1,0) [0|3] "" ZCUP
 SG_ LumLenAdjmtRowFirstPass_UB : 24|1@0+ (1,0) [0|1] "" ZCUP
 SG_ PassSeatDispMassgFct_UB : 34|1@0+ (1,0) [0|1] "" ZCUP
 SG_ PassSeatDispMassgFctMassgInten : 79|2@0+ (1,0) [0|3] "" ZCUP
 SG_ PassSeatDispMassgFctMassgProg : 77|3@0+ (1,0) [0|7] "" ZCUP
 SG_ PassSeatDispMassgFctOnOffl2 : 74|2@0+ (1,0) [0|3] "" ZCUP
 SG_ PassSeatDispSpplFct : 51|3@0+ (1,0) [0|7] "" ZCUP
 SG_ PassSeatDispSpplFct_UB : 48|1@0+ (1,0) [0|1] "" ZCUP
 SG_ SteerWhlHeatngAutStrtReq : 9|1@0+ (1,0) [0|1] "" ZCUD
 SG_ SteerWhlHeatngAutStrtReq_UB : 8|1@0+ (1,0) [0|1] "" ZCUD
 SG_ SunCurtCtrlReq : 23|2@0+ (1,0) [0|3] "" ZCUD
 SG_ SunCurtCtrlReq_UB : 21|1@0+ (1,0) [0|1] "" ZCUD
 SG_ SunRoofCtrlReq : 20|2@0+ (1,0) [0|3] "" ZCUD
 SG_ SunRoofCtrlReq_UB : 18|1@0+ (1,0) [0|1] "" ZCUD
 SG_ SwtPwrStsOfVehSurrndgsVisnRec : 60|1@0+ (1,0) [0|1] "" ZCUD
 SG_ SwtPwrStsOfVehSurrndgsVisnRec_UB : 64|1@0+ (1,0) [0|1] "" ZCUD
 SG_ TelmBookChrgnTyp : 12|3@0+ (1,0) [0|7] "" ZCUD
 SG_ TelmBookChrgnTyp_UB : 13|1@0+ (1,0) [0|1] "" ZCUD
 SG_ WirelschrgActvReqFromHmi : 31|1@0+ (1,0) [0|1] "" ZCUD
 SG_ WirelschrgActvReqFromHmi_UB : 30|1@0+ (1,0) [0|1] "" ZCUD

BO_ 311 DhuZCUCANFD2Fr17 : 64 IHU
 SG_ AirCushInflateDeflateReq : 322|2@0+ (1,0) [0|3] "" ZCUD
 SG_ AirCushInflateDeflateReq_UB : 320|1@0+ (1,0) [0|1] "" ZCUD
 SG_ AmbientLiEffectStatus1 : 43|4@0+ (1,0) [0|15] "" ZCUP
 SG_ AmbientLiEffectStatus1_UB : 44|1@0+ (1,0) [0|1] "" ZCUP
 SG_ AmbLiChrgCorrlnReq : 55|1@0+ (1,0) [0|1] "" ZCUP
 SG_ AmbLiChrgCorrlnReq_UB : 54|1@0+ (1,0) [0|1] "" ZCUP
 SG_ AmbLiDirCorrlnReq : 53|1@0+ (1,0) [0|1] "" ZCUP
 SG_ AmbLiDirCorrlnReq_UB : 52|1@0+ (1,0) [0|1] "" ZCUP
 SG_ AmbLiDoorCorrlnReq : 51|1@0+ (1,0) [0|1] "" ZCUP
 SG_ AmbLiDoorCorrlnReq_UB : 50|1@0+ (1,0) [0|1] "" ZCUP
 SG_ AmbLiDrvModCorrlnReq : 49|1@0+ (1,0) [0|1] "" ZCUP
 SG_ AmbLiDrvModCorrlnReq_UB : 48|1@0+ (1,0) [0|1] "" ZCUP
 SG_ AmbLiRadarCorrlnReq : 63|1@0+ (1,0) [0|1] "" ZCUP
 SG_ AmbLiRadarCorrlnReq_UB : 62|1@0+ (1,0) [0|1] "" ZCUP
 SG_ AmbLiResd : 7|16@0+ (1.0,0.0) [0.0|65535.0] "Unitless" ZCUP
 SG_ AmbLiResd_UB : 27|1@0+ (1,0) [0|1] "" ZCUP
 SG_ AmbLiSpdSwt : 25|2@0+ (1,0) [0|3] "" ZCUP
 SG_ AmbLiSpdSwt_UB : 26|1@0+ (1,0) [0|1] "" ZCUP
 SG_ AmbLiStrtCorrlnReq : 46|1@0+ (1,0) [0|1] "" ZCUP
 SG_ AmbLiStrtCorrlnReq_UB : 45|1@0+ (1,0) [0|1] "" ZCUP
 SG_ AmbLiThemeReq : 39|8@0+ (1.0,0.0) [0.0|255.0] "Unitless" ZCUP
 SG_ AmbLiThemeReq_UB : 47|1@0+ (1,0) [0|1] "" ZCUP
 SG_ AmbLiUnlckCorrlnReq : 61|1@0+ (1,0) [0|1] "" ZCUP
 SG_ AmbLiUnlckCorrlnReq_UB : 60|1@0+ (1,0) [0|1] "" ZCUP
 SG_ AssistantLiEnaSwt : 59|1@0+ (1,0) [0|1] "" ZCUD
 SG_ AssistantLiEnaSwt_UB : 58|1@0+ (1,0) [0|1] "" ZCUD
 SG_ CarpetLiModReq : 71|4@0+ (1,0) [0|15] "" ZCUD
 SG_ CarpetLiModReq_UB : 67|1@0+ (1,0) [0|1] "" ZCUD
 SG_ ChdLockSideSelnSwt : 65|2@0+ (1,0) [0|3] "" ZCUD
 SG_ ChdLockSideSelnSwt_UB : 66|1@0+ (1,0) [0|1] "" ZCUD
 SG_ DoorPocketLiSwt : 79|2@0+ (1,0) [0|3] "" ZCUD
 SG_ DoorPocketLiSwt_UB : 77|1@0+ (1,0) [0|1] "" ZCUD
 SG_ DrvrSeatDispPhytheraFct_UB : 354|1@0+ (1,0) [0|1] "" ZCUD
 SG_ DrvrSeatDispPhytheraFctOnOff1 : 359|1@0+ (1,0) [0|1] "" ZCUD
 SG_ DrvrSeatDispPhytheraFctPhytheraProgTyp : 358|4@0+ (1,0) [0|15] "" ZCUD
 SG_ EasyInOutSecRowLeActv : 338|1@0+ (1,0) [0|1] "" ZCUD
 SG_ EasyInOutSecRowLeActv_UB : 337|1@0+ (1,0) [0|1] "" ZCUD
 SG_ EasyInOutSecRowRiActv : 336|1@0+ (1,0) [0|1] "" ZCUD
 SG_ EasyInOutSecRowRiActv_UB : 328|1@0+ (1,0) [0|1] "" ZCUD
 SG_ ExtrMirrAdjHmiReq : 303|3@0+ (1,0) [0|7] "" ZCUD
 SG_ ExtrMirrAdjHmiReq_UB : 298|1@0+ (1,0) [0|1] "" ZCUD
 SG_ ExtrMirrFoldHmiReq : 296|1@0+ (1,0) [0|1] "" ZCUD
 SG_ ExtrMirrFoldHmiReq_UB : 311|1@0+ (1,0) [0|1] "" ZCUD
 SG_ ExtrMirrSelnHmiReq : 300|2@0+ (1,0) [0|3] "" ZCUD
 SG_ ExtrMirrSelnHmiReq_UB : 297|1@0+ (1,0) [0|1] "" ZCUD
 SG_ FogSetFrntReq : 75|2@0+ (1,0) [0|3] "" ZCUD
 SG_ FogSetFrntReq_UB : 76|1@0+ (1,0) [0|1] "" ZCUD
 SG_ FootwellLiSwt : 85|2@0+ (1,0) [0|3] "" ZCUD
 SG_ FootwellLiSwt_UB : 83|1@0+ (1,0) [0|1] "" ZCUD
 SG_ FrntTechnologyLiPosLiCorrlnSwt : 87|1@0+ (1,0) [0|1] "" ZCUD
 SG_ FrntTechnologyLiPosLiCorrlnSwt_UB : 86|1@0+ (1,0) [0|1] "" ZCUD
 SG_ HmiAC : 222|1@0+ (1,0) [0|1] "" ZCUD,ZCUP
 SG_ HmiAC_UB : 221|1@0+ (1,0) [0|1] "" ZCUD,ZCUP
 SG_ HMIAutoTerrainSetting : 284|1@0+ (1,0) [0|1] "" ZCUD
 SG_ HMIAutoTerrainSetting_UB : 283|1@0+ (1,0) [0|1] "" ZCUD
 SG_ HmiElecFrntDefrstReq : 218|2@0+ (1,0) [0|3] "" ZCUD
 SG_ HmiElecFrntDefrstReq_UB : 216|1@0+ (1,0) [0|1] "" ZCUD
 SG_ HmiElecReMirrDefrstReq : 231|2@0+ (1,0) [0|3] "" ZCUD
 SG_ HmiElecReMirrDefrstReq_UB : 229|1@0+ (1,0) [0|1] "" ZCUD
 SG_ HmiElecReWinDefrstReq : 228|2@0+ (1,0) [0|3] "" ZCUD
 SG_ HmiElecReWinDefrstReq_UB : 226|1@0+ (1,0) [0|1] "" ZCUD
 SG_ IdleChrgCtrl : 225|1@0+ (1,0) [0|1] "" ZCUD
 SG_ IdleChrgCtrl_UB : 224|1@0+ (1,0) [0|1] "" ZCUD
 SG_ LegRestHozlAdjmtRowSecLe : 367|2@0+ (1,0) [0|3] "" ZCUD
 SG_ LegRestHozlAdjmtRowSecLe_UB : 365|1@0+ (1,0) [0|1] "" ZCUD
 SG_ LegRestHozlAdjmtRowSecRi : 364|2@0+ (1,0) [0|3] "" ZCUD
 SG_ LegRestHozlAdjmtRowSecRi_UB : 362|1@0+ (1,0) [0|1] "" ZCUD
 SG_ LegRestRotAdjmtRowThrdLe : 361|2@0+ (1,0) [0|3] "" ZCUD
 SG_ LegRestRotAdjmtRowThrdLe_UB : 353|1@0+ (1,0) [0|1] "" ZCUD
 SG_ LegRestRotAdjmtRowThrdRi : 375|2@0+ (1,0) [0|3] "" ZCUD
 SG_ LegRestRotAdjmtRowThrdRi_UB : 352|1@0+ (1,0) [0|1] "" ZCUD
 SG_ NFCKeyReadReq : 343|4@0+ (1,0) [0|15] "" ZCUD
 SG_ NFCKeyReadReq_UB : 339|1@0+ (1,0) [0|1] "" ZCUD
 SG_ NightLiSwtSts : 373|1@0+ (1,0) [0|1] "" ZCUD
 SG_ NightLiSwtSts_UB : 372|1@0+ (1,0) [0|1] "" ZCUD
 SG_ OneKeyLvlgSwt : 82|2@0+ (1,0) [0|3] "" ZCUD
 SG_ OneKeyLvlgSwt_UB : 80|1@0+ (1,0) [0|1] "" ZCUD
 SG_ OTACmplSts : 282|1@0+ (1,0) [0|1] "" ZCUD
 SG_ OTACmplSts_UB : 281|1@0+ (1,0) [0|1] "" ZCUD
 SG_ PassSeatDispPhytheraFct_UB : 382|1@0+ (1,0) [0|1] "" ZCUP
 SG_ PassSeatDispPhytheraFctOnOff1 : 383|1@0+ (1,0) [0|1] "" ZCUP
 SG_ PassSeatDispPhytheraFctPhytheraProgTyp : 371|4@0+ (1,0) [0|15] "" ZCUP
 SG_ PrpsnHvBattUsgModReq : 255|3@0+ (1,0) [0|7] "" ZCUD
 SG_ PrpsnHvBattUsgModReq_UB : 252|1@0+ (1,0) [0|1] "" ZCUD
 SG_ PwrSldDoorLeReOpenHmiReq : 381|2@0+ (1,0) [0|3] "" ZCUD
 SG_ PwrSldDoorLeReOpenHmiReq_UB : 379|1@0+ (1,0) [0|1] "" ZCUD
 SG_ PwrSldDoorRiReOpenHmiReq : 378|2@0+ (1,0) [0|3] "" ZCUD
 SG_ PwrSldDoorRiReOpenHmiReq_UB : 376|1@0+ (1,0) [0|1] "" ZCUD
 SG_ PwrSldgDoorLePosnReqFromHmi : 391|7@0+ (1.0,0.0) [0.0|101.0] "%" ZCUD
 SG_ PwrSldgDoorLePosnReqFromHmi_UB : 384|1@0+ (1,0) [0|1] "" ZCUD
 SG_ PwrSldgDoorRiPosnReqFromHmi : 399|7@0+ (1.0,0.0) [0.0|101.0] "%" ZCUD
 SG_ PwrSldgDoorRiPosnReqFromHmi_UB : 392|1@0+ (1,0) [0|1] "" ZCUD
 SG_ RadioFrqAM : 250|11@0+ (1.0,522.0) [522.0|1710.0] "Unitless" ZCUD,ZCUP
 SG_ RadioFrqAM_UB : 251|1@0+ (1,0) [0|1] "" ZCUD,ZCUP
 SG_ ReSeatQuickAdjmt : 407|3@0+ (1,0) [0|7] "" ZCUD
 SG_ ReSeatQuickAdjmt_UB : 404|1@0+ (1,0) [0|1] "" ZCUD
 SG_ SaveSetgToMemPrmnt : 310|2@0+ (1,0) [0|3] "" ZCUD,ZCUP
 SG_ SaveSetgToMemPrmnt_UB : 308|1@0+ (1,0) [0|1] "" ZCUD,ZCUP
 SG_ SearchLiSwtSts : 403|1@0+ (1,0) [0|1] "" ZCUD
 SG_ SearchLiSwtSts_UB : 402|1@0+ (1,0) [0|1] "" ZCUD
 SG_ SpdCtrlSwt : 183|1@0+ (1,0) [0|1] "" ZCUD
 SG_ SpdCtrlSwt_UB : 180|1@0+ (1,0) [0|1] "" ZCUD
 SG_ SunRoofAndCurtIninSwt : 265|1@0+ (1,0) [0|1] "" ZCUD
 SG_ SunRoofAndCurtIninSwt_UB : 264|1@0+ (1,0) [0|1] "" ZCUD
 SG_ SuspEasyLoadSet : 267|1@0+ (1,0) [0|1] "" ZCUD
 SG_ SuspEasyLoadSet_UB : 266|1@0+ (1,0) [0|1] "" ZCUD
 SG_ SuspHeiLvlSet : 314|3@0+ (1,0) [0|7] "" ZCUD
 SG_ SuspHeiLvlSet_UB : 304|1@0+ (1,0) [0|1] "" ZCUD
 SG_ TechnologyLiOnOffSwt : 73|1@0+ (1,0) [0|1] "" ZCUD
 SG_ TechnologyLiOnOffSwt_UB : 72|1@0+ (1,0) [0|1] "" ZCUD
 SG_ TrfcSideSetReq : 57|1@0+ (1,0) [0|1] "" ZCUD
 SG_ TrfcSideSetReq_UB : 56|1@0+ (1,0) [0|1] "" ZCUD
 SG_ TrOpenPosnReqFromHmi : 351|7@0+ (1.0,0.0) [0.0|101.0] "%" ZCUD
 SG_ TrOpenPosnReqFromHmi_UB : 344|1@0+ (1,0) [0|1] "" ZCUD
 SG_ TrunkOpenHmiReq : 287|2@0+ (1,0) [0|3] "" ZCUD
 SG_ TrunkOpenHmiReq_UB : 285|1@0+ (1,0) [0|1] "" ZCUD
 SG_ WinOpenDrvrReq : 327|5@0+ (1,0) [0|31] "" ZCUD
 SG_ WinOpenDrvrReq_UB : 306|1@0+ (1,0) [0|1] "" ZCUD
 SG_ WinOpenPassReq : 175|5@0+ (1,0) [0|31] "" ZCUP
 SG_ WinOpenPassReq_UB : 170|1@0+ (1,0) [0|1] "" ZCUP
 SG_ WinOpenReLeReq : 335|5@0+ (1,0) [0|31] "" ZCUD,ZCUP
 SG_ WinOpenReLeReq_UB : 305|1@0+ (1,0) [0|1] "" ZCUD,ZCUP
 SG_ WinOpenReRiReq : 319|5@0+ (1,0) [0|31] "" ZCUD,ZCUP
 SG_ WinOpenReRiReq_UB : 307|1@0+ (1,0) [0|1] "" ZCUD,ZCUP
 SG_ Zone1Settings_UB : 179|1@0+ (1,0) [0|1] "" ZCUP
 SG_ Zone1SettingsBlue : 111|8@0+ (1.0,0.0) [0.0|255.0] "Unitless" ZCUP
 SG_ Zone1SettingsGreen : 119|8@0+ (1.0,0.0) [0.0|255.0] "Unitless" ZCUP
 SG_ Zone1SettingsIntensity : 135|7@0+ (1.0,0.0) [0.0|127.0] "Unitless" ZCUP
 SG_ Zone1SettingsRed : 127|8@0+ (1.0,0.0) [0.0|255.0] "Unitless" ZCUP
 SG_ Zone1SettingsZoneStatus : 128|1@0+ (1,0) [0|1] "" ZCUP
 SG_ Zone2Settings_UB : 169|1@0+ (1,0) [0|1] "" ZCUP
 SG_ Zone2SettingsBlue : 143|8@0+ (1.0,0.0) [0.0|255.0] "Unitless" ZCUP
 SG_ Zone2SettingsGreen : 151|8@0+ (1.0,0.0) [0.0|255.0] "Unitless" ZCUP
 SG_ Zone2SettingsIntensity : 167|7@0+ (1.0,0.0) [0.0|127.0] "Unitless" ZCUP
 SG_ Zone2SettingsRed : 159|8@0+ (1.0,0.0) [0.0|255.0] "Unitless" ZCUP
 SG_ Zone2SettingsZoneStatus : 160|1@0+ (1,0) [0|1] "" ZCUP
 SG_ Zone3Settings_UB : 181|1@0+ (1,0) [0|1] "" ZCUP
 SG_ Zone3SettingsBlue : 191|8@0+ (1.0,0.0) [0.0|255.0] "Unitless" ZCUP
 SG_ Zone3SettingsGreen : 199|8@0+ (1.0,0.0) [0.0|255.0] "Unitless" ZCUP
 SG_ Zone3SettingsIntensity : 215|7@0+ (1.0,0.0) [0.0|127.0] "Unitless" ZCUP
 SG_ Zone3SettingsRed : 207|8@0+ (1.0,0.0) [0.0|255.0] "Unitless" ZCUP
 SG_ Zone3SettingsZoneStatus : 208|1@0+ (1,0) [0|1] "" ZCUP

BO_ 66 DhuZCUCANFD2Fr18 : 64 IHU
 SG_ ApproachReq_UB : 185|1@0+ (1,0) [0|1] "" ZCUD
 SG_ ApproachReqData1 : 199|8@0+ (1.0,0.0) [0.0|255.0] "Unitless" ZCUD
 SG_ ApproachReqData10 : 271|8@0+ (1.0,0.0) [0.0|255.0] "Unitless" ZCUD
 SG_ ApproachReqData11 : 279|8@0+ (1.0,0.0) [0.0|255.0] "Unitless" ZCUD
 SG_ ApproachReqData12 : 287|8@0+ (1.0,0.0) [0.0|255.0] "Unitless" ZCUD
 SG_ ApproachReqData13 : 295|8@0+ (1.0,0.0) [0.0|255.0] "Unitless" ZCUD
 SG_ ApproachReqData14 : 303|8@0+ (1.0,0.0) [0.0|255.0] "Unitless" ZCUD
 SG_ ApproachReqData15 : 311|8@0+ (1.0,0.0) [0.0|255.0] "Unitless" ZCUD
 SG_ ApproachReqData16 : 319|8@0+ (1.0,0.0) [0.0|255.0] "Unitless" ZCUD
 SG_ ApproachReqData2 : 207|8@0+ (1.0,0.0) [0.0|255.0] "Unitless" ZCUD
 SG_ ApproachReqData3 : 215|8@0+ (1.0,0.0) [0.0|255.0] "Unitless" ZCUD
 SG_ ApproachReqData4 : 223|8@0+ (1.0,0.0) [0.0|255.0] "Unitless" ZCUD
 SG_ ApproachReqData5 : 231|8@0+ (1.0,0.0) [0.0|255.0] "Unitless" ZCUD
 SG_ ApproachReqData6 : 239|8@0+ (1.0,0.0) [0.0|255.0] "Unitless" ZCUD
 SG_ ApproachReqData7 : 247|8@0+ (1.0,0.0) [0.0|255.0] "Unitless" ZCUD
 SG_ ApproachReqData8 : 255|8@0+ (1.0,0.0) [0.0|255.0] "Unitless" ZCUD
 SG_ ApproachReqData9 : 263|8@0+ (1.0,0.0) [0.0|255.0] "Unitless" ZCUD
 SG_ DchaChrgnTarVal : 135|10@0+ (0.1,0.0) [0.0|100.0] "%" ZCUD
 SG_ DchaChrgnTarVal_UB : 125|1@0+ (1,0) [0|1] "" ZCUD
 SG_ DChaEngStsCtrl : 65|2@0+ (1,0) [0|3] "" ZCUD
 SG_ DChaEngStsCtrl_UB : 162|1@0+ (1,0) [0|1] "" ZCUD
 SG_ DstFromDestination : 137|10@0+ (1.0,0.0) [0.0|1023.0] "Unitless" ZCUD
 SG_ DstFromDestination_UB : 123|1@0+ (1,0) [0|1] "" ZCUD
 SG_ HVPwrDwnRstReq : 115|1@0+ (1,0) [0|1] "" ZCUD
 SG_ HVPwrDwnRstReq_UB : 124|1@0+ (1,0) [0|1] "" ZCUD
 SG_ PrpsnHvBattUsgOfChrgTarSOC : 159|10@0+ (0.1,0.0) [0.0|100.0] "%" ZCUD
 SG_ PrpsnHvBattUsgOfChrgTarSOC_UB : 126|1@0+ (1,0) [0|1] "" ZCUD
 SG_ ReadLiOpenReq_UB : 127|1@0+ (1,0) [0|1] "" ZCUD
 SG_ ReadLiOpenReqFrontLeft : 79|2@0+ (1,0) [0|3] "" ZCUD
 SG_ ReadLiOpenReqFrontRight : 77|2@0+ (1,0) [0|3] "" ZCUD
 SG_ ReadLiOpenReqSecondRowLeft : 75|2@0+ (1,0) [0|3] "" ZCUD
 SG_ ReadLiOpenReqSecondRowRight : 73|2@0+ (1,0) [0|3] "" ZCUD
 SG_ ReadLiOpenReqThirdRowLeft : 87|2@0+ (1,0) [0|3] "" ZCUD
 SG_ ReadLiOpenReqThirdRowRight : 85|2@0+ (1,0) [0|3] "" ZCUD
 SG_ RemBookChrgnTarVal : 161|10@0+ (0.1,0.0) [0.0|100.0] "%" ZCUD
 SG_ RemBookChrgnTarVal_UB : 163|1@0+ (1,0) [0|1] "" ZCUD
 SG_ RKEAndNFCReqSts_UB : 184|1@0+ (1,0) [0|1] "" ZCUD
 SG_ RKEAndNFCReqStsData1 : 327|8@0+ (1.0,0.0) [0.0|255.0] "Unitless" ZCUD
 SG_ RKEAndNFCReqStsData10 : 399|8@0+ (1.0,0.0) [0.0|255.0] "Unitless" ZCUD
 SG_ RKEAndNFCReqStsData11 : 407|8@0+ (1.0,0.0) [0.0|255.0] "Unitless" ZCUD
 SG_ RKEAndNFCReqStsData12 : 415|8@0+ (1.0,0.0) [0.0|255.0] "Unitless" ZCUD
 SG_ RKEAndNFCReqStsData13 : 423|8@0+ (1.0,0.0) [0.0|255.0] "Unitless" ZCUD
 SG_ RKEAndNFCReqStsData14 : 431|8@0+ (1.0,0.0) [0.0|255.0] "Unitless" ZCUD
 SG_ RKEAndNFCReqStsData15 : 439|8@0+ (1.0,0.0) [0.0|255.0] "Unitless" ZCUD
 SG_ RKEAndNFCReqStsData16 : 447|8@0+ (1.0,0.0) [0.0|255.0] "Unitless" ZCUD
 SG_ RKEAndNFCReqStsData2 : 335|8@0+ (1.0,0.0) [0.0|255.0] "Unitless" ZCUD
 SG_ RKEAndNFCReqStsData3 : 343|8@0+ (1.0,0.0) [0.0|255.0] "Unitless" ZCUD
 SG_ RKEAndNFCReqStsData4 : 351|8@0+ (1.0,0.0) [0.0|255.0] "Unitless" ZCUD
 SG_ RKEAndNFCReqStsData5 : 359|8@0+ (1.0,0.0) [0.0|255.0] "Unitless" ZCUD
 SG_ RKEAndNFCReqStsData6 : 367|8@0+ (1.0,0.0) [0.0|255.0] "Unitless" ZCUD
 SG_ RKEAndNFCReqStsData7 : 375|8@0+ (1.0,0.0) [0.0|255.0] "Unitless" ZCUD
 SG_ RKEAndNFCReqStsData8 : 383|8@0+ (1.0,0.0) [0.0|255.0] "Unitless" ZCUD
 SG_ RKEAndNFCReqStsData9 : 391|8@0+ (1.0,0.0) [0.0|255.0] "Unitless" ZCUD
 SG_ TopPosTrFromHmi : 106|3@0+ (1,0) [0|7] "" ZCUD
 SG_ TopPosTrFromHmi_UB : 186|1@0+ (1,0) [0|1] "" ZCUD
 SG_ UsrSpeechSts : 113|1@0+ (1,0) [0|1] "" ZCUD
 SG_ UsrSpeechSts_UB : 187|1@0+ (1,0) [0|1] "" ZCUD
 SG_ WinOpenAppReq_UB : 164|1@0+ (1,0) [0|1] "" ZCUD,ZCUP
 SG_ WinOpenAppReqWindowOpenValue : 183|8@0+ (1.0,0.0) [0.0|100.0] "%" ZCUD,ZCUP
 SG_ WinOpenAppReqWinOpenClsGlbSts : 191|2@0+ (1,0) [0|3] "" ZCUD,ZCUP

BO_ 272 DhuZCUCANFD2Fr19 : 64 IHU
 SG_ BookTrvlClimaActvReq : 7|2@0+ (1,0) [0|3] "" ZCUP
 SG_ BookTrvlClimaActvReq_UB : 26|1@0+ (1,0) [0|1] "" ZCUP
 SG_ CarFindrHornLiReqFromTelm : 5|2@0+ (1,0) [0|3] "" ZCUD
 SG_ CarFindrHornLiReqFromTelm_UB : 24|1@0+ (1,0) [0|1] "" ZCUD
 SG_ CbnOverHeatProtnEnaFromTelm : 0|1@0+ (1,0) [0|1] "" ZCUP
 SG_ CbnOverHeatProtnEnaFromTelm_UB : 39|1@0+ (1,0) [0|1] "" ZCUP
 SG_ ChrgLidTelmLockgReq : 9|1@0+ (1,0) [0|1] "" ZCUD
 SG_ ChrgLidTelmLockgReq_UB : 38|1@0+ (1,0) [0|1] "" ZCUD
 SG_ ClimaRqrd1 : 23|2@0+ (1,0) [0|3] "" ZCUP
 SG_ ClimaRqrd1_UB : 33|1@0+ (1,0) [0|1] "" ZCUP
 SG_ ClimaTmrStsTelmRqrd : 19|1@0+ (1,0) [0|1] "" ZCUP
 SG_ ClimaTmrStsTelmRqrd_UB : 32|1@0+ (1,0) [0|1] "" ZCUP
 SG_ EmgyAsscTrigSts : 21|2@0+ (1,0) [0|3] "" ZCUD
 SG_ EmgyAsscTrigSts_UB : 47|1@0+ (1,0) [0|1] "" ZCUD
 SG_ EngForbidReqFromTelm : 18|1@0+ (1,0) [0|1] "" ZCUD
 SG_ EngForbidReqFromTelm_UB : 46|1@0+ (1,0) [0|1] "" ZCUD
 SG_ EngPermitReqFromTelm : 17|1@0+ (1,0) [0|1] "" ZCUD
 SG_ EngPermitReqFromTelm_UB : 45|1@0+ (1,0) [0|1] "" ZCUD
 SG_ ExtrLiShowActvnReq : 16|1@0+ (1,0) [0|1] "" ZCUD,ZCUP
 SG_ ExtrLiShowActvnReq_UB : 44|1@0+ (1,0) [0|1] "" ZCUD,ZCUP
 SG_ ExtrLiShowFileTxReq : 29|1@0+ (1,0) [0|1] "" ZCUD
 SG_ ExtrLiShowFileTxReq_UB : 43|1@0+ (1,0) [0|1] "" ZCUD
 SG_ FreqencyChargn : 31|2@0+ (1,0) [0|3] "" ZCUD
 SG_ FreqencyChargn_UB : 42|1@0+ (1,0) [0|1] "" ZCUD
 SG_ RemCtrlLoUPwrOutpReq_UB : 297|1@0+ (1,0) [0|1] "" Vector__XXX
 SG_ RemCtrlLoUPwrOutpReqZone1 : 311|2@0+ (1,0) [0|3] "" Vector__XXX
 SG_ RemCtrlLoUPwrOutpReqZone2 : 309|2@0+ (1,0) [0|3] "" Vector__XXX
 SG_ RemCtrlLoUPwrOutpReqZone3 : 307|2@0+ (1,0) [0|3] "" Vector__XXX
 SG_ RemCtrlLoUPwrOutpReqZone4 : 305|2@0+ (1,0) [0|3] "" Vector__XXX
 SG_ RemCtrlLoUPwrOutpReqZone5 : 319|2@0+ (1,0) [0|3] "" Vector__XXX
 SG_ RemCtrlLoUPwrOutpReqZone6 : 317|2@0+ (1,0) [0|3] "" Vector__XXX
 SG_ TelmDefrostTmr : 79|16@0+ (1.0,0.0) [0.0|65535.0] "s" ZCUP
 SG_ TelmDefrostTmr_UB : 71|1@0+ (1,0) [0|1] "" ZCUP
 SG_ TelmSeatHeatDrvrTmr : 95|16@0+ (1.0,0.0) [0.0|65535.0] "s" ZCUP
 SG_ TelmSeatHeatDrvrTmr_UB : 70|1@0+ (1,0) [0|1] "" ZCUP
 SG_ TelmSeatHeatPassTmr : 111|16@0+ (1.0,0.0) [0.0|65535.0] "s" ZCUP
 SG_ TelmSeatHeatPassTmr_UB : 69|1@0+ (1,0) [0|1] "" ZCUP
 SG_ TelmSeatHeatSecLeTmr : 127|16@0+ (1.0,0.0) [0.0|65535.0] "s" ZCUP
 SG_ TelmSeatHeatSecLeTmr_UB : 68|1@0+ (1,0) [0|1] "" ZCUP
 SG_ TelmSeatHeatSecRiTmr : 143|16@0+ (1.0,0.0) [0.0|65535.0] "s" ZCUP
 SG_ TelmSeatHeatSecRiTmr_UB : 67|1@0+ (1,0) [0|1] "" ZCUP
 SG_ TelmSeatHeatThrdLeTmr : 159|16@0+ (1.0,0.0) [0.0|65535.0] "s" ZCUP
 SG_ TelmSeatHeatThrdLeTmr_UB : 66|1@0+ (1,0) [0|1] "" ZCUP
 SG_ TelmSeatHeatThrdRiTmr : 175|16@0+ (1.0,0.0) [0.0|65535.0] "s" ZCUP
 SG_ TelmSeatHeatThrdRiTmr_UB : 65|1@0+ (1,0) [0|1] "" ZCUP
 SG_ TelmSeatVentnDrvrTmr : 191|16@0+ (1.0,0.0) [0.0|65535.0] "s" ZCUP
 SG_ TelmSeatVentnDrvrTmr_UB : 64|1@0+ (1,0) [0|1] "" ZCUP
 SG_ TelmSeatVentnPassTmr : 207|16@0+ (1.0,0.0) [0.0|65535.0] "s" ZCUP
 SG_ TelmSeatVentnPassTmr_UB : 303|1@0+ (1,0) [0|1] "" ZCUP
 SG_ TelmSeatVentnSecLeTmr : 223|16@0+ (1.0,0.0) [0.0|65535.0] "s" ZCUP
 SG_ TelmSeatVentnSecLeTmr_UB : 302|1@0+ (1,0) [0|1] "" ZCUP
 SG_ TelmSeatVentnSecRiTmr : 239|16@0+ (1.0,0.0) [0.0|65535.0] "s" ZCUP
 SG_ TelmSeatVentnSecRiTmr_UB : 301|1@0+ (1,0) [0|1] "" ZCUP
 SG_ TelmSeatVentnThrdLeTmr : 255|16@0+ (1.0,0.0) [0.0|65535.0] "s" ZCUP
 SG_ TelmSeatVentnThrdLeTmr_UB : 300|1@0+ (1,0) [0|1] "" ZCUP
 SG_ TelmSeatVentnThrdRiTmr : 271|16@0+ (1.0,0.0) [0.0|65535.0] "s" ZCUP
 SG_ TelmSeatVentnThrdRiTmr_UB : 299|1@0+ (1,0) [0|1] "" ZCUP
 SG_ TelmSteerWhlHeatTmr : 287|16@0+ (1.0,0.0) [0.0|65535.0] "s" ZCUP
 SG_ TelmSteerWhlHeatTmr_UB : 298|1@0+ (1,0) [0|1] "" ZCUP
 SG_ TelmThermoTankReq1 : 41|2@0+ (1,0) [0|3] "" ZCUD
 SG_ TelmThermoTankReq1_UB : 56|1@0+ (1,0) [0|1] "" ZCUD
 SG_ TelmThermoTankT : 55|8@0+ (1.0,-50.0) [-50.0|205.0] "degC" ZCUD
 SG_ TelmThermoTankT_UB : 63|1@0+ (1,0) [0|1] "" ZCUD
 SG_ TelmThermoTankTmr1 : 62|5@0+ (1.0,0.0) [0.0|31.0] "hours" ZCUD
 SG_ TelmThermoTankTmr1_UB : 57|1@0+ (1,0) [0|1] "" ZCUD

BO_ 74 DhuZCUCANFD2Fr20 : 64 IHU
 SG_ BLEKeySearchResp_UB : 391|1@0+ (1,0) [0|1] "" ZCUD
 SG_ BLEKeySearchRespData1 : 7|8@0+ (1.0,0.0) [0.0|255.0] "Unitless" ZCUD
 SG_ BLEKeySearchRespData10 : 79|8@0+ (1.0,0.0) [0.0|255.0] "Unitless" ZCUD
 SG_ BLEKeySearchRespData11 : 87|8@0+ (1.0,0.0) [0.0|255.0] "Unitless" ZCUD
 SG_ BLEKeySearchRespData12 : 95|8@0+ (1.0,0.0) [0.0|255.0] "Unitless" ZCUD
 SG_ BLEKeySearchRespData13 : 103|8@0+ (1.0,0.0) [0.0|255.0] "Unitless" ZCUD
 SG_ BLEKeySearchRespData14 : 111|8@0+ (1.0,0.0) [0.0|255.0] "Unitless" ZCUD
 SG_ BLEKeySearchRespData15 : 119|8@0+ (1.0,0.0) [0.0|255.0] "Unitless" ZCUD
 SG_ BLEKeySearchRespData16 : 127|8@0+ (1.0,0.0) [0.0|255.0] "Unitless" ZCUD
 SG_ BLEKeySearchRespData2 : 15|8@0+ (1.0,0.0) [0.0|255.0] "Unitless" ZCUD
 SG_ BLEKeySearchRespData3 : 23|8@0+ (1.0,0.0) [0.0|255.0] "Unitless" ZCUD
 SG_ BLEKeySearchRespData4 : 31|8@0+ (1.0,0.0) [0.0|255.0] "Unitless" ZCUD
 SG_ BLEKeySearchRespData5 : 39|8@0+ (1.0,0.0) [0.0|255.0] "Unitless" ZCUD
 SG_ BLEKeySearchRespData6 : 47|8@0+ (1.0,0.0) [0.0|255.0] "Unitless" ZCUD
 SG_ BLEKeySearchRespData7 : 55|8@0+ (1.0,0.0) [0.0|255.0] "Unitless" ZCUD
 SG_ BLEKeySearchRespData8 : 63|8@0+ (1.0,0.0) [0.0|255.0] "Unitless" ZCUD
 SG_ BLEKeySearchRespData9 : 71|8@0+ (1.0,0.0) [0.0|255.0] "Unitless" ZCUD
 SG_ NFCAndBLEKeyEnaSts_UB : 390|1@0+ (1,0) [0|1] "" ZCUD
 SG_ NFCAndBLEKeyEnaStsData1 : 135|8@0+ (1.0,0.0) [0.0|255.0] "Unitless" ZCUD
 SG_ NFCAndBLEKeyEnaStsData10 : 207|8@0+ (1.0,0.0) [0.0|255.0] "Unitless" ZCUD
 SG_ NFCAndBLEKeyEnaStsData11 : 215|8@0+ (1.0,0.0) [0.0|255.0] "Unitless" ZCUD
 SG_ NFCAndBLEKeyEnaStsData12 : 223|8@0+ (1.0,0.0) [0.0|255.0] "Unitless" ZCUD
 SG_ NFCAndBLEKeyEnaStsData13 : 231|8@0+ (1.0,0.0) [0.0|255.0] "Unitless" ZCUD
 SG_ NFCAndBLEKeyEnaStsData14 : 239|8@0+ (1.0,0.0) [0.0|255.0] "Unitless" ZCUD
 SG_ NFCAndBLEKeyEnaStsData15 : 247|8@0+ (1.0,0.0) [0.0|255.0] "Unitless" ZCUD
 SG_ NFCAndBLEKeyEnaStsData16 : 255|8@0+ (1.0,0.0) [0.0|255.0] "Unitless" ZCUD
 SG_ NFCAndBLEKeyEnaStsData2 : 143|8@0+ (1.0,0.0) [0.0|255.0] "Unitless" ZCUD
 SG_ NFCAndBLEKeyEnaStsData3 : 151|8@0+ (1.0,0.0) [0.0|255.0] "Unitless" ZCUD
 SG_ NFCAndBLEKeyEnaStsData4 : 159|8@0+ (1.0,0.0) [0.0|255.0] "Unitless" ZCUD
 SG_ NFCAndBLEKeyEnaStsData5 : 167|8@0+ (1.0,0.0) [0.0|255.0] "Unitless" ZCUD
 SG_ NFCAndBLEKeyEnaStsData6 : 175|8@0+ (1.0,0.0) [0.0|255.0] "Unitless" ZCUD
 SG_ NFCAndBLEKeyEnaStsData7 : 183|8@0+ (1.0,0.0) [0.0|255.0] "Unitless" ZCUD
 SG_ NFCAndBLEKeyEnaStsData8 : 191|8@0+ (1.0,0.0) [0.0|255.0] "Unitless" ZCUD
 SG_ NFCAndBLEKeyEnaStsData9 : 199|8@0+ (1.0,0.0) [0.0|255.0] "Unitless" ZCUD
 SG_ NFCKeySearchResp_UB : 389|1@0+ (1,0) [0|1] "" ZCUD
 SG_ NFCKeySearchRespData1 : 263|8@0+ (1.0,0.0) [0.0|255.0] "Unitless" ZCUD
 SG_ NFCKeySearchRespData10 : 335|8@0+ (1.0,0.0) [0.0|255.0] "Unitless" ZCUD
 SG_ NFCKeySearchRespData11 : 343|8@0+ (1.0,0.0) [0.0|255.0] "Unitless" ZCUD
 SG_ NFCKeySearchRespData12 : 351|8@0+ (1.0,0.0) [0.0|255.0] "Unitless" ZCUD
 SG_ NFCKeySearchRespData13 : 359|8@0+ (1.0,0.0) [0.0|255.0] "Unitless" ZCUD
 SG_ NFCKeySearchRespData14 : 367|8@0+ (1.0,0.0) [0.0|255.0] "Unitless" ZCUD
 SG_ NFCKeySearchRespData15 : 375|8@0+ (1.0,0.0) [0.0|255.0] "Unitless" ZCUD
 SG_ NFCKeySearchRespData16 : 383|8@0+ (1.0,0.0) [0.0|255.0] "Unitless" ZCUD
 SG_ NFCKeySearchRespData2 : 271|8@0+ (1.0,0.0) [0.0|255.0] "Unitless" ZCUD
 SG_ NFCKeySearchRespData3 : 279|8@0+ (1.0,0.0) [0.0|255.0] "Unitless" ZCUD
 SG_ NFCKeySearchRespData4 : 287|8@0+ (1.0,0.0) [0.0|255.0] "Unitless" ZCUD
 SG_ NFCKeySearchRespData5 : 295|8@0+ (1.0,0.0) [0.0|255.0] "Unitless" ZCUD
 SG_ NFCKeySearchRespData6 : 303|8@0+ (1.0,0.0) [0.0|255.0] "Unitless" ZCUD
 SG_ NFCKeySearchRespData7 : 311|8@0+ (1.0,0.0) [0.0|255.0] "Unitless" ZCUD
 SG_ NFCKeySearchRespData8 : 319|8@0+ (1.0,0.0) [0.0|255.0] "Unitless" ZCUD
 SG_ NFCKeySearchRespData9 : 327|8@0+ (1.0,0.0) [0.0|255.0] "Unitless" ZCUD

BO_ 293 DhuZCUCANFD2Fr21 : 64 IHU
 SG_ AutoHldTechLiEna : 377|1@0+ (1,0) [0|1] "" ZCUD
 SG_ AutoHldTechLiEna_UB : 376|1@0+ (1,0) [0|1] "" ZCUD
 SG_ ChdLockCmnCtrlHmiReq : 418|2@0+ (1,0) [0|3] "" ZCUD
 SG_ ChdLockCmnCtrlHmiReq_UB : 427|1@0+ (1,0) [0|1] "" ZCUD
 SG_ DrvModReqForChampnMod : 7|3@0+ (1,0) [0|7] "" ZCUD
 SG_ DrvModReqForChampnMod_UB : 4|1@0+ (1,0) [0|1] "" ZCUD
 SG_ DrvrLineOfSightSts : 407|4@0+ (1.0,0.0) [0.0|15.0] "Unitless" ZCUD
 SG_ DrvrLineOfSightSts_UB : 403|1@0+ (1,0) [0|1] "" ZCUD
 SG_ LowrTailgOpenHmiReq : 402|2@0+ (1,0) [0|3] "" ZCUD
 SG_ LowrTailgOpenHmiReq_UB : 400|1@0+ (1,0) [0|1] "" ZCUD
 SG_ MusicInfoSeg11_UB : 0|1@0+ (1,0) [0|1] "" ZCUP
 SG_ MusicInfoSeg11SegFftLiShow1 : 15|4@0+ (1.0,0.0) [0.0|15.0] "Unitless" ZCUP
 SG_ MusicInfoSeg11SegFftLiShow10 : 43|4@0+ (1.0,0.0) [0.0|15.0] "Unitless" ZCUP
 SG_ MusicInfoSeg11SegFftLiShow11 : 55|4@0+ (1.0,0.0) [0.0|15.0] "Unitless" ZCUP
 SG_ MusicInfoSeg11SegFftLiShow12 : 51|4@0+ (1.0,0.0) [0.0|15.0] "Unitless" ZCUP
 SG_ MusicInfoSeg11SegFftLiShow13 : 63|4@0+ (1.0,0.0) [0.0|15.0] "Unitless" ZCUP
 SG_ MusicInfoSeg11SegFftLiShow14 : 59|4@0+ (1.0,0.0) [0.0|15.0] "Unitless" ZCUP
 SG_ MusicInfoSeg11SegFftLiShow2 : 11|4@0+ (1.0,0.0) [0.0|15.0] "Unitless" ZCUP
 SG_ MusicInfoSeg11SegFftLiShow3 : 23|4@0+ (1.0,0.0) [0.0|15.0] "Unitless" ZCUP
 SG_ MusicInfoSeg11SegFftLiShow4 : 19|4@0+ (1.0,0.0) [0.0|15.0] "Unitless" ZCUP
 SG_ MusicInfoSeg11SegFftLiShow5 : 31|4@0+ (1.0,0.0) [0.0|15.0] "Unitless" ZCUP
 SG_ MusicInfoSeg11SegFftLiShow6 : 27|4@0+ (1.0,0.0) [0.0|15.0] "Unitless" ZCUP
 SG_ MusicInfoSeg11SegFftLiShow7 : 39|4@0+ (1.0,0.0) [0.0|15.0] "Unitless" ZCUP
 SG_ MusicInfoSeg11SegFftLiShow8 : 35|4@0+ (1.0,0.0) [0.0|15.0] "Unitless" ZCUP
 SG_ MusicInfoSeg11SegFftLiShow9 : 47|4@0+ (1.0,0.0) [0.0|15.0] "Unitless" ZCUP
 SG_ MusicInfoSeg11TimeFlagMessage : 71|4@0+ (1.0,0.0) [0.0|15.0] "Unitless" ZCUP
 SG_ MusicInfoSeg11TimeFlagMusicplay : 67|4@0+ (1.0,0.0) [0.0|15.0] "Unitless" ZCUP
 SG_ MusicInfoSeg12_UB : 1|1@0+ (1,0) [0|1] "" ZCUP
 SG_ MusicInfoSeg12SegFftLiShow15 : 79|4@0+ (1.0,0.0) [0.0|15.0] "Unitless" ZCUP
 SG_ MusicInfoSeg12SegFftLiShow16 : 75|4@0+ (1.0,0.0) [0.0|15.0] "Unitless" ZCUP
 SG_ MusicInfoSeg12SegFftLiShow17 : 87|4@0+ (1.0,0.0) [0.0|15.0] "Unitless" ZCUP
 SG_ MusicInfoSeg12SegFftLiShow18 : 83|4@0+ (1.0,0.0) [0.0|15.0] "Unitless" ZCUP
 SG_ MusicInfoSeg12SegFftLiShow19 : 95|4@0+ (1.0,0.0) [0.0|15.0] "Unitless" ZCUP
 SG_ MusicInfoSeg12SegFftLiShow20 : 91|4@0+ (1.0,0.0) [0.0|15.0] "Unitless" ZCUP
 SG_ MusicInfoSeg12SegFftLiShow21 : 103|4@0+ (1.0,0.0) [0.0|15.0] "Unitless" ZCUP
 SG_ MusicInfoSeg12SegFftLiShow22 : 99|4@0+ (1.0,0.0) [0.0|15.0] "Unitless" ZCUP
 SG_ MusicInfoSeg12SegFftLiShow23 : 111|4@0+ (1.0,0.0) [0.0|15.0] "Unitless" ZCUP
 SG_ MusicInfoSeg12SegFftLiShow24 : 107|4@0+ (1.0,0.0) [0.0|15.0] "Unitless" ZCUP
 SG_ MusicInfoSeg12SegFftLiShow25 : 119|4@0+ (1.0,0.0) [0.0|15.0] "Unitless" ZCUP
 SG_ MusicInfoSeg12SegFftLiShow26 : 115|4@0+ (1.0,0.0) [0.0|15.0] "Unitless" ZCUP
 SG_ MusicInfoSeg12SegFftLiShow27 : 127|4@0+ (1.0,0.0) [0.0|15.0] "Unitless" ZCUP
 SG_ MusicInfoSeg12SegFftLiShow28 : 123|4@0+ (1.0,0.0) [0.0|15.0] "Unitless" ZCUP
 SG_ MusicInfoSeg12TimeFlagMessage : 135|4@0+ (1.0,0.0) [0.0|15.0] "Unitless" ZCUP
 SG_ MusicInfoSeg12TimeFlagMusicplay : 131|4@0+ (1.0,0.0) [0.0|15.0] "Unitless" ZCUP
 SG_ MusicInfoSeg13_UB : 297|1@0+ (1,0) [0|1] "" ZCUP
 SG_ MusicInfoSeg13DownSamplingAmplitude : 271|4@0+ (1.0,0.0) [0.0|15.0] "Unitless" ZCUP
 SG_ MusicInfoSeg13MaxFFT100ms3kAmplitude : 267|4@0+ (1.0,0.0) [0.0|15.0] "Unitless" ZCUP
 SG_ MusicInfoSeg13MaxFFT100ms3kFrequency : 279|8@0+ (1.0,0.0) [0.0|255.0] "Unitless" ZCUP
 SG_ MusicInfoSeg13SegFftLiShow29 : 287|4@0+ (1.0,0.0) [0.0|15.0] "Unitless" ZCUP
 SG_ MusicInfoSeg13SegFftLiShow30 : 283|4@0+ (1.0,0.0) [0.0|15.0] "Unitless" ZCUP
 SG_ MusicInfoSeg13SegFftLiShow31 : 295|4@0+ (1.0,0.0) [0.0|15.0] "Unitless" ZCUP
 SG_ MusicInfoSeg13StateFlagMusicPlay : 299|1@0+ (1,0) [0|1] "" ZCUP
 SG_ MusicInfoSeg13StateFlagNewMusic : 298|1@0+ (1,0) [0|1] "" ZCUP
 SG_ MusicInfoSeg13TimeFlagMessage : 291|4@0+ (1.0,0.0) [0.0|15.0] "Unitless" ZCUP
 SG_ MusicInfoSeg13TimeFlagMusicplay : 303|4@0+ (1.0,0.0) [0.0|15.0] "Unitless" ZCUP
 SG_ MusicInfoSeg21_UB : 2|1@0+ (1,0) [0|1] "" ZCUP
 SG_ MusicInfoSeg21SegFftLiShow1 : 143|4@0+ (1.0,0.0) [0.0|15.0] "Unitless" ZCUP
 SG_ MusicInfoSeg21SegFftLiShow10 : 171|4@0+ (1.0,0.0) [0.0|15.0] "Unitless" ZCUP
 SG_ MusicInfoSeg21SegFftLiShow11 : 183|4@0+ (1.0,0.0) [0.0|15.0] "Unitless" ZCUP
 SG_ MusicInfoSeg21SegFftLiShow12 : 179|4@0+ (1.0,0.0) [0.0|15.0] "Unitless" ZCUP
 SG_ MusicInfoSeg21SegFftLiShow13 : 191|4@0+ (1.0,0.0) [0.0|15.0] "Unitless" ZCUP
 SG_ MusicInfoSeg21SegFftLiShow14 : 187|4@0+ (1.0,0.0) [0.0|15.0] "Unitless" ZCUP
 SG_ MusicInfoSeg21SegFftLiShow2 : 139|4@0+ (1.0,0.0) [0.0|15.0] "Unitless" ZCUP
 SG_ MusicInfoSeg21SegFftLiShow3 : 151|4@0+ (1.0,0.0) [0.0|15.0] "Unitless" ZCUP
 SG_ MusicInfoSeg21SegFftLiShow4 : 147|4@0+ (1.0,0.0) [0.0|15.0] "Unitless" ZCUP
 SG_ MusicInfoSeg21SegFftLiShow5 : 159|4@0+ (1.0,0.0) [0.0|15.0] "Unitless" ZCUP
 SG_ MusicInfoSeg21SegFftLiShow6 : 155|4@0+ (1.0,0.0) [0.0|15.0] "Unitless" ZCUP
 SG_ MusicInfoSeg21SegFftLiShow7 : 167|4@0+ (1.0,0.0) [0.0|15.0] "Unitless" ZCUP
 SG_ MusicInfoSeg21SegFftLiShow8 : 163|4@0+ (1.0,0.0) [0.0|15.0] "Unitless" ZCUP
 SG_ MusicInfoSeg21SegFftLiShow9 : 175|4@0+ (1.0,0.0) [0.0|15.0] "Unitless" ZCUP
 SG_ MusicInfoSeg21TimeFlagMessage : 199|4@0+ (1.0,0.0) [0.0|15.0] "Unitless" ZCUP
 SG_ MusicInfoSeg21TimeFlagMusicplay : 195|4@0+ (1.0,0.0) [0.0|15.0] "Unitless" ZCUP
 SG_ MusicInfoSeg22_UB : 3|1@0+ (1,0) [0|1] "" ZCUP
 SG_ MusicInfoSeg22SegFftLiShow15 : 207|4@0+ (1.0,0.0) [0.0|15.0] "Unitless" ZCUP
 SG_ MusicInfoSeg22SegFftLiShow16 : 203|4@0+ (1.0,0.0) [0.0|15.0] "Unitless" ZCUP
 SG_ MusicInfoSeg22SegFftLiShow17 : 215|4@0+ (1.0,0.0) [0.0|15.0] "Unitless" ZCUP
 SG_ MusicInfoSeg22SegFftLiShow18 : 211|4@0+ (1.0,0.0) [0.0|15.0] "Unitless" ZCUP
 SG_ MusicInfoSeg22SegFftLiShow19 : 223|4@0+ (1.0,0.0) [0.0|15.0] "Unitless" ZCUP
 SG_ MusicInfoSeg22SegFftLiShow20 : 219|4@0+ (1.0,0.0) [0.0|15.0] "Unitless" ZCUP
 SG_ MusicInfoSeg22SegFftLiShow21 : 231|4@0+ (1.0,0.0) [0.0|15.0] "Unitless" ZCUP
 SG_ MusicInfoSeg22SegFftLiShow22 : 227|4@0+ (1.0,0.0) [0.0|15.0] "Unitless" ZCUP
 SG_ MusicInfoSeg22SegFftLiShow23 : 239|4@0+ (1.0,0.0) [0.0|15.0] "Unitless" ZCUP
 SG_ MusicInfoSeg22SegFftLiShow24 : 235|4@0+ (1.0,0.0) [0.0|15.0] "Unitless" ZCUP
 SG_ MusicInfoSeg22SegFftLiShow25 : 247|4@0+ (1.0,0.0) [0.0|15.0] "Unitless" ZCUP
 SG_ MusicInfoSeg22SegFftLiShow26 : 243|4@0+ (1.0,0.0) [0.0|15.0] "Unitless" ZCUP
 SG_ MusicInfoSeg22SegFftLiShow27 : 255|4@0+ (1.0,0.0) [0.0|15.0] "Unitless" ZCUP
 SG_ MusicInfoSeg22SegFftLiShow28 : 251|4@0+ (1.0,0.0) [0.0|15.0] "Unitless" ZCUP
 SG_ MusicInfoSeg22TimeFlagMessage : 263|4@0+ (1.0,0.0) [0.0|15.0] "Unitless" ZCUP
 SG_ MusicInfoSeg22TimeFlagMusicplay : 259|4@0+ (1.0,0.0) [0.0|15.0] "Unitless" ZCUP
 SG_ MusicInfoSeg23_UB : 296|1@0+ (1,0) [0|1] "" ZCUP
 SG_ MusicInfoSeg23DownSamplingAmplitude : 311|4@0+ (1.0,0.0) [0.0|15.0] "Unitless" ZCUP
 SG_ MusicInfoSeg23MaxFFT100ms3kAmplitude : 307|4@0+ (1.0,0.0) [0.0|15.0] "Unitless" ZCUP
 SG_ MusicInfoSeg23MaxFFT100ms3kFrequency : 319|8@0+ (1.0,0.0) [0.0|255.0] "Unitless" ZCUP
 SG_ MusicInfoSeg23SegFftLiShow29 : 327|4@0+ (1.0,0.0) [0.0|15.0] "Unitless" ZCUP
 SG_ MusicInfoSeg23SegFftLiShow30 : 323|4@0+ (1.0,0.0) [0.0|15.0] "Unitless" ZCUP
 SG_ MusicInfoSeg23SegFftLiShow31 : 335|4@0+ (1.0,0.0) [0.0|15.0] "Unitless" ZCUP
 SG_ MusicInfoSeg23StateFlagMusicPlay : 339|1@0+ (1,0) [0|1] "" ZCUP
 SG_ MusicInfoSeg23StateFlagNewMusic : 338|1@0+ (1,0) [0|1] "" ZCUP
 SG_ MusicInfoSeg23TimeFlagMessage : 331|4@0+ (1.0,0.0) [0.0|15.0] "Unitless" ZCUP
 SG_ MusicInfoSeg23TimeFlagMusicplay : 343|4@0+ (1.0,0.0) [0.0|15.0] "Unitless" ZCUP
 SG_ PrkgLiShowSwt : 337|2@0+ (1,0) [0|3] "" ZCUD
 SG_ PrkgLiShowSwt_UB : 351|1@0+ (1,0) [0|1] "" ZCUD
 SG_ RowSecRiSeatZeroGrvySwtReq : 421|2@0+ (1,0) [0|3] "" ZCUD
 SG_ RowSecRiSeatZeroGrvySwtReq_UB : 419|1@0+ (1,0) [0|1] "" ZCUD
 SG_ SunroofGlassAutAdjmtHmiReq : 365|2@0+ (1,0) [0|3] "" ZCUD
 SG_ SunroofGlassAutAdjmtHmiReq_UB : 363|1@0+ (1,0) [0|1] "" ZCUD
 SG_ SunroofTransparencyReq : 375|8@0+ (1.0,0.0) [0.0|255.0] "Unitless" ZCUD
 SG_ SunroofTransparencyReq_UB : 383|1@0+ (1,0) [0|1] "" ZCUD
 SG_ VoiceCtrlMirror_UB : 422|1@0+ (1,0) [0|1] "" ZCUD,ZCUP
 SG_ VoiceCtrlMirrorDirection : 409|2@0+ (1,0) [0|3] "" ZCUD,ZCUP
 SG_ VoiceCtrlMirrorParams : 415|6@0+ (1,0) [0|63] "" ZCUD,ZCUP
 SG_ VoiceCtrlMirrorSide : 423|1@0+ (1,0) [0|1] "" ZCUD,ZCUP
 SG_ WinColorAutAdjmtReLeHmiReq : 362|2@0+ (1,0) [0|3] "" ZCUD
 SG_ WinColorAutAdjmtReLeHmiReq_UB : 360|1@0+ (1,0) [0|1] "" ZCUD
 SG_ WinColorAutAdjmtReRiHmiReq : 382|2@0+ (1,0) [0|3] "" ZCUD
 SG_ WinColorAutAdjmtReRiHmiReq_UB : 380|1@0+ (1,0) [0|1] "" ZCUD
 SG_ WinTransparencyReLeReq : 391|8@0+ (1.0,0.0) [0.0|255.0] "Unitless" ZCUD
 SG_ WinTransparencyReLeReq_UB : 379|1@0+ (1,0) [0|1] "" ZCUD
 SG_ WinTransparencyReRiReq : 399|8@0+ (1.0,0.0) [0.0|255.0] "Unitless" ZCUD
 SG_ WinTransparencyReRiReq_UB : 378|1@0+ (1,0) [0|1] "" ZCUD
 SG_ WPCModuleStsBNCM2 : 431|4@0+ (1,0) [0|15] "" ZCUP
 SG_ WPCModuleStsBNCM2_UB : 416|1@0+ (1,0) [0|1] "" ZCUP

BO_ 96 DhuZCUCANFD2Fr22 : 64 IHU
 SG_ DwnLoadDynLtgPrmForReGrp1_UB : 24|1@0+ (1,0) [0|1] "" ZCUD
 SG_ DwnLoadDynLtgPrmForReGrp10_UB : 312|1@0+ (1,0) [0|1] "" ZCUD
 SG_ DwnLoadDynLtgPrmForReGrp10ContinueTime : 295|8@0+ (1.0,0.0) [0.0|255.0] "Unitless" ZCUD
 SG_ DwnLoadDynLtgPrmForReGrp10HighBrightness : 303|4@0+ (1.0,0.0) [0.0|10.0] "Unitless" ZCUD
 SG_ DwnLoadDynLtgPrmForReGrp10LowBrightness : 299|4@0+ (1.0,0.0) [0.0|10.0] "Unitless" ZCUD
 SG_ DwnLoadDynLtgPrmForReGrp10Mode1 : 311|6@0+ (1,0) [0|63] "" ZCUD
 SG_ DwnLoadDynLtgPrmForReGrp10OffsetTime : 305|6@0+ (1.0,0.0) [0.0|63.0] "Unitless" ZCUD
 SG_ DwnLoadDynLtgPrmForReGrp10Timestamp : 315|3@0+ (1.0,0.0) [0.0|7.0] "Unitless" ZCUD
 SG_ DwnLoadDynLtgPrmForReGrp11_UB : 344|1@0+ (1,0) [0|1] "" ZCUD
 SG_ DwnLoadDynLtgPrmForReGrp11ContinueTime : 327|8@0+ (1.0,0.0) [0.0|255.0] "Unitless" ZCUD
 SG_ DwnLoadDynLtgPrmForReGrp11HighBrightness : 335|4@0+ (1.0,0.0) [0.0|10.0] "Unitless" ZCUD
 SG_ DwnLoadDynLtgPrmForReGrp11LowBrightness : 331|4@0+ (1.0,0.0) [0.0|10.0] "Unitless" ZCUD
 SG_ DwnLoadDynLtgPrmForReGrp11Mode1 : 343|6@0+ (1,0) [0|63] "" ZCUD
 SG_ DwnLoadDynLtgPrmForReGrp11OffsetTime : 337|6@0+ (1.0,0.0) [0.0|63.0] "Unitless" ZCUD
 SG_ DwnLoadDynLtgPrmForReGrp11Timestamp : 347|3@0+ (1.0,0.0) [0.0|7.0] "Unitless" ZCUD
 SG_ DwnLoadDynLtgPrmForReGrp12_UB : 376|1@0+ (1,0) [0|1] "" ZCUD
 SG_ DwnLoadDynLtgPrmForReGrp12ContinueTime : 359|8@0+ (1.0,0.0) [0.0|255.0] "Unitless" ZCUD
 SG_ DwnLoadDynLtgPrmForReGrp12HighBrightness : 367|4@0+ (1.0,0.0) [0.0|10.0] "Unitless" ZCUD
 SG_ DwnLoadDynLtgPrmForReGrp12LowBrightness : 363|4@0+ (1.0,0.0) [0.0|10.0] "Unitless" ZCUD
 SG_ DwnLoadDynLtgPrmForReGrp12Mode1 : 375|6@0+ (1,0) [0|63] "" ZCUD
 SG_ DwnLoadDynLtgPrmForReGrp12OffsetTime : 369|6@0+ (1.0,0.0) [0.0|63.0] "Unitless" ZCUD
 SG_ DwnLoadDynLtgPrmForReGrp12Timestamp : 379|3@0+ (1.0,0.0) [0.0|7.0] "Unitless" ZCUD
 SG_ DwnLoadDynLtgPrmForReGrp13_UB : 408|1@0+ (1,0) [0|1] "" ZCUD
 SG_ DwnLoadDynLtgPrmForReGrp13ContinueTime : 391|8@0+ (1.0,0.0) [0.0|255.0] "Unitless" ZCUD
 SG_ DwnLoadDynLtgPrmForReGrp13HighBrightness : 399|4@0+ (1.0,0.0) [0.0|10.0] "Unitless" ZCUD
 SG_ DwnLoadDynLtgPrmForReGrp13LowBrightness : 395|4@0+ (1.0,0.0) [0.0|10.0] "Unitless" ZCUD
 SG_ DwnLoadDynLtgPrmForReGrp13Mode1 : 407|6@0+ (1,0) [0|63] "" ZCUD
 SG_ DwnLoadDynLtgPrmForReGrp13OffsetTime : 401|6@0+ (1.0,0.0) [0.0|63.0] "Unitless" ZCUD
 SG_ DwnLoadDynLtgPrmForReGrp13Timestamp : 411|3@0+ (1.0,0.0) [0.0|7.0] "Unitless" ZCUD
 SG_ DwnLoadDynLtgPrmForReGrp14_UB : 440|1@0+ (1,0) [0|1] "" ZCUD
 SG_ DwnLoadDynLtgPrmForReGrp14ContinueTime : 423|8@0+ (1.0,0.0) [0.0|255.0] "Unitless" ZCUD
 SG_ DwnLoadDynLtgPrmForReGrp14HighBrightness : 431|4@0+ (1.0,0.0) [0.0|10.0] "Unitless" ZCUD
 SG_ DwnLoadDynLtgPrmForReGrp14LowBrightness : 427|4@0+ (1.0,0.0) [0.0|10.0] "Unitless" ZCUD
 SG_ DwnLoadDynLtgPrmForReGrp14Mode1 : 439|6@0+ (1,0) [0|63] "" ZCUD
 SG_ DwnLoadDynLtgPrmForReGrp14OffsetTime : 433|6@0+ (1.0,0.0) [0.0|63.0] "Unitless" ZCUD
 SG_ DwnLoadDynLtgPrmForReGrp14Timestamp : 443|3@0+ (1.0,0.0) [0.0|7.0] "Unitless" ZCUD
 SG_ DwnLoadDynLtgPrmForReGrp15_UB : 472|1@0+ (1,0) [0|1] "" ZCUD
 SG_ DwnLoadDynLtgPrmForReGrp15ContinueTime : 455|8@0+ (1.0,0.0) [0.0|255.0] "Unitless" ZCUD
 SG_ DwnLoadDynLtgPrmForReGrp15HighBrightness : 463|4@0+ (1.0,0.0) [0.0|10.0] "Unitless" ZCUD
 SG_ DwnLoadDynLtgPrmForReGrp15LowBrightness : 459|4@0+ (1.0,0.0) [0.0|10.0] "Unitless" ZCUD
 SG_ DwnLoadDynLtgPrmForReGrp15Mode1 : 471|6@0+ (1,0) [0|63] "" ZCUD
 SG_ DwnLoadDynLtgPrmForReGrp15OffsetTime : 465|6@0+ (1.0,0.0) [0.0|63.0] "Unitless" ZCUD
 SG_ DwnLoadDynLtgPrmForReGrp15Timestamp : 475|3@0+ (1.0,0.0) [0.0|7.0] "Unitless" ZCUD
 SG_ DwnLoadDynLtgPrmForReGrp16_UB : 504|1@0+ (1,0) [0|1] "" ZCUD
 SG_ DwnLoadDynLtgPrmForReGrp16ContinueTime : 487|8@0+ (1.0,0.0) [0.0|255.0] "Unitless" ZCUD
 SG_ DwnLoadDynLtgPrmForReGrp16HighBrightness : 495|4@0+ (1.0,0.0) [0.0|10.0] "Unitless" ZCUD
 SG_ DwnLoadDynLtgPrmForReGrp16LowBrightness : 491|4@0+ (1.0,0.0) [0.0|10.0] "Unitless" ZCUD
 SG_ DwnLoadDynLtgPrmForReGrp16Mode1 : 503|6@0+ (1,0) [0|63] "" ZCUD
 SG_ DwnLoadDynLtgPrmForReGrp16OffsetTime : 497|6@0+ (1.0,0.0) [0.0|63.0] "Unitless" ZCUD
 SG_ DwnLoadDynLtgPrmForReGrp16Timestamp : 507|3@0+ (1.0,0.0) [0.0|7.0] "Unitless" ZCUD
 SG_ DwnLoadDynLtgPrmForReGrp1ContinueTime : 7|8@0+ (1.0,0.0) [0.0|255.0] "Unitless" ZCUD
 SG_ DwnLoadDynLtgPrmForReGrp1HighBrightness : 15|4@0+ (1.0,0.0) [0.0|10.0] "Unitless" ZCUD
 SG_ DwnLoadDynLtgPrmForReGrp1LowBrightness : 11|4@0+ (1.0,0.0) [0.0|10.0] "Unitless" ZCUD
 SG_ DwnLoadDynLtgPrmForReGrp1Mode1 : 23|6@0+ (1,0) [0|63] "" ZCUD
 SG_ DwnLoadDynLtgPrmForReGrp1OffsetTime : 17|6@0+ (1.0,0.0) [0.0|63.0] "Unitless" ZCUD
 SG_ DwnLoadDynLtgPrmForReGrp1Timestamp : 27|3@0+ (1.0,0.0) [0.0|7.0] "Unitless" ZCUD
 SG_ DwnLoadDynLtgPrmForReGrp2_UB : 56|1@0+ (1,0) [0|1] "" ZCUD
 SG_ DwnLoadDynLtgPrmForReGrp2ContinueTime : 39|8@0+ (1.0,0.0) [0.0|255.0] "Unitless" ZCUD
 SG_ DwnLoadDynLtgPrmForReGrp2HighBrightness : 47|4@0+ (1.0,0.0) [0.0|10.0] "Unitless" ZCUD
 SG_ DwnLoadDynLtgPrmForReGrp2LowBrightness : 43|4@0+ (1.0,0.0) [0.0|10.0] "Unitless" ZCUD
 SG_ DwnLoadDynLtgPrmForReGrp2Mode1 : 55|6@0+ (1,0) [0|63] "" ZCUD
 SG_ DwnLoadDynLtgPrmForReGrp2OffsetTime : 49|6@0+ (1.0,0.0) [0.0|63.0] "Unitless" ZCUD
 SG_ DwnLoadDynLtgPrmForReGrp2Timestamp : 59|3@0+ (1.0,0.0) [0.0|7.0] "Unitless" ZCUD
 SG_ DwnLoadDynLtgPrmForReGrp3_UB : 88|1@0+ (1,0) [0|1] "" ZCUD
 SG_ DwnLoadDynLtgPrmForReGrp3ContinueTime : 71|8@0+ (1.0,0.0) [0.0|255.0] "Unitless" ZCUD
 SG_ DwnLoadDynLtgPrmForReGrp3HighBrightness : 79|4@0+ (1.0,0.0) [0.0|10.0] "Unitless" ZCUD
 SG_ DwnLoadDynLtgPrmForReGrp3LowBrightness : 75|4@0+ (1.0,0.0) [0.0|10.0] "Unitless" ZCUD
 SG_ DwnLoadDynLtgPrmForReGrp3Mode1 : 87|6@0+ (1,0) [0|63] "" ZCUD
 SG_ DwnLoadDynLtgPrmForReGrp3OffsetTime : 81|6@0+ (1.0,0.0) [0.0|63.0] "Unitless" ZCUD
 SG_ DwnLoadDynLtgPrmForReGrp3Timestamp : 91|3@0+ (1.0,0.0) [0.0|7.0] "Unitless" ZCUD
 SG_ DwnLoadDynLtgPrmForReGrp4_UB : 120|1@0+ (1,0) [0|1] "" ZCUD
 SG_ DwnLoadDynLtgPrmForReGrp4ContinueTime : 103|8@0+ (1.0,0.0) [0.0|255.0] "Unitless" ZCUD
 SG_ DwnLoadDynLtgPrmForReGrp4HighBrightness : 111|4@0+ (1.0,0.0) [0.0|10.0] "Unitless" ZCUD
 SG_ DwnLoadDynLtgPrmForReGrp4LowBrightness : 107|4@0+ (1.0,0.0) [0.0|10.0] "Unitless" ZCUD
 SG_ DwnLoadDynLtgPrmForReGrp4Mode1 : 119|6@0+ (1,0) [0|63] "" ZCUD
 SG_ DwnLoadDynLtgPrmForReGrp4OffsetTime : 113|6@0+ (1.0,0.0) [0.0|63.0] "Unitless" ZCUD
 SG_ DwnLoadDynLtgPrmForReGrp4Timestamp : 123|3@0+ (1.0,0.0) [0.0|7.0] "Unitless" ZCUD
 SG_ DwnLoadDynLtgPrmForReGrp5_UB : 152|1@0+ (1,0) [0|1] "" ZCUD
 SG_ DwnLoadDynLtgPrmForReGrp5ContinueTime : 135|8@0+ (1.0,0.0) [0.0|255.0] "Unitless" ZCUD
 SG_ DwnLoadDynLtgPrmForReGrp5HighBrightness : 143|4@0+ (1.0,0.0) [0.0|10.0] "Unitless" ZCUD
 SG_ DwnLoadDynLtgPrmForReGrp5LowBrightness : 139|4@0+ (1.0,0.0) [0.0|10.0] "Unitless" ZCUD
 SG_ DwnLoadDynLtgPrmForReGrp5Mode1 : 151|6@0+ (1,0) [0|63] "" ZCUD
 SG_ DwnLoadDynLtgPrmForReGrp5OffsetTime : 145|6@0+ (1.0,0.0) [0.0|63.0] "Unitless" ZCUD
 SG_ DwnLoadDynLtgPrmForReGrp5Timestamp : 155|3@0+ (1.0,0.0) [0.0|7.0] "Unitless" ZCUD
 SG_ DwnLoadDynLtgPrmForReGrp6_UB : 184|1@0+ (1,0) [0|1] "" ZCUD
 SG_ DwnLoadDynLtgPrmForReGrp6ContinueTime : 167|8@0+ (1.0,0.0) [0.0|255.0] "Unitless" ZCUD
 SG_ DwnLoadDynLtgPrmForReGrp6HighBrightness : 175|4@0+ (1.0,0.0) [0.0|10.0] "Unitless" ZCUD
 SG_ DwnLoadDynLtgPrmForReGrp6LowBrightness : 171|4@0+ (1.0,0.0) [0.0|10.0] "Unitless" ZCUD
 SG_ DwnLoadDynLtgPrmForReGrp6Mode1 : 183|6@0+ (1,0) [0|63] "" ZCUD
 SG_ DwnLoadDynLtgPrmForReGrp6OffsetTime : 177|6@0+ (1.0,0.0) [0.0|63.0] "Unitless" ZCUD
 SG_ DwnLoadDynLtgPrmForReGrp6Timestamp : 187|3@0+ (1.0,0.0) [0.0|7.0] "Unitless" ZCUD
 SG_ DwnLoadDynLtgPrmForReGrp7_UB : 216|1@0+ (1,0) [0|1] "" ZCUD
 SG_ DwnLoadDynLtgPrmForReGrp7ContinueTime : 199|8@0+ (1.0,0.0) [0.0|255.0] "Unitless" ZCUD
 SG_ DwnLoadDynLtgPrmForReGrp7HighBrightness : 207|4@0+ (1.0,0.0) [0.0|10.0] "Unitless" ZCUD
 SG_ DwnLoadDynLtgPrmForReGrp7LowBrightness : 203|4@0+ (1.0,0.0) [0.0|10.0] "Unitless" ZCUD
 SG_ DwnLoadDynLtgPrmForReGrp7Mode1 : 215|6@0+ (1,0) [0|63] "" ZCUD
 SG_ DwnLoadDynLtgPrmForReGrp7OffsetTime : 209|6@0+ (1.0,0.0) [0.0|63.0] "Unitless" ZCUD
 SG_ DwnLoadDynLtgPrmForReGrp7Timestamp : 219|3@0+ (1.0,0.0) [0.0|7.0] "Unitless" ZCUD
 SG_ DwnLoadDynLtgPrmForReGrp8_UB : 248|1@0+ (1,0) [0|1] "" ZCUD
 SG_ DwnLoadDynLtgPrmForReGrp8ContinueTime : 231|8@0+ (1.0,0.0) [0.0|255.0] "Unitless" ZCUD
 SG_ DwnLoadDynLtgPrmForReGrp8HighBrightness : 239|4@0+ (1.0,0.0) [0.0|10.0] "Unitless" ZCUD
 SG_ DwnLoadDynLtgPrmForReGrp8LowBrightness : 235|4@0+ (1.0,0.0) [0.0|10.0] "Unitless" ZCUD
 SG_ DwnLoadDynLtgPrmForReGrp8Mode1 : 247|6@0+ (1,0) [0|63] "" ZCUD
 SG_ DwnLoadDynLtgPrmForReGrp8OffsetTime : 241|6@0+ (1.0,0.0) [0.0|63.0] "Unitless" ZCUD
 SG_ DwnLoadDynLtgPrmForReGrp8Timestamp : 251|3@0+ (1.0,0.0) [0.0|7.0] "Unitless" ZCUD
 SG_ DwnLoadDynLtgPrmForReGrp9_UB : 280|1@0+ (1,0) [0|1] "" ZCUD
 SG_ DwnLoadDynLtgPrmForReGrp9ContinueTime : 263|8@0+ (1.0,0.0) [0.0|255.0] "Unitless" ZCUD
 SG_ DwnLoadDynLtgPrmForReGrp9HighBrightness : 271|4@0+ (1.0,0.0) [0.0|10.0] "Unitless" ZCUD
 SG_ DwnLoadDynLtgPrmForReGrp9LowBrightness : 267|4@0+ (1.0,0.0) [0.0|10.0] "Unitless" ZCUD
 SG_ DwnLoadDynLtgPrmForReGrp9Mode1 : 279|6@0+ (1,0) [0|63] "" ZCUD
 SG_ DwnLoadDynLtgPrmForReGrp9OffsetTime : 273|6@0+ (1.0,0.0) [0.0|63.0] "Unitless" ZCUD
 SG_ DwnLoadDynLtgPrmForReGrp9Timestamp : 283|3@0+ (1.0,0.0) [0.0|7.0] "Unitless" ZCUD

BO_ 97 DhuZCUCANFD2Fr23 : 64 IHU
 SG_ DwnLoadDynLtgPrmForReGrp17_UB : 24|1@0+ (1,0) [0|1] "" ZCUD
 SG_ DwnLoadDynLtgPrmForReGrp17ContinueTime : 7|8@0+ (1.0,0.0) [0.0|255.0] "Unitless" ZCUD
 SG_ DwnLoadDynLtgPrmForReGrp17HighBrightness : 15|4@0+ (1.0,0.0) [0.0|10.0] "Unitless" ZCUD
 SG_ DwnLoadDynLtgPrmForReGrp17LowBrightness : 11|4@0+ (1.0,0.0) [0.0|10.0] "Unitless" ZCUD
 SG_ DwnLoadDynLtgPrmForReGrp17Mode1 : 23|6@0+ (1,0) [0|63] "" ZCUD
 SG_ DwnLoadDynLtgPrmForReGrp17OffsetTime : 17|6@0+ (1.0,0.0) [0.0|63.0] "Unitless" ZCUD
 SG_ DwnLoadDynLtgPrmForReGrp17Timestamp : 27|3@0+ (1.0,0.0) [0.0|7.0] "Unitless" ZCUD
 SG_ DwnLoadDynLtgPrmForReGrp18_UB : 56|1@0+ (1,0) [0|1] "" ZCUD
 SG_ DwnLoadDynLtgPrmForReGrp18ContinueTime : 39|8@0+ (1.0,0.0) [0.0|255.0] "Unitless" ZCUD
 SG_ DwnLoadDynLtgPrmForReGrp18HighBrightness : 47|4@0+ (1.0,0.0) [0.0|10.0] "Unitless" ZCUD
 SG_ DwnLoadDynLtgPrmForReGrp18LowBrightness : 43|4@0+ (1.0,0.0) [0.0|10.0] "Unitless" ZCUD
 SG_ DwnLoadDynLtgPrmForReGrp18Mode1 : 55|6@0+ (1,0) [0|63] "" ZCUD
 SG_ DwnLoadDynLtgPrmForReGrp18OffsetTime : 49|6@0+ (1.0,0.0) [0.0|63.0] "Unitless" ZCUD
 SG_ DwnLoadDynLtgPrmForReGrp18Timestamp : 59|3@0+ (1.0,0.0) [0.0|7.0] "Unitless" ZCUD
 SG_ DwnLoadDynLtgPrmForReGrp19_UB : 88|1@0+ (1,0) [0|1] "" ZCUD
 SG_ DwnLoadDynLtgPrmForReGrp19ContinueTime : 71|8@0+ (1.0,0.0) [0.0|255.0] "Unitless" ZCUD
 SG_ DwnLoadDynLtgPrmForReGrp19HighBrightness : 79|4@0+ (1.0,0.0) [0.0|10.0] "Unitless" ZCUD
 SG_ DwnLoadDynLtgPrmForReGrp19LowBrightness : 75|4@0+ (1.0,0.0) [0.0|10.0] "Unitless" ZCUD
 SG_ DwnLoadDynLtgPrmForReGrp19Mode1 : 87|6@0+ (1,0) [0|63] "" ZCUD
 SG_ DwnLoadDynLtgPrmForReGrp19OffsetTime : 81|6@0+ (1.0,0.0) [0.0|63.0] "Unitless" ZCUD
 SG_ DwnLoadDynLtgPrmForReGrp19Timestamp : 91|3@0+ (1.0,0.0) [0.0|7.0] "Unitless" ZCUD
 SG_ DwnLoadDynLtgPrmForReGrp20_UB : 120|1@0+ (1,0) [0|1] "" ZCUD
 SG_ DwnLoadDynLtgPrmForReGrp20ContinueTime : 103|8@0+ (1.0,0.0) [0.0|255.0] "Unitless" ZCUD
 SG_ DwnLoadDynLtgPrmForReGrp20HighBrightness : 111|4@0+ (1.0,0.0) [0.0|10.0] "Unitless" ZCUD
 SG_ DwnLoadDynLtgPrmForReGrp20LowBrightness : 107|4@0+ (1.0,0.0) [0.0|10.0] "Unitless" ZCUD
 SG_ DwnLoadDynLtgPrmForReGrp20Mode1 : 119|6@0+ (1,0) [0|63] "" ZCUD
 SG_ DwnLoadDynLtgPrmForReGrp20OffsetTime : 113|6@0+ (1.0,0.0) [0.0|63.0] "Unitless" ZCUD
 SG_ DwnLoadDynLtgPrmForReGrp20Timestamp : 123|3@0+ (1.0,0.0) [0.0|7.0] "Unitless" ZCUD
 SG_ DwnLoadDynLtgPrmForReGrp21_UB : 152|1@0+ (1,0) [0|1] "" ZCUD
 SG_ DwnLoadDynLtgPrmForReGrp21ContinueTime : 135|8@0+ (1.0,0.0) [0.0|255.0] "Unitless" ZCUD
 SG_ DwnLoadDynLtgPrmForReGrp21HighBrightness : 143|4@0+ (1.0,0.0) [0.0|10.0] "Unitless" ZCUD
 SG_ DwnLoadDynLtgPrmForReGrp21LowBrightness : 139|4@0+ (1.0,0.0) [0.0|10.0] "Unitless" ZCUD
 SG_ DwnLoadDynLtgPrmForReGrp21Mode1 : 151|6@0+ (1,0) [0|63] "" ZCUD
 SG_ DwnLoadDynLtgPrmForReGrp21OffsetTime : 145|6@0+ (1.0,0.0) [0.0|63.0] "Unitless" ZCUD
 SG_ DwnLoadDynLtgPrmForReGrp21Timestamp : 155|3@0+ (1.0,0.0) [0.0|7.0] "Unitless" ZCUD
 SG_ DwnLoadDynLtgPrmForReGrp22_UB : 184|1@0+ (1,0) [0|1] "" ZCUD
 SG_ DwnLoadDynLtgPrmForReGrp22ContinueTime : 167|8@0+ (1.0,0.0) [0.0|255.0] "Unitless" ZCUD
 SG_ DwnLoadDynLtgPrmForReGrp22HighBrightness : 175|4@0+ (1.0,0.0) [0.0|10.0] "Unitless" ZCUD
 SG_ DwnLoadDynLtgPrmForReGrp22LowBrightness : 171|4@0+ (1.0,0.0) [0.0|10.0] "Unitless" ZCUD
 SG_ DwnLoadDynLtgPrmForReGrp22Mode1 : 183|6@0+ (1,0) [0|63] "" ZCUD
 SG_ DwnLoadDynLtgPrmForReGrp22OffsetTime : 177|6@0+ (1.0,0.0) [0.0|63.0] "Unitless" ZCUD
 SG_ DwnLoadDynLtgPrmForReGrp22Timestamp : 187|3@0+ (1.0,0.0) [0.0|7.0] "Unitless" ZCUD
 SG_ DwnLoadDynLtgPrmForReGrp23_UB : 216|1@0+ (1,0) [0|1] "" ZCUD
 SG_ DwnLoadDynLtgPrmForReGrp23ContinueTime : 199|8@0+ (1.0,0.0) [0.0|255.0] "Unitless" ZCUD
 SG_ DwnLoadDynLtgPrmForReGrp23HighBrightness : 207|4@0+ (1.0,0.0) [0.0|10.0] "Unitless" ZCUD
 SG_ DwnLoadDynLtgPrmForReGrp23LowBrightness : 203|4@0+ (1.0,0.0) [0.0|10.0] "Unitless" ZCUD
 SG_ DwnLoadDynLtgPrmForReGrp23Mode1 : 215|6@0+ (1,0) [0|63] "" ZCUD
 SG_ DwnLoadDynLtgPrmForReGrp23OffsetTime : 209|6@0+ (1.0,0.0) [0.0|63.0] "Unitless" ZCUD
 SG_ DwnLoadDynLtgPrmForReGrp23Timestamp : 219|3@0+ (1.0,0.0) [0.0|7.0] "Unitless" ZCUD
 SG_ DwnLoadDynLtgPrmForReGrp24_UB : 248|1@0+ (1,0) [0|1] "" ZCUD
 SG_ DwnLoadDynLtgPrmForReGrp24ContinueTime : 231|8@0+ (1.0,0.0) [0.0|255.0] "Unitless" ZCUD
 SG_ DwnLoadDynLtgPrmForReGrp24HighBrightness : 239|4@0+ (1.0,0.0) [0.0|10.0] "Unitless" ZCUD
 SG_ DwnLoadDynLtgPrmForReGrp24LowBrightness : 235|4@0+ (1.0,0.0) [0.0|10.0] "Unitless" ZCUD
 SG_ DwnLoadDynLtgPrmForReGrp24Mode1 : 247|6@0+ (1,0) [0|63] "" ZCUD
 SG_ DwnLoadDynLtgPrmForReGrp24OffsetTime : 241|6@0+ (1.0,0.0) [0.0|63.0] "Unitless" ZCUD
 SG_ DwnLoadDynLtgPrmForReGrp24Timestamp : 251|3@0+ (1.0,0.0) [0.0|7.0] "Unitless" ZCUD
 SG_ DwnLoadDynLtgPrmForReGrp25_UB : 280|1@0+ (1,0) [0|1] "" ZCUD
 SG_ DwnLoadDynLtgPrmForReGrp25ContinueTime : 263|8@0+ (1.0,0.0) [0.0|255.0] "Unitless" ZCUD
 SG_ DwnLoadDynLtgPrmForReGrp25HighBrightness : 271|4@0+ (1.0,0.0) [0.0|10.0] "Unitless" ZCUD
 SG_ DwnLoadDynLtgPrmForReGrp25LowBrightness : 267|4@0+ (1.0,0.0) [0.0|10.0] "Unitless" ZCUD
 SG_ DwnLoadDynLtgPrmForReGrp25Mode1 : 279|6@0+ (1,0) [0|63] "" ZCUD
 SG_ DwnLoadDynLtgPrmForReGrp25OffsetTime : 273|6@0+ (1.0,0.0) [0.0|63.0] "Unitless" ZCUD
 SG_ DwnLoadDynLtgPrmForReGrp25Timestamp : 283|3@0+ (1.0,0.0) [0.0|7.0] "Unitless" ZCUD
 SG_ DwnLoadDynLtgPrmForReGrp26_UB : 312|1@0+ (1,0) [0|1] "" ZCUD
 SG_ DwnLoadDynLtgPrmForReGrp26ContinueTime : 295|8@0+ (1.0,0.0) [0.0|255.0] "Unitless" ZCUD
 SG_ DwnLoadDynLtgPrmForReGrp26HighBrightness : 303|4@0+ (1.0,0.0) [0.0|10.0] "Unitless" ZCUD
 SG_ DwnLoadDynLtgPrmForReGrp26LowBrightness : 299|4@0+ (1.0,0.0) [0.0|10.0] "Unitless" ZCUD
 SG_ DwnLoadDynLtgPrmForReGrp26Mode1 : 311|6@0+ (1,0) [0|63] "" ZCUD
 SG_ DwnLoadDynLtgPrmForReGrp26OffsetTime : 305|6@0+ (1.0,0.0) [0.0|63.0] "Unitless" ZCUD
 SG_ DwnLoadDynLtgPrmForReGrp26Timestamp : 315|3@0+ (1.0,0.0) [0.0|7.0] "Unitless" ZCUD
 SG_ DwnLoadDynLtgPrmForReGrp27_UB : 344|1@0+ (1,0) [0|1] "" ZCUD
 SG_ DwnLoadDynLtgPrmForReGrp27ContinueTime : 327|8@0+ (1.0,0.0) [0.0|255.0] "Unitless" ZCUD
 SG_ DwnLoadDynLtgPrmForReGrp27HighBrightness : 335|4@0+ (1.0,0.0) [0.0|10.0] "Unitless" ZCUD
 SG_ DwnLoadDynLtgPrmForReGrp27LowBrightness : 331|4@0+ (1.0,0.0) [0.0|10.0] "Unitless" ZCUD
 SG_ DwnLoadDynLtgPrmForReGrp27Mode1 : 343|6@0+ (1,0) [0|63] "" ZCUD
 SG_ DwnLoadDynLtgPrmForReGrp27OffsetTime : 337|6@0+ (1.0,0.0) [0.0|63.0] "Unitless" ZCUD
 SG_ DwnLoadDynLtgPrmForReGrp27Timestamp : 347|3@0+ (1.0,0.0) [0.0|7.0] "Unitless" ZCUD
 SG_ DwnLoadDynLtgPrmForReGrp28_UB : 376|1@0+ (1,0) [0|1] "" ZCUD
 SG_ DwnLoadDynLtgPrmForReGrp28ContinueTime : 359|8@0+ (1.0,0.0) [0.0|255.0] "Unitless" ZCUD
 SG_ DwnLoadDynLtgPrmForReGrp28HighBrightness : 367|4@0+ (1.0,0.0) [0.0|10.0] "Unitless" ZCUD
 SG_ DwnLoadDynLtgPrmForReGrp28LowBrightness : 363|4@0+ (1.0,0.0) [0.0|10.0] "Unitless" ZCUD
 SG_ DwnLoadDynLtgPrmForReGrp28Mode1 : 375|6@0+ (1,0) [0|63] "" ZCUD
 SG_ DwnLoadDynLtgPrmForReGrp28OffsetTime : 369|6@0+ (1.0,0.0) [0.0|63.0] "Unitless" ZCUD
 SG_ DwnLoadDynLtgPrmForReGrp28Timestamp : 379|3@0+ (1.0,0.0) [0.0|7.0] "Unitless" ZCUD
 SG_ DwnLoadDynLtgPrmForReGrp29_UB : 408|1@0+ (1,0) [0|1] "" ZCUD
 SG_ DwnLoadDynLtgPrmForReGrp29ContinueTime : 391|8@0+ (1.0,0.0) [0.0|255.0] "Unitless" ZCUD
 SG_ DwnLoadDynLtgPrmForReGrp29HighBrightness : 399|4@0+ (1.0,0.0) [0.0|10.0] "Unitless" ZCUD
 SG_ DwnLoadDynLtgPrmForReGrp29LowBrightness : 395|4@0+ (1.0,0.0) [0.0|10.0] "Unitless" ZCUD
 SG_ DwnLoadDynLtgPrmForReGrp29Mode1 : 407|6@0+ (1,0) [0|63] "" ZCUD
 SG_ DwnLoadDynLtgPrmForReGrp29OffsetTime : 401|6@0+ (1.0,0.0) [0.0|63.0] "Unitless" ZCUD
 SG_ DwnLoadDynLtgPrmForReGrp29Timestamp : 411|3@0+ (1.0,0.0) [0.0|7.0] "Unitless" ZCUD
 SG_ DwnLoadDynLtgPrmForReGrp30_UB : 440|1@0+ (1,0) [0|1] "" ZCUD
 SG_ DwnLoadDynLtgPrmForReGrp30ContinueTime : 423|8@0+ (1.0,0.0) [0.0|255.0] "Unitless" ZCUD
 SG_ DwnLoadDynLtgPrmForReGrp30HighBrightness : 431|4@0+ (1.0,0.0) [0.0|10.0] "Unitless" ZCUD
 SG_ DwnLoadDynLtgPrmForReGrp30LowBrightness : 427|4@0+ (1.0,0.0) [0.0|10.0] "Unitless" ZCUD
 SG_ DwnLoadDynLtgPrmForReGrp30Mode1 : 439|6@0+ (1,0) [0|63] "" ZCUD
 SG_ DwnLoadDynLtgPrmForReGrp30OffsetTime : 433|6@0+ (1.0,0.0) [0.0|63.0] "Unitless" ZCUD
 SG_ DwnLoadDynLtgPrmForReGrp30Timestamp : 443|3@0+ (1.0,0.0) [0.0|7.0] "Unitless" ZCUD

BO_ 1352 DhuZCUCANFD2VFCVectorFr : 8 IHU
 SG_ VFCVectorDHUBlockID : 1|2@0+ (1.0,0.0) [0.0|3.0] "Unitless" ETC
 SG_ VFCVectorDHUVFCid0 : 2|1@0+ (1,0) [0|1] "" ETC
 SG_ VFCVectorDHUVFCid1 : 3|1@0+ (1,0) [0|1] "" ETC
 SG_ VFCVectorDHUVFCid10 : 12|1@0+ (1,0) [0|1] "" ETC
 SG_ VFCVectorDHUVFCid11 : 13|1@0+ (1,0) [0|1] "" ETC
 SG_ VFCVectorDHUVFCid12 : 14|1@0+ (1,0) [0|1] "" ETC
 SG_ VFCVectorDHUVFCid13 : 15|1@0+ (1,0) [0|1] "" ETC
 SG_ VFCVectorDHUVFCid14 : 16|1@0+ (1,0) [0|1] "" ETC
 SG_ VFCVectorDHUVFCid15 : 17|1@0+ (1,0) [0|1] "" ETC
 SG_ VFCVectorDHUVFCid16 : 18|1@0+ (1,0) [0|1] "" ETC
 SG_ VFCVectorDHUVFCid17 : 19|1@0+ (1,0) [0|1] "" ETC
 SG_ VFCVectorDHUVFCid18 : 20|1@0+ (1,0) [0|1] "" ETC
 SG_ VFCVectorDHUVFCid19 : 21|1@0+ (1,0) [0|1] "" ETC
 SG_ VFCVectorDHUVFCid2 : 4|1@0+ (1,0) [0|1] "" ETC
 SG_ VFCVectorDHUVFCid20 : 22|1@0+ (1,0) [0|1] "" ETC
 SG_ VFCVectorDHUVFCid21 : 23|1@0+ (1,0) [0|1] "" ETC
 SG_ VFCVectorDHUVFCid22 : 24|1@0+ (1,0) [0|1] "" ETC
 SG_ VFCVectorDHUVFCid23 : 25|1@0+ (1,0) [0|1] "" ETC
 SG_ VFCVectorDHUVFCid24 : 26|1@0+ (1,0) [0|1] "" ETC
 SG_ VFCVectorDHUVFCid25 : 27|1@0+ (1,0) [0|1] "" ETC
 SG_ VFCVectorDHUVFCid26 : 28|1@0+ (1,0) [0|1] "" ETC
 SG_ VFCVectorDHUVFCid27 : 29|1@0+ (1,0) [0|1] "" ETC
 SG_ VFCVectorDHUVFCid28 : 30|1@0+ (1,0) [0|1] "" ETC
 SG_ VFCVectorDHUVFCid29 : 31|1@0+ (1,0) [0|1] "" ETC
 SG_ VFCVectorDHUVFCid3 : 5|1@0+ (1,0) [0|1] "" ETC
 SG_ VFCVectorDHUVFCid30 : 32|1@0+ (1,0) [0|1] "" ETC
 SG_ VFCVectorDHUVFCid31 : 33|1@0+ (1,0) [0|1] "" ETC
 SG_ VFCVectorDHUVFCid32 : 34|1@0+ (1,0) [0|1] "" ETC
 SG_ VFCVectorDHUVFCid33 : 35|1@0+ (1,0) [0|1] "" ETC
 SG_ VFCVectorDHUVFCid34 : 36|1@0+ (1,0) [0|1] "" ETC
 SG_ VFCVectorDHUVFCid35 : 37|1@0+ (1,0) [0|1] "" ETC
 SG_ VFCVectorDHUVFCid36 : 38|1@0+ (1,0) [0|1] "" ETC
 SG_ VFCVectorDHUVFCid37 : 39|1@0+ (1,0) [0|1] "" ETC
 SG_ VFCVectorDHUVFCid38 : 40|1@0+ (1,0) [0|1] "" ETC
 SG_ VFCVectorDHUVFCid39 : 41|1@0+ (1,0) [0|1] "" ETC
 SG_ VFCVectorDHUVFCid4 : 6|1@0+ (1,0) [0|1] "" ETC
 SG_ VFCVectorDHUVFCid40 : 42|1@0+ (1,0) [0|1] "" ETC
 SG_ VFCVectorDHUVFCid41 : 43|1@0+ (1,0) [0|1] "" ETC
 SG_ VFCVectorDHUVFCid42 : 44|1@0+ (1,0) [0|1] "" ETC
 SG_ VFCVectorDHUVFCid43 : 45|1@0+ (1,0) [0|1] "" ETC
 SG_ VFCVectorDHUVFCid44 : 46|1@0+ (1,0) [0|1] "" ETC
 SG_ VFCVectorDHUVFCid45 : 47|1@0+ (1,0) [0|1] "" ETC
 SG_ VFCVectorDHUVFCid46 : 48|1@0+ (1,0) [0|1] "" ETC
 SG_ VFCVectorDHUVFCid47 : 49|1@0+ (1,0) [0|1] "" ETC
 SG_ VFCVectorDHUVFCid48 : 50|1@0+ (1,0) [0|1] "" ETC
 SG_ VFCVectorDHUVFCid49 : 51|1@0+ (1,0) [0|1] "" ETC
 SG_ VFCVectorDHUVFCid5 : 7|1@0+ (1,0) [0|1] "" ETC
 SG_ VFCVectorDHUVFCid50 : 52|1@0+ (1,0) [0|1] "" ETC
 SG_ VFCVectorDHUVFCid51 : 53|1@0+ (1,0) [0|1] "" ETC
 SG_ VFCVectorDHUVFCid52 : 54|1@0+ (1,0) [0|1] "" ETC
 SG_ VFCVectorDHUVFCid53 : 55|1@0+ (1,0) [0|1] "" ETC
 SG_ VFCVectorDHUVFCid54 : 56|1@0+ (1,0) [0|1] "" ETC
 SG_ VFCVectorDHUVFCid55 : 57|1@0+ (1,0) [0|1] "" ETC
 SG_ VFCVectorDHUVFCid56 : 58|1@0+ (1,0) [0|1] "" ETC
 SG_ VFCVectorDHUVFCid57 : 59|1@0+ (1,0) [0|1] "" ETC
 SG_ VFCVectorDHUVFCid58 : 60|1@0+ (1,0) [0|1] "" ETC
 SG_ VFCVectorDHUVFCid59 : 61|1@0+ (1,0) [0|1] "" ETC
 SG_ VFCVectorDHUVFCid6 : 8|1@0+ (1,0) [0|1] "" ETC
 SG_ VFCVectorDHUVFCid60 : 62|1@0+ (1,0) [0|1] "" ETC
 SG_ VFCVectorDHUVFCid61 : 63|1@0+ (1,0) [0|1] "" ETC
 SG_ VFCVectorDHUVFCid7 : 9|1@0+ (1,0) [0|1] "" ETC
 SG_ VFCVectorDHUVFCid8 : 10|1@0+ (1,0) [0|1] "" ETC
 SG_ VFCVectorDHUVFCid9 : 11|1@0+ (1,0) [0|1] "" ETC

CM_ SG_ 464 ActvReSplrPosnReq "Active rear spoiler position control request";
CM_ SG_ 464 BackRestSideSpprtAdjmtRowFirstDrvr "seat side support adjustment ";
CM_ SG_ 464 BackRestSideSpprtAdjmtRowFirstPass "seat side support adjustment ";
CM_ SG_ 464 CushSideSpprtAdjmtRowFirstDrvr "cush side support";
CM_ SG_ 464 CushSideSpprtAdjmtRowFirstPass "cush side support";
CM_ SG_ 464 DiagcComActv "Indicates if a diagnostic communication session is ongoing.";
CM_ SG_ 464 DiagcExtCom "Indicates if a diagnostic tester is connected to the vehicle or if an internal tester is active.";
CM_ SG_ 464 DrvrSeatDispMassgFctMassgInten "Massage program Intensity Level";
CM_ SG_ 464 DrvrSeatDispMassgFctMassgProg "Massage Programs Types";
CM_ SG_ 464 DrvrSeatDispMassgFctOnOffl2 "Turn on or off seat massage";
CM_ SG_ 464 DrvrSeatDispSpplFct "Handles the two way communication for driver multi seat control.";
CM_ SG_ 464 ExtLoUOutlPwrSplyReqRADARMaiSwt "The On/Off status of main switch for External Low Voltage Outlet Power Supply, the status will be on when any status of zone1 to zone6 is on";
CM_ SG_ 464 ExtLoUOutlPwrSplyReqRADARZone1 "The On/Off status of zone1 for External Low Voltage Outlet Power Supply";
CM_ SG_ 464 ExtLoUOutlPwrSplyReqRADARZone2 "The On/Off status of zone2 for External Low Voltage Outlet Power Supply";
CM_ SG_ 464 ExtLoUOutlPwrSplyReqRADARZone3 "The On/Off status of zone3 for External Low Voltage Outlet Power Supply";
CM_ SG_ 464 ExtLoUOutlPwrSplyReqRADARZone4 "The On/Off status of zone4 for External Low Voltage Outlet Power Supply";
CM_ SG_ 464 ExtLoUOutlPwrSplyReqRADARZone5 "The On/Off status of zone5 for External Low Voltage Outlet Power Supply";
CM_ SG_ 464 ExtLoUOutlPwrSplyReqRADARZone6 "The On/Off status of zone6 for External Low Voltage Outlet Power Supply";
CM_ SG_ 464 ExtrLtgFctSts "Exterior Zone Lighting function status indicate";
CM_ SG_ 464 HMIBluetoothCallToAdjAirVol "HMIBluetoothCallToAdjAirVol";
CM_ SG_ 464 HMIIonizerAirCdnr "HMI Ionizer Air Conditioner";
CM_ SG_ 464 HmiSmrtWindFolwSet "intelligent wind following setting";
CM_ SG_ 464 HMIToVMMSwtSwitch1 "Switch from HMI to VMM";
CM_ SG_ 464 HMIToVMMSwtSwitch2 "Switch from HMI to VMM";
CM_ SG_ 464 HMIToVMMSwtSwitch3 "Switch from HMI to VMM";
CM_ SG_ 464 HMIToVMMSwtSwitch4 "Switch from HMI to VMM";
CM_ SG_ 464 HMIToVMMSwtSwitch5 "Switch from HMI to VMM";
CM_ SG_ 464 HMIToVMMSwtSwitch6 "Switch from HMI to VMM";
CM_ SG_ 464 HMIToVMMSwtSwitch7 "Switch from HMI to VMM";
CM_ SG_ 464 HMIToVMMSwtSwitch8 "Switch from HMI to VMM";
CM_ SG_ 464 HmiWinterLockCarPrevnIceSet "Winter Lock Car to prevent Icing Setting";
CM_ SG_ 464 LumHeiAdjmtRowFirstDrvr "lumbar height adjustment";
CM_ SG_ 464 LumHeiAdjmtRowFirstPass "lumbar height adjustment";
CM_ SG_ 464 LumLenAdjmtRowFirstDrvr "lumbar length adjustment";
CM_ SG_ 464 LumLenAdjmtRowFirstPass "lumbar length adjustment";
CM_ SG_ 464 PassSeatDispMassgFctMassgInten "Massage program Intensity Level";
CM_ SG_ 464 PassSeatDispMassgFctMassgProg "Massage Programs Types";
CM_ SG_ 464 PassSeatDispMassgFctOnOffl2 "Turn on or off seat massage";
CM_ SG_ 464 PassSeatDispSpplFct "Handles the two way communication for passenger multi seat control.";
CM_ SG_ 464 SteerWhlHeatngAutStrtReq "automatic start steering wheel heating request";
CM_ SG_ 464 SunCurtCtrlReq "User operate suncurt open and close";
CM_ SG_ 464 SunRoofCtrlReq "User operate sunroof open and close";
CM_ SG_ 464 SwtPwrStsOfVehSurrndgsVisnRec "This signal :Whether DVR is activated during Parking Security Monitor.";
CM_ SG_ 464 TelmBookChrgnTyp "Telm Book Chrgn Type from HIM or APP";
CM_ SG_ 464 WirelschrgActvReqFromHmi "On Off";
CM_ SG_ 311 AirCushInflateDeflateReq "Air cushion inflate&Deflate requst";
CM_ SG_ 311 AmbientLiEffectStatus1 "Ambient light effect of customized mode";
CM_ SG_ 311 AmbLiChrgCorrlnReq "Open or close ambience light indication when charging.";
CM_ SG_ 311 AmbLiDirCorrlnReq "Open or close ambience light indication when turn on direction light.";
CM_ SG_ 311 AmbLiDoorCorrlnReq "Open or close ambience light indication when door is moving.";
CM_ SG_ 311 AmbLiDrvModCorrlnReq "Open or close ambience light indication when drive mode changes.";
CM_ SG_ 311 AmbLiRadarCorrlnReq "Open or close ambience light indication when obstacle is detected.";
CM_ SG_ 311 AmbLiResd "Ambient light reserved signal";
CM_ SG_ 311 AmbLiSpdSwt "Ambient light rate";
CM_ SG_ 311 AmbLiStrtCorrlnReq "Open or close ambience light indication when start vehicle.";
CM_ SG_ 311 AmbLiThemeReq "Select ambient light theme mode";
CM_ SG_ 311 AmbLiUnlckCorrlnReq "ambient light unlock correlation request";
CM_ SG_ 311 AssistantLiEnaSwt "Assistant light switch";
CM_ SG_ 311 CarpetLiModReq "this port is used to inform the exterior light subsystem the user choose which one mode of carpet light.";
CM_ SG_ 311 ChdLockSideSelnSwt "Set which child lock can be control when user click hard switch";
CM_ SG_ 311 DoorPocketLiSwt "Door pocket light switch";
CM_ SG_ 311 DrvrSeatDispPhytheraFctOnOff1 "Turn on or off seat physiotherapy";
CM_ SG_ 311 DrvrSeatDispPhytheraFctPhytheraProgTyp "Physiotherapy Programs Types";
CM_ SG_ 311 EasyInOutSecRowLeActv "easy in out onoff";
CM_ SG_ 311 EasyInOutSecRowRiActv "easy in out onoff";
CM_ SG_ 311 ExtrMirrAdjHmiReq "Adjust the exterior mirror position";
CM_ SG_ 311 ExtrMirrFoldHmiReq "Fold the left and right exterior mirror request";
CM_ SG_ 311 ExtrMirrSelnHmiReq "Select left or right exterior mirror to adjust";
CM_ SG_ 311 FogSetFrntReq "turn on or turn off front fog light";
CM_ SG_ 311 FootwellLiSwt "Footwell light switch";
CM_ SG_ 311 FrntTechnologyLiPosLiCorrlnSwt "Front technology light and position light correlation switch";
CM_ SG_ 311 HmiAC "Hmi Compartment Cooling Request";
CM_ SG_ 311 HMIAutoTerrainSetting "HMIAutoTerrainSetting";
CM_ SG_ 311 HmiElecFrntDefrstReq "Hmi Electric Defrost";
CM_ SG_ 311 HmiElecReMirrDefrstReq "HMI Rear Mirror Defrost";
CM_ SG_ 311 HmiElecReWinDefrstReq "Hmi Rear Window Defrost";
CM_ SG_ 311 IdleChrgCtrl "Soft switch signal for idle charging control.";
CM_ SG_ 311 LegRestHozlAdjmtRowSecLe "Second row left seat leg support front and rear adjustment";
CM_ SG_ 311 LegRestHozlAdjmtRowSecRi "Second row right seat leg support front and rear adjustment";
CM_ SG_ 311 LegRestRotAdjmtRowThrdLe "the third row left seat leg rest rotation(up/down)adjustment";
CM_ SG_ 311 LegRestRotAdjmtRowThrdRi "the third row right seat leg rest rotation(up/down)  adjustment";
CM_ SG_ 311 NFCKeyReadReq "NFC key read request";
CM_ SG_ 311 NightLiSwtSts "Night light switch";
CM_ SG_ 311 OneKeyLvlgSwt "One key leveling soft switch";
CM_ SG_ 311 OTACmplSts "OTA trigger Intelligent power supply";
CM_ SG_ 311 PassSeatDispPhytheraFctOnOff1 "Turn on or off seat physiotherapy";
CM_ SG_ 311 PassSeatDispPhytheraFctPhytheraProgTyp "Physiotherapy Programs Types";
CM_ SG_ 311 PrpsnHvBattUsgModReq "hight voltage power mode request";
CM_ SG_ 311 PwrSldDoorLeReOpenHmiReq "Power sliding left door open or close request";
CM_ SG_ 311 PwrSldDoorRiReOpenHmiReq "Power sliding right door open or close request";
CM_ SG_ 311 PwrSldgDoorLePosnReqFromHmi "Control the left power sliding door 0-100% position status";
CM_ SG_ 311 PwrSldgDoorRiPosnReqFromHmi "Control the right power sliding door 0-100% position status";
CM_ SG_ 311 RadioFrqAM "radio frequency analog";
CM_ SG_ 311 ReSeatQuickAdjmt " Rear seat quick adjustment mode setup";
CM_ SG_ 311 SaveSetgToMemPrmnt "Signal for personal settings saving concept
0: Profile locked, no saving to be performed
1: On the event (toggle 0 to 1) settings shall be saved (manually saving)
2: Automatic saving";
CM_ SG_ 311 SearchLiSwtSts "Click the button to turn on the light, making it easier to find things";
CM_ SG_ 311 SpdCtrlSwt "Speed-based height control soft switch";
CM_ SG_ 311 SunRoofAndCurtIninSwt "Sunroof and sun curtain initialazation switch";
CM_ SG_ 311 SuspEasyLoadSet "SuspEasyLoadSet";
CM_ SG_ 311 SuspHeiLvlSet "SuspHeiLvlSet";
CM_ SG_ 311 TechnologyLiOnOffSwt "Front technology light all on/off switch";
CM_ SG_ 311 TrfcSideSetReq "this signal is used to set Left/Right Traffic Side for exterior  light systerm ";
CM_ SG_ 311 TrOpenPosnReqFromHmi "Request open position from HMI";
CM_ SG_ 311 TrunkOpenHmiReq "Boot lid/Tailgate open or close request";
CM_ SG_ 311 WinOpenDrvrReq "driver window open";
CM_ SG_ 311 WinOpenPassReq "passenger window open";
CM_ SG_ 311 WinOpenReLeReq "rear window left open";
CM_ SG_ 311 WinOpenReRiReq "rear window right open";
CM_ SG_ 311 Zone1SettingsBlue "Color settings for zone 1";
CM_ SG_ 311 Zone1SettingsGreen "Color settings for zone 1";
CM_ SG_ 311 Zone1SettingsIntensity "intensity settings for zone 1";
CM_ SG_ 311 Zone1SettingsRed "Color settings for zone 1";
CM_ SG_ 311 Zone1SettingsZoneStatus "Zone status settings for zone 1";
CM_ SG_ 311 Zone2SettingsBlue "Color settings for zone 2";
CM_ SG_ 311 Zone2SettingsGreen "Color settings for zone 2";
CM_ SG_ 311 Zone2SettingsIntensity "intensity settings for zone 2";
CM_ SG_ 311 Zone2SettingsRed "Color settings for zone 2";
CM_ SG_ 311 Zone2SettingsZoneStatus "Zone status settings for zone 2";
CM_ SG_ 311 Zone3SettingsBlue "Color settings for zone 3";
CM_ SG_ 311 Zone3SettingsGreen "Color settings for zone 3";
CM_ SG_ 311 Zone3SettingsIntensity "intensity settings for zone 3";
CM_ SG_ 311 Zone3SettingsRed "Color settings for zone 3";
CM_ SG_ 311 Zone3SettingsZoneStatus "Zone status settings for zone 3";
CM_ SG_ 66 ApproachReqData1 "data";
CM_ SG_ 66 ApproachReqData10 "data";
CM_ SG_ 66 ApproachReqData11 "data";
CM_ SG_ 66 ApproachReqData12 "data";
CM_ SG_ 66 ApproachReqData13 "data";
CM_ SG_ 66 ApproachReqData14 "data";
CM_ SG_ 66 ApproachReqData15 "data";
CM_ SG_ 66 ApproachReqData16 "data";
CM_ SG_ 66 ApproachReqData2 "data";
CM_ SG_ 66 ApproachReqData3 "data";
CM_ SG_ 66 ApproachReqData4 "data";
CM_ SG_ 66 ApproachReqData5 "data";
CM_ SG_ 66 ApproachReqData6 "data";
CM_ SG_ 66 ApproachReqData7 "data";
CM_ SG_ 66 ApproachReqData8 "data";
CM_ SG_ 66 ApproachReqData9 "data";
CM_ SG_ 66 DchaChrgnTarVal "DisCharging Target Value Setting";
CM_ SG_ 66 DChaEngStsCtrl "on/off button,To start the engine to charge the battery.";
CM_ SG_ 66 DstFromDestination "Distance from destination";
CM_ SG_ 66 HVPwrDwnRstReq "HV Power down reset req.";
CM_ SG_ 66 PrpsnHvBattUsgOfChrgTarSOC "the target SOC of Battery usage mode charge to the propulsion";
CM_ SG_ 66 ReadLiOpenReqFrontLeft "Reading light Open or close request";
CM_ SG_ 66 ReadLiOpenReqFrontRight "Reading light Open or close request";
CM_ SG_ 66 ReadLiOpenReqSecondRowLeft "Reading light Open or close request";
CM_ SG_ 66 ReadLiOpenReqSecondRowRight "Reading light Open or close request";
CM_ SG_ 66 ReadLiOpenReqThirdRowLeft "Reading light Open or close request";
CM_ SG_ 66 ReadLiOpenReqThirdRowRight "Reading light Open or close request";
CM_ SG_ 66 RemBookChrgnTarVal "Remote Book Charging Target Value";
CM_ SG_ 66 RKEAndNFCReqStsData1 "data";
CM_ SG_ 66 RKEAndNFCReqStsData10 "data";
CM_ SG_ 66 RKEAndNFCReqStsData11 "data";
CM_ SG_ 66 RKEAndNFCReqStsData12 "data";
CM_ SG_ 66 RKEAndNFCReqStsData13 "data";
CM_ SG_ 66 RKEAndNFCReqStsData14 "data";
CM_ SG_ 66 RKEAndNFCReqStsData15 "data";
CM_ SG_ 66 RKEAndNFCReqStsData16 "data";
CM_ SG_ 66 RKEAndNFCReqStsData2 "data";
CM_ SG_ 66 RKEAndNFCReqStsData3 "data";
CM_ SG_ 66 RKEAndNFCReqStsData4 "data";
CM_ SG_ 66 RKEAndNFCReqStsData5 "data";
CM_ SG_ 66 RKEAndNFCReqStsData6 "data";
CM_ SG_ 66 RKEAndNFCReqStsData7 "data";
CM_ SG_ 66 RKEAndNFCReqStsData8 "data";
CM_ SG_ 66 RKEAndNFCReqStsData9 "data";
CM_ SG_ 66 TopPosTrFromHmi "This signal is used to set top position of tailgate";
CM_ SG_ 66 UsrSpeechSts "The signal of user speech status";
CM_ SG_ 66 WinOpenAppReqWindowOpenValue "Windows open value pec open 1-100";
CM_ SG_ 66 WinOpenAppReqWinOpenClsGlbSts "Remote global windows open and closed command request from Connected Service Sub-system";
CM_ SG_ 272 BookTrvlClimaActvReq "The request to activate air conditioning for the booking travel function with climate control";
CM_ SG_ 272 CarFindrHornLiReqFromTelm "Request signal from Telematics to activate the Car Locator Horn and Light function (FR Mobile App).";
CM_ SG_ 272 CbnOverHeatProtnEnaFromTelm "Users activate or inactivate the cabin overheat protection function through mobile app";
CM_ SG_ 272 ChrgLidTelmLockgReq "Release request for charging lid unlocking by phone App.";
CM_ SG_ 272 ClimaRqrd1 "Request signal from Telematics to start or stop a remote pre-climatization.";
CM_ SG_ 272 ClimaTmrStsTelmRqrd "Pre-climatization  Indicate  an active time ";
CM_ SG_ 272 EmgyAsscTrigSts "Defined the signal as:
0: when the eCall without trigget
1: eCall been automatically trigget by SRS
2: eCall been manually trigget by user via SOS button
3: eCall has fault when SRS trigget crash   ";
CM_ SG_ 272 EngForbidReqFromTelm "remote forbid engine start";
CM_ SG_ 272 EngPermitReqFromTelm "remote permit engine start";
CM_ SG_ 272 ExtrLiShowActvnReq "Request signal for activating Light show, if the value has been set to on. ";
CM_ SG_ 272 ExtrLiShowFileTxReq "Request signal for transferring sequence table. If the value has been set to on, the parameter of lamp elements can be downloaded from IHU to HCM/RCM. ";
CM_ SG_ 272 FreqencyChargn "FreqencyChargn from TSP";
CM_ SG_ 272 RemCtrlLoUPwrOutpReqZone1 "Low voltage switch for remote control low voltage discharge request 1";
CM_ SG_ 272 RemCtrlLoUPwrOutpReqZone2 "Low voltage switch for remote control low voltage discharge request 2";
CM_ SG_ 272 RemCtrlLoUPwrOutpReqZone3 "Low voltage switch for remote control low voltage discharge request 3";
CM_ SG_ 272 RemCtrlLoUPwrOutpReqZone4 "Low voltage switch for remote control low voltage discharge request 4";
CM_ SG_ 272 RemCtrlLoUPwrOutpReqZone5 "Low voltage switch for remote control low voltage discharge request 5";
CM_ SG_ 272 RemCtrlLoUPwrOutpReqZone6 "Low voltage switch for remote control low voltage discharge request 6";
CM_ SG_ 272 TelmDefrostTmr "TelmDefrostTmr";
CM_ SG_ 272 TelmSeatHeatDrvrTmr "TelmSeatHeatDrvrTmr";
CM_ SG_ 272 TelmSeatHeatPassTmr "TelmSeatHeatPassTmr";
CM_ SG_ 272 TelmSeatHeatSecLeTmr "TelmSeatHeatSecLeTmr";
CM_ SG_ 272 TelmSeatHeatSecRiTmr "TelmSeatHeatSecRiTmr";
CM_ SG_ 272 TelmSeatHeatThrdLeTmr "TelmSeatHeatThrdLeTmr";
CM_ SG_ 272 TelmSeatHeatThrdRiTmr "TelmSeatHeatThrdRiTmr";
CM_ SG_ 272 TelmSeatVentnDrvrTmr "TelmSeatVentnDrvrTmr";
CM_ SG_ 272 TelmSeatVentnPassTmr "TelmSeatVentnPassTmr";
CM_ SG_ 272 TelmSeatVentnSecLeTmr "TelmSeatVentnSecLeTmr";
CM_ SG_ 272 TelmSeatVentnSecRiTmr "TelmSeatVentnSecRiTmr";
CM_ SG_ 272 TelmSeatVentnThrdLeTmr "TelmSeatVentnThrdLeTmr";
CM_ SG_ 272 TelmSeatVentnThrdRiTmr "TelmSeatVentnThrdRiTmr";
CM_ SG_ 272 TelmSteerWhlHeatTmr "TelmSteerWhlHeatTmr";
CM_ SG_ 272 TelmThermoTankReq1 "Remote Thermotank Control request";
CM_ SG_ 272 TelmThermoTankT "temperature setting for Remote Thermotank Control ";
CM_ SG_ 272 TelmThermoTankTmr1 "Running time setting for Remote Thermotank Control ";
CM_ SG_ 74 BLEKeySearchRespData1 "data";
CM_ SG_ 74 BLEKeySearchRespData10 "data";
CM_ SG_ 74 BLEKeySearchRespData11 "data";
CM_ SG_ 74 BLEKeySearchRespData12 "data";
CM_ SG_ 74 BLEKeySearchRespData13 "data";
CM_ SG_ 74 BLEKeySearchRespData14 "data";
CM_ SG_ 74 BLEKeySearchRespData15 "data";
CM_ SG_ 74 BLEKeySearchRespData16 "data";
CM_ SG_ 74 BLEKeySearchRespData2 "data";
CM_ SG_ 74 BLEKeySearchRespData3 "data";
CM_ SG_ 74 BLEKeySearchRespData4 "data";
CM_ SG_ 74 BLEKeySearchRespData5 "data";
CM_ SG_ 74 BLEKeySearchRespData6 "data";
CM_ SG_ 74 BLEKeySearchRespData7 "data";
CM_ SG_ 74 BLEKeySearchRespData8 "data";
CM_ SG_ 74 BLEKeySearchRespData9 "data";
CM_ SG_ 74 NFCAndBLEKeyEnaStsData1 "data";
CM_ SG_ 74 NFCAndBLEKeyEnaStsData10 "data";
CM_ SG_ 74 NFCAndBLEKeyEnaStsData11 "data";
CM_ SG_ 74 NFCAndBLEKeyEnaStsData12 "data";
CM_ SG_ 74 NFCAndBLEKeyEnaStsData13 "data";
CM_ SG_ 74 NFCAndBLEKeyEnaStsData14 "data";
CM_ SG_ 74 NFCAndBLEKeyEnaStsData15 "data";
CM_ SG_ 74 NFCAndBLEKeyEnaStsData16 "data";
CM_ SG_ 74 NFCAndBLEKeyEnaStsData2 "data";
CM_ SG_ 74 NFCAndBLEKeyEnaStsData3 "data";
CM_ SG_ 74 NFCAndBLEKeyEnaStsData4 "data";
CM_ SG_ 74 NFCAndBLEKeyEnaStsData5 "data";
CM_ SG_ 74 NFCAndBLEKeyEnaStsData6 "data";
CM_ SG_ 74 NFCAndBLEKeyEnaStsData7 "data";
CM_ SG_ 74 NFCAndBLEKeyEnaStsData8 "data";
CM_ SG_ 74 NFCAndBLEKeyEnaStsData9 "data";
CM_ SG_ 74 NFCKeySearchRespData1 "data";
CM_ SG_ 74 NFCKeySearchRespData10 "data";
CM_ SG_ 74 NFCKeySearchRespData11 "data";
CM_ SG_ 74 NFCKeySearchRespData12 "data";
CM_ SG_ 74 NFCKeySearchRespData13 "data";
CM_ SG_ 74 NFCKeySearchRespData14 "data";
CM_ SG_ 74 NFCKeySearchRespData15 "data";
CM_ SG_ 74 NFCKeySearchRespData16 "data";
CM_ SG_ 74 NFCKeySearchRespData2 "data";
CM_ SG_ 74 NFCKeySearchRespData3 "data";
CM_ SG_ 74 NFCKeySearchRespData4 "data";
CM_ SG_ 74 NFCKeySearchRespData5 "data";
CM_ SG_ 74 NFCKeySearchRespData6 "data";
CM_ SG_ 74 NFCKeySearchRespData7 "data";
CM_ SG_ 74 NFCKeySearchRespData8 "data";
CM_ SG_ 74 NFCKeySearchRespData9 "data";
CM_ SG_ 293 AutoHldTechLiEna "autohold relative light enable";
CM_ SG_ 293 ChdLockCmnCtrlHmiReq "Switch to control both of child lock";
CM_ SG_ 293 DrvModReqForChampnMod "Drive Mode for champion mode";
CM_ SG_ 293 DrvrLineOfSightSts "The direction of the driver's line of sight";
CM_ SG_ 293 LowrTailgOpenHmiReq "Low tailgate open or close request";
CM_ SG_ 293 MusicInfoSeg11SegFftLiShow1 "amplitude-frequency results of 1st segment";
CM_ SG_ 293 MusicInfoSeg11SegFftLiShow10 "amplitude-frequency results of 11st segment";
CM_ SG_ 293 MusicInfoSeg11SegFftLiShow11 "amplitude-frequency results of 11st segment";
CM_ SG_ 293 MusicInfoSeg11SegFftLiShow12 "amplitude-frequency results of 12st segment";
CM_ SG_ 293 MusicInfoSeg11SegFftLiShow13 "amplitude-frequency results of 13st segment";
CM_ SG_ 293 MusicInfoSeg11SegFftLiShow14 "amplitude-frequency results of 14st segment";
CM_ SG_ 293 MusicInfoSeg11SegFftLiShow2 "amplitude-frequency results of 2st segment";
CM_ SG_ 293 MusicInfoSeg11SegFftLiShow3 "amplitude-frequency results of 3st segment";
CM_ SG_ 293 MusicInfoSeg11SegFftLiShow4 "amplitude-frequency results of 4st segment";
CM_ SG_ 293 MusicInfoSeg11SegFftLiShow5 "amplitude-frequency results of 5st segment";
CM_ SG_ 293 MusicInfoSeg11SegFftLiShow6 "amplitude-frequency results of 6st segment";
CM_ SG_ 293 MusicInfoSeg11SegFftLiShow7 "amplitude-frequency results of 7st segment";
CM_ SG_ 293 MusicInfoSeg11SegFftLiShow8 "amplitude-frequency results of 8st segment";
CM_ SG_ 293 MusicInfoSeg11SegFftLiShow9 "amplitude-frequency results of 9st segment";
CM_ SG_ 293 MusicInfoSeg11TimeFlagMessage "data transmission time stamp";
CM_ SG_ 293 MusicInfoSeg11TimeFlagMusicplay "current music playback time stamp";
CM_ SG_ 293 MusicInfoSeg12SegFftLiShow15 "amplitude-frequency results of 15th segment";
CM_ SG_ 293 MusicInfoSeg12SegFftLiShow16 "amplitude-frequency results of 16th segment";
CM_ SG_ 293 MusicInfoSeg12SegFftLiShow17 "amplitude-frequency results of 17th segment";
CM_ SG_ 293 MusicInfoSeg12SegFftLiShow18 "amplitude-frequency results of 18th segment";
CM_ SG_ 293 MusicInfoSeg12SegFftLiShow19 "amplitude-frequency results of 19th segment";
CM_ SG_ 293 MusicInfoSeg12SegFftLiShow20 "amplitude-frequency results of 20th segment";
CM_ SG_ 293 MusicInfoSeg12SegFftLiShow21 "amplitude-frequency results of 21th segment";
CM_ SG_ 293 MusicInfoSeg12SegFftLiShow22 "amplitude-frequency results of 22th segment";
CM_ SG_ 293 MusicInfoSeg12SegFftLiShow23 "amplitude-frequency results of 23th segment";
CM_ SG_ 293 MusicInfoSeg12SegFftLiShow24 "amplitude-frequency results of 24th segment";
CM_ SG_ 293 MusicInfoSeg12SegFftLiShow25 "amplitude-frequency results of 25th segment";
CM_ SG_ 293 MusicInfoSeg12SegFftLiShow26 "amplitude-frequency results of 26th segment";
CM_ SG_ 293 MusicInfoSeg12SegFftLiShow27 "amplitude-frequency results of 27th segment";
CM_ SG_ 293 MusicInfoSeg12SegFftLiShow28 "amplitude-frequency results of 28th segment";
CM_ SG_ 293 MusicInfoSeg12TimeFlagMessage "data transmission time stamp";
CM_ SG_ 293 MusicInfoSeg12TimeFlagMusicplay "current music playback time stamp";
CM_ SG_ 293 MusicInfoSeg13DownSamplingAmplitude "The down-sampling amplitude data ";
CM_ SG_ 293 MusicInfoSeg13MaxFFT100ms3kAmplitude "The amplitude of max amplitude-frequency point among
100Hz-2.65kHz";
CM_ SG_ 293 MusicInfoSeg13MaxFFT100ms3kFrequency "The frequency of max amplitude-frequency point among
100Hz-2.65kHz";
CM_ SG_ 293 MusicInfoSeg13SegFftLiShow29 "amplitude-frequency results of 29th segment";
CM_ SG_ 293 MusicInfoSeg13SegFftLiShow30 "amplitude-frequency results of 30th segment";
CM_ SG_ 293 MusicInfoSeg13SegFftLiShow31 "amplitude-frequency results of 31th segment";
CM_ SG_ 293 MusicInfoSeg13StateFlagMusicPlay "Music Play Flag";
CM_ SG_ 293 MusicInfoSeg13StateFlagNewMusic "New Music Flag";
CM_ SG_ 293 MusicInfoSeg13TimeFlagMessage "data transmission time stamp";
CM_ SG_ 293 MusicInfoSeg13TimeFlagMusicplay "current music playback time stamp";
CM_ SG_ 293 MusicInfoSeg21SegFftLiShow1 "amplitude-frequency results of 1th segment";
CM_ SG_ 293 MusicInfoSeg21SegFftLiShow10 "amplitude-frequency results of 10th segment";
CM_ SG_ 293 MusicInfoSeg21SegFftLiShow11 "amplitude-frequency results of 11th segment";
CM_ SG_ 293 MusicInfoSeg21SegFftLiShow12 "amplitude-frequency results of 12th segment";
CM_ SG_ 293 MusicInfoSeg21SegFftLiShow13 "amplitude-frequency results of 13th segment";
CM_ SG_ 293 MusicInfoSeg21SegFftLiShow14 "amplitude-frequency results of 14th segment";
CM_ SG_ 293 MusicInfoSeg21SegFftLiShow2 "amplitude-frequency results of 2th segment";
CM_ SG_ 293 MusicInfoSeg21SegFftLiShow3 "amplitude-frequency results of 3th segment";
CM_ SG_ 293 MusicInfoSeg21SegFftLiShow4 "amplitude-frequency results of 4th segment";
CM_ SG_ 293 MusicInfoSeg21SegFftLiShow5 "amplitude-frequency results of 5th segment";
CM_ SG_ 293 MusicInfoSeg21SegFftLiShow6 "amplitude-frequency results of 6th segment";
CM_ SG_ 293 MusicInfoSeg21SegFftLiShow7 "amplitude-frequency results of 7th segment";
CM_ SG_ 293 MusicInfoSeg21SegFftLiShow8 "amplitude-frequency results of 8th segment";
CM_ SG_ 293 MusicInfoSeg21SegFftLiShow9 "amplitude-frequency results of 9th segment";
CM_ SG_ 293 MusicInfoSeg21TimeFlagMessage "data transmission time stamp";
CM_ SG_ 293 MusicInfoSeg21TimeFlagMusicplay "current music playback time stamp";
CM_ SG_ 293 MusicInfoSeg22SegFftLiShow15 "amplitude-frequency results of 15th segment";
CM_ SG_ 293 MusicInfoSeg22SegFftLiShow16 "amplitude-frequency results of 16th segment";
CM_ SG_ 293 MusicInfoSeg22SegFftLiShow17 "amplitude-frequency results of 17th segment";
CM_ SG_ 293 MusicInfoSeg22SegFftLiShow18 "amplitude-frequency results of 18th segment";
CM_ SG_ 293 MusicInfoSeg22SegFftLiShow19 "amplitude-frequency results of 19th segment";
CM_ SG_ 293 MusicInfoSeg22SegFftLiShow20 "amplitude-frequency results of 20th segment";
CM_ SG_ 293 MusicInfoSeg22SegFftLiShow21 "amplitude-frequency results of 21th segment";
CM_ SG_ 293 MusicInfoSeg22SegFftLiShow22 "amplitude-frequency results of 22th segment";
CM_ SG_ 293 MusicInfoSeg22SegFftLiShow23 "amplitude-frequency results of 23th segment";
CM_ SG_ 293 MusicInfoSeg22SegFftLiShow24 "amplitude-frequency results of 24th segment";
CM_ SG_ 293 MusicInfoSeg22SegFftLiShow25 "amplitude-frequency results of 25th segment";
CM_ SG_ 293 MusicInfoSeg22SegFftLiShow26 "amplitude-frequency results of 26th segment";
CM_ SG_ 293 MusicInfoSeg22SegFftLiShow27 "amplitude-frequency results of 27th segment";
CM_ SG_ 293 MusicInfoSeg22SegFftLiShow28 "amplitude-frequency results of 28th segment";
CM_ SG_ 293 MusicInfoSeg22TimeFlagMessage "data transmission time stamp";
CM_ SG_ 293 MusicInfoSeg22TimeFlagMusicplay "current music playback time stamp";
CM_ SG_ 293 MusicInfoSeg23DownSamplingAmplitude "The down-sampling amplitude data ";
CM_ SG_ 293 MusicInfoSeg23MaxFFT100ms3kAmplitude "The amplitude of max amplitude-frequency point among
100Hz-2.65kHz";
CM_ SG_ 293 MusicInfoSeg23MaxFFT100ms3kFrequency "The frequency of max amplitude-frequency point among
100Hz-2.65kHz";
CM_ SG_ 293 MusicInfoSeg23SegFftLiShow29 "amplitude-frequency results of 29th segment";
CM_ SG_ 293 MusicInfoSeg23SegFftLiShow30 "amplitude-frequency results of 30th segment";
CM_ SG_ 293 MusicInfoSeg23SegFftLiShow31 "amplitude-frequency results of 31th segment";
CM_ SG_ 293 MusicInfoSeg23StateFlagMusicPlay "Music Play Flag";
CM_ SG_ 293 MusicInfoSeg23StateFlagNewMusic "New Music Flag";
CM_ SG_ 293 MusicInfoSeg23TimeFlagMessage "data transmission time stamp";
CM_ SG_ 293 MusicInfoSeg23TimeFlagMusicplay "current music playback time stamp";
CM_ SG_ 293 PrkgLiShowSwt "Parking light show switch";
CM_ SG_ 293 RowSecRiSeatZeroGrvySwtReq "Second row right seat zero gravity switch request";
CM_ SG_ 293 SunroofGlassAutAdjmtHmiReq "Sunroof glass transparency automatic adjustment HMI request";
CM_ SG_ 293 SunroofTransparencyReq "Request sunroof transparency";
CM_ SG_ 293 VoiceCtrlMirrorDirection "direction of mirrror, up down left right";
CM_ SG_ 293 VoiceCtrlMirrorParams "control params for mirror";
CM_ SG_ 293 VoiceCtrlMirrorSide "side of mirror, left or right";
CM_ SG_ 293 WinColorAutAdjmtReLeHmiReq "window glass transparency automatic adjustment soft switch left";
CM_ SG_ 293 WinColorAutAdjmtReRiHmiReq "window glass transparency automatic adjustment soft switch right";
CM_ SG_ 293 WinTransparencyReLeReq "Request left window transparency";
CM_ SG_ 293 WinTransparencyReRiReq "Request right window transparency";
CM_ SG_ 293 WPCModuleStsBNCM2 "WPC charging status and exception status";
CM_ SG_ 96 DwnLoadDynLtgPrmForReGrp10ContinueTime "Light Show Continue Time Parameter 3";
CM_ SG_ 96 DwnLoadDynLtgPrmForReGrp10HighBrightness "Light Show Upper Brightness Parameter 3";
CM_ SG_ 96 DwnLoadDynLtgPrmForReGrp10LowBrightness "Light Show Lower Brightness Parameter 3";
CM_ SG_ 96 DwnLoadDynLtgPrmForReGrp10Mode1 "Light Show Mode Parameter 3";
CM_ SG_ 96 DwnLoadDynLtgPrmForReGrp10OffsetTime "Light Show Offset Time Parameter 3";
CM_ SG_ 96 DwnLoadDynLtgPrmForReGrp10Timestamp "Light Show time stamp 3";
CM_ SG_ 96 DwnLoadDynLtgPrmForReGrp11ContinueTime "Light Show Continue Time Parameter 3";
CM_ SG_ 96 DwnLoadDynLtgPrmForReGrp11HighBrightness "Light Show Upper Brightness Parameter 3";
CM_ SG_ 96 DwnLoadDynLtgPrmForReGrp11LowBrightness "Light Show Lower Brightness Parameter 3";
CM_ SG_ 96 DwnLoadDynLtgPrmForReGrp11Mode1 "Light Show Mode Parameter 3";
CM_ SG_ 96 DwnLoadDynLtgPrmForReGrp11OffsetTime "Light Show Offset Time Parameter 3";
CM_ SG_ 96 DwnLoadDynLtgPrmForReGrp11Timestamp "Light Show time stamp 3";
CM_ SG_ 96 DwnLoadDynLtgPrmForReGrp12ContinueTime "Light Show Continue Time Parameter 3";
CM_ SG_ 96 DwnLoadDynLtgPrmForReGrp12HighBrightness "Light Show Upper Brightness Parameter 3";
CM_ SG_ 96 DwnLoadDynLtgPrmForReGrp12LowBrightness "Light Show Lower Brightness Parameter 3";
CM_ SG_ 96 DwnLoadDynLtgPrmForReGrp12Mode1 "Light Show Mode Parameter 3";
CM_ SG_ 96 DwnLoadDynLtgPrmForReGrp12OffsetTime "Light Show Offset Time Parameter 3";
CM_ SG_ 96 DwnLoadDynLtgPrmForReGrp12Timestamp "Light Show time stamp 3";
CM_ SG_ 96 DwnLoadDynLtgPrmForReGrp13ContinueTime "Light Show Continue Time Parameter 3";
CM_ SG_ 96 DwnLoadDynLtgPrmForReGrp13HighBrightness "Light Show Upper Brightness Parameter 3";
CM_ SG_ 96 DwnLoadDynLtgPrmForReGrp13LowBrightness "Light Show Lower Brightness Parameter 3";
CM_ SG_ 96 DwnLoadDynLtgPrmForReGrp13Mode1 "Light Show Mode Parameter 3";
CM_ SG_ 96 DwnLoadDynLtgPrmForReGrp13OffsetTime "Light Show Offset Time Parameter 3";
CM_ SG_ 96 DwnLoadDynLtgPrmForReGrp13Timestamp "Light Show time stamp 3";
CM_ SG_ 96 DwnLoadDynLtgPrmForReGrp14ContinueTime "Light Show Continue Time Parameter 3";
CM_ SG_ 96 DwnLoadDynLtgPrmForReGrp14HighBrightness "Light Show Upper Brightness Parameter 3";
CM_ SG_ 96 DwnLoadDynLtgPrmForReGrp14LowBrightness "Light Show Lower Brightness Parameter 3";
CM_ SG_ 96 DwnLoadDynLtgPrmForReGrp14Mode1 "Light Show Mode Parameter 3";
CM_ SG_ 96 DwnLoadDynLtgPrmForReGrp14OffsetTime "Light Show Offset Time Parameter 3 ";
CM_ SG_ 96 DwnLoadDynLtgPrmForReGrp14Timestamp "Light Show time stamp 3";
CM_ SG_ 96 DwnLoadDynLtgPrmForReGrp15ContinueTime "Light Show Continue Time Parameter 3";
CM_ SG_ 96 DwnLoadDynLtgPrmForReGrp15HighBrightness "Light Show Upper Brightness Parameter 3";
CM_ SG_ 96 DwnLoadDynLtgPrmForReGrp15LowBrightness "Light Show Lower Brightness Parameter 3";
CM_ SG_ 96 DwnLoadDynLtgPrmForReGrp15Mode1 "Light Show Mode Parameter 3";
CM_ SG_ 96 DwnLoadDynLtgPrmForReGrp15OffsetTime "Light Show Offset Time Parameter 3";
CM_ SG_ 96 DwnLoadDynLtgPrmForReGrp15Timestamp "Light Show time stamp 3";
CM_ SG_ 96 DwnLoadDynLtgPrmForReGrp16ContinueTime "Light Show Continue Time Parameter 3";
CM_ SG_ 96 DwnLoadDynLtgPrmForReGrp16HighBrightness "Light Show Upper Brightness Parameter 3";
CM_ SG_ 96 DwnLoadDynLtgPrmForReGrp16LowBrightness "Light Show Lower Brightness Parameter 3";
CM_ SG_ 96 DwnLoadDynLtgPrmForReGrp16Mode1 "Light Show Mode Parameter 3";
CM_ SG_ 96 DwnLoadDynLtgPrmForReGrp16OffsetTime "Light Show Offset Time Parameter 3";
CM_ SG_ 96 DwnLoadDynLtgPrmForReGrp16Timestamp "Light Show time stamp 3";
CM_ SG_ 96 DwnLoadDynLtgPrmForReGrp1ContinueTime "Light Show Continue Time Parameter 3";
CM_ SG_ 96 DwnLoadDynLtgPrmForReGrp1HighBrightness "Light Show Upper Brightness Parameter 3";
CM_ SG_ 96 DwnLoadDynLtgPrmForReGrp1LowBrightness "Light Show Lower Brightness Parameter 3";
CM_ SG_ 96 DwnLoadDynLtgPrmForReGrp1Mode1 "Light Show Mode Parameter 3";
CM_ SG_ 96 DwnLoadDynLtgPrmForReGrp1OffsetTime "Light Show Offset Time Parameter 3";
CM_ SG_ 96 DwnLoadDynLtgPrmForReGrp1Timestamp "Light Show time stamp 3";
CM_ SG_ 96 DwnLoadDynLtgPrmForReGrp2ContinueTime "Light Show Continue Time Parameter 3";
CM_ SG_ 96 DwnLoadDynLtgPrmForReGrp2HighBrightness "Light Show Upper Brightness Parameter 3";
CM_ SG_ 96 DwnLoadDynLtgPrmForReGrp2LowBrightness "Light Show Lower Brightness Parameter 3";
CM_ SG_ 96 DwnLoadDynLtgPrmForReGrp2Mode1 "Light Show Mode Parameter 3";
CM_ SG_ 96 DwnLoadDynLtgPrmForReGrp2OffsetTime "Light Show Offset Time Parameter 3";
CM_ SG_ 96 DwnLoadDynLtgPrmForReGrp2Timestamp "Light Show time stamp 3";
CM_ SG_ 96 DwnLoadDynLtgPrmForReGrp3ContinueTime "Light Show Continue Time Parameter 3";
CM_ SG_ 96 DwnLoadDynLtgPrmForReGrp3HighBrightness "Light Show Upper Brightness Parameter 3";
CM_ SG_ 96 DwnLoadDynLtgPrmForReGrp3LowBrightness "Light Show Lower Brightness Parameter 3";
CM_ SG_ 96 DwnLoadDynLtgPrmForReGrp3Mode1 "Light Show Mode Parameter 3";
CM_ SG_ 96 DwnLoadDynLtgPrmForReGrp3OffsetTime "Light Show Offset Time Parameter 3";
CM_ SG_ 96 DwnLoadDynLtgPrmForReGrp3Timestamp "Light Show time stamp 3";
CM_ SG_ 96 DwnLoadDynLtgPrmForReGrp4ContinueTime "Light Show Continue Time Parameter 3";
CM_ SG_ 96 DwnLoadDynLtgPrmForReGrp4HighBrightness "Light Show Upper Brightness Parameter 3";
CM_ SG_ 96 DwnLoadDynLtgPrmForReGrp4LowBrightness "Light Show Lower Brightness Parameter 3";
CM_ SG_ 96 DwnLoadDynLtgPrmForReGrp4Mode1 "Light Show Mode Parameter 3";
CM_ SG_ 96 DwnLoadDynLtgPrmForReGrp4OffsetTime "Light Show Offset Time Parameter 3";
CM_ SG_ 96 DwnLoadDynLtgPrmForReGrp4Timestamp "Light Show time stamp 3";
CM_ SG_ 96 DwnLoadDynLtgPrmForReGrp5ContinueTime "Light Show Continue Time Parameter 3";
CM_ SG_ 96 DwnLoadDynLtgPrmForReGrp5HighBrightness "Light Show Upper Brightness Parameter 3";
CM_ SG_ 96 DwnLoadDynLtgPrmForReGrp5LowBrightness "Light Show Lower Brightness Parameter 3";
CM_ SG_ 96 DwnLoadDynLtgPrmForReGrp5Mode1 "Light Show Mode Parameter 3";
CM_ SG_ 96 DwnLoadDynLtgPrmForReGrp5OffsetTime "Light Show Offset Time Parameter 3 ";
CM_ SG_ 96 DwnLoadDynLtgPrmForReGrp5Timestamp "Light Show time stamp 3";
CM_ SG_ 96 DwnLoadDynLtgPrmForReGrp6ContinueTime "Light Show Continue Time Parameter 3";
CM_ SG_ 96 DwnLoadDynLtgPrmForReGrp6HighBrightness "Light Show Upper Brightness Parameter 3";
CM_ SG_ 96 DwnLoadDynLtgPrmForReGrp6LowBrightness "Light Show Lower Brightness Parameter 3";
CM_ SG_ 96 DwnLoadDynLtgPrmForReGrp6Mode1 "Light Show Mode Parameter 3";
CM_ SG_ 96 DwnLoadDynLtgPrmForReGrp6OffsetTime "Light Show Offset Time Parameter 3";
CM_ SG_ 96 DwnLoadDynLtgPrmForReGrp6Timestamp "Light Show time stamp 3";
CM_ SG_ 96 DwnLoadDynLtgPrmForReGrp7ContinueTime "Light Show Continue Time Parameter 3";
CM_ SG_ 96 DwnLoadDynLtgPrmForReGrp7HighBrightness "Light Show Upper Brightness Parameter 3";
CM_ SG_ 96 DwnLoadDynLtgPrmForReGrp7LowBrightness "Light Show Lower Brightness Parameter 3";
CM_ SG_ 96 DwnLoadDynLtgPrmForReGrp7Mode1 "Light Show Mode Parameter 3";
CM_ SG_ 96 DwnLoadDynLtgPrmForReGrp7OffsetTime "Light Show Offset Time Parameter 3";
CM_ SG_ 96 DwnLoadDynLtgPrmForReGrp7Timestamp "Light Show time stamp 3";
CM_ SG_ 96 DwnLoadDynLtgPrmForReGrp8ContinueTime "Light Show Continue Time Parameter 3";
CM_ SG_ 96 DwnLoadDynLtgPrmForReGrp8HighBrightness "Light Show Upper Brightness Parameter 3";
CM_ SG_ 96 DwnLoadDynLtgPrmForReGrp8LowBrightness "Light Show Lower Brightness Parameter 3";
CM_ SG_ 96 DwnLoadDynLtgPrmForReGrp8Mode1 "Light Show Mode Parameter 3";
CM_ SG_ 96 DwnLoadDynLtgPrmForReGrp8OffsetTime "Light Show Offset Time Parameter 3";
CM_ SG_ 96 DwnLoadDynLtgPrmForReGrp8Timestamp "Light Show time stamp 3";
CM_ SG_ 96 DwnLoadDynLtgPrmForReGrp9ContinueTime "Light Show Continue Time Parameter 3";
CM_ SG_ 96 DwnLoadDynLtgPrmForReGrp9HighBrightness "Light Show Upper Brightness Parameter 3";
CM_ SG_ 96 DwnLoadDynLtgPrmForReGrp9LowBrightness "Light Show Lower Brightness Parameter 3";
CM_ SG_ 96 DwnLoadDynLtgPrmForReGrp9Mode1 "Light Show Mode Parameter 3";
CM_ SG_ 96 DwnLoadDynLtgPrmForReGrp9OffsetTime "Light Show Offset Time Parameter 3";
CM_ SG_ 96 DwnLoadDynLtgPrmForReGrp9Timestamp "Light Show time stamp 3";
CM_ SG_ 97 DwnLoadDynLtgPrmForReGrp17ContinueTime "Light Show Continue Time Parameter 3";
CM_ SG_ 97 DwnLoadDynLtgPrmForReGrp17HighBrightness "Light Show Upper Brightness Parameter 3";
CM_ SG_ 97 DwnLoadDynLtgPrmForReGrp17LowBrightness "Light Show Lower Brightness Parameter 3";
CM_ SG_ 97 DwnLoadDynLtgPrmForReGrp17Mode1 "Light Show Mode Parameter 3";
CM_ SG_ 97 DwnLoadDynLtgPrmForReGrp17OffsetTime "Light Show Offset Time Parameter 3";
CM_ SG_ 97 DwnLoadDynLtgPrmForReGrp17Timestamp "Light Show time stamp 3";
CM_ SG_ 97 DwnLoadDynLtgPrmForReGrp18ContinueTime "Light Show Continue Time Parameter 3";
CM_ SG_ 97 DwnLoadDynLtgPrmForReGrp18HighBrightness "Light Show Upper Brightness Parameter 3";
CM_ SG_ 97 DwnLoadDynLtgPrmForReGrp18LowBrightness "Light Show Lower Brightness Parameter 3";
CM_ SG_ 97 DwnLoadDynLtgPrmForReGrp18Mode1 "Light Show Mode Parameter 3";
CM_ SG_ 97 DwnLoadDynLtgPrmForReGrp18OffsetTime "Light Show Offset Time Parameter 3";
CM_ SG_ 97 DwnLoadDynLtgPrmForReGrp18Timestamp "Light Show time stamp 3";
CM_ SG_ 97 DwnLoadDynLtgPrmForReGrp19ContinueTime "Light Show Continue Time Parameter 3";
CM_ SG_ 97 DwnLoadDynLtgPrmForReGrp19HighBrightness "Light Show Upper Brightness Parameter 3";
CM_ SG_ 97 DwnLoadDynLtgPrmForReGrp19LowBrightness "Light Show Lower Brightness Parameter 3";
CM_ SG_ 97 DwnLoadDynLtgPrmForReGrp19Mode1 "Light Show Mode Parameter 3";
CM_ SG_ 97 DwnLoadDynLtgPrmForReGrp19OffsetTime "Light Show Offset Time Parameter 3";
CM_ SG_ 97 DwnLoadDynLtgPrmForReGrp19Timestamp "Light Show time stamp 3";
CM_ SG_ 97 DwnLoadDynLtgPrmForReGrp20ContinueTime "Light Show Continue Time Parameter 3";
CM_ SG_ 97 DwnLoadDynLtgPrmForReGrp20HighBrightness "Light Show Upper Brightness Parameter 3";
CM_ SG_ 97 DwnLoadDynLtgPrmForReGrp20LowBrightness "Light Show Lower Brightness Parameter 3";
CM_ SG_ 97 DwnLoadDynLtgPrmForReGrp20Mode1 "Light Show Mode Parameter 3";
CM_ SG_ 97 DwnLoadDynLtgPrmForReGrp20OffsetTime "Light Show Offset Time Parameter 3";
CM_ SG_ 97 DwnLoadDynLtgPrmForReGrp20Timestamp "Light Show time stamp 3";
CM_ SG_ 97 DwnLoadDynLtgPrmForReGrp21ContinueTime "Light Show Continue Time Parameter 3";
CM_ SG_ 97 DwnLoadDynLtgPrmForReGrp21HighBrightness "Light Show Upper Brightness Parameter 3";
CM_ SG_ 97 DwnLoadDynLtgPrmForReGrp21LowBrightness "Light Show Lower Brightness Parameter 3";
CM_ SG_ 97 DwnLoadDynLtgPrmForReGrp21Mode1 "Light Show Mode Parameter 3";
CM_ SG_ 97 DwnLoadDynLtgPrmForReGrp21OffsetTime "Light Show Offset Time Parameter 3";
CM_ SG_ 97 DwnLoadDynLtgPrmForReGrp21Timestamp "Light Show time stamp 3";
CM_ SG_ 97 DwnLoadDynLtgPrmForReGrp22ContinueTime "Light Show Continue Time Parameter 3";
CM_ SG_ 97 DwnLoadDynLtgPrmForReGrp22HighBrightness "Light Show Upper Brightness Parameter 3";
CM_ SG_ 97 DwnLoadDynLtgPrmForReGrp22LowBrightness "Light Show Lower Brightness Parameter 3";
CM_ SG_ 97 DwnLoadDynLtgPrmForReGrp22Mode1 "Light Show Mode Parameter 3";
CM_ SG_ 97 DwnLoadDynLtgPrmForReGrp22OffsetTime "Light Show Offset Time Parameter 3";
CM_ SG_ 97 DwnLoadDynLtgPrmForReGrp22Timestamp "Light Show time stamp 3";
CM_ SG_ 97 DwnLoadDynLtgPrmForReGrp23ContinueTime "Light Show Continue Time Parameter 3";
CM_ SG_ 97 DwnLoadDynLtgPrmForReGrp23HighBrightness "Light Show Upper Brightness Parameter 3";
CM_ SG_ 97 DwnLoadDynLtgPrmForReGrp23LowBrightness "Light Show Lower Brightness Parameter 3";
CM_ SG_ 97 DwnLoadDynLtgPrmForReGrp23Mode1 "Light Show Mode Parameter 3";
CM_ SG_ 97 DwnLoadDynLtgPrmForReGrp23OffsetTime "Light Show Offset Time Parameter 3";
CM_ SG_ 97 DwnLoadDynLtgPrmForReGrp23Timestamp "Light Show time stamp 3";
CM_ SG_ 97 DwnLoadDynLtgPrmForReGrp24ContinueTime "Light Show Continue Time Parameter 3";
CM_ SG_ 97 DwnLoadDynLtgPrmForReGrp24HighBrightness "Light Show Upper Brightness Parameter 3";
CM_ SG_ 97 DwnLoadDynLtgPrmForReGrp24LowBrightness "Light Show Lower Brightness Parameter 3";
CM_ SG_ 97 DwnLoadDynLtgPrmForReGrp24Mode1 "Light Show Mode Parameter 3";
CM_ SG_ 97 DwnLoadDynLtgPrmForReGrp24OffsetTime "Light Show Offset Time Parameter 3";
CM_ SG_ 97 DwnLoadDynLtgPrmForReGrp24Timestamp "Light Show time stamp 3";
CM_ SG_ 97 DwnLoadDynLtgPrmForReGrp25ContinueTime "Light Show Continue Time Parameter 3";
CM_ SG_ 97 DwnLoadDynLtgPrmForReGrp25HighBrightness "Light Show Upper Brightness Parameter 3";
CM_ SG_ 97 DwnLoadDynLtgPrmForReGrp25LowBrightness "Light Show Lower Brightness Parameter 3";
CM_ SG_ 97 DwnLoadDynLtgPrmForReGrp25Mode1 "Light Show Mode Parameter 3";
CM_ SG_ 97 DwnLoadDynLtgPrmForReGrp25OffsetTime "Light Show Offset Time Parameter 3";
CM_ SG_ 97 DwnLoadDynLtgPrmForReGrp25Timestamp "Light Show time stamp 3";
CM_ SG_ 97 DwnLoadDynLtgPrmForReGrp26ContinueTime "Light Show Continue Time Parameter 3";
CM_ SG_ 97 DwnLoadDynLtgPrmForReGrp26HighBrightness "Light Show Upper Brightness Parameter 3";
CM_ SG_ 97 DwnLoadDynLtgPrmForReGrp26LowBrightness "Light Show Lower Brightness Parameter 3";
CM_ SG_ 97 DwnLoadDynLtgPrmForReGrp26Mode1 "Light Show Mode Parameter 3";
CM_ SG_ 97 DwnLoadDynLtgPrmForReGrp26OffsetTime "Light Show Offset Time Parameter 3";
CM_ SG_ 97 DwnLoadDynLtgPrmForReGrp26Timestamp "Light Show time stamp 3";
CM_ SG_ 97 DwnLoadDynLtgPrmForReGrp27ContinueTime "Light Show Continue Time Parameter 3";
CM_ SG_ 97 DwnLoadDynLtgPrmForReGrp27HighBrightness "Light Show Upper Brightness Parameter 3";
CM_ SG_ 97 DwnLoadDynLtgPrmForReGrp27LowBrightness "Light Show Lower Brightness Parameter 3";
CM_ SG_ 97 DwnLoadDynLtgPrmForReGrp27Mode1 "Light Show Mode Parameter 3";
CM_ SG_ 97 DwnLoadDynLtgPrmForReGrp27OffsetTime "Light Show Offset Time Parameter 3 ";
CM_ SG_ 97 DwnLoadDynLtgPrmForReGrp27Timestamp "Light Show time stamp 3";
CM_ SG_ 97 DwnLoadDynLtgPrmForReGrp28ContinueTime "Light Show Continue Time Parameter 3";
CM_ SG_ 97 DwnLoadDynLtgPrmForReGrp28HighBrightness "Light Show Upper Brightness Parameter 3";
CM_ SG_ 97 DwnLoadDynLtgPrmForReGrp28LowBrightness "Light Show Lower Brightness Parameter 3";
CM_ SG_ 97 DwnLoadDynLtgPrmForReGrp28Mode1 "Light Show Mode Parameter 3";
CM_ SG_ 97 DwnLoadDynLtgPrmForReGrp28OffsetTime "Light Show Offset Time Parameter 3";
CM_ SG_ 97 DwnLoadDynLtgPrmForReGrp28Timestamp "Light Show time stamp 3";
CM_ SG_ 97 DwnLoadDynLtgPrmForReGrp29ContinueTime "Light Show Continue Time Parameter 3";
CM_ SG_ 97 DwnLoadDynLtgPrmForReGrp29HighBrightness "Light Show Upper Brightness Parameter 3";
CM_ SG_ 97 DwnLoadDynLtgPrmForReGrp29LowBrightness "Light Show Lower Brightness Parameter 3";
CM_ SG_ 97 DwnLoadDynLtgPrmForReGrp29Mode1 "Light Show Mode Parameter 3";
CM_ SG_ 97 DwnLoadDynLtgPrmForReGrp29OffsetTime "Light Show Offset Time Parameter 3";
CM_ SG_ 97 DwnLoadDynLtgPrmForReGrp29Timestamp "Light Show time stamp 3";
CM_ SG_ 97 DwnLoadDynLtgPrmForReGrp30ContinueTime "Light Show Continue Time Parameter 3";
CM_ SG_ 97 DwnLoadDynLtgPrmForReGrp30HighBrightness "Light Show Upper Brightness Parameter 3";
CM_ SG_ 97 DwnLoadDynLtgPrmForReGrp30LowBrightness "Light Show Lower Brightness Parameter 3";
CM_ SG_ 97 DwnLoadDynLtgPrmForReGrp30Mode1 "Light Show Mode Parameter 3";
CM_ SG_ 97 DwnLoadDynLtgPrmForReGrp30OffsetTime "Light Show Offset Time Parameter 3";
CM_ SG_ 97 DwnLoadDynLtgPrmForReGrp30Timestamp "Light Show time stamp 3";
CM_ SG_ 1352 VFCVectorDHUBlockID "BlockID";
CM_ SG_ 1352 VFCVectorDHUVFCid0 "SettingsComfort";
CM_ SG_ 1352 VFCVectorDHUVFCid1 "ParkingDrivingClimatization";
CM_ SG_ 1352 VFCVectorDHUVFCid10 "ExteriorLighting";
CM_ SG_ 1352 VFCVectorDHUVFCid11 "VFC11";
CM_ SG_ 1352 VFCVectorDHUVFCid12 "Alarm";
CM_ SG_ 1352 VFCVectorDHUVFCid13 "VFC13";
CM_ SG_ 1352 VFCVectorDHUVFCid14 "InteriorLighting";
CM_ SG_ 1352 VFCVectorDHUVFCid15 "VFC15";
CM_ SG_ 1352 VFCVectorDHUVFCid16 "Locking";
CM_ SG_ 1352 VFCVectorDHUVFCid17 "RemoteKeyFunctionality";
CM_ SG_ 1352 VFCVectorDHUVFCid18 "PropulsionStart";
CM_ SG_ 1352 VFCVectorDHUVFCid19 "VFC19";
CM_ SG_ 1352 VFCVectorDHUVFCid2 "PostClimatisation";
CM_ SG_ 1352 VFCVectorDHUVFCid20 "VFC20";
CM_ SG_ 1352 VFCVectorDHUVFCid21 "PowerClosures";
CM_ SG_ 1352 VFCVectorDHUVFCid22 "VehicleDriving";
CM_ SG_ 1352 VFCVectorDHUVFCid23 "VFC23";
CM_ SG_ 1352 VFCVectorDHUVFCid24 "SettingsProfile";
CM_ SG_ 1352 VFCVectorDHUVFCid25 "SeatComfortFunctions";
CM_ SG_ 1352 VFCVectorDHUVFCid26 "Brake";
CM_ SG_ 1352 VFCVectorDHUVFCid27 "InfotainmentPoll";
CM_ SG_ 1352 VFCVectorDHUVFCid28 "HVEnergyStorage";
CM_ SG_ 1352 VFCVectorDHUVFCid29 "VFC29";
CM_ SG_ 1352 VFCVectorDHUVFCid3 "PowertrainParkingClimatization";
CM_ SG_ 1352 VFCVectorDHUVFCid30 "TelematicsConnectivity";
CM_ SG_ 1352 VFCVectorDHUVFCid31 "VFC31";
CM_ SG_ 1352 VFCVectorDHUVFCid32 "VFC32";
CM_ SG_ 1352 VFCVectorDHUVFCid33 "Diagnostics";
CM_ SG_ 1352 VFCVectorDHUVFCid34 "VehicleModeManagement";
CM_ SG_ 1352 VFCVectorDHUVFCid35 "TrailerCaravanFunctions";
CM_ SG_ 1352 VFCVectorDHUVFCid36 "Immobilizer";
CM_ SG_ 1352 VFCVectorDHUVFCid37 "Windows";
CM_ SG_ 1352 VFCVectorDHUVFCid38 "Visibility";
CM_ SG_ 1352 VFCVectorDHUVFCid39 "VFC39";
CM_ SG_ 1352 VFCVectorDHUVFCid4 "VFC4";
CM_ SG_ 1352 VFCVectorDHUVFCid40 "VFC40";
CM_ SG_ 1352 VFCVectorDHUVFCid41 "InfotainmentPush";
CM_ SG_ 1352 VFCVectorDHUVFCid42 "ChargingHV";
CM_ SG_ 1352 VFCVectorDHUVFCid43 "BodyPreClimatisation";
CM_ SG_ 1352 VFCVectorDHUVFCid44 "Crash";
CM_ SG_ 1352 VFCVectorDHUVFCid45 "GlobalShortDuration";
CM_ SG_ 1352 VFCVectorDHUVFCid46 "ExteriorLightsHazard";
CM_ SG_ 1352 VFCVectorDHUVFCid47 "VFC47";
CM_ SG_ 1352 VFCVectorDHUVFCid48 "DoorOpenWarning";
CM_ SG_ 1352 VFCVectorDHUVFCid49 "ChargingLVInit";
CM_ SG_ 1352 VFCVectorDHUVFCid5 "VFC5";
CM_ SG_ 1352 VFCVectorDHUVFCid50 "VFC50";
CM_ SG_ 1352 VFCVectorDHUVFCid51 "VFC51";
CM_ SG_ 1352 VFCVectorDHUVFCid52 "HVBatteryThermalEventWarning";
CM_ SG_ 1352 VFCVectorDHUVFCid53 "VisualAssist";
CM_ SG_ 1352 VFCVectorDHUVFCid54 "PassiveSafety";
CM_ SG_ 1352 VFCVectorDHUVFCid55 "LifeDetection";
CM_ SG_ 1352 VFCVectorDHUVFCid56 "BackboneFlexray";
CM_ SG_ 1352 VFCVectorDHUVFCid57 "Functionmarket";
CM_ SG_ 1352 VFCVectorDHUVFCid58 "VFC58";
CM_ SG_ 1352 VFCVectorDHUVFCid59 "VFC59";
CM_ SG_ 1352 VFCVectorDHUVFCid6 "SettingsVehicle";
CM_ SG_ 1352 VFCVectorDHUVFCid60 "VFC60";
CM_ SG_ 1352 VFCVectorDHUVFCid61 "VFC61";
CM_ SG_ 1352 VFCVectorDHUVFCid7 "VFC7";
CM_ SG_ 1352 VFCVectorDHUVFCid8 "VFC8";
CM_ SG_ 1352 VFCVectorDHUVFCid9 "IPWakeup";
BA_DEF_ BO_ "CANFD_BRS" ENUM "0","1";
BA_DEF_ BO_ "GenMsgCycleTime" INT 0 65536; // [ms]
BA_DEF_ BO_ "GenMsgDelayTime" INT 0 65536; // [ms]
BA_DEF_ BO_ "GenMsgSendType" ENUM "cyclic", "spontaneous", "not-used", "not-used", "not-used", "cyclicAndSpontaneous", "not-used", "cyclicIfActive", "NoMsgSendType"; // [us]
BA_DEF_ BO_ "GenMsgStartDelayTime" INT 0 65536; // [ms]
BA_DEF_ BO_ "VFrameFormat" ENUM "StandardCAN","ExtendedCAN","reserved","J1939PG","reserved","reserved","reserved","reserved","reserved","reserved","reserved","reserved","reserved","reserved","StandardCAN_FD","ExtendedCAN_FD";
BA_DEF_ SG_ "GenSigSendType" ENUM "Cyclic","OnWrite","OnWriteWithRepetition","OnChange","OnChangeWithRepetition","IfActive","IfActiveWithRepetition","NoSigSendType";
BA_DEF_ SG_ "GenSigStartValue" HEX 0 80000000;
BA_DEF_ BO_ "GenMsgILSupport" ENUM "No","Yes";
BA_DEF_ BO_ "NmAsrMessage" ENUM "No","Yes";
BA_DEF_ SG_ "GenSigFuncType" ENUM "NoFunction","n/a","n/a","n/a","n/a","n/a","n/a","n/a","n/a","n/a","n/a","n/a","n/a","n/a","n/a","CHK","CNTR","n/a","n/a","n/a","CNTR_AR_01","CRC_AR_01_BOTH","CRC_AR_01_ALT","CRC_AR_01_LOW","CRC_AR_01_NIBBLE","CNTR_AR_04","CRC_AR_04A","CNTR_AR_05","CRC_AR_05";
BA_DEF_ SG_ "GenSigDataID" STRING;
BA_DEF_DEF_ "CANFD_BRS" "1";
BA_DEF_DEF_ "GenSigStartValue" 0;
BA_DEF_DEF_ "VFrameFormat" "J1939PG";
BA_DEF_DEF_ "GenSigSendType" "NoSigSendType";
BA_DEF_DEF_ "GenMsgCycleTime" 0;
BA_DEF_DEF_ "GenMsgDelayTime" 0;
BA_DEF_DEF_ "GenMsgStartDelayTime" 0;
BA_DEF_DEF_ "GenMsgSendType" "NoMsgSendType";
BA_DEF_DEF_ "GenMsgILSupport" "Yes";
BA_DEF_DEF_ "NmAsrMessage" "No";
BA_DEF_DEF_ "GenSigFuncType" "NoFunction";
BA_DEF_DEF_ "GenSigDataID" "";
// Frame: DhuZCUCANFD2Fr16
BA_ "GenMsgCycleTime" BO_ 464 200.000;
BA_ "GenMsgSendType" BO_ 464 0;
BA_ "VFrameFormat" BO_ 464 14;
// Frame: DhuZCUCANFD2Fr17
BA_ "GenMsgCycleTime" BO_ 311 50.000;
BA_ "GenMsgSendType" BO_ 311 0;
BA_ "VFrameFormat" BO_ 311 14;
// Frame: DhuZCUCANFD2Fr18
BA_ "GenMsgDelayTime" BO_ 66 10.000;
BA_ "GenMsgSendType" BO_ 66 1;
BA_ "VFrameFormat" BO_ 66 14;
// Frame: DhuZCUCANFD2Fr19
BA_ "GenMsgDelayTime" BO_ 272 25.000;
BA_ "GenMsgSendType" BO_ 272 1;
BA_ "VFrameFormat" BO_ 272 14;
// Frame: DhuZCUCANFD2Fr20
BA_ "GenMsgDelayTime" BO_ 74 10.000;
BA_ "GenMsgSendType" BO_ 74 1;
BA_ "VFrameFormat" BO_ 74 14;
// Frame: DhuZCUCANFD2Fr21
BA_ "GenMsgCycleTime" BO_ 293 40.000;
BA_ "GenMsgSendType" BO_ 293 0;
BA_ "VFrameFormat" BO_ 293 14;
// Frame: DhuZCUCANFD2Fr22
BA_ "GenMsgDelayTime" BO_ 96 5.000;
BA_ "GenMsgSendType" BO_ 96 1;
BA_ "VFrameFormat" BO_ 96 14;
// Frame: DhuZCUCANFD2Fr23
BA_ "GenMsgDelayTime" BO_ 97 5.000;
BA_ "GenMsgSendType" BO_ 97 1;
BA_ "VFrameFormat" BO_ 97 14;
// Frame: DhuZCUCANFD2VFCVectorFr
BA_ "GenMsgCycleTime" BO_ 1352 500.000;
BA_ "GenMsgSendType" BO_ 1352 0;
BA_ "VFrameFormat" BO_ 1352 0;
BA_ "GenSigSendType" SG_ 464 ActvReSplrPosnReq 0;
BA_ "GenSigSendType" SG_ 311 AirCushInflateDeflateReq 0;
BA_ "GenSigSendType" SG_ 311 AmbLiChrgCorrlnReq 0;
BA_ "GenSigSendType" SG_ 311 AmbLiDirCorrlnReq 0;
BA_ "GenSigSendType" SG_ 311 AmbLiDoorCorrlnReq 0;
BA_ "GenSigSendType" SG_ 311 AmbLiDrvModCorrlnReq 0;
BA_ "GenSigSendType" SG_ 311 AmbLiRadarCorrlnReq 0;
BA_ "GenSigSendType" SG_ 311 AmbLiResd 0;
BA_ "GenSigSendType" SG_ 311 AmbLiSpdSwt 0;
BA_ "GenSigStartValue" SG_ 311 AmbLiSpdSwt 1;
BA_ "GenSigSendType" SG_ 311 AmbLiStrtCorrlnReq 0;
BA_ "GenSigSendType" SG_ 311 AmbLiThemeReq 0;
BA_ "GenSigStartValue" SG_ 311 AmbLiThemeReq 255;
BA_ "GenSigSendType" SG_ 311 AmbLiUnlckCorrlnReq 0;
BA_ "GenSigSendType" SG_ 311 AmbientLiEffectStatus1 0;
BA_ "GenSigSendType" SG_ 66 ApproachReqData1 1;
BA_ "GenSigSendType" SG_ 66 ApproachReqData10 1;
BA_ "GenSigSendType" SG_ 66 ApproachReqData11 1;
BA_ "GenSigSendType" SG_ 66 ApproachReqData12 1;
BA_ "GenSigSendType" SG_ 66 ApproachReqData13 1;
BA_ "GenSigSendType" SG_ 66 ApproachReqData14 1;
BA_ "GenSigSendType" SG_ 66 ApproachReqData15 1;
BA_ "GenSigSendType" SG_ 66 ApproachReqData16 1;
BA_ "GenSigSendType" SG_ 66 ApproachReqData2 1;
BA_ "GenSigSendType" SG_ 66 ApproachReqData3 1;
BA_ "GenSigSendType" SG_ 66 ApproachReqData4 1;
BA_ "GenSigSendType" SG_ 66 ApproachReqData5 1;
BA_ "GenSigSendType" SG_ 66 ApproachReqData6 1;
BA_ "GenSigSendType" SG_ 66 ApproachReqData7 1;
BA_ "GenSigSendType" SG_ 66 ApproachReqData8 1;
BA_ "GenSigSendType" SG_ 66 ApproachReqData9 1;
BA_ "GenSigSendType" SG_ 311 AssistantLiEnaSwt 0;
BA_ "GenSigSendType" SG_ 293 AutoHldTechLiEna 0;
BA_ "GenSigSendType" SG_ 74 BLEKeySearchRespData1 1;
BA_ "GenSigSendType" SG_ 74 BLEKeySearchRespData10 1;
BA_ "GenSigSendType" SG_ 74 BLEKeySearchRespData11 1;
BA_ "GenSigSendType" SG_ 74 BLEKeySearchRespData12 1;
BA_ "GenSigSendType" SG_ 74 BLEKeySearchRespData13 1;
BA_ "GenSigSendType" SG_ 74 BLEKeySearchRespData14 1;
BA_ "GenSigSendType" SG_ 74 BLEKeySearchRespData15 1;
BA_ "GenSigSendType" SG_ 74 BLEKeySearchRespData16 1;
BA_ "GenSigSendType" SG_ 74 BLEKeySearchRespData2 1;
BA_ "GenSigSendType" SG_ 74 BLEKeySearchRespData3 1;
BA_ "GenSigSendType" SG_ 74 BLEKeySearchRespData4 1;
BA_ "GenSigSendType" SG_ 74 BLEKeySearchRespData5 1;
BA_ "GenSigSendType" SG_ 74 BLEKeySearchRespData6 1;
BA_ "GenSigSendType" SG_ 74 BLEKeySearchRespData7 1;
BA_ "GenSigSendType" SG_ 74 BLEKeySearchRespData8 1;
BA_ "GenSigSendType" SG_ 74 BLEKeySearchRespData9 1;
BA_ "GenSigSendType" SG_ 464 BackRestSideSpprtAdjmtRowFirstDrvr 0;
BA_ "GenSigSendType" SG_ 464 BackRestSideSpprtAdjmtRowFirstPass 0;
BA_ "GenSigSendType" SG_ 272 BookTrvlClimaActvReq 1;
BA_ "GenSigSendType" SG_ 272 CarFindrHornLiReqFromTelm 1;
BA_ "GenSigSendType" SG_ 311 CarpetLiModReq 0;
BA_ "GenSigSendType" SG_ 272 CbnOverHeatProtnEnaFromTelm 1;
BA_ "GenSigSendType" SG_ 293 ChdLockCmnCtrlHmiReq 0;
BA_ "GenSigSendType" SG_ 311 ChdLockSideSelnSwt 0;
BA_ "GenSigSendType" SG_ 272 ChrgLidTelmLockgReq 1;
BA_ "GenSigSendType" SG_ 272 ClimaRqrd1 1;
BA_ "GenSigSendType" SG_ 272 ClimaTmrStsTelmRqrd 1;
BA_ "GenSigSendType" SG_ 464 CushSideSpprtAdjmtRowFirstDrvr 0;
BA_ "GenSigSendType" SG_ 464 CushSideSpprtAdjmtRowFirstPass 0;
BA_ "GenSigSendType" SG_ 66 DChaEngStsCtrl 1;
BA_ "GenSigSendType" SG_ 66 DchaChrgnTarVal 1;
BA_ "GenSigSendType" SG_ 464 DiagcComActv 0;
BA_ "GenSigSendType" SG_ 464 DiagcExtCom 0;
BA_ "GenSigSendType" SG_ 311 DoorPocketLiSwt 0;
BA_ "GenSigSendType" SG_ 293 DrvModReqForChampnMod 0;
BA_ "GenSigSendType" SG_ 293 DrvrLineOfSightSts 0;
BA_ "GenSigSendType" SG_ 464 DrvrSeatDispMassgFctMassgInten 0;
BA_ "GenSigSendType" SG_ 464 DrvrSeatDispMassgFctMassgProg 0;
BA_ "GenSigSendType" SG_ 464 DrvrSeatDispMassgFctOnOffl2 0;
BA_ "GenSigStartValue" SG_ 464 DrvrSeatDispMassgFctOnOffl2 2;
BA_ "GenSigSendType" SG_ 311 DrvrSeatDispPhytheraFctOnOff1 0;
BA_ "GenSigSendType" SG_ 311 DrvrSeatDispPhytheraFctPhytheraProgTyp 0;
BA_ "GenSigSendType" SG_ 464 DrvrSeatDispSpplFct 0;
BA_ "GenSigSendType" SG_ 66 DstFromDestination 1;
BA_ "GenSigSendType" SG_ 96 DwnLoadDynLtgPrmForReGrp10ContinueTime 1;
BA_ "GenSigSendType" SG_ 96 DwnLoadDynLtgPrmForReGrp10HighBrightness 1;
BA_ "GenSigSendType" SG_ 96 DwnLoadDynLtgPrmForReGrp10LowBrightness 1;
BA_ "GenSigSendType" SG_ 96 DwnLoadDynLtgPrmForReGrp10Mode1 1;
BA_ "GenSigSendType" SG_ 96 DwnLoadDynLtgPrmForReGrp10OffsetTime 1;
BA_ "GenSigSendType" SG_ 96 DwnLoadDynLtgPrmForReGrp10Timestamp 1;
BA_ "GenSigSendType" SG_ 96 DwnLoadDynLtgPrmForReGrp11ContinueTime 1;
BA_ "GenSigSendType" SG_ 96 DwnLoadDynLtgPrmForReGrp11HighBrightness 1;
BA_ "GenSigSendType" SG_ 96 DwnLoadDynLtgPrmForReGrp11LowBrightness 1;
BA_ "GenSigSendType" SG_ 96 DwnLoadDynLtgPrmForReGrp11Mode1 1;
BA_ "GenSigSendType" SG_ 96 DwnLoadDynLtgPrmForReGrp11OffsetTime 1;
BA_ "GenSigSendType" SG_ 96 DwnLoadDynLtgPrmForReGrp11Timestamp 1;
BA_ "GenSigSendType" SG_ 96 DwnLoadDynLtgPrmForReGrp12ContinueTime 1;
BA_ "GenSigSendType" SG_ 96 DwnLoadDynLtgPrmForReGrp12HighBrightness 1;
BA_ "GenSigSendType" SG_ 96 DwnLoadDynLtgPrmForReGrp12LowBrightness 1;
BA_ "GenSigSendType" SG_ 96 DwnLoadDynLtgPrmForReGrp12Mode1 1;
BA_ "GenSigSendType" SG_ 96 DwnLoadDynLtgPrmForReGrp12OffsetTime 1;
BA_ "GenSigSendType" SG_ 96 DwnLoadDynLtgPrmForReGrp12Timestamp 1;
BA_ "GenSigSendType" SG_ 96 DwnLoadDynLtgPrmForReGrp13ContinueTime 1;
BA_ "GenSigSendType" SG_ 96 DwnLoadDynLtgPrmForReGrp13HighBrightness 1;
BA_ "GenSigSendType" SG_ 96 DwnLoadDynLtgPrmForReGrp13LowBrightness 1;
BA_ "GenSigSendType" SG_ 96 DwnLoadDynLtgPrmForReGrp13Mode1 1;
BA_ "GenSigSendType" SG_ 96 DwnLoadDynLtgPrmForReGrp13OffsetTime 1;
BA_ "GenSigSendType" SG_ 96 DwnLoadDynLtgPrmForReGrp13Timestamp 1;
BA_ "GenSigSendType" SG_ 96 DwnLoadDynLtgPrmForReGrp14ContinueTime 1;
BA_ "GenSigSendType" SG_ 96 DwnLoadDynLtgPrmForReGrp14HighBrightness 1;
BA_ "GenSigSendType" SG_ 96 DwnLoadDynLtgPrmForReGrp14LowBrightness 1;
BA_ "GenSigSendType" SG_ 96 DwnLoadDynLtgPrmForReGrp14Mode1 1;
BA_ "GenSigSendType" SG_ 96 DwnLoadDynLtgPrmForReGrp14OffsetTime 1;
BA_ "GenSigSendType" SG_ 96 DwnLoadDynLtgPrmForReGrp14Timestamp 1;
BA_ "GenSigSendType" SG_ 96 DwnLoadDynLtgPrmForReGrp15ContinueTime 1;
BA_ "GenSigSendType" SG_ 96 DwnLoadDynLtgPrmForReGrp15HighBrightness 1;
BA_ "GenSigSendType" SG_ 96 DwnLoadDynLtgPrmForReGrp15LowBrightness 1;
BA_ "GenSigSendType" SG_ 96 DwnLoadDynLtgPrmForReGrp15Mode1 1;
BA_ "GenSigSendType" SG_ 96 DwnLoadDynLtgPrmForReGrp15OffsetTime 1;
BA_ "GenSigSendType" SG_ 96 DwnLoadDynLtgPrmForReGrp15Timestamp 1;
BA_ "GenSigSendType" SG_ 96 DwnLoadDynLtgPrmForReGrp16ContinueTime 1;
BA_ "GenSigSendType" SG_ 96 DwnLoadDynLtgPrmForReGrp16HighBrightness 1;
BA_ "GenSigSendType" SG_ 96 DwnLoadDynLtgPrmForReGrp16LowBrightness 1;
BA_ "GenSigSendType" SG_ 96 DwnLoadDynLtgPrmForReGrp16Mode1 1;
BA_ "GenSigSendType" SG_ 96 DwnLoadDynLtgPrmForReGrp16OffsetTime 1;
BA_ "GenSigSendType" SG_ 96 DwnLoadDynLtgPrmForReGrp16Timestamp 1;
BA_ "GenSigSendType" SG_ 97 DwnLoadDynLtgPrmForReGrp17ContinueTime 1;
BA_ "GenSigSendType" SG_ 97 DwnLoadDynLtgPrmForReGrp17HighBrightness 1;
BA_ "GenSigSendType" SG_ 97 DwnLoadDynLtgPrmForReGrp17LowBrightness 1;
BA_ "GenSigSendType" SG_ 97 DwnLoadDynLtgPrmForReGrp17Mode1 1;
BA_ "GenSigSendType" SG_ 97 DwnLoadDynLtgPrmForReGrp17OffsetTime 1;
BA_ "GenSigSendType" SG_ 97 DwnLoadDynLtgPrmForReGrp17Timestamp 1;
BA_ "GenSigSendType" SG_ 97 DwnLoadDynLtgPrmForReGrp18ContinueTime 1;
BA_ "GenSigSendType" SG_ 97 DwnLoadDynLtgPrmForReGrp18HighBrightness 1;
BA_ "GenSigSendType" SG_ 97 DwnLoadDynLtgPrmForReGrp18LowBrightness 1;
BA_ "GenSigSendType" SG_ 97 DwnLoadDynLtgPrmForReGrp18Mode1 1;
BA_ "GenSigSendType" SG_ 97 DwnLoadDynLtgPrmForReGrp18OffsetTime 1;
BA_ "GenSigSendType" SG_ 97 DwnLoadDynLtgPrmForReGrp18Timestamp 1;
BA_ "GenSigSendType" SG_ 97 DwnLoadDynLtgPrmForReGrp19ContinueTime 1;
BA_ "GenSigSendType" SG_ 97 DwnLoadDynLtgPrmForReGrp19HighBrightness 1;
BA_ "GenSigSendType" SG_ 97 DwnLoadDynLtgPrmForReGrp19LowBrightness 1;
BA_ "GenSigSendType" SG_ 97 DwnLoadDynLtgPrmForReGrp19Mode1 1;
BA_ "GenSigSendType" SG_ 97 DwnLoadDynLtgPrmForReGrp19OffsetTime 1;
BA_ "GenSigSendType" SG_ 97 DwnLoadDynLtgPrmForReGrp19Timestamp 1;
BA_ "GenSigSendType" SG_ 96 DwnLoadDynLtgPrmForReGrp1ContinueTime 1;
BA_ "GenSigSendType" SG_ 96 DwnLoadDynLtgPrmForReGrp1HighBrightness 1;
BA_ "GenSigSendType" SG_ 96 DwnLoadDynLtgPrmForReGrp1LowBrightness 1;
BA_ "GenSigSendType" SG_ 96 DwnLoadDynLtgPrmForReGrp1Mode1 1;
BA_ "GenSigSendType" SG_ 96 DwnLoadDynLtgPrmForReGrp1OffsetTime 1;
BA_ "GenSigSendType" SG_ 96 DwnLoadDynLtgPrmForReGrp1Timestamp 1;
BA_ "GenSigSendType" SG_ 97 DwnLoadDynLtgPrmForReGrp20ContinueTime 1;
BA_ "GenSigSendType" SG_ 97 DwnLoadDynLtgPrmForReGrp20HighBrightness 1;
BA_ "GenSigSendType" SG_ 97 DwnLoadDynLtgPrmForReGrp20LowBrightness 1;
BA_ "GenSigSendType" SG_ 97 DwnLoadDynLtgPrmForReGrp20Mode1 1;
BA_ "GenSigSendType" SG_ 97 DwnLoadDynLtgPrmForReGrp20OffsetTime 1;
BA_ "GenSigSendType" SG_ 97 DwnLoadDynLtgPrmForReGrp20Timestamp 1;
BA_ "GenSigSendType" SG_ 97 DwnLoadDynLtgPrmForReGrp21ContinueTime 1;
BA_ "GenSigSendType" SG_ 97 DwnLoadDynLtgPrmForReGrp21HighBrightness 1;
BA_ "GenSigSendType" SG_ 97 DwnLoadDynLtgPrmForReGrp21LowBrightness 1;
BA_ "GenSigSendType" SG_ 97 DwnLoadDynLtgPrmForReGrp21Mode1 1;
BA_ "GenSigSendType" SG_ 97 DwnLoadDynLtgPrmForReGrp21OffsetTime 1;
BA_ "GenSigSendType" SG_ 97 DwnLoadDynLtgPrmForReGrp21Timestamp 1;
BA_ "GenSigSendType" SG_ 97 DwnLoadDynLtgPrmForReGrp22ContinueTime 1;
BA_ "GenSigSendType" SG_ 97 DwnLoadDynLtgPrmForReGrp22HighBrightness 1;
BA_ "GenSigSendType" SG_ 97 DwnLoadDynLtgPrmForReGrp22LowBrightness 1;
BA_ "GenSigSendType" SG_ 97 DwnLoadDynLtgPrmForReGrp22Mode1 1;
BA_ "GenSigSendType" SG_ 97 DwnLoadDynLtgPrmForReGrp22OffsetTime 1;
BA_ "GenSigSendType" SG_ 97 DwnLoadDynLtgPrmForReGrp22Timestamp 1;
BA_ "GenSigSendType" SG_ 97 DwnLoadDynLtgPrmForReGrp23ContinueTime 1;
BA_ "GenSigSendType" SG_ 97 DwnLoadDynLtgPrmForReGrp23HighBrightness 1;
BA_ "GenSigSendType" SG_ 97 DwnLoadDynLtgPrmForReGrp23LowBrightness 1;
BA_ "GenSigSendType" SG_ 97 DwnLoadDynLtgPrmForReGrp23Mode1 1;
BA_ "GenSigSendType" SG_ 97 DwnLoadDynLtgPrmForReGrp23OffsetTime 1;
BA_ "GenSigSendType" SG_ 97 DwnLoadDynLtgPrmForReGrp23Timestamp 1;
BA_ "GenSigSendType" SG_ 97 DwnLoadDynLtgPrmForReGrp24ContinueTime 1;
BA_ "GenSigSendType" SG_ 97 DwnLoadDynLtgPrmForReGrp24HighBrightness 1;
BA_ "GenSigSendType" SG_ 97 DwnLoadDynLtgPrmForReGrp24LowBrightness 1;
BA_ "GenSigSendType" SG_ 97 DwnLoadDynLtgPrmForReGrp24Mode1 1;
BA_ "GenSigSendType" SG_ 97 DwnLoadDynLtgPrmForReGrp24OffsetTime 1;
BA_ "GenSigSendType" SG_ 97 DwnLoadDynLtgPrmForReGrp24Timestamp 1;
BA_ "GenSigSendType" SG_ 97 DwnLoadDynLtgPrmForReGrp25ContinueTime 1;
BA_ "GenSigSendType" SG_ 97 DwnLoadDynLtgPrmForReGrp25HighBrightness 1;
BA_ "GenSigSendType" SG_ 97 DwnLoadDynLtgPrmForReGrp25LowBrightness 1;
BA_ "GenSigSendType" SG_ 97 DwnLoadDynLtgPrmForReGrp25Mode1 1;
BA_ "GenSigSendType" SG_ 97 DwnLoadDynLtgPrmForReGrp25OffsetTime 1;
BA_ "GenSigSendType" SG_ 97 DwnLoadDynLtgPrmForReGrp25Timestamp 1;
BA_ "GenSigSendType" SG_ 97 DwnLoadDynLtgPrmForReGrp26ContinueTime 1;
BA_ "GenSigSendType" SG_ 97 DwnLoadDynLtgPrmForReGrp26HighBrightness 1;
BA_ "GenSigSendType" SG_ 97 DwnLoadDynLtgPrmForReGrp26LowBrightness 1;
BA_ "GenSigSendType" SG_ 97 DwnLoadDynLtgPrmForReGrp26Mode1 1;
BA_ "GenSigSendType" SG_ 97 DwnLoadDynLtgPrmForReGrp26OffsetTime 1;
BA_ "GenSigSendType" SG_ 97 DwnLoadDynLtgPrmForReGrp26Timestamp 1;
BA_ "GenSigSendType" SG_ 97 DwnLoadDynLtgPrmForReGrp27ContinueTime 1;
BA_ "GenSigSendType" SG_ 97 DwnLoadDynLtgPrmForReGrp27HighBrightness 1;
BA_ "GenSigSendType" SG_ 97 DwnLoadDynLtgPrmForReGrp27LowBrightness 1;
BA_ "GenSigSendType" SG_ 97 DwnLoadDynLtgPrmForReGrp27Mode1 1;
BA_ "GenSigSendType" SG_ 97 DwnLoadDynLtgPrmForReGrp27OffsetTime 1;
BA_ "GenSigSendType" SG_ 97 DwnLoadDynLtgPrmForReGrp27Timestamp 1;
BA_ "GenSigSendType" SG_ 97 DwnLoadDynLtgPrmForReGrp28ContinueTime 1;
BA_ "GenSigSendType" SG_ 97 DwnLoadDynLtgPrmForReGrp28HighBrightness 1;
BA_ "GenSigSendType" SG_ 97 DwnLoadDynLtgPrmForReGrp28LowBrightness 1;
BA_ "GenSigSendType" SG_ 97 DwnLoadDynLtgPrmForReGrp28Mode1 1;
BA_ "GenSigSendType" SG_ 97 DwnLoadDynLtgPrmForReGrp28OffsetTime 1;
BA_ "GenSigSendType" SG_ 97 DwnLoadDynLtgPrmForReGrp28Timestamp 1;
BA_ "GenSigSendType" SG_ 97 DwnLoadDynLtgPrmForReGrp29ContinueTime 1;
BA_ "GenSigSendType" SG_ 97 DwnLoadDynLtgPrmForReGrp29HighBrightness 1;
BA_ "GenSigSendType" SG_ 97 DwnLoadDynLtgPrmForReGrp29LowBrightness 1;
BA_ "GenSigSendType" SG_ 97 DwnLoadDynLtgPrmForReGrp29Mode1 1;
BA_ "GenSigSendType" SG_ 97 DwnLoadDynLtgPrmForReGrp29OffsetTime 1;
BA_ "GenSigSendType" SG_ 97 DwnLoadDynLtgPrmForReGrp29Timestamp 1;
BA_ "GenSigSendType" SG_ 96 DwnLoadDynLtgPrmForReGrp2ContinueTime 1;
BA_ "GenSigSendType" SG_ 96 DwnLoadDynLtgPrmForReGrp2HighBrightness 1;
BA_ "GenSigSendType" SG_ 96 DwnLoadDynLtgPrmForReGrp2LowBrightness 1;
BA_ "GenSigSendType" SG_ 96 DwnLoadDynLtgPrmForReGrp2Mode1 1;
BA_ "GenSigSendType" SG_ 96 DwnLoadDynLtgPrmForReGrp2OffsetTime 1;
BA_ "GenSigSendType" SG_ 96 DwnLoadDynLtgPrmForReGrp2Timestamp 1;
BA_ "GenSigSendType" SG_ 97 DwnLoadDynLtgPrmForReGrp30ContinueTime 1;
BA_ "GenSigSendType" SG_ 97 DwnLoadDynLtgPrmForReGrp30HighBrightness 1;
BA_ "GenSigSendType" SG_ 97 DwnLoadDynLtgPrmForReGrp30LowBrightness 1;
BA_ "GenSigSendType" SG_ 97 DwnLoadDynLtgPrmForReGrp30Mode1 1;
BA_ "GenSigSendType" SG_ 97 DwnLoadDynLtgPrmForReGrp30OffsetTime 1;
BA_ "GenSigSendType" SG_ 97 DwnLoadDynLtgPrmForReGrp30Timestamp 1;
BA_ "GenSigSendType" SG_ 96 DwnLoadDynLtgPrmForReGrp3ContinueTime 1;
BA_ "GenSigSendType" SG_ 96 DwnLoadDynLtgPrmForReGrp3HighBrightness 1;
BA_ "GenSigSendType" SG_ 96 DwnLoadDynLtgPrmForReGrp3LowBrightness 1;
BA_ "GenSigSendType" SG_ 96 DwnLoadDynLtgPrmForReGrp3Mode1 1;
BA_ "GenSigSendType" SG_ 96 DwnLoadDynLtgPrmForReGrp3OffsetTime 1;
BA_ "GenSigSendType" SG_ 96 DwnLoadDynLtgPrmForReGrp3Timestamp 1;
BA_ "GenSigSendType" SG_ 96 DwnLoadDynLtgPrmForReGrp4ContinueTime 1;
BA_ "GenSigSendType" SG_ 96 DwnLoadDynLtgPrmForReGrp4HighBrightness 1;
BA_ "GenSigSendType" SG_ 96 DwnLoadDynLtgPrmForReGrp4LowBrightness 1;
BA_ "GenSigSendType" SG_ 96 DwnLoadDynLtgPrmForReGrp4Mode1 1;
BA_ "GenSigSendType" SG_ 96 DwnLoadDynLtgPrmForReGrp4OffsetTime 1;
BA_ "GenSigSendType" SG_ 96 DwnLoadDynLtgPrmForReGrp4Timestamp 1;
BA_ "GenSigSendType" SG_ 96 DwnLoadDynLtgPrmForReGrp5ContinueTime 1;
BA_ "GenSigSendType" SG_ 96 DwnLoadDynLtgPrmForReGrp5HighBrightness 1;
BA_ "GenSigSendType" SG_ 96 DwnLoadDynLtgPrmForReGrp5LowBrightness 1;
BA_ "GenSigSendType" SG_ 96 DwnLoadDynLtgPrmForReGrp5Mode1 1;
BA_ "GenSigSendType" SG_ 96 DwnLoadDynLtgPrmForReGrp5OffsetTime 1;
BA_ "GenSigSendType" SG_ 96 DwnLoadDynLtgPrmForReGrp5Timestamp 1;
BA_ "GenSigSendType" SG_ 96 DwnLoadDynLtgPrmForReGrp6ContinueTime 1;
BA_ "GenSigSendType" SG_ 96 DwnLoadDynLtgPrmForReGrp6HighBrightness 1;
BA_ "GenSigSendType" SG_ 96 DwnLoadDynLtgPrmForReGrp6LowBrightness 1;
BA_ "GenSigSendType" SG_ 96 DwnLoadDynLtgPrmForReGrp6Mode1 1;
BA_ "GenSigSendType" SG_ 96 DwnLoadDynLtgPrmForReGrp6OffsetTime 1;
BA_ "GenSigSendType" SG_ 96 DwnLoadDynLtgPrmForReGrp6Timestamp 1;
BA_ "GenSigSendType" SG_ 96 DwnLoadDynLtgPrmForReGrp7ContinueTime 1;
BA_ "GenSigSendType" SG_ 96 DwnLoadDynLtgPrmForReGrp7HighBrightness 1;
BA_ "GenSigSendType" SG_ 96 DwnLoadDynLtgPrmForReGrp7LowBrightness 1;
BA_ "GenSigSendType" SG_ 96 DwnLoadDynLtgPrmForReGrp7Mode1 1;
BA_ "GenSigSendType" SG_ 96 DwnLoadDynLtgPrmForReGrp7OffsetTime 1;
BA_ "GenSigSendType" SG_ 96 DwnLoadDynLtgPrmForReGrp7Timestamp 1;
BA_ "GenSigSendType" SG_ 96 DwnLoadDynLtgPrmForReGrp8ContinueTime 1;
BA_ "GenSigSendType" SG_ 96 DwnLoadDynLtgPrmForReGrp8HighBrightness 1;
BA_ "GenSigSendType" SG_ 96 DwnLoadDynLtgPrmForReGrp8LowBrightness 1;
BA_ "GenSigSendType" SG_ 96 DwnLoadDynLtgPrmForReGrp8Mode1 1;
BA_ "GenSigSendType" SG_ 96 DwnLoadDynLtgPrmForReGrp8OffsetTime 1;
BA_ "GenSigSendType" SG_ 96 DwnLoadDynLtgPrmForReGrp8Timestamp 1;
BA_ "GenSigSendType" SG_ 96 DwnLoadDynLtgPrmForReGrp9ContinueTime 1;
BA_ "GenSigSendType" SG_ 96 DwnLoadDynLtgPrmForReGrp9HighBrightness 1;
BA_ "GenSigSendType" SG_ 96 DwnLoadDynLtgPrmForReGrp9LowBrightness 1;
BA_ "GenSigSendType" SG_ 96 DwnLoadDynLtgPrmForReGrp9Mode1 1;
BA_ "GenSigSendType" SG_ 96 DwnLoadDynLtgPrmForReGrp9OffsetTime 1;
BA_ "GenSigSendType" SG_ 96 DwnLoadDynLtgPrmForReGrp9Timestamp 1;
BA_ "GenSigSendType" SG_ 311 EasyInOutSecRowLeActv 0;
BA_ "GenSigSendType" SG_ 311 EasyInOutSecRowRiActv 0;
BA_ "GenSigSendType" SG_ 272 EmgyAsscTrigSts 1;
BA_ "GenSigSendType" SG_ 272 EngForbidReqFromTelm 1;
BA_ "GenSigSendType" SG_ 272 EngPermitReqFromTelm 1;
BA_ "GenSigSendType" SG_ 464 ExtLoUOutlPwrSplyReqRADARMaiSwt 0;
BA_ "GenSigSendType" SG_ 464 ExtLoUOutlPwrSplyReqRADARZone1 0;
BA_ "GenSigSendType" SG_ 464 ExtLoUOutlPwrSplyReqRADARZone2 0;
BA_ "GenSigSendType" SG_ 464 ExtLoUOutlPwrSplyReqRADARZone3 0;
BA_ "GenSigSendType" SG_ 464 ExtLoUOutlPwrSplyReqRADARZone4 0;
BA_ "GenSigSendType" SG_ 464 ExtLoUOutlPwrSplyReqRADARZone5 0;
BA_ "GenSigSendType" SG_ 464 ExtLoUOutlPwrSplyReqRADARZone6 0;
BA_ "GenSigSendType" SG_ 272 ExtrLiShowActvnReq 1;
BA_ "GenSigSendType" SG_ 272 ExtrLiShowFileTxReq 1;
BA_ "GenSigSendType" SG_ 464 ExtrLtgFctSts 0;
BA_ "GenSigSendType" SG_ 311 ExtrMirrAdjHmiReq 0;
BA_ "GenSigSendType" SG_ 311 ExtrMirrFoldHmiReq 0;
BA_ "GenSigSendType" SG_ 311 ExtrMirrSelnHmiReq 0;
BA_ "GenSigSendType" SG_ 311 FogSetFrntReq 0;
BA_ "GenSigSendType" SG_ 311 FootwellLiSwt 0;
BA_ "GenSigSendType" SG_ 272 FreqencyChargn 1;
BA_ "GenSigSendType" SG_ 311 FrntTechnologyLiPosLiCorrlnSwt 0;
BA_ "GenSigSendType" SG_ 311 HMIAutoTerrainSetting 0;
BA_ "GenSigSendType" SG_ 464 HMIBluetoothCallToAdjAirVol 0;
BA_ "GenSigSendType" SG_ 464 HMIIonizerAirCdnr 0;
BA_ "GenSigSendType" SG_ 464 HMIToVMMSwtSwitch1 0;
BA_ "GenSigSendType" SG_ 464 HMIToVMMSwtSwitch2 0;
BA_ "GenSigSendType" SG_ 464 HMIToVMMSwtSwitch3 0;
BA_ "GenSigSendType" SG_ 464 HMIToVMMSwtSwitch4 0;
BA_ "GenSigSendType" SG_ 464 HMIToVMMSwtSwitch5 0;
BA_ "GenSigSendType" SG_ 464 HMIToVMMSwtSwitch6 0;
BA_ "GenSigSendType" SG_ 464 HMIToVMMSwtSwitch7 0;
BA_ "GenSigSendType" SG_ 464 HMIToVMMSwtSwitch8 0;
BA_ "GenSigSendType" SG_ 66 HVPwrDwnRstReq 1;
BA_ "GenSigSendType" SG_ 311 HmiAC 0;
BA_ "GenSigSendType" SG_ 311 HmiElecFrntDefrstReq 0;
BA_ "GenSigSendType" SG_ 311 HmiElecReMirrDefrstReq 0;
BA_ "GenSigSendType" SG_ 311 HmiElecReWinDefrstReq 0;
BA_ "GenSigSendType" SG_ 464 HmiSmrtWindFolwSet 0;
BA_ "GenSigSendType" SG_ 464 HmiWinterLockCarPrevnIceSet 0;
BA_ "GenSigSendType" SG_ 311 IdleChrgCtrl 0;
BA_ "GenSigSendType" SG_ 311 LegRestHozlAdjmtRowSecLe 0;
BA_ "GenSigSendType" SG_ 311 LegRestHozlAdjmtRowSecRi 0;
BA_ "GenSigSendType" SG_ 311 LegRestRotAdjmtRowThrdLe 0;
BA_ "GenSigSendType" SG_ 311 LegRestRotAdjmtRowThrdRi 0;
BA_ "GenSigSendType" SG_ 293 LowrTailgOpenHmiReq 0;
BA_ "GenSigSendType" SG_ 464 LumHeiAdjmtRowFirstDrvr 0;
BA_ "GenSigSendType" SG_ 464 LumHeiAdjmtRowFirstPass 0;
BA_ "GenSigSendType" SG_ 464 LumLenAdjmtRowFirstDrvr 0;
BA_ "GenSigSendType" SG_ 464 LumLenAdjmtRowFirstPass 0;
BA_ "GenSigSendType" SG_ 293 MusicInfoSeg11SegFftLiShow1 0;
BA_ "GenSigSendType" SG_ 293 MusicInfoSeg11SegFftLiShow10 0;
BA_ "GenSigSendType" SG_ 293 MusicInfoSeg11SegFftLiShow11 0;
BA_ "GenSigSendType" SG_ 293 MusicInfoSeg11SegFftLiShow12 0;
BA_ "GenSigSendType" SG_ 293 MusicInfoSeg11SegFftLiShow13 0;
BA_ "GenSigSendType" SG_ 293 MusicInfoSeg11SegFftLiShow14 0;
BA_ "GenSigSendType" SG_ 293 MusicInfoSeg11SegFftLiShow2 0;
BA_ "GenSigSendType" SG_ 293 MusicInfoSeg11SegFftLiShow3 0;
BA_ "GenSigSendType" SG_ 293 MusicInfoSeg11SegFftLiShow4 0;
BA_ "GenSigSendType" SG_ 293 MusicInfoSeg11SegFftLiShow5 0;
BA_ "GenSigSendType" SG_ 293 MusicInfoSeg11SegFftLiShow6 0;
BA_ "GenSigSendType" SG_ 293 MusicInfoSeg11SegFftLiShow7 0;
BA_ "GenSigSendType" SG_ 293 MusicInfoSeg11SegFftLiShow8 0;
BA_ "GenSigSendType" SG_ 293 MusicInfoSeg11SegFftLiShow9 0;
BA_ "GenSigSendType" SG_ 293 MusicInfoSeg11TimeFlagMessage 0;
BA_ "GenSigSendType" SG_ 293 MusicInfoSeg11TimeFlagMusicplay 0;
BA_ "GenSigSendType" SG_ 293 MusicInfoSeg12SegFftLiShow15 0;
BA_ "GenSigSendType" SG_ 293 MusicInfoSeg12SegFftLiShow16 0;
BA_ "GenSigSendType" SG_ 293 MusicInfoSeg12SegFftLiShow17 0;
BA_ "GenSigSendType" SG_ 293 MusicInfoSeg12SegFftLiShow18 0;
BA_ "GenSigSendType" SG_ 293 MusicInfoSeg12SegFftLiShow19 0;
BA_ "GenSigSendType" SG_ 293 MusicInfoSeg12SegFftLiShow20 0;
BA_ "GenSigSendType" SG_ 293 MusicInfoSeg12SegFftLiShow21 0;
BA_ "GenSigSendType" SG_ 293 MusicInfoSeg12SegFftLiShow22 0;
BA_ "GenSigSendType" SG_ 293 MusicInfoSeg12SegFftLiShow23 0;
BA_ "GenSigSendType" SG_ 293 MusicInfoSeg12SegFftLiShow24 0;
BA_ "GenSigSendType" SG_ 293 MusicInfoSeg12SegFftLiShow25 0;
BA_ "GenSigSendType" SG_ 293 MusicInfoSeg12SegFftLiShow26 0;
BA_ "GenSigSendType" SG_ 293 MusicInfoSeg12SegFftLiShow27 0;
BA_ "GenSigSendType" SG_ 293 MusicInfoSeg12SegFftLiShow28 0;
BA_ "GenSigSendType" SG_ 293 MusicInfoSeg12TimeFlagMessage 0;
BA_ "GenSigSendType" SG_ 293 MusicInfoSeg12TimeFlagMusicplay 0;
BA_ "GenSigSendType" SG_ 293 MusicInfoSeg13DownSamplingAmplitude 0;
BA_ "GenSigSendType" SG_ 293 MusicInfoSeg13MaxFFT100ms3kAmplitude 0;
BA_ "GenSigSendType" SG_ 293 MusicInfoSeg13MaxFFT100ms3kFrequency 0;
BA_ "GenSigSendType" SG_ 293 MusicInfoSeg13SegFftLiShow29 0;
BA_ "GenSigSendType" SG_ 293 MusicInfoSeg13SegFftLiShow30 0;
BA_ "GenSigSendType" SG_ 293 MusicInfoSeg13SegFftLiShow31 0;
BA_ "GenSigSendType" SG_ 293 MusicInfoSeg13StateFlagMusicPlay 0;
BA_ "GenSigSendType" SG_ 293 MusicInfoSeg13StateFlagNewMusic 0;
BA_ "GenSigSendType" SG_ 293 MusicInfoSeg13TimeFlagMessage 0;
BA_ "GenSigSendType" SG_ 293 MusicInfoSeg13TimeFlagMusicplay 0;
BA_ "GenSigSendType" SG_ 293 MusicInfoSeg21SegFftLiShow1 0;
BA_ "GenSigSendType" SG_ 293 MusicInfoSeg21SegFftLiShow10 0;
BA_ "GenSigSendType" SG_ 293 MusicInfoSeg21SegFftLiShow11 0;
BA_ "GenSigSendType" SG_ 293 MusicInfoSeg21SegFftLiShow12 0;
BA_ "GenSigSendType" SG_ 293 MusicInfoSeg21SegFftLiShow13 0;
BA_ "GenSigSendType" SG_ 293 MusicInfoSeg21SegFftLiShow14 0;
BA_ "GenSigSendType" SG_ 293 MusicInfoSeg21SegFftLiShow2 0;
BA_ "GenSigSendType" SG_ 293 MusicInfoSeg21SegFftLiShow3 0;
BA_ "GenSigSendType" SG_ 293 MusicInfoSeg21SegFftLiShow4 0;
BA_ "GenSigSendType" SG_ 293 MusicInfoSeg21SegFftLiShow5 0;
BA_ "GenSigSendType" SG_ 293 MusicInfoSeg21SegFftLiShow6 0;
BA_ "GenSigSendType" SG_ 293 MusicInfoSeg21SegFftLiShow7 0;
BA_ "GenSigSendType" SG_ 293 MusicInfoSeg21SegFftLiShow8 0;
BA_ "GenSigSendType" SG_ 293 MusicInfoSeg21SegFftLiShow9 0;
BA_ "GenSigSendType" SG_ 293 MusicInfoSeg21TimeFlagMessage 0;
BA_ "GenSigSendType" SG_ 293 MusicInfoSeg21TimeFlagMusicplay 0;
BA_ "GenSigSendType" SG_ 293 MusicInfoSeg22SegFftLiShow15 0;
BA_ "GenSigSendType" SG_ 293 MusicInfoSeg22SegFftLiShow16 0;
BA_ "GenSigSendType" SG_ 293 MusicInfoSeg22SegFftLiShow17 0;
BA_ "GenSigSendType" SG_ 293 MusicInfoSeg22SegFftLiShow18 0;
BA_ "GenSigSendType" SG_ 293 MusicInfoSeg22SegFftLiShow19 0;
BA_ "GenSigSendType" SG_ 293 MusicInfoSeg22SegFftLiShow20 0;
BA_ "GenSigSendType" SG_ 293 MusicInfoSeg22SegFftLiShow21 0;
BA_ "GenSigSendType" SG_ 293 MusicInfoSeg22SegFftLiShow22 0;
BA_ "GenSigSendType" SG_ 293 MusicInfoSeg22SegFftLiShow23 0;
BA_ "GenSigSendType" SG_ 293 MusicInfoSeg22SegFftLiShow24 0;
BA_ "GenSigSendType" SG_ 293 MusicInfoSeg22SegFftLiShow25 0;
BA_ "GenSigSendType" SG_ 293 MusicInfoSeg22SegFftLiShow26 0;
BA_ "GenSigSendType" SG_ 293 MusicInfoSeg22SegFftLiShow27 0;
BA_ "GenSigSendType" SG_ 293 MusicInfoSeg22SegFftLiShow28 0;
BA_ "GenSigSendType" SG_ 293 MusicInfoSeg22TimeFlagMessage 0;
BA_ "GenSigSendType" SG_ 293 MusicInfoSeg22TimeFlagMusicplay 0;
BA_ "GenSigSendType" SG_ 293 MusicInfoSeg23DownSamplingAmplitude 0;
BA_ "GenSigSendType" SG_ 293 MusicInfoSeg23MaxFFT100ms3kAmplitude 0;
BA_ "GenSigSendType" SG_ 293 MusicInfoSeg23MaxFFT100ms3kFrequency 0;
BA_ "GenSigSendType" SG_ 293 MusicInfoSeg23SegFftLiShow29 0;
BA_ "GenSigSendType" SG_ 293 MusicInfoSeg23SegFftLiShow30 0;
BA_ "GenSigSendType" SG_ 293 MusicInfoSeg23SegFftLiShow31 0;
BA_ "GenSigSendType" SG_ 293 MusicInfoSeg23StateFlagMusicPlay 0;
BA_ "GenSigSendType" SG_ 293 MusicInfoSeg23StateFlagNewMusic 0;
BA_ "GenSigSendType" SG_ 293 MusicInfoSeg23TimeFlagMessage 0;
BA_ "GenSigSendType" SG_ 293 MusicInfoSeg23TimeFlagMusicplay 0;
BA_ "GenSigSendType" SG_ 74 NFCAndBLEKeyEnaStsData1 1;
BA_ "GenSigSendType" SG_ 74 NFCAndBLEKeyEnaStsData10 1;
BA_ "GenSigSendType" SG_ 74 NFCAndBLEKeyEnaStsData11 1;
BA_ "GenSigSendType" SG_ 74 NFCAndBLEKeyEnaStsData12 1;
BA_ "GenSigSendType" SG_ 74 NFCAndBLEKeyEnaStsData13 1;
BA_ "GenSigSendType" SG_ 74 NFCAndBLEKeyEnaStsData14 1;
BA_ "GenSigSendType" SG_ 74 NFCAndBLEKeyEnaStsData15 1;
BA_ "GenSigSendType" SG_ 74 NFCAndBLEKeyEnaStsData16 1;
BA_ "GenSigSendType" SG_ 74 NFCAndBLEKeyEnaStsData2 1;
BA_ "GenSigSendType" SG_ 74 NFCAndBLEKeyEnaStsData3 1;
BA_ "GenSigSendType" SG_ 74 NFCAndBLEKeyEnaStsData4 1;
BA_ "GenSigSendType" SG_ 74 NFCAndBLEKeyEnaStsData5 1;
BA_ "GenSigSendType" SG_ 74 NFCAndBLEKeyEnaStsData6 1;
BA_ "GenSigSendType" SG_ 74 NFCAndBLEKeyEnaStsData7 1;
BA_ "GenSigSendType" SG_ 74 NFCAndBLEKeyEnaStsData8 1;
BA_ "GenSigSendType" SG_ 74 NFCAndBLEKeyEnaStsData9 1;
BA_ "GenSigSendType" SG_ 311 NFCKeyReadReq 0;
BA_ "GenSigSendType" SG_ 74 NFCKeySearchRespData1 1;
BA_ "GenSigSendType" SG_ 74 NFCKeySearchRespData10 1;
BA_ "GenSigSendType" SG_ 74 NFCKeySearchRespData11 1;
BA_ "GenSigSendType" SG_ 74 NFCKeySearchRespData12 1;
BA_ "GenSigSendType" SG_ 74 NFCKeySearchRespData13 1;
BA_ "GenSigSendType" SG_ 74 NFCKeySearchRespData14 1;
BA_ "GenSigSendType" SG_ 74 NFCKeySearchRespData15 1;
BA_ "GenSigSendType" SG_ 74 NFCKeySearchRespData16 1;
BA_ "GenSigSendType" SG_ 74 NFCKeySearchRespData2 1;
BA_ "GenSigSendType" SG_ 74 NFCKeySearchRespData3 1;
BA_ "GenSigSendType" SG_ 74 NFCKeySearchRespData4 1;
BA_ "GenSigSendType" SG_ 74 NFCKeySearchRespData5 1;
BA_ "GenSigSendType" SG_ 74 NFCKeySearchRespData6 1;
BA_ "GenSigSendType" SG_ 74 NFCKeySearchRespData7 1;
BA_ "GenSigSendType" SG_ 74 NFCKeySearchRespData8 1;
BA_ "GenSigSendType" SG_ 74 NFCKeySearchRespData9 1;
BA_ "GenSigSendType" SG_ 311 NightLiSwtSts 0;
BA_ "GenSigSendType" SG_ 311 OTACmplSts 1;
BA_ "GenSigSendType" SG_ 311 OneKeyLvlgSwt 0;
BA_ "GenSigSendType" SG_ 464 PassSeatDispMassgFctMassgInten 0;
BA_ "GenSigSendType" SG_ 464 PassSeatDispMassgFctMassgProg 0;
BA_ "GenSigSendType" SG_ 464 PassSeatDispMassgFctOnOffl2 0;
BA_ "GenSigStartValue" SG_ 464 PassSeatDispMassgFctOnOffl2 2;
BA_ "GenSigSendType" SG_ 311 PassSeatDispPhytheraFctOnOff1 0;
BA_ "GenSigSendType" SG_ 311 PassSeatDispPhytheraFctPhytheraProgTyp 0;
BA_ "GenSigSendType" SG_ 464 PassSeatDispSpplFct 0;
BA_ "GenSigSendType" SG_ 293 PrkgLiShowSwt 0;
BA_ "GenSigSendType" SG_ 311 PrpsnHvBattUsgModReq 0;
BA_ "GenSigSendType" SG_ 66 PrpsnHvBattUsgOfChrgTarSOC 1;
BA_ "GenSigStartValue" SG_ 66 PrpsnHvBattUsgOfChrgTarSOC 1000;
BA_ "GenSigSendType" SG_ 311 PwrSldDoorLeReOpenHmiReq 0;
BA_ "GenSigSendType" SG_ 311 PwrSldDoorRiReOpenHmiReq 0;
BA_ "GenSigSendType" SG_ 311 PwrSldgDoorLePosnReqFromHmi 0;
BA_ "GenSigStartValue" SG_ 311 PwrSldgDoorLePosnReqFromHmi 101;
BA_ "GenSigSendType" SG_ 311 PwrSldgDoorRiPosnReqFromHmi 0;
BA_ "GenSigStartValue" SG_ 311 PwrSldgDoorRiPosnReqFromHmi 101;
BA_ "GenSigSendType" SG_ 66 RKEAndNFCReqStsData1 1;
BA_ "GenSigSendType" SG_ 66 RKEAndNFCReqStsData10 1;
BA_ "GenSigSendType" SG_ 66 RKEAndNFCReqStsData11 1;
BA_ "GenSigSendType" SG_ 66 RKEAndNFCReqStsData12 1;
BA_ "GenSigSendType" SG_ 66 RKEAndNFCReqStsData13 1;
BA_ "GenSigSendType" SG_ 66 RKEAndNFCReqStsData14 1;
BA_ "GenSigSendType" SG_ 66 RKEAndNFCReqStsData15 1;
BA_ "GenSigSendType" SG_ 66 RKEAndNFCReqStsData16 1;
BA_ "GenSigSendType" SG_ 66 RKEAndNFCReqStsData2 1;
BA_ "GenSigSendType" SG_ 66 RKEAndNFCReqStsData3 1;
BA_ "GenSigSendType" SG_ 66 RKEAndNFCReqStsData4 1;
BA_ "GenSigSendType" SG_ 66 RKEAndNFCReqStsData5 1;
BA_ "GenSigSendType" SG_ 66 RKEAndNFCReqStsData6 1;
BA_ "GenSigSendType" SG_ 66 RKEAndNFCReqStsData7 1;
BA_ "GenSigSendType" SG_ 66 RKEAndNFCReqStsData8 1;
BA_ "GenSigSendType" SG_ 66 RKEAndNFCReqStsData9 1;
BA_ "GenSigSendType" SG_ 311 RadioFrqAM 0;
BA_ "GenSigSendType" SG_ 311 ReSeatQuickAdjmt 0;
BA_ "GenSigSendType" SG_ 66 ReadLiOpenReqFrontLeft 1;
BA_ "GenSigSendType" SG_ 66 ReadLiOpenReqFrontRight 1;
BA_ "GenSigSendType" SG_ 66 ReadLiOpenReqSecondRowLeft 1;
BA_ "GenSigSendType" SG_ 66 ReadLiOpenReqSecondRowRight 1;
BA_ "GenSigSendType" SG_ 66 ReadLiOpenReqThirdRowLeft 1;
BA_ "GenSigSendType" SG_ 66 ReadLiOpenReqThirdRowRight 1;
BA_ "GenSigSendType" SG_ 66 RemBookChrgnTarVal 1;
BA_ "GenSigSendType" SG_ 272 RemCtrlLoUPwrOutpReqZone1 1;
BA_ "GenSigSendType" SG_ 272 RemCtrlLoUPwrOutpReqZone2 1;
BA_ "GenSigSendType" SG_ 272 RemCtrlLoUPwrOutpReqZone3 1;
BA_ "GenSigSendType" SG_ 272 RemCtrlLoUPwrOutpReqZone4 1;
BA_ "GenSigSendType" SG_ 272 RemCtrlLoUPwrOutpReqZone5 1;
BA_ "GenSigSendType" SG_ 272 RemCtrlLoUPwrOutpReqZone6 1;
BA_ "GenSigSendType" SG_ 293 RowSecRiSeatZeroGrvySwtReq 0;
BA_ "GenSigSendType" SG_ 311 SaveSetgToMemPrmnt 0;
BA_ "GenSigSendType" SG_ 311 SearchLiSwtSts 0;
BA_ "GenSigSendType" SG_ 311 SpdCtrlSwt 0;
BA_ "GenSigStartValue" SG_ 311 SpdCtrlSwt 1;
BA_ "GenSigSendType" SG_ 464 SteerWhlHeatngAutStrtReq 0;
BA_ "GenSigSendType" SG_ 464 SunCurtCtrlReq 0;
BA_ "GenSigSendType" SG_ 311 SunRoofAndCurtIninSwt 0;
BA_ "GenSigSendType" SG_ 464 SunRoofCtrlReq 0;
BA_ "GenSigSendType" SG_ 293 SunroofGlassAutAdjmtHmiReq 0;
BA_ "GenSigSendType" SG_ 293 SunroofTransparencyReq 0;
BA_ "GenSigStartValue" SG_ 293 SunroofTransparencyReq 255;
BA_ "GenSigSendType" SG_ 311 SuspEasyLoadSet 0;
BA_ "GenSigSendType" SG_ 311 SuspHeiLvlSet 0;
BA_ "GenSigStartValue" SG_ 311 SuspHeiLvlSet 3;
BA_ "GenSigSendType" SG_ 311 TechnologyLiOnOffSwt 0;
BA_ "GenSigSendType" SG_ 464 TelmBookChrgnTyp 0;
BA_ "GenSigSendType" SG_ 272 TelmDefrostTmr 1;
BA_ "GenSigSendType" SG_ 272 TelmSeatHeatDrvrTmr 1;
BA_ "GenSigSendType" SG_ 272 TelmSeatHeatPassTmr 1;
BA_ "GenSigSendType" SG_ 272 TelmSeatHeatSecLeTmr 1;
BA_ "GenSigSendType" SG_ 272 TelmSeatHeatSecRiTmr 1;
BA_ "GenSigSendType" SG_ 272 TelmSeatHeatThrdLeTmr 1;
BA_ "GenSigSendType" SG_ 272 TelmSeatHeatThrdRiTmr 1;
BA_ "GenSigSendType" SG_ 272 TelmSeatVentnDrvrTmr 1;
BA_ "GenSigSendType" SG_ 272 TelmSeatVentnPassTmr 1;
BA_ "GenSigSendType" SG_ 272 TelmSeatVentnSecLeTmr 1;
BA_ "GenSigSendType" SG_ 272 TelmSeatVentnSecRiTmr 1;
BA_ "GenSigSendType" SG_ 272 TelmSeatVentnThrdLeTmr 1;
BA_ "GenSigSendType" SG_ 272 TelmSeatVentnThrdRiTmr 1;
BA_ "GenSigSendType" SG_ 272 TelmSteerWhlHeatTmr 1;
BA_ "GenSigSendType" SG_ 272 TelmThermoTankReq1 1;
BA_ "GenSigSendType" SG_ 272 TelmThermoTankT 1;
BA_ "GenSigStartValue" SG_ 272 TelmThermoTankT 250;
BA_ "GenSigSendType" SG_ 272 TelmThermoTankTmr1 1;
BA_ "GenSigSendType" SG_ 66 TopPosTrFromHmi 1;
BA_ "GenSigSendType" SG_ 311 TrOpenPosnReqFromHmi 0;
BA_ "GenSigStartValue" SG_ 311 TrOpenPosnReqFromHmi 101;
BA_ "GenSigSendType" SG_ 311 TrfcSideSetReq 0;
BA_ "GenSigSendType" SG_ 311 TrunkOpenHmiReq 0;
BA_ "GenSigSendType" SG_ 66 UsrSpeechSts 1;
BA_ "GenSigSendType" SG_ 1352 VFCVectorDHUBlockID 0;
BA_ "GenSigSendType" SG_ 1352 VFCVectorDHUVFCid0 0;
BA_ "GenSigSendType" SG_ 1352 VFCVectorDHUVFCid1 0;
BA_ "GenSigSendType" SG_ 1352 VFCVectorDHUVFCid10 0;
BA_ "GenSigSendType" SG_ 1352 VFCVectorDHUVFCid11 0;
BA_ "GenSigSendType" SG_ 1352 VFCVectorDHUVFCid12 0;
BA_ "GenSigSendType" SG_ 1352 VFCVectorDHUVFCid13 0;
BA_ "GenSigSendType" SG_ 1352 VFCVectorDHUVFCid14 0;
BA_ "GenSigSendType" SG_ 1352 VFCVectorDHUVFCid15 0;
BA_ "GenSigSendType" SG_ 1352 VFCVectorDHUVFCid16 0;
BA_ "GenSigSendType" SG_ 1352 VFCVectorDHUVFCid17 0;
BA_ "GenSigSendType" SG_ 1352 VFCVectorDHUVFCid18 0;
BA_ "GenSigSendType" SG_ 1352 VFCVectorDHUVFCid19 0;
BA_ "GenSigSendType" SG_ 1352 VFCVectorDHUVFCid2 0;
BA_ "GenSigSendType" SG_ 1352 VFCVectorDHUVFCid20 0;
BA_ "GenSigSendType" SG_ 1352 VFCVectorDHUVFCid21 0;
BA_ "GenSigSendType" SG_ 1352 VFCVectorDHUVFCid22 0;
BA_ "GenSigSendType" SG_ 1352 VFCVectorDHUVFCid23 0;
BA_ "GenSigSendType" SG_ 1352 VFCVectorDHUVFCid24 0;
BA_ "GenSigSendType" SG_ 1352 VFCVectorDHUVFCid25 0;
BA_ "GenSigSendType" SG_ 1352 VFCVectorDHUVFCid26 0;
BA_ "GenSigSendType" SG_ 1352 VFCVectorDHUVFCid27 0;
BA_ "GenSigSendType" SG_ 1352 VFCVectorDHUVFCid28 0;
BA_ "GenSigSendType" SG_ 1352 VFCVectorDHUVFCid29 0;
BA_ "GenSigSendType" SG_ 1352 VFCVectorDHUVFCid3 0;
BA_ "GenSigSendType" SG_ 1352 VFCVectorDHUVFCid30 0;
BA_ "GenSigSendType" SG_ 1352 VFCVectorDHUVFCid31 0;
BA_ "GenSigSendType" SG_ 1352 VFCVectorDHUVFCid32 0;
BA_ "GenSigSendType" SG_ 1352 VFCVectorDHUVFCid33 0;
BA_ "GenSigSendType" SG_ 1352 VFCVectorDHUVFCid34 0;
BA_ "GenSigSendType" SG_ 1352 VFCVectorDHUVFCid35 0;
BA_ "GenSigSendType" SG_ 1352 VFCVectorDHUVFCid36 0;
BA_ "GenSigSendType" SG_ 1352 VFCVectorDHUVFCid37 0;
BA_ "GenSigSendType" SG_ 1352 VFCVectorDHUVFCid38 0;
BA_ "GenSigSendType" SG_ 1352 VFCVectorDHUVFCid39 0;
BA_ "GenSigSendType" SG_ 1352 VFCVectorDHUVFCid4 0;
BA_ "GenSigSendType" SG_ 1352 VFCVectorDHUVFCid40 0;
BA_ "GenSigSendType" SG_ 1352 VFCVectorDHUVFCid41 0;
BA_ "GenSigSendType" SG_ 1352 VFCVectorDHUVFCid42 0;
BA_ "GenSigSendType" SG_ 1352 VFCVectorDHUVFCid43 0;
BA_ "GenSigSendType" SG_ 1352 VFCVectorDHUVFCid44 0;
BA_ "GenSigSendType" SG_ 1352 VFCVectorDHUVFCid45 0;
BA_ "GenSigSendType" SG_ 1352 VFCVectorDHUVFCid46 0;
BA_ "GenSigSendType" SG_ 1352 VFCVectorDHUVFCid47 0;
BA_ "GenSigSendType" SG_ 1352 VFCVectorDHUVFCid48 0;
BA_ "GenSigSendType" SG_ 1352 VFCVectorDHUVFCid49 0;
BA_ "GenSigSendType" SG_ 1352 VFCVectorDHUVFCid5 0;
BA_ "GenSigSendType" SG_ 1352 VFCVectorDHUVFCid50 0;
BA_ "GenSigSendType" SG_ 1352 VFCVectorDHUVFCid51 0;
BA_ "GenSigSendType" SG_ 1352 VFCVectorDHUVFCid52 0;
BA_ "GenSigSendType" SG_ 1352 VFCVectorDHUVFCid53 0;
BA_ "GenSigSendType" SG_ 1352 VFCVectorDHUVFCid54 0;
BA_ "GenSigSendType" SG_ 1352 VFCVectorDHUVFCid55 0;
BA_ "GenSigSendType" SG_ 1352 VFCVectorDHUVFCid56 0;
BA_ "GenSigSendType" SG_ 1352 VFCVectorDHUVFCid57 0;
BA_ "GenSigSendType" SG_ 1352 VFCVectorDHUVFCid58 0;
BA_ "GenSigSendType" SG_ 1352 VFCVectorDHUVFCid59 0;
BA_ "GenSigSendType" SG_ 1352 VFCVectorDHUVFCid6 0;
BA_ "GenSigSendType" SG_ 1352 VFCVectorDHUVFCid60 0;
BA_ "GenSigSendType" SG_ 1352 VFCVectorDHUVFCid61 0;
BA_ "GenSigSendType" SG_ 1352 VFCVectorDHUVFCid7 0;
BA_ "GenSigSendType" SG_ 1352 VFCVectorDHUVFCid8 0;
BA_ "GenSigSendType" SG_ 1352 VFCVectorDHUVFCid9 0;
BA_ "GenSigSendType" SG_ 293 VoiceCtrlMirrorDirection 0;
BA_ "GenSigSendType" SG_ 293 VoiceCtrlMirrorParams 0;
BA_ "GenSigSendType" SG_ 293 VoiceCtrlMirrorSide 0;
BA_ "GenSigStartValue" SG_ 293 WPCModuleStsBNCM2 1;
BA_ "GenSigSendType" SG_ 293 WinColorAutAdjmtReLeHmiReq 0;
BA_ "GenSigSendType" SG_ 293 WinColorAutAdjmtReRiHmiReq 0;
BA_ "GenSigSendType" SG_ 66 WinOpenAppReqWinOpenClsGlbSts 1;
BA_ "GenSigSendType" SG_ 66 WinOpenAppReqWindowOpenValue 1;
BA_ "GenSigSendType" SG_ 311 WinOpenDrvrReq 0;
BA_ "GenSigSendType" SG_ 311 WinOpenPassReq 0;
BA_ "GenSigSendType" SG_ 311 WinOpenReLeReq 0;
BA_ "GenSigSendType" SG_ 311 WinOpenReRiReq 0;
BA_ "GenSigSendType" SG_ 293 WinTransparencyReLeReq 0;
BA_ "GenSigStartValue" SG_ 293 WinTransparencyReLeReq 255;
BA_ "GenSigSendType" SG_ 293 WinTransparencyReRiReq 0;
BA_ "GenSigStartValue" SG_ 293 WinTransparencyReRiReq 255;
BA_ "GenSigSendType" SG_ 464 WirelschrgActvReqFromHmi 0;
BA_ "GenSigSendType" SG_ 311 Zone1SettingsBlue 0;
BA_ "GenSigSendType" SG_ 311 Zone1SettingsGreen 0;
BA_ "GenSigSendType" SG_ 311 Zone1SettingsIntensity 0;
BA_ "GenSigSendType" SG_ 311 Zone1SettingsRed 0;
BA_ "GenSigSendType" SG_ 311 Zone1SettingsZoneStatus 0;
BA_ "GenSigSendType" SG_ 311 Zone2SettingsBlue 0;
BA_ "GenSigSendType" SG_ 311 Zone2SettingsGreen 0;
BA_ "GenSigSendType" SG_ 311 Zone2SettingsIntensity 0;
BA_ "GenSigSendType" SG_ 311 Zone2SettingsRed 0;
BA_ "GenSigSendType" SG_ 311 Zone2SettingsZoneStatus 0;
BA_ "GenSigSendType" SG_ 311 Zone3SettingsBlue 0;
BA_ "GenSigSendType" SG_ 311 Zone3SettingsGreen 0;
BA_ "GenSigSendType" SG_ 311 Zone3SettingsIntensity 0;
BA_ "GenSigSendType" SG_ 311 Zone3SettingsRed 0;
BA_ "GenSigSendType" SG_ 311 Zone3SettingsZoneStatus 0;
VAL_ 464 ActvReSplrPosnReq 0 "PosnReq_PosnUkwn" 1 "PosnReq_PosnP0" 2 "PosnReq_PosnP1" 3 "PosnReq_PosnP2" 4 "PosnReq_Resd1" 5 "PosnReq_Resd2" 6 "PosnReq_Resd3" 7 "PosnReq_Resd4";
VAL_ 464 BackRestSideSpprtAdjmtRowFirstDrvr 0 "SwtHozlSts1_Idle" 1 "SwtHozlSts1_Fwd" 2 "SwtHozlSts1_Backw";
VAL_ 464 BackRestSideSpprtAdjmtRowFirstPass 0 "SwtHozlSts1_Idle" 1 "SwtHozlSts1_Fwd" 2 "SwtHozlSts1_Backw";
VAL_ 464 CushSideSpprtAdjmtRowFirstDrvr 0 "SwtVertSts1_Idle" 1 "SwtVertSts1_Up" 2 "SwtVertSts1_Dwn";
VAL_ 464 CushSideSpprtAdjmtRowFirstPass 0 "SwtVertSts1_Idle" 1 "SwtVertSts1_Up" 2 "SwtVertSts1_Dwn";
VAL_ 464 DiagcComActv 0 "YesNo2_No" 1 "YesNo2_Yes";
VAL_ 464 DiagcExtCom 0 "YesNo2_No" 1 "YesNo2_Yes";
VAL_ 464 DrvrSeatDispMassgFctMassgInten 0 "MassgIntenLvl_IntenLo" 1 "MassgIntenLvl_IntenNorm" 2 "MassgIntenLvl_IntenHi" 3 "MassgIntenLvl_Off";
VAL_ 464 DrvrSeatDispMassgFctMassgProg 0 "MassgProgTyp_Prog1" 1 "MassgProgTyp_Prog2" 2 "MassgProgTyp_Prog3" 3 "MassgProgTyp_Prog4" 4 "MassgProgTyp_Prog5" 5 "MassgProgTyp_Prog6" 6 "MassgProgTyp_Prog7" 7 "MassgProgTyp_Prog8";
VAL_ 464 DrvrSeatDispMassgFctOnOffl2 0 "OnOffl2_Off" 1 "OnOffl2_On" 2 "OnOffl2_Idle";
VAL_ 464 DrvrSeatDispSpplFct 0 "SeatActvSpplFct1_NotAvl" 1 "SeatActvSpplFct1_LumExtnAndLumHei" 2 "SeatActvSpplFct1_BackBlster" 3 "SeatActvSpplFct1_CushExtn" 4 "SeatActvSpplFct1_HdrestHeiAndHdrestTilt" 5 "SeatActvSpplFct1_MassgFct" 6 "SeatActvSpplFct1_ShoulderFct" 7 "SeatActvSpplFct1_LegrestFct";
VAL_ 464 ExtLoUOutlPwrSplyReqRADARMaiSwt 0 "OnOff1_Off" 1 "OnOff1_On";
VAL_ 464 ExtLoUOutlPwrSplyReqRADARZone1 0 "OnOff1_Off" 1 "OnOff1_On";
VAL_ 464 ExtLoUOutlPwrSplyReqRADARZone2 0 "OnOff1_Off" 1 "OnOff1_On";
VAL_ 464 ExtLoUOutlPwrSplyReqRADARZone3 0 "OnOff1_Off" 1 "OnOff1_On";
VAL_ 464 ExtLoUOutlPwrSplyReqRADARZone4 0 "OnOff1_Off" 1 "OnOff1_On";
VAL_ 464 ExtLoUOutlPwrSplyReqRADARZone5 0 "OnOff1_Off" 1 "OnOff1_On";
VAL_ 464 ExtLoUOutlPwrSplyReqRADARZone6 0 "OnOff1_Off" 1 "OnOff1_On";
VAL_ 464 ExtrLtgFctSts 0 "OnOff1_Off" 1 "OnOff1_On";
VAL_ 464 HMIBluetoothCallToAdjAirVol 0 "OnOffNoReq_NoReq" 1 "OnOffNoReq_On" 2 "OnOffNoReq_Off";
VAL_ 464 HMIIonizerAirCdnr 0 "OnOff1_Off" 1 "OnOff1_On";
VAL_ 464 HmiSmrtWindFolwSet 0 "OnOff1_Off" 1 "OnOff1_On";
VAL_ 464 HMIToVMMSwtSwitch1 0 "OnOff1_Off" 1 "OnOff1_On";
VAL_ 464 HMIToVMMSwtSwitch2 0 "OnOff1_Off" 1 "OnOff1_On";
VAL_ 464 HMIToVMMSwtSwitch3 0 "OnOff1_Off" 1 "OnOff1_On";
VAL_ 464 HMIToVMMSwtSwitch4 0 "OnOff1_Off" 1 "OnOff1_On";
VAL_ 464 HMIToVMMSwtSwitch5 0 "OnOff1_Off" 1 "OnOff1_On";
VAL_ 464 HMIToVMMSwtSwitch6 0 "OnOff1_Off" 1 "OnOff1_On";
VAL_ 464 HMIToVMMSwtSwitch7 0 "OnOff1_Off" 1 "OnOff1_On";
VAL_ 464 HMIToVMMSwtSwitch8 0 "OnOff1_Off" 1 "OnOff1_On";
VAL_ 464 HmiWinterLockCarPrevnIceSet 0 "OnOff1_Off" 1 "OnOff1_On";
VAL_ 464 LumHeiAdjmtRowFirstDrvr 0 "SwtVertSts1_Idle" 1 "SwtVertSts1_Up" 2 "SwtVertSts1_Dwn";
VAL_ 464 LumHeiAdjmtRowFirstPass 0 "SwtVertSts1_Idle" 1 "SwtVertSts1_Up" 2 "SwtVertSts1_Dwn";
VAL_ 464 LumLenAdjmtRowFirstDrvr 0 "SwtHozlSts1_Idle" 1 "SwtHozlSts1_Fwd" 2 "SwtHozlSts1_Backw";
VAL_ 464 LumLenAdjmtRowFirstPass 0 "SwtHozlSts1_Idle" 1 "SwtHozlSts1_Fwd" 2 "SwtHozlSts1_Backw";
VAL_ 464 PassSeatDispMassgFctMassgInten 0 "MassgIntenLvl_IntenLo" 1 "MassgIntenLvl_IntenNorm" 2 "MassgIntenLvl_IntenHi" 3 "MassgIntenLvl_Off";
VAL_ 464 PassSeatDispMassgFctMassgProg 0 "MassgProgTyp_Prog1" 1 "MassgProgTyp_Prog2" 2 "MassgProgTyp_Prog3" 3 "MassgProgTyp_Prog4" 4 "MassgProgTyp_Prog5" 5 "MassgProgTyp_Prog6" 6 "MassgProgTyp_Prog7" 7 "MassgProgTyp_Prog8";
VAL_ 464 PassSeatDispMassgFctOnOffl2 0 "OnOffl2_Off" 1 "OnOffl2_On" 2 "OnOffl2_Idle";
VAL_ 464 PassSeatDispSpplFct 0 "SeatActvSpplFct1_NotAvl" 1 "SeatActvSpplFct1_LumExtnAndLumHei" 2 "SeatActvSpplFct1_BackBlster" 3 "SeatActvSpplFct1_CushExtn" 4 "SeatActvSpplFct1_HdrestHeiAndHdrestTilt" 5 "SeatActvSpplFct1_MassgFct" 6 "SeatActvSpplFct1_ShoulderFct" 7 "SeatActvSpplFct1_LegrestFct";
VAL_ 464 SteerWhlHeatngAutStrtReq 0 "OnOff1_Off" 1 "OnOff1_On";
VAL_ 464 SunCurtCtrlReq 0 "OnOffNoReq_NoReq" 1 "OnOffNoReq_On" 2 "OnOffNoReq_Off";
VAL_ 464 SunRoofCtrlReq 0 "OnOffNoReq_NoReq" 1 "OnOffNoReq_On" 2 "OnOffNoReq_Off";
VAL_ 464 SwtPwrStsOfVehSurrndgsVisnRec 0 "OnOff1_Off" 1 "OnOff1_On";
VAL_ 464 TelmBookChrgnTyp 0 "TelmBookChrgnTyp_Idle" 1 "TelmBookChrgnTyp_Off" 2 "TelmBookChrgnTyp_SingleBooking" 3 "TelmBookChrgnTyp_CyclicBooking" 4 "TelmBookChrgnTyp_PlugInBooking";
VAL_ 464 WirelschrgActvReqFromHmi 0 "OnOff1_Off" 1 "OnOff1_On";
VAL_ 311 AirCushInflateDeflateReq 0 "OnOffNoReq_NoReq" 1 "OnOffNoReq_On" 2 "OnOffNoReq_Off";
VAL_ 311 AmbientLiEffectStatus1 0 "AmbientLiEffectStatus1_SingleEffect" 1 "AmbientLiEffectStatus1_TransitionEffect" 2 "AmbientLiEffectStatus1_BreathingEffect" 3 "AmbientLiEffectStatus1_HeartbeatEffect";
VAL_ 311 AmbLiChrgCorrlnReq 0 "OnOff1_Off" 1 "OnOff1_On";
VAL_ 311 AmbLiDirCorrlnReq 0 "OnOff1_Off" 1 "OnOff1_On";
VAL_ 311 AmbLiDoorCorrlnReq 0 "OnOff1_Off" 1 "OnOff1_On";
VAL_ 311 AmbLiDrvModCorrlnReq 0 "OnOff1_Off" 1 "OnOff1_On";
VAL_ 311 AmbLiRadarCorrlnReq 0 "OnOff1_Off" 1 "OnOff1_On";
VAL_ 311 AmbLiSpdSwt 0 "AmbLiSpd_Slow" 1 "AmbLiSpd_Medium" 2 "AmbLiSpd_Fast" 3 "AmbLiSpd_Fastest";
VAL_ 311 AmbLiStrtCorrlnReq 0 "OnOff1_Off" 1 "OnOff1_On";
VAL_ 311 AmbLiUnlckCorrlnReq 0 "OnOff1_Off" 1 "OnOff1_On";
VAL_ 311 AssistantLiEnaSwt 0 "OnOff1_Off" 1 "OnOff1_On";
VAL_ 311 CarpetLiModReq 0 "ModeReq_Mode1" 1 "ModeReq_Mode2" 2 "ModeReq_Mode3" 3 "ModeReq_Mode4" 4 "ModeReq_Mode5" 5 "ModeReq_Mode6";
VAL_ 311 ChdLockSideSelnSwt 0 "ParkAssiLeRi1_None" 1 "ParkAssiLeRi1_Left" 2 "ParkAssiLeRi1_Right" 3 "ParkAssiLeRi1_LeftAndRight";
VAL_ 311 DoorPocketLiSwt 0 "OnOffNoReq_NoReq" 1 "OnOffNoReq_On" 2 "OnOffNoReq_Off";
VAL_ 311 DrvrSeatDispPhytheraFctOnOff1 0 "OnOff1_Off" 1 "OnOff1_On";
VAL_ 311 DrvrSeatDispPhytheraFctPhytheraProgTyp 0 "PhytheraProgTyp_Prog1" 1 "PhytheraProgTyp_Prog2" 2 "PhytheraProgTyp_Prog3" 3 "PhytheraProgTyp_Prog4" 4 "PhytheraProgTyp_Prog5" 5 "PhytheraProgTyp_Prog6" 6 "PhytheraProgTyp_Prog7" 7 "PhytheraProgTyp_Prog8" 8 "PhytheraProgTyp_Prog9" 9 "PhytheraProgTyp_Prog10";
VAL_ 311 EasyInOutSecRowLeActv 0 "Boolean_FALSE" 1 "Boolean_TRUE";
VAL_ 311 EasyInOutSecRowRiActv 0 "Boolean_FALSE" 1 "Boolean_TRUE";
VAL_ 311 ExtrMirrAdjHmiReq 0 "MirrDirReqTyp_Idle" 1 "MirrDirReqTyp_Up" 2 "MirrDirReqTyp_Down" 3 "MirrDirReqTyp_Left" 4 "MirrDirReqTyp_Right";
VAL_ 311 ExtrMirrFoldHmiReq 0 "PsdNotPsd1_NotPsd" 1 "PsdNotPsd1_Psd";
VAL_ 311 ExtrMirrSelnHmiReq 0 "idle" 1 "left" 2 "right";
VAL_ 311 FogSetFrntReq 0 "OnOffNoReq_NoReq" 1 "OnOffNoReq_On" 2 "OnOffNoReq_Off";
VAL_ 311 FootwellLiSwt 0 "OnOffNoReq_NoReq" 1 "OnOffNoReq_On" 2 "OnOffNoReq_Off";
VAL_ 311 FrntTechnologyLiPosLiCorrlnSwt 0 "OnOff1_Off" 1 "OnOff1_On";
VAL_ 311 HmiAC 0 "HmiCmptmtCoolgReq_Off" 1 "HmiCmptmtCoolgReq_Auto";
VAL_ 311 HMIAutoTerrainSetting 0 "OnOff1_Off" 1 "OnOff1_On";
VAL_ 311 HmiElecFrntDefrstReq 0 "OnOffNoReq_NoReq" 1 "OnOffNoReq_On" 2 "OnOffNoReq_Off";
VAL_ 311 HmiElecReMirrDefrstReq 0 "OnOffNoReq_NoReq" 1 "OnOffNoReq_On" 2 "OnOffNoReq_Off";
VAL_ 311 HmiElecReWinDefrstReq 0 "OnOffNoReq_NoReq" 1 "OnOffNoReq_On" 2 "OnOffNoReq_Off";
VAL_ 311 IdleChrgCtrl 0 "PsdNotPsd_NotPsd" 1 "PsdNotPsd_Psd";
VAL_ 311 LegRestHozlAdjmtRowSecLe 0 "SwtHozlSts1_Idle" 1 "SwtHozlSts1_Fwd" 2 "SwtHozlSts1_Backw";
VAL_ 311 LegRestHozlAdjmtRowSecRi 0 "SwtHozlSts1_Idle" 1 "SwtHozlSts1_Fwd" 2 "SwtHozlSts1_Backw";
VAL_ 311 LegRestRotAdjmtRowThrdLe 0 "SwtVertSts1_Idle" 1 "SwtVertSts1_Up" 2 "SwtVertSts1_Dwn";
VAL_ 311 LegRestRotAdjmtRowThrdRi 0 "SwtVertSts1_Idle" 1 "SwtVertSts1_Up" 2 "SwtVertSts1_Dwn";
VAL_ 311 NFCKeyReadReq 0 "KeyLocn1_KeyLocnIdle" 1 "KeyLocn1_KeyLocnAll" 2 "KeyLocn1_KeyLocnAllExt" 3 "KeyLocn1_KeyLocnDrvrExt" 4 "KeyLocn1_KeyLocnPassExt" 5 "KeyLocn1_KeyLocnTrExt" 6 "KeyLocn1_KeyLocnAllInt" 7 "KeyLocn1_KeyLocnDrvrInt" 8 "KeyLocn1_KeyLocnPassInt" 9 "KeyLocn1_KeyLocnResvInt" 10 "KeyLocn1_KeyLocnResvIntSimple";
VAL_ 311 NightLiSwtSts 0 "OnOff1_Off" 1 "OnOff1_On";
VAL_ 311 OneKeyLvlgSwt 0 "OnOffNoReq_NoReq" 1 "OnOffNoReq_On" 2 "OnOffNoReq_Off";
VAL_ 311 OTACmplSts 0 "Boolean_FALSE" 1 "Boolean_TRUE";
VAL_ 311 PassSeatDispPhytheraFctOnOff1 0 "OnOff1_Off" 1 "OnOff1_On";
VAL_ 311 PassSeatDispPhytheraFctPhytheraProgTyp 0 "PhytheraProgTyp_Prog1" 1 "PhytheraProgTyp_Prog2" 2 "PhytheraProgTyp_Prog3" 3 "PhytheraProgTyp_Prog4" 4 "PhytheraProgTyp_Prog5" 5 "PhytheraProgTyp_Prog6" 6 "PhytheraProgTyp_Prog7" 7 "PhytheraProgTyp_Prog8" 8 "PhytheraProgTyp_Prog9" 9 "PhytheraProgTyp_Prog10";
VAL_ 311 PrpsnHvBattUsgModReq 0 "HvBattUsgType_NoReq" 1 "HvBattUsgType_Norm" 2 "HvBattUsgType_Hld" 3 "HvBattUsgType_HldSmt" 4 "HvBattUsgType_Chrg" 5 "HvBattUsgType_NotOfUse1" 6 "HvBattUsgType_NotOfUse2" 7 "HvBattUsgType_NotOfUse3";
VAL_ 311 PwrSldDoorLeReOpenHmiReq 0 "DoorOpenerIdle" 1 "DoorOpenerOpen" 2 "DoorOpenerCls" 3 "DoorOpenerStop";
VAL_ 311 PwrSldDoorRiReOpenHmiReq 0 "DoorOpenerIdle" 1 "DoorOpenerOpen" 2 "DoorOpenerCls" 3 "DoorOpenerStop";
VAL_ 311 ReSeatQuickAdjmt 0 "SeatQuickAdjmt_Non" 1 "SeatQuickAdjmt_TwoPeopleRide" 2 "SeatQuickAdjmt_FourPeopleAboard" 3 "SeatQuickAdjmt_SixPeopleRide" 4 "SeatQuickAdjmt_GolfTravel" 5 "SeatQuickAdjmt_StorgMod" 6 "SeatQuickAdjmt_OneBtnIntoBed" 7 "SeatQuickAdjmt_Reserved";
VAL_ 311 SaveSetgToMemPrmnt 0 "OffOnAut1_Off" 1 "OffOnAut1_On" 2 "OffOnAut1_Aut";
VAL_ 311 SearchLiSwtSts 0 "OnOff1_Off" 1 "OnOff1_On";
VAL_ 311 SpdCtrlSwt 0 "OnOff1_Off" 1 "OnOff1_On";
VAL_ 311 SunRoofAndCurtIninSwt 0 "PsdNotPsd1_NotPsd" 1 "PsdNotPsd1_Psd";
VAL_ 311 SuspEasyLoadSet 0 "OnOff1_Off" 1 "OnOff1_On";
VAL_ 311 SuspHeiLvlSet 0 "SuspHeiLvlSet_Reserve1" 1 "SuspHeiLvlSet_Hi2" 2 "SuspHeiLvlSet_Hi1" 3 "SuspHeiLvlSet_Norm" 4 "SuspHeiLvlSet_Lo1" 5 "SuspHeiLvlSet_Lo2" 6 "SuspHeiLvlSet_Reserve2" 7 "SuspHeiLvlSet_Reserve3";
VAL_ 311 TechnologyLiOnOffSwt 0 "OnOff1_Off" 1 "OnOff1_On";
VAL_ 311 TrfcSideSetReq 0 "RiLeTyp_Right" 1 "RiLeTyp_Left";
VAL_ 311 TrunkOpenHmiReq 0 "DoorOpenerIdle" 1 "DoorOpenerOpen" 2 "DoorOpenerCls" 3 "DoorOpenerStop";
VAL_ 311 WinOpenDrvrReq 0 "WinAndRoofAndCurtPosnTyp_PosnUkwn" 1 "WinAndRoofAndCurtPosnTyp_ClsFull" 2 "WinAndRoofAndCurtPosnTyp_PercOpen4" 3 "WinAndRoofAndCurtPosnTyp_PercOpen8" 4 "WinAndRoofAndCurtPosnTyp_PercOpen12" 5 "WinAndRoofAndCurtPosnTyp_PercOpen16" 6 "WinAndRoofAndCurtPosnTyp_PercOpen20" 7 "WinAndRoofAndCurtPosnTyp_PercOpen24" 8 "WinAndRoofAndCurtPosnTyp_PercOpen28" 9 "WinAndRoofAndCurtPosnTyp_PercOpen32" 10 "WinAndRoofAndCurtPosnTyp_PercOpen36" 11 "WinAndRoofAndCurtPosnTyp_PercOpen40" 12 "WinAndRoofAndCurtPosnTyp_PercOpen44" 13 "WinAndRoofAndCurtPosnTyp_PercOpen48" 14 "WinAndRoofAndCurtPosnTyp_PercOpen52" 15 "WinAndRoofAndCurtPosnTyp_PercOpen56" 16 "WinAndRoofAndCurtPosnTyp_PercOpen60" 17 "WinAndRoofAndCurtPosnTyp_PercOpen64" 18 "WinAndRoofAndCurtPosnTyp_PercOpen68" 19 "WinAndRoofAndCurtPosnTyp_PercOpen72" 20 "WinAndRoofAndCurtPosnTyp_PercOpen76" 21 "WinAndRoofAndCurtPosnTyp_PercOpen80" 22 "WinAndRoofAndCurtPosnTyp_PercOpen84" 23 "WinAndRoofAndCurtPosnTyp_PercOpen88" 24 "WinAndRoofAndCurtPosnTyp_PercOpen92" 25 "WinAndRoofAndCurtPosnTyp_PercOpen96" 26 "WinAndRoofAndCurtPosnTyp_OpenFull" 27 "WinAndRoofAndCurtPosnTyp_Resd1" 28 "WinAndRoofAndCurtPosnTyp_Resd2" 29 "WinAndRoofAndCurtPosnTyp_Resd3" 30 "WinAndRoofAndCurtPosnTyp_Resd4" 31 "WinAndRoofAndCurtPosnTyp_Movg";
VAL_ 311 WinOpenPassReq 0 "WinAndRoofAndCurtPosnTyp_PosnUkwn" 1 "WinAndRoofAndCurtPosnTyp_ClsFull" 2 "WinAndRoofAndCurtPosnTyp_PercOpen4" 3 "WinAndRoofAndCurtPosnTyp_PercOpen8" 4 "WinAndRoofAndCurtPosnTyp_PercOpen12" 5 "WinAndRoofAndCurtPosnTyp_PercOpen16" 6 "WinAndRoofAndCurtPosnTyp_PercOpen20" 7 "WinAndRoofAndCurtPosnTyp_PercOpen24" 8 "WinAndRoofAndCurtPosnTyp_PercOpen28" 9 "WinAndRoofAndCurtPosnTyp_PercOpen32" 10 "WinAndRoofAndCurtPosnTyp_PercOpen36" 11 "WinAndRoofAndCurtPosnTyp_PercOpen40" 12 "WinAndRoofAndCurtPosnTyp_PercOpen44" 13 "WinAndRoofAndCurtPosnTyp_PercOpen48" 14 "WinAndRoofAndCurtPosnTyp_PercOpen52" 15 "WinAndRoofAndCurtPosnTyp_PercOpen56" 16 "WinAndRoofAndCurtPosnTyp_PercOpen60" 17 "WinAndRoofAndCurtPosnTyp_PercOpen64" 18 "WinAndRoofAndCurtPosnTyp_PercOpen68" 19 "WinAndRoofAndCurtPosnTyp_PercOpen72" 20 "WinAndRoofAndCurtPosnTyp_PercOpen76" 21 "WinAndRoofAndCurtPosnTyp_PercOpen80" 22 "WinAndRoofAndCurtPosnTyp_PercOpen84" 23 "WinAndRoofAndCurtPosnTyp_PercOpen88" 24 "WinAndRoofAndCurtPosnTyp_PercOpen92" 25 "WinAndRoofAndCurtPosnTyp_PercOpen96" 26 "WinAndRoofAndCurtPosnTyp_OpenFull" 27 "WinAndRoofAndCurtPosnTyp_Resd1" 28 "WinAndRoofAndCurtPosnTyp_Resd2" 29 "WinAndRoofAndCurtPosnTyp_Resd3" 30 "WinAndRoofAndCurtPosnTyp_Resd4" 31 "WinAndRoofAndCurtPosnTyp_Movg";
VAL_ 311 WinOpenReLeReq 0 "WinAndRoofAndCurtPosnTyp_PosnUkwn" 1 "WinAndRoofAndCurtPosnTyp_ClsFull" 2 "WinAndRoofAndCurtPosnTyp_PercOpen4" 3 "WinAndRoofAndCurtPosnTyp_PercOpen8" 4 "WinAndRoofAndCurtPosnTyp_PercOpen12" 5 "WinAndRoofAndCurtPosnTyp_PercOpen16" 6 "WinAndRoofAndCurtPosnTyp_PercOpen20" 7 "WinAndRoofAndCurtPosnTyp_PercOpen24" 8 "WinAndRoofAndCurtPosnTyp_PercOpen28" 9 "WinAndRoofAndCurtPosnTyp_PercOpen32" 10 "WinAndRoofAndCurtPosnTyp_PercOpen36" 11 "WinAndRoofAndCurtPosnTyp_PercOpen40" 12 "WinAndRoofAndCurtPosnTyp_PercOpen44" 13 "WinAndRoofAndCurtPosnTyp_PercOpen48" 14 "WinAndRoofAndCurtPosnTyp_PercOpen52" 15 "WinAndRoofAndCurtPosnTyp_PercOpen56" 16 "WinAndRoofAndCurtPosnTyp_PercOpen60" 17 "WinAndRoofAndCurtPosnTyp_PercOpen64" 18 "WinAndRoofAndCurtPosnTyp_PercOpen68" 19 "WinAndRoofAndCurtPosnTyp_PercOpen72" 20 "WinAndRoofAndCurtPosnTyp_PercOpen76" 21 "WinAndRoofAndCurtPosnTyp_PercOpen80" 22 "WinAndRoofAndCurtPosnTyp_PercOpen84" 23 "WinAndRoofAndCurtPosnTyp_PercOpen88" 24 "WinAndRoofAndCurtPosnTyp_PercOpen92" 25 "WinAndRoofAndCurtPosnTyp_PercOpen96" 26 "WinAndRoofAndCurtPosnTyp_OpenFull" 27 "WinAndRoofAndCurtPosnTyp_Resd1" 28 "WinAndRoofAndCurtPosnTyp_Resd2" 29 "WinAndRoofAndCurtPosnTyp_Resd3" 30 "WinAndRoofAndCurtPosnTyp_Resd4" 31 "WinAndRoofAndCurtPosnTyp_Movg";
VAL_ 311 WinOpenReRiReq 0 "WinAndRoofAndCurtPosnTyp_PosnUkwn" 1 "WinAndRoofAndCurtPosnTyp_ClsFull" 2 "WinAndRoofAndCurtPosnTyp_PercOpen4" 3 "WinAndRoofAndCurtPosnTyp_PercOpen8" 4 "WinAndRoofAndCurtPosnTyp_PercOpen12" 5 "WinAndRoofAndCurtPosnTyp_PercOpen16" 6 "WinAndRoofAndCurtPosnTyp_PercOpen20" 7 "WinAndRoofAndCurtPosnTyp_PercOpen24" 8 "WinAndRoofAndCurtPosnTyp_PercOpen28" 9 "WinAndRoofAndCurtPosnTyp_PercOpen32" 10 "WinAndRoofAndCurtPosnTyp_PercOpen36" 11 "WinAndRoofAndCurtPosnTyp_PercOpen40" 12 "WinAndRoofAndCurtPosnTyp_PercOpen44" 13 "WinAndRoofAndCurtPosnTyp_PercOpen48" 14 "WinAndRoofAndCurtPosnTyp_PercOpen52" 15 "WinAndRoofAndCurtPosnTyp_PercOpen56" 16 "WinAndRoofAndCurtPosnTyp_PercOpen60" 17 "WinAndRoofAndCurtPosnTyp_PercOpen64" 18 "WinAndRoofAndCurtPosnTyp_PercOpen68" 19 "WinAndRoofAndCurtPosnTyp_PercOpen72" 20 "WinAndRoofAndCurtPosnTyp_PercOpen76" 21 "WinAndRoofAndCurtPosnTyp_PercOpen80" 22 "WinAndRoofAndCurtPosnTyp_PercOpen84" 23 "WinAndRoofAndCurtPosnTyp_PercOpen88" 24 "WinAndRoofAndCurtPosnTyp_PercOpen92" 25 "WinAndRoofAndCurtPosnTyp_PercOpen96" 26 "WinAndRoofAndCurtPosnTyp_OpenFull" 27 "WinAndRoofAndCurtPosnTyp_Resd1" 28 "WinAndRoofAndCurtPosnTyp_Resd2" 29 "WinAndRoofAndCurtPosnTyp_Resd3" 30 "WinAndRoofAndCurtPosnTyp_Resd4" 31 "WinAndRoofAndCurtPosnTyp_Movg";
VAL_ 311 Zone1SettingsZoneStatus 0 "OnOff1_Off" 1 "OnOff1_On";
VAL_ 311 Zone2SettingsZoneStatus 0 "OnOff1_Off" 1 "OnOff1_On";
VAL_ 311 Zone3SettingsZoneStatus 0 "OnOff1_Off" 1 "OnOff1_On";
VAL_ 66 DChaEngStsCtrl 0 "IdleEnaDis_Idle" 1 "IdleEnaDis_Ena" 2 "IdleEnaDis_Dis";
VAL_ 66 HVPwrDwnRstReq 0 "OnOff1_Off" 1 "OnOff1_On";
VAL_ 66 ReadLiOpenReqFrontLeft 0 "OnOffNoReq_NoReq" 1 "OnOffNoReq_On" 2 "OnOffNoReq_Off";
VAL_ 66 ReadLiOpenReqFrontRight 0 "OnOffNoReq_NoReq" 1 "OnOffNoReq_On" 2 "OnOffNoReq_Off";
VAL_ 66 ReadLiOpenReqSecondRowLeft 0 "OnOffNoReq_NoReq" 1 "OnOffNoReq_On" 2 "OnOffNoReq_Off";
VAL_ 66 ReadLiOpenReqSecondRowRight 0 "OnOffNoReq_NoReq" 1 "OnOffNoReq_On" 2 "OnOffNoReq_Off";
VAL_ 66 ReadLiOpenReqThirdRowLeft 0 "OnOffNoReq_NoReq" 1 "OnOffNoReq_On" 2 "OnOffNoReq_Off";
VAL_ 66 ReadLiOpenReqThirdRowRight 0 "OnOffNoReq_NoReq" 1 "OnOffNoReq_On" 2 "OnOffNoReq_Off";
VAL_ 66 TopPosTrFromHmi 0 "PosPerc1_NoReq" 1 "PosPerc1_0to20PercTopPos" 2 "PosPerc1_21to40PercTopPos" 3 "PosPerc1_41to60PercTopPos" 4 "PosPerc1_61to80PercTopPos" 5 "PosPerc1_81to100PercTopPos";
VAL_ 66 UsrSpeechSts 0 "OnOff1_Off" 1 "OnOff1_On";
VAL_ 66 WinOpenAppReqWinOpenClsGlbSts 0 "WinOpenClsGlbReqFromTelm_Idle" 1 "WinOpenClsGlbReqFromTelm_Open" 2 "WinOpenClsGlbReqFromTelm_Close";
VAL_ 272 BookTrvlClimaActvReq 0 "OnOffNoReq_NoReq" 1 "OnOffNoReq_On" 2 "OnOffNoReq_Off";
VAL_ 272 CarFindrHornLiReqFromTelm 0 "CarFindrHornLiReqFromTelm_NoReq" 1 "CarFindrHornLiReqFromTelm_HornReq" 2 "CarFindrHornLiReqFromTelm_LiReq" 3 "CarFindrHornLiReqFromTelm_HornLiReq";
VAL_ 272 CbnOverHeatProtnEnaFromTelm 0 "OnOff1_Off" 1 "OnOff1_On";
VAL_ 272 ChrgLidTelmLockgReq 0 "ReqSts1_NotReqd" 1 "ReqSts1_Reqd";
VAL_ 272 ClimaRqrd1 0 "OnOffNoReq_NoReq" 1 "OnOffNoReq_On" 2 "OnOffNoReq_Off";
VAL_ 272 ClimaTmrStsTelmRqrd 0 "OnOff1_Off" 1 "OnOff1_On";
VAL_ 272 EmgyAsscTrigSts 0 "AfsStsReq_Inactive" 1 "AfsStsReq_AutomaticallySet" 2 "AfsStsReq_ManuallySet" 3 "AfsStsReq_Fault";
VAL_ 272 EngForbidReqFromTelm 0 "ReqSts1_NotReqd" 1 "ReqSts1_Reqd";
VAL_ 272 EngPermitReqFromTelm 0 "ReqSts1_NotReqd" 1 "ReqSts1_Reqd";
VAL_ 272 ExtrLiShowActvnReq 0 "OnOff1_Off" 1 "OnOff1_On";
VAL_ 272 ExtrLiShowFileTxReq 0 "OnOff1_Off" 1 "OnOff1_On";
VAL_ 272 FreqencyChargn 0 "FreqencyChargnsts_UnDefined" 1 "FreqencyChargnsts_Low" 2 "FreqencyChargnsts_Middle" 3 "FreqencyChargnsts_High";
VAL_ 272 RemCtrlLoUPwrOutpReqZone1 0 "Swt1_Idle" 1 "Swt1_ON" 2 "Swt1_Off" 3 "Swt1_NotUsed";
VAL_ 272 RemCtrlLoUPwrOutpReqZone2 0 "Swt1_Idle" 1 "Swt1_ON" 2 "Swt1_Off" 3 "Swt1_NotUsed";
VAL_ 272 RemCtrlLoUPwrOutpReqZone3 0 "Swt1_Idle" 1 "Swt1_ON" 2 "Swt1_Off" 3 "Swt1_NotUsed";
VAL_ 272 RemCtrlLoUPwrOutpReqZone4 0 "Swt1_Idle" 1 "Swt1_ON" 2 "Swt1_Off" 3 "Swt1_NotUsed";
VAL_ 272 RemCtrlLoUPwrOutpReqZone5 0 "Swt1_Idle" 1 "Swt1_ON" 2 "Swt1_Off" 3 "Swt1_NotUsed";
VAL_ 272 RemCtrlLoUPwrOutpReqZone6 0 "Swt1_Idle" 1 "Swt1_ON" 2 "Swt1_Off" 3 "Swt1_NotUsed";
VAL_ 272 TelmThermoTankReq1 0 "Req_NoReq" 1 "Req_off" 2 "Req_Coolg" 3 "Req_Heatlg";
VAL_ 293 AutoHldTechLiEna 0 "OnOff1_Off" 1 "OnOff1_On";
VAL_ 293 ChdLockCmnCtrlHmiReq 0 "LockgCenReq2_Idle" 1 "LockgCenReq2_Unlck" 2 "LockgCenReq2_Lock";
VAL_ 293 DrvModReqForChampnMod 0 "SteerMod_Ukwn" 1 "SteerMod_Mod1" 2 "SteerMod_Mod2" 3 "SteerMod_Mod3" 4 "SteerMod_Mod4" 5 "SteerMod_Resd5" 6 "SteerMod_Resd6" 7 "SteerMod_Resd7";
VAL_ 293 LowrTailgOpenHmiReq 0 "DoorOpenerIdle" 1 "DoorOpenerOpen" 2 "DoorOpenerCls" 3 "DoorOpenerStop";
VAL_ 293 MusicInfoSeg13StateFlagMusicPlay 0 "Boolean_FALSE" 1 "Boolean_TRUE";
VAL_ 293 MusicInfoSeg13StateFlagNewMusic 0 "Boolean_FALSE" 1 "Boolean_TRUE";
VAL_ 293 MusicInfoSeg23StateFlagMusicPlay 0 "Boolean_FALSE" 1 "Boolean_TRUE";
VAL_ 293 MusicInfoSeg23StateFlagNewMusic 0 "Boolean_FALSE" 1 "Boolean_TRUE";
VAL_ 293 PrkgLiShowSwt 0 "PrkgLiShowSwt_NoReq" 1 "PrkgLiShowSwt_Static" 2 "PrkgLiShowSwt_Dynamic" 3 "PrkgLiShowSwt_Off";
VAL_ 293 RowSecRiSeatZeroGrvySwtReq 0 "SeatCtrlReq_Idle" 1 "SeatCtrlReq_Move" 2 "SeatCtrlReq_Return" 3 "SeatCtrlReq_Stop";
VAL_ 293 SunroofGlassAutAdjmtHmiReq 0 "OnOffNoReq_NoReq" 1 "OnOffNoReq_On" 2 "OnOffNoReq_Off";
VAL_ 293 VoiceCtrlMirrorDirection 0 "Direction2_Up" 1 "Direction2_Down" 2 "Direction2_Left" 3 "Direction2_Right";
VAL_ 293 VoiceCtrlMirrorParams 0 "VoiceCtrlMirrorParams_Idle" 1 "VoiceCtrlMirrorParams_Step1" 2 "VoiceCtrlMirrorParams_Step2" 3 "VoiceCtrlMirrorParams_Step3" 4 "VoiceCtrlMirrorParams_Step4" 5 "VoiceCtrlMirrorParams_Step5" 6 "VoiceCtrlMirrorParams_Step6" 7 "VoiceCtrlMirrorParams_Step7" 8 "VoiceCtrlMirrorParams_Step8" 9 "VoiceCtrlMirrorParams_Step9" 10 "VoiceCtrlMirrorParams_Step10" 11 "VoiceCtrlMirrorParams_Step11" 12 "VoiceCtrlMirrorParams_Step12" 13 "VoiceCtrlMirrorParams_Step13" 14 "VoiceCtrlMirrorParams_Step14" 15 "VoiceCtrlMirrorParams_Step15" 16 "VoiceCtrlMirrorParams_Step16" 17 "VoiceCtrlMirrorParams_Step17" 18 "VoiceCtrlMirrorParams_Step18" 19 "VoiceCtrlMirrorParams_Step19" 20 "VoiceCtrlMirrorParams_Step20" 62 "VoiceCtrlMirrorParams_Half" 63 "VoiceCtrlMirrorParams_Max";
VAL_ 293 VoiceCtrlMirrorSide 0 "VoiceCtrlMirrorSide_Drv" 1 "VoiceCtrlMirrorSide_Psn";
VAL_ 293 WinColorAutAdjmtReLeHmiReq 0 "OnOffNoReq_NoReq" 1 "OnOffNoReq_On" 2 "OnOffNoReq_Off";
VAL_ 293 WinColorAutAdjmtReRiHmiReq 0 "OnOffNoReq_NoReq" 1 "OnOffNoReq_On" 2 "OnOffNoReq_Off";
VAL_ 293 WPCModuleStsBNCM2 0 "WPCModuleSts_OverTemperatureProtected" 1 "WPCModuleSts_Standby" 2 "WPCModuleSts_Charging" 3 "WPCModuleSts_FOD" 4 "WPCModuleSts_VoltageProtected" 5 "WPCModuleSts_OverPowerProtected" 6 "WPCModuleSts_Transmittingcoildisable" 7 "WPCModuleSts_OFF" 8 "WPCModuleSts_ChargingCompleted" 9 "WPCModuleSts_DeactivatedbyUser" 10 "WPCModuleSts_50WCharging" 11 "WPCModuleSts_Resvd3" 12 "WPCModuleSts_Resvd4" 13 "WPCModuleSts_Resvd5" 14 "WPCModuleSts_Resvd6" 15 "WPCModuleSts_Invalid";
VAL_ 96 DwnLoadDynLtgPrmForReGrp10Mode1 0 "Mode6_Off" 1 "Mode6_On" 2 "Mode6_GradualOn" 3 "Mode6_GradualOff" 4 "Mode6_ForwardWipingOn" 5 "Mode6_BackwardWipingOn" 6 "Mode6_OutwardWipingOn" 7 "Mode6_InwardWipingOn" 8 "Mode6_ForwardWipingOff" 9 "Mode6_BackwardWipingOff" 10 "Mode6_OutwardWipingOff" 11 "Mode6_InwardWipingOff" 12 "Mode6_ForwardScanning" 13 "Mode6_BackwardScanning" 14 "Mode6_BreathOn" 15 "Mode6_BreathOff" 16 "Mode6_Spare1" 17 "Mode6_Spare2" 56 "Mode1_Stack" 57 "Mode1_Disappear";
VAL_ 96 DwnLoadDynLtgPrmForReGrp11Mode1 0 "Mode6_Off" 1 "Mode6_On" 2 "Mode6_GradualOn" 3 "Mode6_GradualOff" 4 "Mode6_ForwardWipingOn" 5 "Mode6_BackwardWipingOn" 6 "Mode6_OutwardWipingOn" 7 "Mode6_InwardWipingOn" 8 "Mode6_ForwardWipingOff" 9 "Mode6_BackwardWipingOff" 10 "Mode6_OutwardWipingOff" 11 "Mode6_InwardWipingOff" 12 "Mode6_ForwardScanning" 13 "Mode6_BackwardScanning" 14 "Mode6_BreathOn" 15 "Mode6_BreathOff" 16 "Mode6_Spare1" 17 "Mode6_Spare2" 56 "Mode1_Stack" 57 "Mode1_Disappear";
VAL_ 96 DwnLoadDynLtgPrmForReGrp12Mode1 0 "Mode6_Off" 1 "Mode6_On" 2 "Mode6_GradualOn" 3 "Mode6_GradualOff" 4 "Mode6_ForwardWipingOn" 5 "Mode6_BackwardWipingOn" 6 "Mode6_OutwardWipingOn" 7 "Mode6_InwardWipingOn" 8 "Mode6_ForwardWipingOff" 9 "Mode6_BackwardWipingOff" 10 "Mode6_OutwardWipingOff" 11 "Mode6_InwardWipingOff" 12 "Mode6_ForwardScanning" 13 "Mode6_BackwardScanning" 14 "Mode6_BreathOn" 15 "Mode6_BreathOff" 16 "Mode6_Spare1" 17 "Mode6_Spare2" 56 "Mode1_Stack" 57 "Mode1_Disappear";
VAL_ 96 DwnLoadDynLtgPrmForReGrp13Mode1 0 "Mode6_Off" 1 "Mode6_On" 2 "Mode6_GradualOn" 3 "Mode6_GradualOff" 4 "Mode6_ForwardWipingOn" 5 "Mode6_BackwardWipingOn" 6 "Mode6_OutwardWipingOn" 7 "Mode6_InwardWipingOn" 8 "Mode6_ForwardWipingOff" 9 "Mode6_BackwardWipingOff" 10 "Mode6_OutwardWipingOff" 11 "Mode6_InwardWipingOff" 12 "Mode6_ForwardScanning" 13 "Mode6_BackwardScanning" 14 "Mode6_BreathOn" 15 "Mode6_BreathOff" 16 "Mode6_Spare1" 17 "Mode6_Spare2" 56 "Mode1_Stack" 57 "Mode1_Disappear";
VAL_ 96 DwnLoadDynLtgPrmForReGrp14Mode1 0 "Mode6_Off" 1 "Mode6_On" 2 "Mode6_GradualOn" 3 "Mode6_GradualOff" 4 "Mode6_ForwardWipingOn" 5 "Mode6_BackwardWipingOn" 6 "Mode6_OutwardWipingOn" 7 "Mode6_InwardWipingOn" 8 "Mode6_ForwardWipingOff" 9 "Mode6_BackwardWipingOff" 10 "Mode6_OutwardWipingOff" 11 "Mode6_InwardWipingOff" 12 "Mode6_ForwardScanning" 13 "Mode6_BackwardScanning" 14 "Mode6_BreathOn" 15 "Mode6_BreathOff" 16 "Mode6_Spare1" 17 "Mode6_Spare2" 56 "Mode1_Stack" 57 "Mode1_Disappear";
VAL_ 96 DwnLoadDynLtgPrmForReGrp15Mode1 0 "Mode6_Off" 1 "Mode6_On" 2 "Mode6_GradualOn" 3 "Mode6_GradualOff" 4 "Mode6_ForwardWipingOn" 5 "Mode6_BackwardWipingOn" 6 "Mode6_OutwardWipingOn" 7 "Mode6_InwardWipingOn" 8 "Mode6_ForwardWipingOff" 9 "Mode6_BackwardWipingOff" 10 "Mode6_OutwardWipingOff" 11 "Mode6_InwardWipingOff" 12 "Mode6_ForwardScanning" 13 "Mode6_BackwardScanning" 14 "Mode6_BreathOn" 15 "Mode6_BreathOff" 16 "Mode6_Spare1" 17 "Mode6_Spare2" 56 "Mode1_Stack" 57 "Mode1_Disappear";
VAL_ 96 DwnLoadDynLtgPrmForReGrp16Mode1 0 "Mode6_Off" 1 "Mode6_On" 2 "Mode6_GradualOn" 3 "Mode6_GradualOff" 4 "Mode6_ForwardWipingOn" 5 "Mode6_BackwardWipingOn" 6 "Mode6_OutwardWipingOn" 7 "Mode6_InwardWipingOn" 8 "Mode6_ForwardWipingOff" 9 "Mode6_BackwardWipingOff" 10 "Mode6_OutwardWipingOff" 11 "Mode6_InwardWipingOff" 12 "Mode6_ForwardScanning" 13 "Mode6_BackwardScanning" 14 "Mode6_BreathOn" 15 "Mode6_BreathOff" 16 "Mode6_Spare1" 17 "Mode6_Spare2" 56 "Mode1_Stack" 57 "Mode1_Disappear";
VAL_ 96 DwnLoadDynLtgPrmForReGrp1Mode1 0 "Mode6_Off" 1 "Mode6_On" 2 "Mode6_GradualOn" 3 "Mode6_GradualOff" 4 "Mode6_ForwardWipingOn" 5 "Mode6_BackwardWipingOn" 6 "Mode6_OutwardWipingOn" 7 "Mode6_InwardWipingOn" 8 "Mode6_ForwardWipingOff" 9 "Mode6_BackwardWipingOff" 10 "Mode6_OutwardWipingOff" 11 "Mode6_InwardWipingOff" 12 "Mode6_ForwardScanning" 13 "Mode6_BackwardScanning" 14 "Mode6_BreathOn" 15 "Mode6_BreathOff" 16 "Mode6_Spare1" 17 "Mode6_Spare2" 56 "Mode1_Stack" 57 "Mode1_Disappear";
VAL_ 96 DwnLoadDynLtgPrmForReGrp2Mode1 0 "Mode6_Off" 1 "Mode6_On" 2 "Mode6_GradualOn" 3 "Mode6_GradualOff" 4 "Mode6_ForwardWipingOn" 5 "Mode6_BackwardWipingOn" 6 "Mode6_OutwardWipingOn" 7 "Mode6_InwardWipingOn" 8 "Mode6_ForwardWipingOff" 9 "Mode6_BackwardWipingOff" 10 "Mode6_OutwardWipingOff" 11 "Mode6_InwardWipingOff" 12 "Mode6_ForwardScanning" 13 "Mode6_BackwardScanning" 14 "Mode6_BreathOn" 15 "Mode6_BreathOff" 16 "Mode6_Spare1" 17 "Mode6_Spare2" 56 "Mode1_Stack" 57 "Mode1_Disappear";
VAL_ 96 DwnLoadDynLtgPrmForReGrp3Mode1 0 "Mode6_Off" 1 "Mode6_On" 2 "Mode6_GradualOn" 3 "Mode6_GradualOff" 4 "Mode6_ForwardWipingOn" 5 "Mode6_BackwardWipingOn" 6 "Mode6_OutwardWipingOn" 7 "Mode6_InwardWipingOn" 8 "Mode6_ForwardWipingOff" 9 "Mode6_BackwardWipingOff" 10 "Mode6_OutwardWipingOff" 11 "Mode6_InwardWipingOff" 12 "Mode6_ForwardScanning" 13 "Mode6_BackwardScanning" 14 "Mode6_BreathOn" 15 "Mode6_BreathOff" 16 "Mode6_Spare1" 17 "Mode6_Spare2" 56 "Mode1_Stack" 57 "Mode1_Disappear";
VAL_ 96 DwnLoadDynLtgPrmForReGrp4Mode1 0 "Mode6_Off" 1 "Mode6_On" 2 "Mode6_GradualOn" 3 "Mode6_GradualOff" 4 "Mode6_ForwardWipingOn" 5 "Mode6_BackwardWipingOn" 6 "Mode6_OutwardWipingOn" 7 "Mode6_InwardWipingOn" 8 "Mode6_ForwardWipingOff" 9 "Mode6_BackwardWipingOff" 10 "Mode6_OutwardWipingOff" 11 "Mode6_InwardWipingOff" 12 "Mode6_ForwardScanning" 13 "Mode6_BackwardScanning" 14 "Mode6_BreathOn" 15 "Mode6_BreathOff" 16 "Mode6_Spare1" 17 "Mode6_Spare2" 56 "Mode1_Stack" 57 "Mode1_Disappear";
VAL_ 96 DwnLoadDynLtgPrmForReGrp5Mode1 0 "Mode6_Off" 1 "Mode6_On" 2 "Mode6_GradualOn" 3 "Mode6_GradualOff" 4 "Mode6_ForwardWipingOn" 5 "Mode6_BackwardWipingOn" 6 "Mode6_OutwardWipingOn" 7 "Mode6_InwardWipingOn" 8 "Mode6_ForwardWipingOff" 9 "Mode6_BackwardWipingOff" 10 "Mode6_OutwardWipingOff" 11 "Mode6_InwardWipingOff" 12 "Mode6_ForwardScanning" 13 "Mode6_BackwardScanning" 14 "Mode6_BreathOn" 15 "Mode6_BreathOff" 16 "Mode6_Spare1" 17 "Mode6_Spare2" 56 "Mode1_Stack" 57 "Mode1_Disappear";
VAL_ 96 DwnLoadDynLtgPrmForReGrp6Mode1 0 "Mode6_Off" 1 "Mode6_On" 2 "Mode6_GradualOn" 3 "Mode6_GradualOff" 4 "Mode6_ForwardWipingOn" 5 "Mode6_BackwardWipingOn" 6 "Mode6_OutwardWipingOn" 7 "Mode6_InwardWipingOn" 8 "Mode6_ForwardWipingOff" 9 "Mode6_BackwardWipingOff" 10 "Mode6_OutwardWipingOff" 11 "Mode6_InwardWipingOff" 12 "Mode6_ForwardScanning" 13 "Mode6_BackwardScanning" 14 "Mode6_BreathOn" 15 "Mode6_BreathOff" 16 "Mode6_Spare1" 17 "Mode6_Spare2" 56 "Mode1_Stack" 57 "Mode1_Disappear";
VAL_ 96 DwnLoadDynLtgPrmForReGrp7Mode1 0 "Mode6_Off" 1 "Mode6_On" 2 "Mode6_GradualOn" 3 "Mode6_GradualOff" 4 "Mode6_ForwardWipingOn" 5 "Mode6_BackwardWipingOn" 6 "Mode6_OutwardWipingOn" 7 "Mode6_InwardWipingOn" 8 "Mode6_ForwardWipingOff" 9 "Mode6_BackwardWipingOff" 10 "Mode6_OutwardWipingOff" 11 "Mode6_InwardWipingOff" 12 "Mode6_ForwardScanning" 13 "Mode6_BackwardScanning" 14 "Mode6_BreathOn" 15 "Mode6_BreathOff" 16 "Mode6_Spare1" 17 "Mode6_Spare2" 56 "Mode1_Stack" 57 "Mode1_Disappear";
VAL_ 96 DwnLoadDynLtgPrmForReGrp8Mode1 0 "Mode6_Off" 1 "Mode6_On" 2 "Mode6_GradualOn" 3 "Mode6_GradualOff" 4 "Mode6_ForwardWipingOn" 5 "Mode6_BackwardWipingOn" 6 "Mode6_OutwardWipingOn" 7 "Mode6_InwardWipingOn" 8 "Mode6_ForwardWipingOff" 9 "Mode6_BackwardWipingOff" 10 "Mode6_OutwardWipingOff" 11 "Mode6_InwardWipingOff" 12 "Mode6_ForwardScanning" 13 "Mode6_BackwardScanning" 14 "Mode6_BreathOn" 15 "Mode6_BreathOff" 16 "Mode6_Spare1" 17 "Mode6_Spare2" 56 "Mode1_Stack" 57 "Mode1_Disappear";
VAL_ 96 DwnLoadDynLtgPrmForReGrp9Mode1 0 "Mode6_Off" 1 "Mode6_On" 2 "Mode6_GradualOn" 3 "Mode6_GradualOff" 4 "Mode6_ForwardWipingOn" 5 "Mode6_BackwardWipingOn" 6 "Mode6_OutwardWipingOn" 7 "Mode6_InwardWipingOn" 8 "Mode6_ForwardWipingOff" 9 "Mode6_BackwardWipingOff" 10 "Mode6_OutwardWipingOff" 11 "Mode6_InwardWipingOff" 12 "Mode6_ForwardScanning" 13 "Mode6_BackwardScanning" 14 "Mode6_BreathOn" 15 "Mode6_BreathOff" 16 "Mode6_Spare1" 17 "Mode6_Spare2" 56 "Mode1_Stack" 57 "Mode1_Disappear";
VAL_ 97 DwnLoadDynLtgPrmForReGrp17Mode1 0 "Mode6_Off" 1 "Mode6_On" 2 "Mode6_GradualOn" 3 "Mode6_GradualOff" 4 "Mode6_ForwardWipingOn" 5 "Mode6_BackwardWipingOn" 6 "Mode6_OutwardWipingOn" 7 "Mode6_InwardWipingOn" 8 "Mode6_ForwardWipingOff" 9 "Mode6_BackwardWipingOff" 10 "Mode6_OutwardWipingOff" 11 "Mode6_InwardWipingOff" 12 "Mode6_ForwardScanning" 13 "Mode6_BackwardScanning" 14 "Mode6_BreathOn" 15 "Mode6_BreathOff" 16 "Mode6_Spare1" 17 "Mode6_Spare2" 56 "Mode1_Stack" 57 "Mode1_Disappear";
VAL_ 97 DwnLoadDynLtgPrmForReGrp18Mode1 0 "Mode6_Off" 1 "Mode6_On" 2 "Mode6_GradualOn" 3 "Mode6_GradualOff" 4 "Mode6_ForwardWipingOn" 5 "Mode6_BackwardWipingOn" 6 "Mode6_OutwardWipingOn" 7 "Mode6_InwardWipingOn" 8 "Mode6_ForwardWipingOff" 9 "Mode6_BackwardWipingOff" 10 "Mode6_OutwardWipingOff" 11 "Mode6_InwardWipingOff" 12 "Mode6_ForwardScanning" 13 "Mode6_BackwardScanning" 14 "Mode6_BreathOn" 15 "Mode6_BreathOff" 16 "Mode6_Spare1" 17 "Mode6_Spare2" 56 "Mode1_Stack" 57 "Mode1_Disappear";
VAL_ 97 DwnLoadDynLtgPrmForReGrp19Mode1 0 "Mode6_Off" 1 "Mode6_On" 2 "Mode6_GradualOn" 3 "Mode6_GradualOff" 4 "Mode6_ForwardWipingOn" 5 "Mode6_BackwardWipingOn" 6 "Mode6_OutwardWipingOn" 7 "Mode6_InwardWipingOn" 8 "Mode6_ForwardWipingOff" 9 "Mode6_BackwardWipingOff" 10 "Mode6_OutwardWipingOff" 11 "Mode6_InwardWipingOff" 12 "Mode6_ForwardScanning" 13 "Mode6_BackwardScanning" 14 "Mode6_BreathOn" 15 "Mode6_BreathOff" 16 "Mode6_Spare1" 17 "Mode6_Spare2" 56 "Mode1_Stack" 57 "Mode1_Disappear";
VAL_ 97 DwnLoadDynLtgPrmForReGrp20Mode1 0 "Mode6_Off" 1 "Mode6_On" 2 "Mode6_GradualOn" 3 "Mode6_GradualOff" 4 "Mode6_ForwardWipingOn" 5 "Mode6_BackwardWipingOn" 6 "Mode6_OutwardWipingOn" 7 "Mode6_InwardWipingOn" 8 "Mode6_ForwardWipingOff" 9 "Mode6_BackwardWipingOff" 10 "Mode6_OutwardWipingOff" 11 "Mode6_InwardWipingOff" 12 "Mode6_ForwardScanning" 13 "Mode6_BackwardScanning" 14 "Mode6_BreathOn" 15 "Mode6_BreathOff" 16 "Mode6_Spare1" 17 "Mode6_Spare2" 56 "Mode1_Stack" 57 "Mode1_Disappear";
VAL_ 97 DwnLoadDynLtgPrmForReGrp21Mode1 0 "Mode6_Off" 1 "Mode6_On" 2 "Mode6_GradualOn" 3 "Mode6_GradualOff" 4 "Mode6_ForwardWipingOn" 5 "Mode6_BackwardWipingOn" 6 "Mode6_OutwardWipingOn" 7 "Mode6_InwardWipingOn" 8 "Mode6_ForwardWipingOff" 9 "Mode6_BackwardWipingOff" 10 "Mode6_OutwardWipingOff" 11 "Mode6_InwardWipingOff" 12 "Mode6_ForwardScanning" 13 "Mode6_BackwardScanning" 14 "Mode6_BreathOn" 15 "Mode6_BreathOff" 16 "Mode6_Spare1" 17 "Mode6_Spare2" 56 "Mode1_Stack" 57 "Mode1_Disappear";
VAL_ 97 DwnLoadDynLtgPrmForReGrp22Mode1 0 "Mode6_Off" 1 "Mode6_On" 2 "Mode6_GradualOn" 3 "Mode6_GradualOff" 4 "Mode6_ForwardWipingOn" 5 "Mode6_BackwardWipingOn" 6 "Mode6_OutwardWipingOn" 7 "Mode6_InwardWipingOn" 8 "Mode6_ForwardWipingOff" 9 "Mode6_BackwardWipingOff" 10 "Mode6_OutwardWipingOff" 11 "Mode6_InwardWipingOff" 12 "Mode6_ForwardScanning" 13 "Mode6_BackwardScanning" 14 "Mode6_BreathOn" 15 "Mode6_BreathOff" 16 "Mode6_Spare1" 17 "Mode6_Spare2" 56 "Mode1_Stack" 57 "Mode1_Disappear";
VAL_ 97 DwnLoadDynLtgPrmForReGrp23Mode1 0 "Mode6_Off" 1 "Mode6_On" 2 "Mode6_GradualOn" 3 "Mode6_GradualOff" 4 "Mode6_ForwardWipingOn" 5 "Mode6_BackwardWipingOn" 6 "Mode6_OutwardWipingOn" 7 "Mode6_InwardWipingOn" 8 "Mode6_ForwardWipingOff" 9 "Mode6_BackwardWipingOff" 10 "Mode6_OutwardWipingOff" 11 "Mode6_InwardWipingOff" 12 "Mode6_ForwardScanning" 13 "Mode6_BackwardScanning" 14 "Mode6_BreathOn" 15 "Mode6_BreathOff" 16 "Mode6_Spare1" 17 "Mode6_Spare2" 56 "Mode1_Stack" 57 "Mode1_Disappear";
VAL_ 97 DwnLoadDynLtgPrmForReGrp24Mode1 0 "Mode6_Off" 1 "Mode6_On" 2 "Mode6_GradualOn" 3 "Mode6_GradualOff" 4 "Mode6_ForwardWipingOn" 5 "Mode6_BackwardWipingOn" 6 "Mode6_OutwardWipingOn" 7 "Mode6_InwardWipingOn" 8 "Mode6_ForwardWipingOff" 9 "Mode6_BackwardWipingOff" 10 "Mode6_OutwardWipingOff" 11 "Mode6_InwardWipingOff" 12 "Mode6_ForwardScanning" 13 "Mode6_BackwardScanning" 14 "Mode6_BreathOn" 15 "Mode6_BreathOff" 16 "Mode6_Spare1" 17 "Mode6_Spare2" 56 "Mode1_Stack" 57 "Mode1_Disappear";
VAL_ 97 DwnLoadDynLtgPrmForReGrp25Mode1 0 "Mode6_Off" 1 "Mode6_On" 2 "Mode6_GradualOn" 3 "Mode6_GradualOff" 4 "Mode6_ForwardWipingOn" 5 "Mode6_BackwardWipingOn" 6 "Mode6_OutwardWipingOn" 7 "Mode6_InwardWipingOn" 8 "Mode6_ForwardWipingOff" 9 "Mode6_BackwardWipingOff" 10 "Mode6_OutwardWipingOff" 11 "Mode6_InwardWipingOff" 12 "Mode6_ForwardScanning" 13 "Mode6_BackwardScanning" 14 "Mode6_BreathOn" 15 "Mode6_BreathOff" 16 "Mode6_Spare1" 17 "Mode6_Spare2" 56 "Mode1_Stack" 57 "Mode1_Disappear";
VAL_ 97 DwnLoadDynLtgPrmForReGrp26Mode1 0 "Mode6_Off" 1 "Mode6_On" 2 "Mode6_GradualOn" 3 "Mode6_GradualOff" 4 "Mode6_ForwardWipingOn" 5 "Mode6_BackwardWipingOn" 6 "Mode6_OutwardWipingOn" 7 "Mode6_InwardWipingOn" 8 "Mode6_ForwardWipingOff" 9 "Mode6_BackwardWipingOff" 10 "Mode6_OutwardWipingOff" 11 "Mode6_InwardWipingOff" 12 "Mode6_ForwardScanning" 13 "Mode6_BackwardScanning" 14 "Mode6_BreathOn" 15 "Mode6_BreathOff" 16 "Mode6_Spare1" 17 "Mode6_Spare2" 56 "Mode1_Stack" 57 "Mode1_Disappear";
VAL_ 97 DwnLoadDynLtgPrmForReGrp27Mode1 0 "Mode6_Off" 1 "Mode6_On" 2 "Mode6_GradualOn" 3 "Mode6_GradualOff" 4 "Mode6_ForwardWipingOn" 5 "Mode6_BackwardWipingOn" 6 "Mode6_OutwardWipingOn" 7 "Mode6_InwardWipingOn" 8 "Mode6_ForwardWipingOff" 9 "Mode6_BackwardWipingOff" 10 "Mode6_OutwardWipingOff" 11 "Mode6_InwardWipingOff" 12 "Mode6_ForwardScanning" 13 "Mode6_BackwardScanning" 14 "Mode6_BreathOn" 15 "Mode6_BreathOff" 16 "Mode6_Spare1" 17 "Mode6_Spare2" 56 "Mode1_Stack" 57 "Mode1_Disappear";
VAL_ 97 DwnLoadDynLtgPrmForReGrp28Mode1 0 "Mode6_Off" 1 "Mode6_On" 2 "Mode6_GradualOn" 3 "Mode6_GradualOff" 4 "Mode6_ForwardWipingOn" 5 "Mode6_BackwardWipingOn" 6 "Mode6_OutwardWipingOn" 7 "Mode6_InwardWipingOn" 8 "Mode6_ForwardWipingOff" 9 "Mode6_BackwardWipingOff" 10 "Mode6_OutwardWipingOff" 11 "Mode6_InwardWipingOff" 12 "Mode6_ForwardScanning" 13 "Mode6_BackwardScanning" 14 "Mode6_BreathOn" 15 "Mode6_BreathOff" 16 "Mode6_Spare1" 17 "Mode6_Spare2" 56 "Mode1_Stack" 57 "Mode1_Disappear";
VAL_ 97 DwnLoadDynLtgPrmForReGrp29Mode1 0 "Mode6_Off" 1 "Mode6_On" 2 "Mode6_GradualOn" 3 "Mode6_GradualOff" 4 "Mode6_ForwardWipingOn" 5 "Mode6_BackwardWipingOn" 6 "Mode6_OutwardWipingOn" 7 "Mode6_InwardWipingOn" 8 "Mode6_ForwardWipingOff" 9 "Mode6_BackwardWipingOff" 10 "Mode6_OutwardWipingOff" 11 "Mode6_InwardWipingOff" 12 "Mode6_ForwardScanning" 13 "Mode6_BackwardScanning" 14 "Mode6_BreathOn" 15 "Mode6_BreathOff" 16 "Mode6_Spare1" 17 "Mode6_Spare2" 56 "Mode1_Stack" 57 "Mode1_Disappear";
VAL_ 97 DwnLoadDynLtgPrmForReGrp30Mode1 0 "Mode6_Off" 1 "Mode6_On" 2 "Mode6_GradualOn" 3 "Mode6_GradualOff" 4 "Mode6_ForwardWipingOn" 5 "Mode6_BackwardWipingOn" 6 "Mode6_OutwardWipingOn" 7 "Mode6_InwardWipingOn" 8 "Mode6_ForwardWipingOff" 9 "Mode6_BackwardWipingOff" 10 "Mode6_OutwardWipingOff" 11 "Mode6_InwardWipingOff" 12 "Mode6_ForwardScanning" 13 "Mode6_BackwardScanning" 14 "Mode6_BreathOn" 15 "Mode6_BreathOff" 16 "Mode6_Spare1" 17 "Mode6_Spare2" 56 "Mode1_Stack" 57 "Mode1_Disappear";
VAL_ 1352 VFCVectorDHUVFCid0 0 "VFCOnOff_Off" 1 "VFCOnOff_On";
VAL_ 1352 VFCVectorDHUVFCid1 0 "VFCOnOff_Off" 1 "VFCOnOff_On";
VAL_ 1352 VFCVectorDHUVFCid10 0 "VFCOnOff_Off" 1 "VFCOnOff_On";
VAL_ 1352 VFCVectorDHUVFCid11 0 "VFCOnOff_Off" 1 "VFCOnOff_On";
VAL_ 1352 VFCVectorDHUVFCid12 0 "VFCOnOff_Off" 1 "VFCOnOff_On";
VAL_ 1352 VFCVectorDHUVFCid13 0 "VFCOnOff_Off" 1 "VFCOnOff_On";
VAL_ 1352 VFCVectorDHUVFCid14 0 "VFCOnOff_Off" 1 "VFCOnOff_On";
VAL_ 1352 VFCVectorDHUVFCid15 0 "VFCOnOff_Off" 1 "VFCOnOff_On";
VAL_ 1352 VFCVectorDHUVFCid16 0 "VFCOnOff_Off" 1 "VFCOnOff_On";
VAL_ 1352 VFCVectorDHUVFCid17 0 "VFCOnOff_Off" 1 "VFCOnOff_On";
VAL_ 1352 VFCVectorDHUVFCid18 0 "VFCOnOff_Off" 1 "VFCOnOff_On";
VAL_ 1352 VFCVectorDHUVFCid19 0 "VFCOnOff_Off" 1 "VFCOnOff_On";
VAL_ 1352 VFCVectorDHUVFCid2 0 "VFCOnOff_Off" 1 "VFCOnOff_On";
VAL_ 1352 VFCVectorDHUVFCid20 0 "VFCOnOff_Off" 1 "VFCOnOff_On";
VAL_ 1352 VFCVectorDHUVFCid21 0 "VFCOnOff_Off" 1 "VFCOnOff_On";
VAL_ 1352 VFCVectorDHUVFCid22 0 "VFCOnOff_Off" 1 "VFCOnOff_On";
VAL_ 1352 VFCVectorDHUVFCid23 0 "VFCOnOff_Off" 1 "VFCOnOff_On";
VAL_ 1352 VFCVectorDHUVFCid24 0 "VFCOnOff_Off" 1 "VFCOnOff_On";
VAL_ 1352 VFCVectorDHUVFCid25 0 "VFCOnOff_Off" 1 "VFCOnOff_On";
VAL_ 1352 VFCVectorDHUVFCid26 0 "VFCOnOff_Off" 1 "VFCOnOff_On";
VAL_ 1352 VFCVectorDHUVFCid27 0 "VFCOnOff_Off" 1 "VFCOnOff_On";
VAL_ 1352 VFCVectorDHUVFCid28 0 "VFCOnOff_Off" 1 "VFCOnOff_On";
VAL_ 1352 VFCVectorDHUVFCid29 0 "VFCOnOff_Off" 1 "VFCOnOff_On";
VAL_ 1352 VFCVectorDHUVFCid3 0 "VFCOnOff_Off" 1 "VFCOnOff_On";
VAL_ 1352 VFCVectorDHUVFCid30 0 "VFCOnOff_Off" 1 "VFCOnOff_On";
VAL_ 1352 VFCVectorDHUVFCid31 0 "VFCOnOff_Off" 1 "VFCOnOff_On";
VAL_ 1352 VFCVectorDHUVFCid32 0 "VFCOnOff_Off" 1 "VFCOnOff_On";
VAL_ 1352 VFCVectorDHUVFCid33 0 "VFCOnOff_Off" 1 "VFCOnOff_On";
VAL_ 1352 VFCVectorDHUVFCid34 0 "VFCOnOff_Off" 1 "VFCOnOff_On";
VAL_ 1352 VFCVectorDHUVFCid35 0 "VFCOnOff_Off" 1 "VFCOnOff_On";
VAL_ 1352 VFCVectorDHUVFCid36 0 "VFCOnOff_Off" 1 "VFCOnOff_On";
VAL_ 1352 VFCVectorDHUVFCid37 0 "VFCOnOff_Off" 1 "VFCOnOff_On";
VAL_ 1352 VFCVectorDHUVFCid38 0 "VFCOnOff_Off" 1 "VFCOnOff_On";
VAL_ 1352 VFCVectorDHUVFCid39 0 "VFCOnOff_Off" 1 "VFCOnOff_On";
VAL_ 1352 VFCVectorDHUVFCid4 0 "VFCOnOff_Off" 1 "VFCOnOff_On";
VAL_ 1352 VFCVectorDHUVFCid40 0 "VFCOnOff_Off" 1 "VFCOnOff_On";
VAL_ 1352 VFCVectorDHUVFCid41 0 "VFCOnOff_Off" 1 "VFCOnOff_On";
VAL_ 1352 VFCVectorDHUVFCid42 0 "VFCOnOff_Off" 1 "VFCOnOff_On";
VAL_ 1352 VFCVectorDHUVFCid43 0 "VFCOnOff_Off" 1 "VFCOnOff_On";
VAL_ 1352 VFCVectorDHUVFCid44 0 "VFCOnOff_Off" 1 "VFCOnOff_On";
VAL_ 1352 VFCVectorDHUVFCid45 0 "VFCOnOff_Off" 1 "VFCOnOff_On";
VAL_ 1352 VFCVectorDHUVFCid46 0 "VFCOnOff_Off" 1 "VFCOnOff_On";
VAL_ 1352 VFCVectorDHUVFCid47 0 "VFCOnOff_Off" 1 "VFCOnOff_On";
VAL_ 1352 VFCVectorDHUVFCid48 0 "VFCOnOff_Off" 1 "VFCOnOff_On";
VAL_ 1352 VFCVectorDHUVFCid49 0 "VFCOnOff_Off" 1 "VFCOnOff_On";
VAL_ 1352 VFCVectorDHUVFCid5 0 "VFCOnOff_Off" 1 "VFCOnOff_On";
VAL_ 1352 VFCVectorDHUVFCid50 0 "VFCOnOff_Off" 1 "VFCOnOff_On";
VAL_ 1352 VFCVectorDHUVFCid51 0 "VFCOnOff_Off" 1 "VFCOnOff_On";
VAL_ 1352 VFCVectorDHUVFCid52 0 "VFCOnOff_Off" 1 "VFCOnOff_On";
VAL_ 1352 VFCVectorDHUVFCid53 0 "VFCOnOff_Off" 1 "VFCOnOff_On";
VAL_ 1352 VFCVectorDHUVFCid54 0 "VFCOnOff_Off" 1 "VFCOnOff_On";
VAL_ 1352 VFCVectorDHUVFCid55 0 "VFCOnOff_Off" 1 "VFCOnOff_On";
VAL_ 1352 VFCVectorDHUVFCid56 0 "VFCOnOff_Off" 1 "VFCOnOff_On";
VAL_ 1352 VFCVectorDHUVFCid57 0 "VFCOnOff_Off" 1 "VFCOnOff_On";
VAL_ 1352 VFCVectorDHUVFCid58 0 "VFCOnOff_Off" 1 "VFCOnOff_On";
VAL_ 1352 VFCVectorDHUVFCid59 0 "VFCOnOff_Off" 1 "VFCOnOff_On";
VAL_ 1352 VFCVectorDHUVFCid6 0 "VFCOnOff_Off" 1 "VFCOnOff_On";
VAL_ 1352 VFCVectorDHUVFCid60 0 "VFCOnOff_Off" 1 "VFCOnOff_On";
VAL_ 1352 VFCVectorDHUVFCid61 0 "VFCOnOff_Off" 1 "VFCOnOff_On";
VAL_ 1352 VFCVectorDHUVFCid7 0 "VFCOnOff_Off" 1 "VFCOnOff_On";
VAL_ 1352 VFCVectorDHUVFCid8 0 "VFCOnOff_Off" 1 "VFCOnOff_On";
VAL_ 1352 VFCVectorDHUVFCid9 0 "VFCOnOff_Off" 1 "VFCOnOff_On";
SIG_GROUP_ 66 ApproachReq 1 : ApproachReqData1 ApproachReqData10 ApproachReqData11 ApproachReqData12 ApproachReqData13 ApproachReqData14 ApproachReqData15 ApproachReqData16 ApproachReqData2 ApproachReqData3 ApproachReqData4 ApproachReqData5 ApproachReqData6 ApproachReqData7 ApproachReqData8 ApproachReqData9;
SIG_GROUP_ 74 BLEKeySearchResp 1 : BLEKeySearchRespData1 BLEKeySearchRespData10 BLEKeySearchRespData11 BLEKeySearchRespData12 BLEKeySearchRespData13 BLEKeySearchRespData14 BLEKeySearchRespData15 BLEKeySearchRespData16 BLEKeySearchRespData2 BLEKeySearchRespData3 BLEKeySearchRespData4 BLEKeySearchRespData5 BLEKeySearchRespData6 BLEKeySearchRespData7 BLEKeySearchRespData8 BLEKeySearchRespData9;
SIG_GROUP_ 464 DrvrSeatDispMassgFct 1 : DrvrSeatDispMassgFctMassgInten DrvrSeatDispMassgFctMassgProg DrvrSeatDispMassgFctOnOffl2;
SIG_GROUP_ 311 DrvrSeatDispPhytheraFct 1 : DrvrSeatDispPhytheraFctOnOff1 DrvrSeatDispPhytheraFctPhytheraProgTyp;
SIG_GROUP_ 96 DwnLoadDynLtgPrmForReGrp1 1 : DwnLoadDynLtgPrmForReGrp1ContinueTime DwnLoadDynLtgPrmForReGrp1HighBrightness DwnLoadDynLtgPrmForReGrp1LowBrightness DwnLoadDynLtgPrmForReGrp1Mode1 DwnLoadDynLtgPrmForReGrp1OffsetTime DwnLoadDynLtgPrmForReGrp1Timestamp;
SIG_GROUP_ 96 DwnLoadDynLtgPrmForReGrp10 1 : DwnLoadDynLtgPrmForReGrp10ContinueTime DwnLoadDynLtgPrmForReGrp10HighBrightness DwnLoadDynLtgPrmForReGrp10LowBrightness DwnLoadDynLtgPrmForReGrp10Mode1 DwnLoadDynLtgPrmForReGrp10OffsetTime DwnLoadDynLtgPrmForReGrp10Timestamp;
SIG_GROUP_ 96 DwnLoadDynLtgPrmForReGrp11 1 : DwnLoadDynLtgPrmForReGrp11ContinueTime DwnLoadDynLtgPrmForReGrp11HighBrightness DwnLoadDynLtgPrmForReGrp11LowBrightness DwnLoadDynLtgPrmForReGrp11Mode1 DwnLoadDynLtgPrmForReGrp11OffsetTime DwnLoadDynLtgPrmForReGrp11Timestamp;
SIG_GROUP_ 96 DwnLoadDynLtgPrmForReGrp12 1 : DwnLoadDynLtgPrmForReGrp12ContinueTime DwnLoadDynLtgPrmForReGrp12HighBrightness DwnLoadDynLtgPrmForReGrp12LowBrightness DwnLoadDynLtgPrmForReGrp12Mode1 DwnLoadDynLtgPrmForReGrp12OffsetTime DwnLoadDynLtgPrmForReGrp12Timestamp;
SIG_GROUP_ 96 DwnLoadDynLtgPrmForReGrp13 1 : DwnLoadDynLtgPrmForReGrp13ContinueTime DwnLoadDynLtgPrmForReGrp13HighBrightness DwnLoadDynLtgPrmForReGrp13LowBrightness DwnLoadDynLtgPrmForReGrp13Mode1 DwnLoadDynLtgPrmForReGrp13OffsetTime DwnLoadDynLtgPrmForReGrp13Timestamp;
SIG_GROUP_ 96 DwnLoadDynLtgPrmForReGrp14 1 : DwnLoadDynLtgPrmForReGrp14ContinueTime DwnLoadDynLtgPrmForReGrp14HighBrightness DwnLoadDynLtgPrmForReGrp14LowBrightness DwnLoadDynLtgPrmForReGrp14Mode1 DwnLoadDynLtgPrmForReGrp14OffsetTime DwnLoadDynLtgPrmForReGrp14Timestamp;
SIG_GROUP_ 96 DwnLoadDynLtgPrmForReGrp15 1 : DwnLoadDynLtgPrmForReGrp15ContinueTime DwnLoadDynLtgPrmForReGrp15HighBrightness DwnLoadDynLtgPrmForReGrp15LowBrightness DwnLoadDynLtgPrmForReGrp15Mode1 DwnLoadDynLtgPrmForReGrp15OffsetTime DwnLoadDynLtgPrmForReGrp15Timestamp;
SIG_GROUP_ 96 DwnLoadDynLtgPrmForReGrp16 1 : DwnLoadDynLtgPrmForReGrp16ContinueTime DwnLoadDynLtgPrmForReGrp16HighBrightness DwnLoadDynLtgPrmForReGrp16LowBrightness DwnLoadDynLtgPrmForReGrp16Mode1 DwnLoadDynLtgPrmForReGrp16OffsetTime DwnLoadDynLtgPrmForReGrp16Timestamp;
SIG_GROUP_ 97 DwnLoadDynLtgPrmForReGrp17 1 : DwnLoadDynLtgPrmForReGrp17ContinueTime DwnLoadDynLtgPrmForReGrp17HighBrightness DwnLoadDynLtgPrmForReGrp17LowBrightness DwnLoadDynLtgPrmForReGrp17Mode1 DwnLoadDynLtgPrmForReGrp17OffsetTime DwnLoadDynLtgPrmForReGrp17Timestamp;
SIG_GROUP_ 97 DwnLoadDynLtgPrmForReGrp18 1 : DwnLoadDynLtgPrmForReGrp18ContinueTime DwnLoadDynLtgPrmForReGrp18HighBrightness DwnLoadDynLtgPrmForReGrp18LowBrightness DwnLoadDynLtgPrmForReGrp18Mode1 DwnLoadDynLtgPrmForReGrp18OffsetTime DwnLoadDynLtgPrmForReGrp18Timestamp;
SIG_GROUP_ 97 DwnLoadDynLtgPrmForReGrp19 1 : DwnLoadDynLtgPrmForReGrp19ContinueTime DwnLoadDynLtgPrmForReGrp19HighBrightness DwnLoadDynLtgPrmForReGrp19LowBrightness DwnLoadDynLtgPrmForReGrp19Mode1 DwnLoadDynLtgPrmForReGrp19OffsetTime DwnLoadDynLtgPrmForReGrp19Timestamp;
SIG_GROUP_ 96 DwnLoadDynLtgPrmForReGrp2 1 : DwnLoadDynLtgPrmForReGrp2ContinueTime DwnLoadDynLtgPrmForReGrp2HighBrightness DwnLoadDynLtgPrmForReGrp2LowBrightness DwnLoadDynLtgPrmForReGrp2Mode1 DwnLoadDynLtgPrmForReGrp2OffsetTime DwnLoadDynLtgPrmForReGrp2Timestamp;
SIG_GROUP_ 97 DwnLoadDynLtgPrmForReGrp20 1 : DwnLoadDynLtgPrmForReGrp20ContinueTime DwnLoadDynLtgPrmForReGrp20HighBrightness DwnLoadDynLtgPrmForReGrp20LowBrightness DwnLoadDynLtgPrmForReGrp20Mode1 DwnLoadDynLtgPrmForReGrp20OffsetTime DwnLoadDynLtgPrmForReGrp20Timestamp;
SIG_GROUP_ 97 DwnLoadDynLtgPrmForReGrp21 1 : DwnLoadDynLtgPrmForReGrp21ContinueTime DwnLoadDynLtgPrmForReGrp21HighBrightness DwnLoadDynLtgPrmForReGrp21LowBrightness DwnLoadDynLtgPrmForReGrp21Mode1 DwnLoadDynLtgPrmForReGrp21OffsetTime DwnLoadDynLtgPrmForReGrp21Timestamp;
SIG_GROUP_ 97 DwnLoadDynLtgPrmForReGrp22 1 : DwnLoadDynLtgPrmForReGrp22ContinueTime DwnLoadDynLtgPrmForReGrp22HighBrightness DwnLoadDynLtgPrmForReGrp22LowBrightness DwnLoadDynLtgPrmForReGrp22Mode1 DwnLoadDynLtgPrmForReGrp22OffsetTime DwnLoadDynLtgPrmForReGrp22Timestamp;
SIG_GROUP_ 97 DwnLoadDynLtgPrmForReGrp23 1 : DwnLoadDynLtgPrmForReGrp23ContinueTime DwnLoadDynLtgPrmForReGrp23HighBrightness DwnLoadDynLtgPrmForReGrp23LowBrightness DwnLoadDynLtgPrmForReGrp23Mode1 DwnLoadDynLtgPrmForReGrp23OffsetTime DwnLoadDynLtgPrmForReGrp23Timestamp;
SIG_GROUP_ 97 DwnLoadDynLtgPrmForReGrp24 1 : DwnLoadDynLtgPrmForReGrp24ContinueTime DwnLoadDynLtgPrmForReGrp24HighBrightness DwnLoadDynLtgPrmForReGrp24LowBrightness DwnLoadDynLtgPrmForReGrp24Mode1 DwnLoadDynLtgPrmForReGrp24OffsetTime DwnLoadDynLtgPrmForReGrp24Timestamp;
SIG_GROUP_ 97 DwnLoadDynLtgPrmForReGrp25 1 : DwnLoadDynLtgPrmForReGrp25ContinueTime DwnLoadDynLtgPrmForReGrp25HighBrightness DwnLoadDynLtgPrmForReGrp25LowBrightness DwnLoadDynLtgPrmForReGrp25Mode1 DwnLoadDynLtgPrmForReGrp25OffsetTime DwnLoadDynLtgPrmForReGrp25Timestamp;
SIG_GROUP_ 97 DwnLoadDynLtgPrmForReGrp26 1 : DwnLoadDynLtgPrmForReGrp26ContinueTime DwnLoadDynLtgPrmForReGrp26HighBrightness DwnLoadDynLtgPrmForReGrp26LowBrightness DwnLoadDynLtgPrmForReGrp26Mode1 DwnLoadDynLtgPrmForReGrp26OffsetTime DwnLoadDynLtgPrmForReGrp26Timestamp;
SIG_GROUP_ 97 DwnLoadDynLtgPrmForReGrp27 1 : DwnLoadDynLtgPrmForReGrp27ContinueTime DwnLoadDynLtgPrmForReGrp27HighBrightness DwnLoadDynLtgPrmForReGrp27LowBrightness DwnLoadDynLtgPrmForReGrp27Mode1 DwnLoadDynLtgPrmForReGrp27OffsetTime DwnLoadDynLtgPrmForReGrp27Timestamp;
SIG_GROUP_ 97 DwnLoadDynLtgPrmForReGrp28 1 : DwnLoadDynLtgPrmForReGrp28ContinueTime DwnLoadDynLtgPrmForReGrp28HighBrightness DwnLoadDynLtgPrmForReGrp28LowBrightness DwnLoadDynLtgPrmForReGrp28Mode1 DwnLoadDynLtgPrmForReGrp28OffsetTime DwnLoadDynLtgPrmForReGrp28Timestamp;
SIG_GROUP_ 97 DwnLoadDynLtgPrmForReGrp29 1 : DwnLoadDynLtgPrmForReGrp29ContinueTime DwnLoadDynLtgPrmForReGrp29HighBrightness DwnLoadDynLtgPrmForReGrp29LowBrightness DwnLoadDynLtgPrmForReGrp29Mode1 DwnLoadDynLtgPrmForReGrp29OffsetTime DwnLoadDynLtgPrmForReGrp29Timestamp;
SIG_GROUP_ 96 DwnLoadDynLtgPrmForReGrp3 1 : DwnLoadDynLtgPrmForReGrp3ContinueTime DwnLoadDynLtgPrmForReGrp3HighBrightness DwnLoadDynLtgPrmForReGrp3LowBrightness DwnLoadDynLtgPrmForReGrp3Mode1 DwnLoadDynLtgPrmForReGrp3OffsetTime DwnLoadDynLtgPrmForReGrp3Timestamp;
SIG_GROUP_ 97 DwnLoadDynLtgPrmForReGrp30 1 : DwnLoadDynLtgPrmForReGrp30ContinueTime DwnLoadDynLtgPrmForReGrp30HighBrightness DwnLoadDynLtgPrmForReGrp30LowBrightness DwnLoadDynLtgPrmForReGrp30Mode1 DwnLoadDynLtgPrmForReGrp30OffsetTime DwnLoadDynLtgPrmForReGrp30Timestamp;
SIG_GROUP_ 96 DwnLoadDynLtgPrmForReGrp4 1 : DwnLoadDynLtgPrmForReGrp4ContinueTime DwnLoadDynLtgPrmForReGrp4HighBrightness DwnLoadDynLtgPrmForReGrp4LowBrightness DwnLoadDynLtgPrmForReGrp4Mode1 DwnLoadDynLtgPrmForReGrp4OffsetTime DwnLoadDynLtgPrmForReGrp4Timestamp;
SIG_GROUP_ 96 DwnLoadDynLtgPrmForReGrp5 1 : DwnLoadDynLtgPrmForReGrp5ContinueTime DwnLoadDynLtgPrmForReGrp5HighBrightness DwnLoadDynLtgPrmForReGrp5LowBrightness DwnLoadDynLtgPrmForReGrp5Mode1 DwnLoadDynLtgPrmForReGrp5OffsetTime DwnLoadDynLtgPrmForReGrp5Timestamp;
SIG_GROUP_ 96 DwnLoadDynLtgPrmForReGrp6 1 : DwnLoadDynLtgPrmForReGrp6ContinueTime DwnLoadDynLtgPrmForReGrp6HighBrightness DwnLoadDynLtgPrmForReGrp6LowBrightness DwnLoadDynLtgPrmForReGrp6Mode1 DwnLoadDynLtgPrmForReGrp6OffsetTime DwnLoadDynLtgPrmForReGrp6Timestamp;
SIG_GROUP_ 96 DwnLoadDynLtgPrmForReGrp7 1 : DwnLoadDynLtgPrmForReGrp7ContinueTime DwnLoadDynLtgPrmForReGrp7HighBrightness DwnLoadDynLtgPrmForReGrp7LowBrightness DwnLoadDynLtgPrmForReGrp7Mode1 DwnLoadDynLtgPrmForReGrp7OffsetTime DwnLoadDynLtgPrmForReGrp7Timestamp;
SIG_GROUP_ 96 DwnLoadDynLtgPrmForReGrp8 1 : DwnLoadDynLtgPrmForReGrp8ContinueTime DwnLoadDynLtgPrmForReGrp8HighBrightness DwnLoadDynLtgPrmForReGrp8LowBrightness DwnLoadDynLtgPrmForReGrp8Mode1 DwnLoadDynLtgPrmForReGrp8OffsetTime DwnLoadDynLtgPrmForReGrp8Timestamp;
SIG_GROUP_ 96 DwnLoadDynLtgPrmForReGrp9 1 : DwnLoadDynLtgPrmForReGrp9ContinueTime DwnLoadDynLtgPrmForReGrp9HighBrightness DwnLoadDynLtgPrmForReGrp9LowBrightness DwnLoadDynLtgPrmForReGrp9Mode1 DwnLoadDynLtgPrmForReGrp9OffsetTime DwnLoadDynLtgPrmForReGrp9Timestamp;
SIG_GROUP_ 464 ExtLoUOutlPwrSplyReqRADAR 1 : ExtLoUOutlPwrSplyReqRADARMaiSwt ExtLoUOutlPwrSplyReqRADARZone1 ExtLoUOutlPwrSplyReqRADARZone2 ExtLoUOutlPwrSplyReqRADARZone3 ExtLoUOutlPwrSplyReqRADARZone4 ExtLoUOutlPwrSplyReqRADARZone5 ExtLoUOutlPwrSplyReqRADARZone6;
SIG_GROUP_ 464 HMIToVMMSwt 1 : HMIToVMMSwtSwitch1 HMIToVMMSwtSwitch2 HMIToVMMSwtSwitch3 HMIToVMMSwtSwitch4 HMIToVMMSwtSwitch5 HMIToVMMSwtSwitch6 HMIToVMMSwtSwitch7 HMIToVMMSwtSwitch8;
SIG_GROUP_ 293 MusicInfoSeg11 1 : MusicInfoSeg11SegFftLiShow1 MusicInfoSeg11SegFftLiShow10 MusicInfoSeg11SegFftLiShow11 MusicInfoSeg11SegFftLiShow12 MusicInfoSeg11SegFftLiShow13 MusicInfoSeg11SegFftLiShow14 MusicInfoSeg11SegFftLiShow2 MusicInfoSeg11SegFftLiShow3 MusicInfoSeg11SegFftLiShow4 MusicInfoSeg11SegFftLiShow5 MusicInfoSeg11SegFftLiShow6 MusicInfoSeg11SegFftLiShow7 MusicInfoSeg11SegFftLiShow8 MusicInfoSeg11SegFftLiShow9 MusicInfoSeg11TimeFlagMessage MusicInfoSeg11TimeFlagMusicplay;
SIG_GROUP_ 293 MusicInfoSeg12 1 : MusicInfoSeg12SegFftLiShow15 MusicInfoSeg12SegFftLiShow16 MusicInfoSeg12SegFftLiShow17 MusicInfoSeg12SegFftLiShow18 MusicInfoSeg12SegFftLiShow19 MusicInfoSeg12SegFftLiShow20 MusicInfoSeg12SegFftLiShow21 MusicInfoSeg12SegFftLiShow22 MusicInfoSeg12SegFftLiShow23 MusicInfoSeg12SegFftLiShow24 MusicInfoSeg12SegFftLiShow25 MusicInfoSeg12SegFftLiShow26 MusicInfoSeg12SegFftLiShow27 MusicInfoSeg12SegFftLiShow28 MusicInfoSeg12TimeFlagMessage MusicInfoSeg12TimeFlagMusicplay;
SIG_GROUP_ 293 MusicInfoSeg13 1 : MusicInfoSeg13DownSamplingAmplitude MusicInfoSeg13MaxFFT100ms3kAmplitude MusicInfoSeg13MaxFFT100ms3kFrequency MusicInfoSeg13SegFftLiShow29 MusicInfoSeg13SegFftLiShow30 MusicInfoSeg13SegFftLiShow31 MusicInfoSeg13StateFlagMusicPlay MusicInfoSeg13StateFlagNewMusic MusicInfoSeg13TimeFlagMessage MusicInfoSeg13TimeFlagMusicplay;
SIG_GROUP_ 293 MusicInfoSeg21 1 : MusicInfoSeg21SegFftLiShow1 MusicInfoSeg21SegFftLiShow10 MusicInfoSeg21SegFftLiShow11 MusicInfoSeg21SegFftLiShow12 MusicInfoSeg21SegFftLiShow13 MusicInfoSeg21SegFftLiShow14 MusicInfoSeg21SegFftLiShow2 MusicInfoSeg21SegFftLiShow3 MusicInfoSeg21SegFftLiShow4 MusicInfoSeg21SegFftLiShow5 MusicInfoSeg21SegFftLiShow6 MusicInfoSeg21SegFftLiShow7 MusicInfoSeg21SegFftLiShow8 MusicInfoSeg21SegFftLiShow9 MusicInfoSeg21TimeFlagMessage MusicInfoSeg21TimeFlagMusicplay;
SIG_GROUP_ 293 MusicInfoSeg22 1 : MusicInfoSeg22SegFftLiShow15 MusicInfoSeg22SegFftLiShow16 MusicInfoSeg22SegFftLiShow17 MusicInfoSeg22SegFftLiShow18 MusicInfoSeg22SegFftLiShow19 MusicInfoSeg22SegFftLiShow20 MusicInfoSeg22SegFftLiShow21 MusicInfoSeg22SegFftLiShow22 MusicInfoSeg22SegFftLiShow23 MusicInfoSeg22SegFftLiShow24 MusicInfoSeg22SegFftLiShow25 MusicInfoSeg22SegFftLiShow26 MusicInfoSeg22SegFftLiShow27 MusicInfoSeg22SegFftLiShow28 MusicInfoSeg22TimeFlagMessage MusicInfoSeg22TimeFlagMusicplay;
SIG_GROUP_ 293 MusicInfoSeg23 1 : MusicInfoSeg23DownSamplingAmplitude MusicInfoSeg23MaxFFT100ms3kAmplitude MusicInfoSeg23MaxFFT100ms3kFrequency MusicInfoSeg23SegFftLiShow29 MusicInfoSeg23SegFftLiShow30 MusicInfoSeg23SegFftLiShow31 MusicInfoSeg23StateFlagMusicPlay MusicInfoSeg23StateFlagNewMusic MusicInfoSeg23TimeFlagMessage MusicInfoSeg23TimeFlagMusicplay;
SIG_GROUP_ 74 NFCAndBLEKeyEnaSts 1 : NFCAndBLEKeyEnaStsData1 NFCAndBLEKeyEnaStsData10 NFCAndBLEKeyEnaStsData11 NFCAndBLEKeyEnaStsData12 NFCAndBLEKeyEnaStsData13 NFCAndBLEKeyEnaStsData14 NFCAndBLEKeyEnaStsData15 NFCAndBLEKeyEnaStsData16 NFCAndBLEKeyEnaStsData2 NFCAndBLEKeyEnaStsData3 NFCAndBLEKeyEnaStsData4 NFCAndBLEKeyEnaStsData5 NFCAndBLEKeyEnaStsData6 NFCAndBLEKeyEnaStsData7 NFCAndBLEKeyEnaStsData8 NFCAndBLEKeyEnaStsData9;
SIG_GROUP_ 74 NFCKeySearchResp 1 : NFCKeySearchRespData1 NFCKeySearchRespData10 NFCKeySearchRespData11 NFCKeySearchRespData12 NFCKeySearchRespData13 NFCKeySearchRespData14 NFCKeySearchRespData15 NFCKeySearchRespData16 NFCKeySearchRespData2 NFCKeySearchRespData3 NFCKeySearchRespData4 NFCKeySearchRespData5 NFCKeySearchRespData6 NFCKeySearchRespData7 NFCKeySearchRespData8 NFCKeySearchRespData9;
SIG_GROUP_ 464 PassSeatDispMassgFct 1 : PassSeatDispMassgFctMassgInten PassSeatDispMassgFctMassgProg PassSeatDispMassgFctOnOffl2;
SIG_GROUP_ 311 PassSeatDispPhytheraFct 1 : PassSeatDispPhytheraFctOnOff1 PassSeatDispPhytheraFctPhytheraProgTyp;
SIG_GROUP_ 66 ReadLiOpenReq 1 : ReadLiOpenReqFrontLeft ReadLiOpenReqFrontRight ReadLiOpenReqSecondRowLeft ReadLiOpenReqSecondRowRight ReadLiOpenReqThirdRowLeft ReadLiOpenReqThirdRowRight;
SIG_GROUP_ 272 RemCtrlLoUPwrOutpReq 1 : RemCtrlLoUPwrOutpReqZone1 RemCtrlLoUPwrOutpReqZone2 RemCtrlLoUPwrOutpReqZone3 RemCtrlLoUPwrOutpReqZone4 RemCtrlLoUPwrOutpReqZone5 RemCtrlLoUPwrOutpReqZone6;
SIG_GROUP_ 66 RKEAndNFCReqSts 1 : RKEAndNFCReqStsData1 RKEAndNFCReqStsData10 RKEAndNFCReqStsData11 RKEAndNFCReqStsData12 RKEAndNFCReqStsData13 RKEAndNFCReqStsData14 RKEAndNFCReqStsData15 RKEAndNFCReqStsData16 RKEAndNFCReqStsData2 RKEAndNFCReqStsData3 RKEAndNFCReqStsData4 RKEAndNFCReqStsData5 RKEAndNFCReqStsData6 RKEAndNFCReqStsData7 RKEAndNFCReqStsData8 RKEAndNFCReqStsData9;
SIG_GROUP_ 1352 VFCVectorDHU 1 : VFCVectorDHUBlockID VFCVectorDHUVFCid0 VFCVectorDHUVFCid1 VFCVectorDHUVFCid10 VFCVectorDHUVFCid11 VFCVectorDHUVFCid12 VFCVectorDHUVFCid13 VFCVectorDHUVFCid14 VFCVectorDHUVFCid15 VFCVectorDHUVFCid16 VFCVectorDHUVFCid17 VFCVectorDHUVFCid18 VFCVectorDHUVFCid19 VFCVectorDHUVFCid2 VFCVectorDHUVFCid20 VFCVectorDHUVFCid21 VFCVectorDHUVFCid22 VFCVectorDHUVFCid23 VFCVectorDHUVFCid24 VFCVectorDHUVFCid25 VFCVectorDHUVFCid26 VFCVectorDHUVFCid27 VFCVectorDHUVFCid28 VFCVectorDHUVFCid29 VFCVectorDHUVFCid3 VFCVectorDHUVFCid30 VFCVectorDHUVFCid31 VFCVectorDHUVFCid32 VFCVectorDHUVFCid33 VFCVectorDHUVFCid34 VFCVectorDHUVFCid35 VFCVectorDHUVFCid36 VFCVectorDHUVFCid37 VFCVectorDHUVFCid38 VFCVectorDHUVFCid39 VFCVectorDHUVFCid4 VFCVectorDHUVFCid40 VFCVectorDHUVFCid41 VFCVectorDHUVFCid42 VFCVectorDHUVFCid43 VFCVectorDHUVFCid44 VFCVectorDHUVFCid45 VFCVectorDHUVFCid46 VFCVectorDHUVFCid47 VFCVectorDHUVFCid48 VFCVectorDHUVFCid49 VFCVectorDHUVFCid5 VFCVectorDHUVFCid50 VFCVectorDHUVFCid51 VFCVectorDHUVFCid52 VFCVectorDHUVFCid53 VFCVectorDHUVFCid54 VFCVectorDHUVFCid55 VFCVectorDHUVFCid56 VFCVectorDHUVFCid57 VFCVectorDHUVFCid58 VFCVectorDHUVFCid59 VFCVectorDHUVFCid6 VFCVectorDHUVFCid60 VFCVectorDHUVFCid61 VFCVectorDHUVFCid7 VFCVectorDHUVFCid8 VFCVectorDHUVFCid9;
SIG_GROUP_ 293 VoiceCtrlMirror 1 : VoiceCtrlMirrorDirection VoiceCtrlMirrorParams VoiceCtrlMirrorSide;
SIG_GROUP_ 66 WinOpenAppReq 1 : WinOpenAppReqWindowOpenValue WinOpenAppReqWinOpenClsGlbSts;
SIG_GROUP_ 311 Zone1Settings 1 : Zone1SettingsBlue Zone1SettingsGreen Zone1SettingsIntensity Zone1SettingsRed Zone1SettingsZoneStatus;
SIG_GROUP_ 311 Zone2Settings 1 : Zone2SettingsBlue Zone2SettingsGreen Zone2SettingsIntensity Zone2SettingsRed Zone2SettingsZoneStatus;
SIG_GROUP_ 311 Zone3Settings 1 : Zone3SettingsBlue Zone3SettingsGreen Zone3SettingsIntensity Zone3SettingsRed Zone3SettingsZoneStatus;
