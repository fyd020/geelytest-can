// *************************************************************************** *
// *                                                                           *
// * Description:         CANDB File                                           *
// * Generated at:        2025-01-24 14:38                                     *
// * System:              SDB22436                                             *
// * Variant:             L946_ADCU9_ZCUD                                      *
// * Network:             ZCU_CANFD2                                           *
// *                                                                           *
// *************************************************************************** *
VERSION "ZCU_CANFD2"

NS_ :

BS_ :

BU_ :  ETC IHU ZCUD ZCUP

BO_ 813 ZCUDZCUCANFD2Fr41 : 64 ZCUD
 SG_ VFCVectorHVSC_UB : 455|1@0+ (1,0) [0|1] "" IHU
 SG_ VFCVectorHVSCBlockID : 1|2@0+ (1.0,0.0) [0.0|3.0] "Unitless" IHU
 SG_ VFCVectorHVSCVFCid0 : 2|1@0+ (1,0) [0|1] "" IHU
 SG_ VFCVectorHVSCVFCid1 : 3|1@0+ (1,0) [0|1] "" IHU
 SG_ VFCVectorHVSCVFCid10 : 12|1@0+ (1,0) [0|1] "" IHU
 SG_ VFCVectorHVSCVFCid11 : 13|1@0+ (1,0) [0|1] "" IHU
 SG_ VFCVectorHVSCVFCid12 : 14|1@0+ (1,0) [0|1] "" IHU
 SG_ VFCVectorHVSCVFCid13 : 15|1@0+ (1,0) [0|1] "" IHU
 SG_ VFCVectorHVSCVFCid14 : 16|1@0+ (1,0) [0|1] "" IHU
 SG_ VFCVectorHVSCVFCid15 : 17|1@0+ (1,0) [0|1] "" IHU
 SG_ VFCVectorHVSCVFCid16 : 18|1@0+ (1,0) [0|1] "" IHU
 SG_ VFCVectorHVSCVFCid17 : 19|1@0+ (1,0) [0|1] "" IHU
 SG_ VFCVectorHVSCVFCid18 : 20|1@0+ (1,0) [0|1] "" IHU
 SG_ VFCVectorHVSCVFCid19 : 21|1@0+ (1,0) [0|1] "" IHU
 SG_ VFCVectorHVSCVFCid2 : 4|1@0+ (1,0) [0|1] "" IHU
 SG_ VFCVectorHVSCVFCid20 : 22|1@0+ (1,0) [0|1] "" IHU
 SG_ VFCVectorHVSCVFCid21 : 23|1@0+ (1,0) [0|1] "" IHU
 SG_ VFCVectorHVSCVFCid22 : 24|1@0+ (1,0) [0|1] "" IHU
 SG_ VFCVectorHVSCVFCid23 : 25|1@0+ (1,0) [0|1] "" IHU
 SG_ VFCVectorHVSCVFCid24 : 26|1@0+ (1,0) [0|1] "" IHU
 SG_ VFCVectorHVSCVFCid25 : 27|1@0+ (1,0) [0|1] "" IHU
 SG_ VFCVectorHVSCVFCid26 : 28|1@0+ (1,0) [0|1] "" IHU
 SG_ VFCVectorHVSCVFCid27 : 29|1@0+ (1,0) [0|1] "" IHU
 SG_ VFCVectorHVSCVFCid28 : 30|1@0+ (1,0) [0|1] "" IHU
 SG_ VFCVectorHVSCVFCid29 : 31|1@0+ (1,0) [0|1] "" IHU
 SG_ VFCVectorHVSCVFCid3 : 5|1@0+ (1,0) [0|1] "" IHU
 SG_ VFCVectorHVSCVFCid30 : 32|1@0+ (1,0) [0|1] "" IHU
 SG_ VFCVectorHVSCVFCid31 : 33|1@0+ (1,0) [0|1] "" IHU
 SG_ VFCVectorHVSCVFCid32 : 34|1@0+ (1,0) [0|1] "" IHU
 SG_ VFCVectorHVSCVFCid33 : 35|1@0+ (1,0) [0|1] "" IHU
 SG_ VFCVectorHVSCVFCid34 : 36|1@0+ (1,0) [0|1] "" IHU
 SG_ VFCVectorHVSCVFCid35 : 37|1@0+ (1,0) [0|1] "" IHU
 SG_ VFCVectorHVSCVFCid36 : 38|1@0+ (1,0) [0|1] "" IHU
 SG_ VFCVectorHVSCVFCid37 : 39|1@0+ (1,0) [0|1] "" IHU
 SG_ VFCVectorHVSCVFCid38 : 40|1@0+ (1,0) [0|1] "" IHU
 SG_ VFCVectorHVSCVFCid39 : 41|1@0+ (1,0) [0|1] "" IHU
 SG_ VFCVectorHVSCVFCid4 : 6|1@0+ (1,0) [0|1] "" IHU
 SG_ VFCVectorHVSCVFCid40 : 42|1@0+ (1,0) [0|1] "" IHU
 SG_ VFCVectorHVSCVFCid41 : 43|1@0+ (1,0) [0|1] "" IHU
 SG_ VFCVectorHVSCVFCid42 : 44|1@0+ (1,0) [0|1] "" IHU
 SG_ VFCVectorHVSCVFCid43 : 45|1@0+ (1,0) [0|1] "" IHU
 SG_ VFCVectorHVSCVFCid44 : 46|1@0+ (1,0) [0|1] "" IHU
 SG_ VFCVectorHVSCVFCid45 : 47|1@0+ (1,0) [0|1] "" IHU
 SG_ VFCVectorHVSCVFCid46 : 48|1@0+ (1,0) [0|1] "" IHU
 SG_ VFCVectorHVSCVFCid47 : 49|1@0+ (1,0) [0|1] "" IHU
 SG_ VFCVectorHVSCVFCid48 : 50|1@0+ (1,0) [0|1] "" IHU
 SG_ VFCVectorHVSCVFCid49 : 51|1@0+ (1,0) [0|1] "" IHU
 SG_ VFCVectorHVSCVFCid5 : 7|1@0+ (1,0) [0|1] "" IHU
 SG_ VFCVectorHVSCVFCid50 : 52|1@0+ (1,0) [0|1] "" IHU
 SG_ VFCVectorHVSCVFCid51 : 53|1@0+ (1,0) [0|1] "" IHU
 SG_ VFCVectorHVSCVFCid52 : 54|1@0+ (1,0) [0|1] "" IHU
 SG_ VFCVectorHVSCVFCid53 : 55|1@0+ (1,0) [0|1] "" IHU
 SG_ VFCVectorHVSCVFCid54 : 56|1@0+ (1,0) [0|1] "" IHU
 SG_ VFCVectorHVSCVFCid55 : 57|1@0+ (1,0) [0|1] "" IHU
 SG_ VFCVectorHVSCVFCid56 : 58|1@0+ (1,0) [0|1] "" IHU
 SG_ VFCVectorHVSCVFCid57 : 59|1@0+ (1,0) [0|1] "" IHU
 SG_ VFCVectorHVSCVFCid58 : 60|1@0+ (1,0) [0|1] "" IHU
 SG_ VFCVectorHVSCVFCid59 : 61|1@0+ (1,0) [0|1] "" IHU
 SG_ VFCVectorHVSCVFCid6 : 8|1@0+ (1,0) [0|1] "" IHU
 SG_ VFCVectorHVSCVFCid60 : 62|1@0+ (1,0) [0|1] "" IHU
 SG_ VFCVectorHVSCVFCid61 : 63|1@0+ (1,0) [0|1] "" IHU
 SG_ VFCVectorHVSCVFCid7 : 9|1@0+ (1,0) [0|1] "" IHU
 SG_ VFCVectorHVSCVFCid8 : 10|1@0+ (1,0) [0|1] "" IHU
 SG_ VFCVectorHVSCVFCid9 : 11|1@0+ (1,0) [0|1] "" IHU
 SG_ VFCVectorHWAM_UB : 454|1@0+ (1,0) [0|1] "" IHU
 SG_ VFCVectorHWAMBlockID : 65|2@0+ (1.0,0.0) [0.0|3.0] "Unitless" IHU
 SG_ VFCVectorHWAMVFCid0 : 66|1@0+ (1,0) [0|1] "" IHU
 SG_ VFCVectorHWAMVFCid1 : 67|1@0+ (1,0) [0|1] "" IHU
 SG_ VFCVectorHWAMVFCid10 : 76|1@0+ (1,0) [0|1] "" IHU
 SG_ VFCVectorHWAMVFCid11 : 77|1@0+ (1,0) [0|1] "" IHU
 SG_ VFCVectorHWAMVFCid12 : 78|1@0+ (1,0) [0|1] "" IHU
 SG_ VFCVectorHWAMVFCid13 : 79|1@0+ (1,0) [0|1] "" IHU
 SG_ VFCVectorHWAMVFCid14 : 80|1@0+ (1,0) [0|1] "" IHU
 SG_ VFCVectorHWAMVFCid15 : 81|1@0+ (1,0) [0|1] "" IHU
 SG_ VFCVectorHWAMVFCid16 : 82|1@0+ (1,0) [0|1] "" IHU
 SG_ VFCVectorHWAMVFCid17 : 83|1@0+ (1,0) [0|1] "" IHU
 SG_ VFCVectorHWAMVFCid18 : 84|1@0+ (1,0) [0|1] "" IHU
 SG_ VFCVectorHWAMVFCid19 : 85|1@0+ (1,0) [0|1] "" IHU
 SG_ VFCVectorHWAMVFCid2 : 68|1@0+ (1,0) [0|1] "" IHU
 SG_ VFCVectorHWAMVFCid20 : 86|1@0+ (1,0) [0|1] "" IHU
 SG_ VFCVectorHWAMVFCid21 : 87|1@0+ (1,0) [0|1] "" IHU
 SG_ VFCVectorHWAMVFCid22 : 88|1@0+ (1,0) [0|1] "" IHU
 SG_ VFCVectorHWAMVFCid23 : 89|1@0+ (1,0) [0|1] "" IHU
 SG_ VFCVectorHWAMVFCid24 : 90|1@0+ (1,0) [0|1] "" IHU
 SG_ VFCVectorHWAMVFCid25 : 91|1@0+ (1,0) [0|1] "" IHU
 SG_ VFCVectorHWAMVFCid26 : 92|1@0+ (1,0) [0|1] "" IHU
 SG_ VFCVectorHWAMVFCid27 : 93|1@0+ (1,0) [0|1] "" IHU
 SG_ VFCVectorHWAMVFCid28 : 94|1@0+ (1,0) [0|1] "" IHU
 SG_ VFCVectorHWAMVFCid29 : 95|1@0+ (1,0) [0|1] "" IHU
 SG_ VFCVectorHWAMVFCid3 : 69|1@0+ (1,0) [0|1] "" IHU
 SG_ VFCVectorHWAMVFCid30 : 96|1@0+ (1,0) [0|1] "" IHU
 SG_ VFCVectorHWAMVFCid31 : 97|1@0+ (1,0) [0|1] "" IHU
 SG_ VFCVectorHWAMVFCid32 : 98|1@0+ (1,0) [0|1] "" IHU
 SG_ VFCVectorHWAMVFCid33 : 99|1@0+ (1,0) [0|1] "" IHU
 SG_ VFCVectorHWAMVFCid34 : 100|1@0+ (1,0) [0|1] "" IHU
 SG_ VFCVectorHWAMVFCid35 : 101|1@0+ (1,0) [0|1] "" IHU
 SG_ VFCVectorHWAMVFCid36 : 102|1@0+ (1,0) [0|1] "" IHU
 SG_ VFCVectorHWAMVFCid37 : 103|1@0+ (1,0) [0|1] "" IHU
 SG_ VFCVectorHWAMVFCid38 : 104|1@0+ (1,0) [0|1] "" IHU
 SG_ VFCVectorHWAMVFCid39 : 105|1@0+ (1,0) [0|1] "" IHU
 SG_ VFCVectorHWAMVFCid4 : 70|1@0+ (1,0) [0|1] "" IHU
 SG_ VFCVectorHWAMVFCid40 : 106|1@0+ (1,0) [0|1] "" IHU
 SG_ VFCVectorHWAMVFCid41 : 107|1@0+ (1,0) [0|1] "" IHU
 SG_ VFCVectorHWAMVFCid42 : 108|1@0+ (1,0) [0|1] "" IHU
 SG_ VFCVectorHWAMVFCid43 : 109|1@0+ (1,0) [0|1] "" IHU
 SG_ VFCVectorHWAMVFCid44 : 110|1@0+ (1,0) [0|1] "" IHU
 SG_ VFCVectorHWAMVFCid45 : 111|1@0+ (1,0) [0|1] "" IHU
 SG_ VFCVectorHWAMVFCid46 : 112|1@0+ (1,0) [0|1] "" IHU
 SG_ VFCVectorHWAMVFCid47 : 113|1@0+ (1,0) [0|1] "" IHU
 SG_ VFCVectorHWAMVFCid48 : 114|1@0+ (1,0) [0|1] "" IHU
 SG_ VFCVectorHWAMVFCid49 : 115|1@0+ (1,0) [0|1] "" IHU
 SG_ VFCVectorHWAMVFCid5 : 71|1@0+ (1,0) [0|1] "" IHU
 SG_ VFCVectorHWAMVFCid50 : 116|1@0+ (1,0) [0|1] "" IHU
 SG_ VFCVectorHWAMVFCid51 : 117|1@0+ (1,0) [0|1] "" IHU
 SG_ VFCVectorHWAMVFCid52 : 118|1@0+ (1,0) [0|1] "" IHU
 SG_ VFCVectorHWAMVFCid53 : 119|1@0+ (1,0) [0|1] "" IHU
 SG_ VFCVectorHWAMVFCid54 : 120|1@0+ (1,0) [0|1] "" IHU
 SG_ VFCVectorHWAMVFCid55 : 121|1@0+ (1,0) [0|1] "" IHU
 SG_ VFCVectorHWAMVFCid56 : 122|1@0+ (1,0) [0|1] "" IHU
 SG_ VFCVectorHWAMVFCid57 : 123|1@0+ (1,0) [0|1] "" IHU
 SG_ VFCVectorHWAMVFCid58 : 124|1@0+ (1,0) [0|1] "" IHU
 SG_ VFCVectorHWAMVFCid59 : 125|1@0+ (1,0) [0|1] "" IHU
 SG_ VFCVectorHWAMVFCid6 : 72|1@0+ (1,0) [0|1] "" IHU
 SG_ VFCVectorHWAMVFCid60 : 126|1@0+ (1,0) [0|1] "" IHU
 SG_ VFCVectorHWAMVFCid61 : 127|1@0+ (1,0) [0|1] "" IHU
 SG_ VFCVectorHWAMVFCid7 : 73|1@0+ (1,0) [0|1] "" IHU
 SG_ VFCVectorHWAMVFCid8 : 74|1@0+ (1,0) [0|1] "" IHU
 SG_ VFCVectorHWAMVFCid9 : 75|1@0+ (1,0) [0|1] "" IHU

BO_ 836 ZCUDZCUCANFD2Fr42 : 64 ZCUD
 SG_ SecDcDcChas1DataEvtA_UB : 56|1@0+ (1,0) [0|1] "" IHU
 SG_ SecDcDcChas1DataEvtACnt : 63|7@0+ (1.0,0.0) [0.0|127.0] "Unitless" IHU
 SG_ SecDcDcChas1DataEvtAData1 : 15|8@0+ (1.0,0.0) [0.0|255.0] "Unitless" IHU
 SG_ SecDcDcChas1DataEvtAData2 : 23|8@0+ (1.0,0.0) [0.0|255.0] "Unitless" IHU
 SG_ SecDcDcChas1DataEvtAData3 : 31|8@0+ (1.0,0.0) [0.0|255.0] "Unitless" IHU
 SG_ SecDcDcChas1DataEvtAData4 : 39|8@0+ (1.0,0.0) [0.0|255.0] "Unitless" IHU
 SG_ SecDcDcChas1DataEvtAData5 : 47|8@0+ (1.0,0.0) [0.0|255.0] "Unitless" IHU
 SG_ SecDcDcChas1DataEvtAData6 : 55|8@0+ (1.0,0.0) [0.0|255.0] "Unitless" IHU
 SG_ SecDcDcChas1DataEvtAID : 7|8@0+ (1.0,0.0) [0.0|255.0] "Unitless" IHU
 SG_ SecDcDcChas1DataPrdA_UB : 120|1@0+ (1,0) [0|1] "" IHU
 SG_ SecDcDcChas1DataPrdACnt : 127|7@0+ (1.0,0.0) [0.0|127.0] "Unitless" IHU
 SG_ SecDcDcChas1DataPrdAData1 : 71|8@0+ (1.0,0.0) [0.0|255.0] "Unitless" IHU
 SG_ SecDcDcChas1DataPrdAData2 : 79|8@0+ (1.0,0.0) [0.0|255.0] "Unitless" IHU
 SG_ SecDcDcChas1DataPrdAData3 : 87|8@0+ (1.0,0.0) [0.0|255.0] "Unitless" IHU
 SG_ SecDcDcChas1DataPrdAData4 : 95|8@0+ (1.0,0.0) [0.0|255.0] "Unitless" IHU
 SG_ SecDcDcChas1DataPrdAData5 : 103|8@0+ (1.0,0.0) [0.0|255.0] "Unitless" IHU
 SG_ SecDcDcChas1DataPrdAData6 : 111|8@0+ (1.0,0.0) [0.0|255.0] "Unitless" IHU
 SG_ SecDcDcChas1DataPrdAData7 : 119|8@0+ (1.0,0.0) [0.0|255.0] "Unitless" IHU
 SG_ VFCVectorCMD_UB : 199|1@0+ (1,0) [0|1] "" IHU
 SG_ VFCVectorCMDBlockID : 129|2@0+ (1.0,0.0) [0.0|3.0] "Unitless" IHU
 SG_ VFCVectorCMDVFCid0 : 130|1@0+ (1,0) [0|1] "" IHU
 SG_ VFCVectorCMDVFCid1 : 131|1@0+ (1,0) [0|1] "" IHU
 SG_ VFCVectorCMDVFCid10 : 140|1@0+ (1,0) [0|1] "" IHU
 SG_ VFCVectorCMDVFCid11 : 141|1@0+ (1,0) [0|1] "" IHU
 SG_ VFCVectorCMDVFCid12 : 142|1@0+ (1,0) [0|1] "" IHU
 SG_ VFCVectorCMDVFCid13 : 143|1@0+ (1,0) [0|1] "" IHU
 SG_ VFCVectorCMDVFCid14 : 144|1@0+ (1,0) [0|1] "" IHU
 SG_ VFCVectorCMDVFCid15 : 145|1@0+ (1,0) [0|1] "" IHU
 SG_ VFCVectorCMDVFCid16 : 146|1@0+ (1,0) [0|1] "" IHU
 SG_ VFCVectorCMDVFCid17 : 147|1@0+ (1,0) [0|1] "" IHU
 SG_ VFCVectorCMDVFCid18 : 148|1@0+ (1,0) [0|1] "" IHU
 SG_ VFCVectorCMDVFCid19 : 149|1@0+ (1,0) [0|1] "" IHU
 SG_ VFCVectorCMDVFCid2 : 132|1@0+ (1,0) [0|1] "" IHU
 SG_ VFCVectorCMDVFCid20 : 150|1@0+ (1,0) [0|1] "" IHU
 SG_ VFCVectorCMDVFCid21 : 151|1@0+ (1,0) [0|1] "" IHU
 SG_ VFCVectorCMDVFCid22 : 152|1@0+ (1,0) [0|1] "" IHU
 SG_ VFCVectorCMDVFCid23 : 153|1@0+ (1,0) [0|1] "" IHU
 SG_ VFCVectorCMDVFCid24 : 154|1@0+ (1,0) [0|1] "" IHU
 SG_ VFCVectorCMDVFCid25 : 155|1@0+ (1,0) [0|1] "" IHU
 SG_ VFCVectorCMDVFCid26 : 156|1@0+ (1,0) [0|1] "" IHU
 SG_ VFCVectorCMDVFCid27 : 157|1@0+ (1,0) [0|1] "" IHU
 SG_ VFCVectorCMDVFCid28 : 158|1@0+ (1,0) [0|1] "" IHU
 SG_ VFCVectorCMDVFCid29 : 159|1@0+ (1,0) [0|1] "" IHU
 SG_ VFCVectorCMDVFCid3 : 133|1@0+ (1,0) [0|1] "" IHU
 SG_ VFCVectorCMDVFCid30 : 160|1@0+ (1,0) [0|1] "" IHU
 SG_ VFCVectorCMDVFCid31 : 161|1@0+ (1,0) [0|1] "" IHU
 SG_ VFCVectorCMDVFCid32 : 162|1@0+ (1,0) [0|1] "" IHU
 SG_ VFCVectorCMDVFCid33 : 163|1@0+ (1,0) [0|1] "" IHU
 SG_ VFCVectorCMDVFCid34 : 164|1@0+ (1,0) [0|1] "" IHU
 SG_ VFCVectorCMDVFCid35 : 165|1@0+ (1,0) [0|1] "" IHU
 SG_ VFCVectorCMDVFCid36 : 166|1@0+ (1,0) [0|1] "" IHU
 SG_ VFCVectorCMDVFCid37 : 167|1@0+ (1,0) [0|1] "" IHU
 SG_ VFCVectorCMDVFCid38 : 168|1@0+ (1,0) [0|1] "" IHU
 SG_ VFCVectorCMDVFCid39 : 169|1@0+ (1,0) [0|1] "" IHU
 SG_ VFCVectorCMDVFCid4 : 134|1@0+ (1,0) [0|1] "" IHU
 SG_ VFCVectorCMDVFCid40 : 170|1@0+ (1,0) [0|1] "" IHU
 SG_ VFCVectorCMDVFCid41 : 171|1@0+ (1,0) [0|1] "" IHU
 SG_ VFCVectorCMDVFCid42 : 172|1@0+ (1,0) [0|1] "" IHU
 SG_ VFCVectorCMDVFCid43 : 173|1@0+ (1,0) [0|1] "" IHU
 SG_ VFCVectorCMDVFCid44 : 174|1@0+ (1,0) [0|1] "" IHU
 SG_ VFCVectorCMDVFCid45 : 175|1@0+ (1,0) [0|1] "" IHU
 SG_ VFCVectorCMDVFCid46 : 176|1@0+ (1,0) [0|1] "" IHU
 SG_ VFCVectorCMDVFCid47 : 177|1@0+ (1,0) [0|1] "" IHU
 SG_ VFCVectorCMDVFCid48 : 178|1@0+ (1,0) [0|1] "" IHU
 SG_ VFCVectorCMDVFCid49 : 179|1@0+ (1,0) [0|1] "" IHU
 SG_ VFCVectorCMDVFCid5 : 135|1@0+ (1,0) [0|1] "" IHU
 SG_ VFCVectorCMDVFCid50 : 180|1@0+ (1,0) [0|1] "" IHU
 SG_ VFCVectorCMDVFCid51 : 181|1@0+ (1,0) [0|1] "" IHU
 SG_ VFCVectorCMDVFCid52 : 182|1@0+ (1,0) [0|1] "" IHU
 SG_ VFCVectorCMDVFCid53 : 183|1@0+ (1,0) [0|1] "" IHU
 SG_ VFCVectorCMDVFCid54 : 184|1@0+ (1,0) [0|1] "" IHU
 SG_ VFCVectorCMDVFCid55 : 185|1@0+ (1,0) [0|1] "" IHU
 SG_ VFCVectorCMDVFCid56 : 186|1@0+ (1,0) [0|1] "" IHU
 SG_ VFCVectorCMDVFCid57 : 187|1@0+ (1,0) [0|1] "" IHU
 SG_ VFCVectorCMDVFCid58 : 188|1@0+ (1,0) [0|1] "" IHU
 SG_ VFCVectorCMDVFCid59 : 189|1@0+ (1,0) [0|1] "" IHU
 SG_ VFCVectorCMDVFCid6 : 136|1@0+ (1,0) [0|1] "" IHU
 SG_ VFCVectorCMDVFCid60 : 190|1@0+ (1,0) [0|1] "" IHU
 SG_ VFCVectorCMDVFCid61 : 191|1@0+ (1,0) [0|1] "" IHU
 SG_ VFCVectorCMDVFCid7 : 137|1@0+ (1,0) [0|1] "" IHU
 SG_ VFCVectorCMDVFCid8 : 138|1@0+ (1,0) [0|1] "" IHU
 SG_ VFCVectorCMDVFCid9 : 139|1@0+ (1,0) [0|1] "" IHU
 SG_ VFCVectorCMP_UB : 198|1@0+ (1,0) [0|1] "" IHU
 SG_ VFCVectorCMPBlockID : 201|2@0+ (1.0,0.0) [0.0|3.0] "Unitless" IHU
 SG_ VFCVectorCMPVFCid0 : 202|1@0+ (1,0) [0|1] "" IHU
 SG_ VFCVectorCMPVFCid1 : 203|1@0+ (1,0) [0|1] "" IHU
 SG_ VFCVectorCMPVFCid10 : 212|1@0+ (1,0) [0|1] "" IHU
 SG_ VFCVectorCMPVFCid11 : 213|1@0+ (1,0) [0|1] "" IHU
 SG_ VFCVectorCMPVFCid12 : 214|1@0+ (1,0) [0|1] "" IHU
 SG_ VFCVectorCMPVFCid13 : 215|1@0+ (1,0) [0|1] "" IHU
 SG_ VFCVectorCMPVFCid14 : 216|1@0+ (1,0) [0|1] "" IHU
 SG_ VFCVectorCMPVFCid15 : 217|1@0+ (1,0) [0|1] "" IHU
 SG_ VFCVectorCMPVFCid16 : 218|1@0+ (1,0) [0|1] "" IHU
 SG_ VFCVectorCMPVFCid17 : 219|1@0+ (1,0) [0|1] "" IHU
 SG_ VFCVectorCMPVFCid18 : 220|1@0+ (1,0) [0|1] "" IHU
 SG_ VFCVectorCMPVFCid19 : 221|1@0+ (1,0) [0|1] "" IHU
 SG_ VFCVectorCMPVFCid2 : 204|1@0+ (1,0) [0|1] "" IHU
 SG_ VFCVectorCMPVFCid20 : 222|1@0+ (1,0) [0|1] "" IHU
 SG_ VFCVectorCMPVFCid21 : 223|1@0+ (1,0) [0|1] "" IHU
 SG_ VFCVectorCMPVFCid22 : 224|1@0+ (1,0) [0|1] "" IHU
 SG_ VFCVectorCMPVFCid23 : 225|1@0+ (1,0) [0|1] "" IHU
 SG_ VFCVectorCMPVFCid24 : 226|1@0+ (1,0) [0|1] "" IHU
 SG_ VFCVectorCMPVFCid25 : 227|1@0+ (1,0) [0|1] "" IHU
 SG_ VFCVectorCMPVFCid26 : 228|1@0+ (1,0) [0|1] "" IHU
 SG_ VFCVectorCMPVFCid27 : 229|1@0+ (1,0) [0|1] "" IHU
 SG_ VFCVectorCMPVFCid28 : 230|1@0+ (1,0) [0|1] "" IHU
 SG_ VFCVectorCMPVFCid29 : 231|1@0+ (1,0) [0|1] "" IHU
 SG_ VFCVectorCMPVFCid3 : 205|1@0+ (1,0) [0|1] "" IHU
 SG_ VFCVectorCMPVFCid30 : 232|1@0+ (1,0) [0|1] "" IHU
 SG_ VFCVectorCMPVFCid31 : 233|1@0+ (1,0) [0|1] "" IHU
 SG_ VFCVectorCMPVFCid32 : 234|1@0+ (1,0) [0|1] "" IHU
 SG_ VFCVectorCMPVFCid33 : 235|1@0+ (1,0) [0|1] "" IHU
 SG_ VFCVectorCMPVFCid34 : 236|1@0+ (1,0) [0|1] "" IHU
 SG_ VFCVectorCMPVFCid35 : 237|1@0+ (1,0) [0|1] "" IHU
 SG_ VFCVectorCMPVFCid36 : 238|1@0+ (1,0) [0|1] "" IHU
 SG_ VFCVectorCMPVFCid37 : 239|1@0+ (1,0) [0|1] "" IHU
 SG_ VFCVectorCMPVFCid38 : 240|1@0+ (1,0) [0|1] "" IHU
 SG_ VFCVectorCMPVFCid39 : 241|1@0+ (1,0) [0|1] "" IHU
 SG_ VFCVectorCMPVFCid4 : 206|1@0+ (1,0) [0|1] "" IHU
 SG_ VFCVectorCMPVFCid40 : 242|1@0+ (1,0) [0|1] "" IHU
 SG_ VFCVectorCMPVFCid41 : 243|1@0+ (1,0) [0|1] "" IHU
 SG_ VFCVectorCMPVFCid42 : 244|1@0+ (1,0) [0|1] "" IHU
 SG_ VFCVectorCMPVFCid43 : 245|1@0+ (1,0) [0|1] "" IHU
 SG_ VFCVectorCMPVFCid44 : 246|1@0+ (1,0) [0|1] "" IHU
 SG_ VFCVectorCMPVFCid45 : 247|1@0+ (1,0) [0|1] "" IHU
 SG_ VFCVectorCMPVFCid46 : 248|1@0+ (1,0) [0|1] "" IHU
 SG_ VFCVectorCMPVFCid47 : 249|1@0+ (1,0) [0|1] "" IHU
 SG_ VFCVectorCMPVFCid48 : 250|1@0+ (1,0) [0|1] "" IHU
 SG_ VFCVectorCMPVFCid49 : 251|1@0+ (1,0) [0|1] "" IHU
 SG_ VFCVectorCMPVFCid5 : 207|1@0+ (1,0) [0|1] "" IHU
 SG_ VFCVectorCMPVFCid50 : 252|1@0+ (1,0) [0|1] "" IHU
 SG_ VFCVectorCMPVFCid51 : 253|1@0+ (1,0) [0|1] "" IHU
 SG_ VFCVectorCMPVFCid52 : 254|1@0+ (1,0) [0|1] "" IHU
 SG_ VFCVectorCMPVFCid53 : 255|1@0+ (1,0) [0|1] "" IHU
 SG_ VFCVectorCMPVFCid54 : 256|1@0+ (1,0) [0|1] "" IHU
 SG_ VFCVectorCMPVFCid55 : 257|1@0+ (1,0) [0|1] "" IHU
 SG_ VFCVectorCMPVFCid56 : 258|1@0+ (1,0) [0|1] "" IHU
 SG_ VFCVectorCMPVFCid57 : 259|1@0+ (1,0) [0|1] "" IHU
 SG_ VFCVectorCMPVFCid58 : 260|1@0+ (1,0) [0|1] "" IHU
 SG_ VFCVectorCMPVFCid59 : 261|1@0+ (1,0) [0|1] "" IHU
 SG_ VFCVectorCMPVFCid6 : 208|1@0+ (1,0) [0|1] "" IHU
 SG_ VFCVectorCMPVFCid60 : 262|1@0+ (1,0) [0|1] "" IHU
 SG_ VFCVectorCMPVFCid61 : 263|1@0+ (1,0) [0|1] "" IHU
 SG_ VFCVectorCMPVFCid7 : 209|1@0+ (1,0) [0|1] "" IHU
 SG_ VFCVectorCMPVFCid8 : 210|1@0+ (1,0) [0|1] "" IHU
 SG_ VFCVectorCMPVFCid9 : 211|1@0+ (1,0) [0|1] "" IHU
 SG_ VFCVectorSDLBlockID : 329|2@0+ (1.0,0.0) [0.0|3.0] "Unitless" IHU
 SG_ VFCVectorSDLVFCid0 : 330|1@0+ (1,0) [0|1] "" IHU
 SG_ VFCVectorSDLVFCid1 : 331|1@0+ (1,0) [0|1] "" IHU
 SG_ VFCVectorSDLVFCid10 : 340|1@0+ (1,0) [0|1] "" IHU
 SG_ VFCVectorSDLVFCid11 : 341|1@0+ (1,0) [0|1] "" IHU
 SG_ VFCVectorSDLVFCid12 : 342|1@0+ (1,0) [0|1] "" IHU
 SG_ VFCVectorSDLVFCid13 : 343|1@0+ (1,0) [0|1] "" IHU
 SG_ VFCVectorSDLVFCid14 : 344|1@0+ (1,0) [0|1] "" IHU
 SG_ VFCVectorSDLVFCid15 : 345|1@0+ (1,0) [0|1] "" IHU
 SG_ VFCVectorSDLVFCid16 : 346|1@0+ (1,0) [0|1] "" IHU
 SG_ VFCVectorSDLVFCid17 : 347|1@0+ (1,0) [0|1] "" IHU
 SG_ VFCVectorSDLVFCid18 : 348|1@0+ (1,0) [0|1] "" IHU
 SG_ VFCVectorSDLVFCid19 : 349|1@0+ (1,0) [0|1] "" IHU
 SG_ VFCVectorSDLVFCid2 : 332|1@0+ (1,0) [0|1] "" IHU
 SG_ VFCVectorSDLVFCid20 : 350|1@0+ (1,0) [0|1] "" IHU
 SG_ VFCVectorSDLVFCid21 : 351|1@0+ (1,0) [0|1] "" IHU
 SG_ VFCVectorSDLVFCid22 : 352|1@0+ (1,0) [0|1] "" IHU
 SG_ VFCVectorSDLVFCid23 : 353|1@0+ (1,0) [0|1] "" IHU
 SG_ VFCVectorSDLVFCid24 : 354|1@0+ (1,0) [0|1] "" IHU
 SG_ VFCVectorSDLVFCid25 : 355|1@0+ (1,0) [0|1] "" IHU
 SG_ VFCVectorSDLVFCid26 : 356|1@0+ (1,0) [0|1] "" IHU
 SG_ VFCVectorSDLVFCid27 : 357|1@0+ (1,0) [0|1] "" IHU
 SG_ VFCVectorSDLVFCid28 : 358|1@0+ (1,0) [0|1] "" IHU
 SG_ VFCVectorSDLVFCid29 : 359|1@0+ (1,0) [0|1] "" IHU
 SG_ VFCVectorSDLVFCid3 : 333|1@0+ (1,0) [0|1] "" IHU
 SG_ VFCVectorSDLVFCid30 : 360|1@0+ (1,0) [0|1] "" IHU
 SG_ VFCVectorSDLVFCid31 : 361|1@0+ (1,0) [0|1] "" IHU
 SG_ VFCVectorSDLVFCid32 : 362|1@0+ (1,0) [0|1] "" IHU
 SG_ VFCVectorSDLVFCid33 : 363|1@0+ (1,0) [0|1] "" IHU
 SG_ VFCVectorSDLVFCid34 : 364|1@0+ (1,0) [0|1] "" IHU
 SG_ VFCVectorSDLVFCid35 : 365|1@0+ (1,0) [0|1] "" IHU
 SG_ VFCVectorSDLVFCid36 : 366|1@0+ (1,0) [0|1] "" IHU
 SG_ VFCVectorSDLVFCid37 : 367|1@0+ (1,0) [0|1] "" IHU
 SG_ VFCVectorSDLVFCid38 : 368|1@0+ (1,0) [0|1] "" IHU
 SG_ VFCVectorSDLVFCid39 : 369|1@0+ (1,0) [0|1] "" IHU
 SG_ VFCVectorSDLVFCid4 : 334|1@0+ (1,0) [0|1] "" IHU
 SG_ VFCVectorSDLVFCid40 : 370|1@0+ (1,0) [0|1] "" IHU
 SG_ VFCVectorSDLVFCid41 : 371|1@0+ (1,0) [0|1] "" IHU
 SG_ VFCVectorSDLVFCid42 : 372|1@0+ (1,0) [0|1] "" IHU
 SG_ VFCVectorSDLVFCid43 : 373|1@0+ (1,0) [0|1] "" IHU
 SG_ VFCVectorSDLVFCid44 : 374|1@0+ (1,0) [0|1] "" IHU
 SG_ VFCVectorSDLVFCid45 : 375|1@0+ (1,0) [0|1] "" IHU
 SG_ VFCVectorSDLVFCid46 : 376|1@0+ (1,0) [0|1] "" IHU
 SG_ VFCVectorSDLVFCid47 : 377|1@0+ (1,0) [0|1] "" IHU
 SG_ VFCVectorSDLVFCid48 : 378|1@0+ (1,0) [0|1] "" IHU
 SG_ VFCVectorSDLVFCid49 : 379|1@0+ (1,0) [0|1] "" IHU
 SG_ VFCVectorSDLVFCid5 : 335|1@0+ (1,0) [0|1] "" IHU
 SG_ VFCVectorSDLVFCid50 : 380|1@0+ (1,0) [0|1] "" IHU
 SG_ VFCVectorSDLVFCid51 : 381|1@0+ (1,0) [0|1] "" IHU
 SG_ VFCVectorSDLVFCid52 : 382|1@0+ (1,0) [0|1] "" IHU
 SG_ VFCVectorSDLVFCid53 : 383|1@0+ (1,0) [0|1] "" IHU
 SG_ VFCVectorSDLVFCid54 : 384|1@0+ (1,0) [0|1] "" IHU
 SG_ VFCVectorSDLVFCid55 : 385|1@0+ (1,0) [0|1] "" IHU
 SG_ VFCVectorSDLVFCid56 : 386|1@0+ (1,0) [0|1] "" IHU
 SG_ VFCVectorSDLVFCid57 : 387|1@0+ (1,0) [0|1] "" IHU
 SG_ VFCVectorSDLVFCid58 : 388|1@0+ (1,0) [0|1] "" IHU
 SG_ VFCVectorSDLVFCid59 : 389|1@0+ (1,0) [0|1] "" IHU
 SG_ VFCVectorSDLVFCid6 : 336|1@0+ (1,0) [0|1] "" IHU
 SG_ VFCVectorSDLVFCid60 : 390|1@0+ (1,0) [0|1] "" IHU
 SG_ VFCVectorSDLVFCid61 : 391|1@0+ (1,0) [0|1] "" IHU
 SG_ VFCVectorSDLVFCid7 : 337|1@0+ (1,0) [0|1] "" IHU
 SG_ VFCVectorSDLVFCid8 : 338|1@0+ (1,0) [0|1] "" IHU
 SG_ VFCVectorSDLVFCid9 : 339|1@0+ (1,0) [0|1] "" IHU
 SG_ VFCVectorSDRBlockID : 393|2@0+ (1.0,0.0) [0.0|3.0] "Unitless" IHU
 SG_ VFCVectorSDRVFCid0 : 394|1@0+ (1,0) [0|1] "" IHU
 SG_ VFCVectorSDRVFCid1 : 395|1@0+ (1,0) [0|1] "" IHU
 SG_ VFCVectorSDRVFCid10 : 404|1@0+ (1,0) [0|1] "" IHU
 SG_ VFCVectorSDRVFCid11 : 405|1@0+ (1,0) [0|1] "" IHU
 SG_ VFCVectorSDRVFCid12 : 406|1@0+ (1,0) [0|1] "" IHU
 SG_ VFCVectorSDRVFCid13 : 407|1@0+ (1,0) [0|1] "" IHU
 SG_ VFCVectorSDRVFCid14 : 408|1@0+ (1,0) [0|1] "" IHU
 SG_ VFCVectorSDRVFCid15 : 409|1@0+ (1,0) [0|1] "" IHU
 SG_ VFCVectorSDRVFCid16 : 410|1@0+ (1,0) [0|1] "" IHU
 SG_ VFCVectorSDRVFCid17 : 411|1@0+ (1,0) [0|1] "" IHU
 SG_ VFCVectorSDRVFCid18 : 412|1@0+ (1,0) [0|1] "" IHU
 SG_ VFCVectorSDRVFCid19 : 413|1@0+ (1,0) [0|1] "" IHU
 SG_ VFCVectorSDRVFCid2 : 396|1@0+ (1,0) [0|1] "" IHU
 SG_ VFCVectorSDRVFCid20 : 414|1@0+ (1,0) [0|1] "" IHU
 SG_ VFCVectorSDRVFCid21 : 415|1@0+ (1,0) [0|1] "" IHU
 SG_ VFCVectorSDRVFCid22 : 416|1@0+ (1,0) [0|1] "" IHU
 SG_ VFCVectorSDRVFCid23 : 417|1@0+ (1,0) [0|1] "" IHU
 SG_ VFCVectorSDRVFCid24 : 418|1@0+ (1,0) [0|1] "" IHU
 SG_ VFCVectorSDRVFCid25 : 419|1@0+ (1,0) [0|1] "" IHU
 SG_ VFCVectorSDRVFCid26 : 420|1@0+ (1,0) [0|1] "" IHU
 SG_ VFCVectorSDRVFCid27 : 421|1@0+ (1,0) [0|1] "" IHU
 SG_ VFCVectorSDRVFCid28 : 422|1@0+ (1,0) [0|1] "" IHU
 SG_ VFCVectorSDRVFCid29 : 423|1@0+ (1,0) [0|1] "" IHU
 SG_ VFCVectorSDRVFCid3 : 397|1@0+ (1,0) [0|1] "" IHU
 SG_ VFCVectorSDRVFCid30 : 424|1@0+ (1,0) [0|1] "" IHU
 SG_ VFCVectorSDRVFCid31 : 425|1@0+ (1,0) [0|1] "" IHU
 SG_ VFCVectorSDRVFCid32 : 426|1@0+ (1,0) [0|1] "" IHU
 SG_ VFCVectorSDRVFCid33 : 427|1@0+ (1,0) [0|1] "" IHU
 SG_ VFCVectorSDRVFCid34 : 428|1@0+ (1,0) [0|1] "" IHU
 SG_ VFCVectorSDRVFCid35 : 429|1@0+ (1,0) [0|1] "" IHU
 SG_ VFCVectorSDRVFCid36 : 430|1@0+ (1,0) [0|1] "" IHU
 SG_ VFCVectorSDRVFCid37 : 431|1@0+ (1,0) [0|1] "" IHU
 SG_ VFCVectorSDRVFCid38 : 432|1@0+ (1,0) [0|1] "" IHU
 SG_ VFCVectorSDRVFCid39 : 433|1@0+ (1,0) [0|1] "" IHU
 SG_ VFCVectorSDRVFCid4 : 398|1@0+ (1,0) [0|1] "" IHU
 SG_ VFCVectorSDRVFCid40 : 434|1@0+ (1,0) [0|1] "" IHU
 SG_ VFCVectorSDRVFCid41 : 435|1@0+ (1,0) [0|1] "" IHU
 SG_ VFCVectorSDRVFCid42 : 436|1@0+ (1,0) [0|1] "" IHU
 SG_ VFCVectorSDRVFCid43 : 437|1@0+ (1,0) [0|1] "" IHU
 SG_ VFCVectorSDRVFCid44 : 438|1@0+ (1,0) [0|1] "" IHU
 SG_ VFCVectorSDRVFCid45 : 439|1@0+ (1,0) [0|1] "" IHU
 SG_ VFCVectorSDRVFCid46 : 440|1@0+ (1,0) [0|1] "" IHU
 SG_ VFCVectorSDRVFCid47 : 441|1@0+ (1,0) [0|1] "" IHU
 SG_ VFCVectorSDRVFCid48 : 442|1@0+ (1,0) [0|1] "" IHU
 SG_ VFCVectorSDRVFCid49 : 443|1@0+ (1,0) [0|1] "" IHU
 SG_ VFCVectorSDRVFCid5 : 399|1@0+ (1,0) [0|1] "" IHU
 SG_ VFCVectorSDRVFCid50 : 444|1@0+ (1,0) [0|1] "" IHU
 SG_ VFCVectorSDRVFCid51 : 445|1@0+ (1,0) [0|1] "" IHU
 SG_ VFCVectorSDRVFCid52 : 446|1@0+ (1,0) [0|1] "" IHU
 SG_ VFCVectorSDRVFCid53 : 447|1@0+ (1,0) [0|1] "" IHU
 SG_ VFCVectorSDRVFCid54 : 448|1@0+ (1,0) [0|1] "" IHU
 SG_ VFCVectorSDRVFCid55 : 449|1@0+ (1,0) [0|1] "" IHU
 SG_ VFCVectorSDRVFCid56 : 450|1@0+ (1,0) [0|1] "" IHU
 SG_ VFCVectorSDRVFCid57 : 451|1@0+ (1,0) [0|1] "" IHU
 SG_ VFCVectorSDRVFCid58 : 452|1@0+ (1,0) [0|1] "" IHU
 SG_ VFCVectorSDRVFCid59 : 453|1@0+ (1,0) [0|1] "" IHU
 SG_ VFCVectorSDRVFCid6 : 400|1@0+ (1,0) [0|1] "" IHU
 SG_ VFCVectorSDRVFCid60 : 454|1@0+ (1,0) [0|1] "" IHU
 SG_ VFCVectorSDRVFCid61 : 455|1@0+ (1,0) [0|1] "" IHU
 SG_ VFCVectorSDRVFCid7 : 401|1@0+ (1,0) [0|1] "" IHU
 SG_ VFCVectorSDRVFCid8 : 402|1@0+ (1,0) [0|1] "" IHU
 SG_ VFCVectorSDRVFCid9 : 403|1@0+ (1,0) [0|1] "" IHU

BO_ 928 ZCUDZCUCANFD2Fr43 : 64 ZCUD
 SG_ ExtrLiShowActvnReLeFb : 509|2@0+ (1,0) [0|3] "" IHU
 SG_ ExtrLiShowActvnReLeFb_UB : 507|1@0+ (1,0) [0|1] "" IHU
 SG_ ExtrLiShowActvnReRiFb : 505|2@0+ (1,0) [0|3] "" IHU
 SG_ ExtrLiShowActvnReRiFb_UB : 506|1@0+ (1,0) [0|1] "" IHU
 SG_ ZCUDSResdSig10ToZCUDM : 151|16@0+ (1.0,0.0) [0.0|65535.0] "Unitless" IHU
 SG_ ZCUDSResdSig10ToZCUDM_UB : 270|1@0+ (1,0) [0|1] "" IHU
 SG_ ZCUDSResdSig11ToZCUDM : 167|16@0+ (1.0,0.0) [0.0|65535.0] "Unitless" IHU
 SG_ ZCUDSResdSig11ToZCUDM_UB : 269|1@0+ (1,0) [0|1] "" IHU
 SG_ ZCUDSResdSig12ToZCUDM : 183|16@0+ (1.0,0.0) [0.0|65535.0] "Unitless" IHU
 SG_ ZCUDSResdSig12ToZCUDM_UB : 268|1@0+ (1,0) [0|1] "" IHU
 SG_ ZCUDSResdSig13ToZCUDM : 199|16@0+ (1.0,0.0) [0.0|65535.0] "Unitless" IHU
 SG_ ZCUDSResdSig13ToZCUDM_UB : 267|1@0+ (1,0) [0|1] "" IHU
 SG_ ZCUDSResdSig14ToZCUDM : 215|16@0+ (1.0,0.0) [0.0|65535.0] "Unitless" IHU
 SG_ ZCUDSResdSig14ToZCUDM_UB : 266|1@0+ (1,0) [0|1] "" IHU
 SG_ ZCUDSResdSig15ToZCUDM : 231|16@0+ (1.0,0.0) [0.0|65535.0] "Unitless" IHU
 SG_ ZCUDSResdSig15ToZCUDM_UB : 265|1@0+ (1,0) [0|1] "" IHU
 SG_ ZCUDSResdSig16ToZCUDM : 247|16@0+ (1.0,0.0) [0.0|65535.0] "Unitless" IHU
 SG_ ZCUDSResdSig16ToZCUDM_UB : 264|1@0+ (1,0) [0|1] "" IHU
 SG_ ZCUDSResdSig17ToZCUDM : 279|16@0+ (1.0,0.0) [0.0|65535.0] "Unitless" IHU
 SG_ ZCUDSResdSig17ToZCUDM_UB : 498|1@0+ (1,0) [0|1] "" IHU
 SG_ ZCUDSResdSig18ToZCUDM : 295|16@0+ (1.0,0.0) [0.0|65535.0] "Unitless" IHU
 SG_ ZCUDSResdSig18ToZCUDM_UB : 497|1@0+ (1,0) [0|1] "" IHU
 SG_ ZCUDSResdSig19ToZCUDM : 311|24@0+ (1.0,0.0) [0.0|16777215.0] "Unitless" IHU
 SG_ ZCUDSResdSig19ToZCUDM_UB : 496|1@0+ (1,0) [0|1] "" IHU
 SG_ ZCUDSResdSig1ToZCUDM : 7|16@0+ (1.0,0.0) [0.0|65535.0] "Unitless" IHU
 SG_ ZCUDSResdSig1ToZCUDM_UB : 263|1@0+ (1,0) [0|1] "" IHU
 SG_ ZCUDSResdSig20ToZCUDM : 335|32@0+ (1.0,0.0) [0.0|4294967295.0] "Unitless" IHU
 SG_ ZCUDSResdSig20ToZCUDM_UB : 511|1@0+ (1,0) [0|1] "" IHU
 SG_ ZCUDSResdSig21ToZCUDM : 367|64@0+ (1.0,0.0) [0.0|18446744073709552000.0] "Unitless" IHU
 SG_ ZCUDSResdSig21ToZCUDM_UB : 510|1@0+ (1,0) [0|1] "" IHU
 SG_ ZCUDSResdSig22ToZCUDMSafety_UB : 499|1@0+ (1,0) [0|1] "" IHU
 SG_ ZCUDSResdSig22ToZCUDMSafetyChks : 495|8@0+ (1.0,0.0) [0.0|255.0] "Unitless" IHU
 SG_ ZCUDSResdSig22ToZCUDMSafetyCntr : 503|4@0+ (1.0,0.0) [0.0|15.0] "Unitless" IHU
 SG_ ZCUDSResdSig22ToZCUDMSafetyUInt64 : 431|64@0+ (1.0,0.0) [0.0|18446744073709552000.0] "Unitless" IHU
 SG_ ZCUDSResdSig2ToZCUDM : 23|16@0+ (1.0,0.0) [0.0|65535.0] "Unitless" IHU
 SG_ ZCUDSResdSig2ToZCUDM_UB : 262|1@0+ (1,0) [0|1] "" IHU
 SG_ ZCUDSResdSig3ToZCUDM : 39|16@0+ (1.0,0.0) [0.0|65535.0] "Unitless" IHU
 SG_ ZCUDSResdSig3ToZCUDM_UB : 261|1@0+ (1,0) [0|1] "" IHU
 SG_ ZCUDSResdSig4ToZCUDM : 55|16@0+ (1.0,0.0) [0.0|65535.0] "Unitless" IHU
 SG_ ZCUDSResdSig4ToZCUDM_UB : 260|1@0+ (1,0) [0|1] "" IHU
 SG_ ZCUDSResdSig5ToZCUDM : 71|16@0+ (1.0,0.0) [0.0|65535.0] "Unitless" IHU
 SG_ ZCUDSResdSig5ToZCUDM_UB : 259|1@0+ (1,0) [0|1] "" IHU
 SG_ ZCUDSResdSig6ToZCUDM : 87|16@0+ (1.0,0.0) [0.0|65535.0] "Unitless" IHU
 SG_ ZCUDSResdSig6ToZCUDM_UB : 258|1@0+ (1,0) [0|1] "" IHU
 SG_ ZCUDSResdSig7ToZCUDM : 103|16@0+ (1.0,0.0) [0.0|65535.0] "Unitless" IHU
 SG_ ZCUDSResdSig7ToZCUDM_UB : 257|1@0+ (1,0) [0|1] "" IHU
 SG_ ZCUDSResdSig8ToZCUDM : 119|16@0+ (1.0,0.0) [0.0|65535.0] "Unitless" IHU
 SG_ ZCUDSResdSig8ToZCUDM_UB : 256|1@0+ (1,0) [0|1] "" IHU
 SG_ ZCUDSResdSig9ToZCUDM : 135|16@0+ (1.0,0.0) [0.0|65535.0] "Unitless" IHU
 SG_ ZCUDSResdSig9ToZCUDM_UB : 271|1@0+ (1,0) [0|1] "" IHU

BO_ 1177 ZCUDZCUCANFD2Fr44 : 64 ZCUD
 SG_ ExvFltSts : 508|5@0+ (1,0) [0|31] "" IHU
 SG_ ExvFltSts_UB : 509|1@0+ (1,0) [0|1] "" IHU
 SG_ ZCUDMResdSig10ToZCUDS : 151|16@0+ (1.0,0.0) [0.0|65535.0] "Unitless" IHU
 SG_ ZCUDMResdSig10ToZCUDS_UB : 270|1@0+ (1,0) [0|1] "" IHU
 SG_ ZCUDMResdSig11ToZCUDS : 167|16@0+ (1.0,0.0) [0.0|65535.0] "Unitless" IHU
 SG_ ZCUDMResdSig11ToZCUDS_UB : 269|1@0+ (1,0) [0|1] "" IHU
 SG_ ZCUDMResdSig12ToZCUDS : 183|16@0+ (1.0,0.0) [0.0|65535.0] "Unitless" IHU
 SG_ ZCUDMResdSig12ToZCUDS_UB : 268|1@0+ (1,0) [0|1] "" IHU
 SG_ ZCUDMResdSig13ToZCUDS : 199|16@0+ (1.0,0.0) [0.0|65535.0] "Unitless" IHU
 SG_ ZCUDMResdSig13ToZCUDS_UB : 267|1@0+ (1,0) [0|1] "" IHU
 SG_ ZCUDMResdSig14ToZCUDS : 215|16@0+ (1.0,0.0) [0.0|65535.0] "Unitless" IHU
 SG_ ZCUDMResdSig14ToZCUDS_UB : 266|1@0+ (1,0) [0|1] "" IHU
 SG_ ZCUDMResdSig15ToZCUDS : 231|16@0+ (1.0,0.0) [0.0|65535.0] "Unitless" IHU
 SG_ ZCUDMResdSig15ToZCUDS_UB : 265|1@0+ (1,0) [0|1] "" IHU
 SG_ ZCUDMResdSig16ToZCUDS : 247|16@0+ (1.0,0.0) [0.0|65535.0] "Unitless" IHU
 SG_ ZCUDMResdSig16ToZCUDS_UB : 264|1@0+ (1,0) [0|1] "" IHU
 SG_ ZCUDMResdSig17ToZCUDS : 279|16@0+ (1.0,0.0) [0.0|65535.0] "Unitless" IHU
 SG_ ZCUDMResdSig17ToZCUDS_UB : 498|1@0+ (1,0) [0|1] "" IHU
 SG_ ZCUDMResdSig18ToZCUDS : 295|16@0+ (1.0,0.0) [0.0|65535.0] "Unitless" IHU
 SG_ ZCUDMResdSig18ToZCUDS_UB : 497|1@0+ (1,0) [0|1] "" IHU
 SG_ ZCUDMResdSig19ToZCUDS : 311|24@0+ (1.0,0.0) [0.0|16777215.0] "Unitless" IHU
 SG_ ZCUDMResdSig19ToZCUDS_UB : 496|1@0+ (1,0) [0|1] "" IHU
 SG_ ZCUDMResdSig1ToZCUDS : 7|16@0+ (1.0,0.0) [0.0|65535.0] "Unitless" IHU
 SG_ ZCUDMResdSig1ToZCUDS_UB : 263|1@0+ (1,0) [0|1] "" IHU
 SG_ ZCUDMResdSig20ToZCUDS : 335|32@0+ (1.0,0.0) [0.0|4294967295.0] "Unitless" IHU
 SG_ ZCUDMResdSig20ToZCUDS_UB : 511|1@0+ (1,0) [0|1] "" IHU
 SG_ ZCUDMResdSig21ToZCUDS : 367|64@0+ (1.0,0.0) [0.0|18446744073709552000.0] "Unitless" IHU
 SG_ ZCUDMResdSig21ToZCUDS_UB : 510|1@0+ (1,0) [0|1] "" IHU
 SG_ ZCUDMResdSig22ToZCUDSSafety_UB : 499|1@0+ (1,0) [0|1] "" IHU
 SG_ ZCUDMResdSig22ToZCUDSSafetyChks : 495|8@0+ (1.0,0.0) [0.0|255.0] "Unitless" IHU
 SG_ ZCUDMResdSig22ToZCUDSSafetyCntr : 503|4@0+ (1.0,0.0) [0.0|15.0] "Unitless" IHU
 SG_ ZCUDMResdSig22ToZCUDSSafetyUInt64 : 431|64@0+ (1.0,0.0) [0.0|18446744073709552000.0] "Unitless" IHU
 SG_ ZCUDMResdSig2ToZCUDS : 23|16@0+ (1.0,0.0) [0.0|65535.0] "Unitless" IHU
 SG_ ZCUDMResdSig2ToZCUDS_UB : 262|1@0+ (1,0) [0|1] "" IHU
 SG_ ZCUDMResdSig3ToZCUDS : 39|16@0+ (1.0,0.0) [0.0|65535.0] "Unitless" IHU
 SG_ ZCUDMResdSig3ToZCUDS_UB : 261|1@0+ (1,0) [0|1] "" IHU
 SG_ ZCUDMResdSig4ToZCUDS : 55|16@0+ (1.0,0.0) [0.0|65535.0] "Unitless" IHU
 SG_ ZCUDMResdSig4ToZCUDS_UB : 260|1@0+ (1,0) [0|1] "" IHU
 SG_ ZCUDMResdSig5ToZCUDS : 71|16@0+ (1.0,0.0) [0.0|65535.0] "Unitless" IHU
 SG_ ZCUDMResdSig5ToZCUDS_UB : 259|1@0+ (1,0) [0|1] "" IHU
 SG_ ZCUDMResdSig6ToZCUDS : 87|16@0+ (1.0,0.0) [0.0|65535.0] "Unitless" IHU
 SG_ ZCUDMResdSig6ToZCUDS_UB : 258|1@0+ (1,0) [0|1] "" IHU
 SG_ ZCUDMResdSig7ToZCUDS : 103|16@0+ (1.0,0.0) [0.0|65535.0] "Unitless" IHU
 SG_ ZCUDMResdSig7ToZCUDS_UB : 257|1@0+ (1,0) [0|1] "" IHU
 SG_ ZCUDMResdSig8ToZCUDS : 119|16@0+ (1.0,0.0) [0.0|65535.0] "Unitless" IHU
 SG_ ZCUDMResdSig8ToZCUDS_UB : 256|1@0+ (1,0) [0|1] "" IHU
 SG_ ZCUDMResdSig9ToZCUDS : 135|16@0+ (1.0,0.0) [0.0|65535.0] "Unitless" IHU
 SG_ ZCUDMResdSig9ToZCUDS_UB : 271|1@0+ (1,0) [0|1] "" IHU

BO_ 320 ZCUDZCUCANFD2Fr45 : 64 ZCUD
 SG_ BotmSnsrStsFromFootOper : 18|1@0+ (1,0) [0|1] "" IHU
 SG_ BotmSnsrStsFromFootOper_UB : 17|1@0+ (1,0) [0|1] "" IHU
 SG_ DockColumGrayReqForTvc : 505|1@0+ (1,0) [0|1] "" IHU
 SG_ DockColumGrayReqForTvc_UB : 504|1@0+ (1,0) [0|1] "" IHU
 SG_ GaGearAct : 7|3@0+ (1.0,0.0) [0.0|7.0] "Unitless" IHU
 SG_ GaGearAct_UB : 4|1@0+ (1,0) [0|1] "" IHU
 SG_ LinCtrlForRowSecLeSeatAdjmt : 15|2@0+ (1,0) [0|3] "" IHU
 SG_ LinCtrlForRowSecLeSeatAdjmt_UB : 13|1@0+ (1,0) [0|1] "" IHU
 SG_ LinCtrlForRowSecRiSeatAdjmt : 11|2@0+ (1,0) [0|3] "" IHU
 SG_ LinCtrlForRowSecRiSeatAdjmt_UB : 12|1@0+ (1,0) [0|1] "" IHU
 SG_ LowrTailgOpenerSwt : 9|1@0+ (1,0) [0|1] "" IHU
 SG_ LowrTailgOpenerSwt_UB : 8|1@0+ (1,0) [0|1] "" IHU
 SG_ MagChrgLidTip1 : 111|1@0+ (1,0) [0|1] "" IHU
 SG_ MagChrgLidTip1_UB : 110|1@0+ (1,0) [0|1] "" IHU
 SG_ MagChrgLidTip2 : 109|1@0+ (1,0) [0|1] "" IHU
 SG_ MagChrgLidTip2_UB : 108|1@0+ (1,0) [0|1] "" IHU
 SG_ NFCKeyReadStsToHMI_UB : 16|1@0+ (1,0) [0|1] "" IHU
 SG_ NFCKeyReadStsToHMIKey0 : 31|2@0+ (1,0) [0|3] "" IHU
 SG_ NFCKeyReadStsToHMIKey1 : 29|2@0+ (1,0) [0|3] "" IHU
 SG_ NFCKeyReadStsToHMIKey10 : 43|2@0+ (1,0) [0|3] "" IHU
 SG_ NFCKeyReadStsToHMIKey11 : 41|2@0+ (1,0) [0|3] "" IHU
 SG_ NFCKeyReadStsToHMIKey12 : 55|2@0+ (1,0) [0|3] "" IHU
 SG_ NFCKeyReadStsToHMIKey13 : 53|2@0+ (1,0) [0|3] "" IHU
 SG_ NFCKeyReadStsToHMIKey14 : 51|2@0+ (1,0) [0|3] "" IHU
 SG_ NFCKeyReadStsToHMIKey15 : 49|2@0+ (1,0) [0|3] "" IHU
 SG_ NFCKeyReadStsToHMIKey2 : 27|2@0+ (1,0) [0|3] "" IHU
 SG_ NFCKeyReadStsToHMIKey3 : 25|2@0+ (1,0) [0|3] "" IHU
 SG_ NFCKeyReadStsToHMIKey4 : 39|2@0+ (1,0) [0|3] "" IHU
 SG_ NFCKeyReadStsToHMIKey5 : 37|2@0+ (1,0) [0|3] "" IHU
 SG_ NFCKeyReadStsToHMIKey6 : 35|2@0+ (1,0) [0|3] "" IHU
 SG_ NFCKeyReadStsToHMIKey7 : 33|2@0+ (1,0) [0|3] "" IHU
 SG_ NFCKeyReadStsToHMIKey8 : 47|2@0+ (1,0) [0|3] "" IHU
 SG_ NFCKeyReadStsToHMIKey9 : 45|2@0+ (1,0) [0|3] "" IHU
 SG_ PtCluTqCp_UB : 61|1@0+ (1,0) [0|1] "" IHU
 SG_ PtCluTqCpReq1 : 60|13@0+ (0.1,-5.0) [-5.0|814.1] "NewtonMeter" IHU
 SG_ PtCluTqCpReq2 : 79|13@0+ (0.1,-5.0) [-5.0|814.1] "NewtonMeter" IHU
 SG_ PtDirAllwdToTrsmActr_UB : 82|1@0+ (1,0) [0|1] "" IHU
 SG_ PtDirAllwdToTrsmActrChks : 95|8@0+ (1.0,0.0) [0.0|255.0] "Unitless" IHU
 SG_ PtDirAllwdToTrsmActrCntr : 103|4@0+ (1.0,0.0) [0.0|15.0] "Unitless" IHU
 SG_ PtDirAllwdToTrsmActrFwd : 99|1@0+ (1,0) [0|1] "" IHU
 SG_ PtDirAllwdToTrsmActrNeut : 98|1@0+ (1,0) [0|1] "" IHU
 SG_ PtDirAllwdToTrsmActrParkRls : 97|1@0+ (1,0) [0|1] "" IHU
 SG_ PtDirAllwdToTrsmActrRvs : 96|1@0+ (1,0) [0|1] "" IHU
 SG_ PtEngTqAct : 106|11@0+ (1.0,-1024.0) [-1024.0|1023.0] "NewtonMeter" IHU
 SG_ PtEngTqAct_UB : 107|1@0+ (1,0) [0|1] "" IHU
 SG_ PtGearActrAdpnCmd : 63|1@0+ (1,0) [0|1] "" IHU
 SG_ PtGearActrAdpnCmd_UB : 62|1@0+ (1,0) [0|1] "" IHU
 SG_ PtGearActtn_UB : 168|1@0+ (1,0) [0|1] "" IHU
 SG_ PtGearActtnAllwdSts1 : 175|2@0+ (1,0) [0|3] "" IHU
 SG_ PtGearActtnAllwdSts2 : 173|2@0+ (1,0) [0|3] "" IHU
 SG_ PtGearActtnModReq : 171|2@0+ (1,0) [0|3] "" IHU
 SG_ PtGearActtnPfmncReq : 159|8@0+ (1.0,0.0) [0.0|255.0] "Unitless" IHU
 SG_ PtGearActtnPrio : 169|1@0+ (1,0) [0|1] "" IHU
 SG_ PtGearActtnReq1 : 167|4@0+ (1,0) [0|15] "" IHU
 SG_ PtGearActtnReq2 : 163|4@0+ (1,0) [0|15] "" IHU
 SG_ RWA1ColAgTar_UB : 183|1@0+ (1,0) [0|1] "" IHU
 SG_ RWA1ColAgTarAg : 182|15@0- (0.0009765625,0.0) [-14.5|14.5] "rad" IHU
 SG_ RWA1ColAgTarAgSpd : 199|14@0- (0.0078125,0.0) [-50.0|50.0] "rad/s" IHU
 SG_ RWA1ColAgTarChks : 215|8@0+ (1.0,0.0) [0.0|255.0] "Unitless" IHU
 SG_ RWA1ColAgTarCntr : 223|4@0+ (1.0,0.0) [0.0|15.0] "Unitless" IHU
 SG_ RWA1ColAgTarQf : 201|2@0+ (1,0) [0|3] "" IHU
 SG_ SbWDecoupldStsH1_UB : 234|1@0+ (1,0) [0|1] "" IHU
 SG_ SbWDecoupldStsH1Chks : 231|8@0+ (1.0,0.0) [0.0|255.0] "Unitless" IHU
 SG_ SbWDecoupldStsH1Cntr : 239|4@0+ (1.0,0.0) [0.0|15.0] "Unitless" IHU
 SG_ SbWDecoupldStsH1SbWDecoupldSts : 235|1@0+ (1,0) [0|1] "" IHU
 SG_ SbWErrReqH1_UB : 128|1@0+ (1,0) [0|1] "" IHU
 SG_ SbWErrReqH1Chks : 127|8@0+ (1.0,0.0) [0.0|255.0] "Unitless" IHU
 SG_ SbWErrReqH1Cntr : 135|4@0+ (1.0,0.0) [0.0|15.0] "Unitless" IHU
 SG_ SbWErrReqH1ErrReq : 131|3@0+ (1,0) [0|7] "" IHU
 SG_ SBWErrReqR1_UB : 144|1@0+ (1,0) [0|1] "" IHU
 SG_ SBWErrReqR1Chks : 143|8@0+ (1.0,0.0) [0.0|255.0] "Unitless" IHU
 SG_ SBWErrReqR1Cntr : 151|4@0+ (1.0,0.0) [0.0|15.0] "Unitless" IHU
 SG_ SBWErrReqR1ErrReq : 147|3@0+ (1,0) [0|7] "" IHU
 SG_ SumActv : 81|1@0+ (1,0) [0|1] "" IHU
 SG_ SumActv_UB : 80|1@0+ (1,0) [0|1] "" IHU
 SG_ SupHeatTAct : 247|8@0+ (1.0,-30.0) [-30.0|225.0] "m" IHU
 SG_ SupHeatTAct_UB : 232|1@0+ (1,0) [0|1] "" IHU
 SG_ TankTurnIndcnMsg : 319|5@0+ (1.0,0.0) [0.0|31.0] "Unitless" IHU
 SG_ TankTurnIndcnMsg_UB : 314|1@0+ (1,0) [0|1] "" IHU
 SG_ TankTurnModSts_UB : 304|1@0+ (1,0) [0|1] "" IHU
 SG_ TankTurnModStsChks : 303|8@0+ (1.0,0.0) [0.0|255.0] "Unitless" IHU
 SG_ TankTurnModStsCntr : 311|4@0+ (1.0,0.0) [0.0|15.0] "Unitless" IHU
 SG_ TankTurnModStsTankTurnModSts : 307|3@0+ (1,0) [0|7] "" IHU
 SG_ TrsmClu0FltIndcn : 271|2@0+ (1,0) [0|3] "" IHU
 SG_ TrsmClu0FltIndcn_UB : 269|1@0+ (1,0) [0|1] "" IHU
 SG_ TrsmCluSlipStsOfClu0 : 259|3@0+ (1,0) [0|7] "" IHU
 SG_ TrsmCluSlipStsOfClu0_UB : 256|1@0+ (1,0) [0|1] "" IHU
 SG_ TrsmCluT1_UB : 348|1@0+ (1,0) [0|1] "" IHU
 SG_ TrsmCluT1Qf : 350|2@0+ (1,0) [0|3] "" IHU
 SG_ TrsmCluT1Val : 343|9@0+ (1.25,-40.0) [-40.0|598.75] "degC" IHU
 SG_ TrsmCluT2_UB : 347|1@0+ (1,0) [0|1] "" IHU
 SG_ TrsmCluT2Qf : 346|2@0+ (1,0) [0|3] "" IHU
 SG_ TrsmCluT2Val : 344|9@0+ (1.25,-40.0) [-40.0|598.75] "degC" IHU
 SG_ TrsmCluTq_UB : 290|1@0+ (1,0) [0|1] "" IHU
 SG_ TrsmCluTqActOfClu0 : 322|11@0+ (1.0,-1024.0) [-1024.0|1023.0] "NewtonMeter" IHU
 SG_ TrsmCluTqActOfClu0_UB : 323|1@0+ (1,0) [0|1] "" IHU
 SG_ TrsmCluTqCp1 : 268|13@0+ (0.1,-5.0) [-5.0|814.1] "NewtonMeter" IHU
 SG_ TrsmCluTqCp2 : 287|13@0+ (0.1,-5.0) [-5.0|814.1] "NewtonMeter" IHU
 SG_ TrsmDtModAct : 219|3@0+ (1,0) [0|7] "" IHU
 SG_ TrsmDtModAct_UB : 216|1@0+ (1,0) [0|1] "" IHU
 SG_ TrsmEngmtLimd3_UB : 370|1@0+ (1,0) [0|1] "" IHU
 SG_ TrsmEngmtLimd3TrsmEngmtLimd : 371|1@0+ (1,0) [0|1] "" IHU
 SG_ TrsmEngmtLimd3TrsmEngmtLimdChks : 367|8@0+ (1.0,0.0) [0.0|255.0] "Unitless" IHU
 SG_ TrsmEngmtLimd3TrsmEngmtLimdCntr : 375|4@0+ (1.0,0.0) [0.0|15.0] "Unitless" IHU
 SG_ TrsmErrIndcnReq2 : 289|1@0+ (1,0) [0|1] "" IHU
 SG_ TrsmErrIndcnReq2_UB : 288|1@0+ (1,0) [0|1] "" IHU
 SG_ TrsmGbxActrOff : 369|1@0+ (1,0) [0|1] "" IHU
 SG_ TrsmGbxActrOff_UB : 368|1@0+ (1,0) [0|1] "" IHU
 SG_ TrsmGearActrScanForRefActv : 509|1@0+ (1,0) [0|1] "" IHU
 SG_ TrsmGearActrScanForRefActv_UB : 508|1@0+ (1,0) [0|1] "" IHU
 SG_ TrsmGearActrScanForRefReq : 507|1@0+ (1,0) [0|1] "" IHU
 SG_ TrsmGearActrScanForRefReq_UB : 506|1@0+ (1,0) [0|1] "" IHU
 SG_ TrsmGearActrTLvl : 385|2@0+ (1,0) [0|3] "" IHU
 SG_ TrsmGearActrTLvl_UB : 386|1@0+ (1,0) [0|1] "" IHU
 SG_ TrsmGearNotAvlSts2 : 383|12@0+ (1.0,0.0) [0.0|4095.0] "Unitless" IHU
 SG_ TrsmGearNotAvlSts2_UB : 387|1@0+ (1,0) [0|1] "" IHU
 SG_ TrsmHardRotReq1 : 481|1@0+ (1,0) [0|1] "" IHU
 SG_ TrsmHardRotReq1_UB : 480|1@0+ (1,0) [0|1] "" IHU
 SG_ TrsmModNotAvlSts3 : 495|8@0+ (1.0,0.0) [0.0|255.0] "Unitless" IHU
 SG_ TrsmModNotAvlSts3_UB : 511|1@0+ (1,0) [0|1] "" IHU
 SG_ TrsmNRec_UB : 448|1@0+ (1,0) [0|1] "" IHU
 SG_ TrsmNRecChks : 447|8@0+ (1.0,0.0) [0.0|255.0] "Unitless" IHU
 SG_ TrsmNRecCntr : 455|4@0+ (1.0,0.0) [0.0|15.0] "Unitless" IHU
 SG_ TrsmNRecInp1 : 399|14@0+ (1.0,0.0) [0.0|16383.0] "rpm" IHU
 SG_ TrsmNRecInp2 : 415|14@0+ (1.0,0.0) [0.0|16383.0] "rpm" IHU
 SG_ TrsmNRecInpDir1 : 451|1@0+ (1,0) [0|1] "" IHU
 SG_ TrsmNRecInpDir2 : 450|1@0+ (1,0) [0|1] "" IHU
 SG_ TrsmNRecInpQf1 : 401|2@0+ (1,0) [0|3] "" IHU
 SG_ TrsmNRecInpQf2 : 417|2@0+ (1,0) [0|3] "" IHU
 SG_ TrsmNRecOutp : 431|14@0+ (1.0,0.0) [0.0|16383.0] "rpm" IHU
 SG_ TrsmNRecOutpDir : 449|1@0+ (1,0) [0|1] "" IHU
 SG_ TrsmNRecOutpQf : 433|2@0+ (1,0) [0|3] "" IHU
 SG_ TrsmOutpN_UB : 482|1@0+ (1,0) [0|1] "" IHU
 SG_ TrsmOutpNChks : 479|8@0+ (1.0,0.0) [0.0|255.0] "Unitless" IHU
 SG_ TrsmOutpNCntr : 487|4@0+ (1.0,0.0) [0.0|15.0] "Unitless" IHU
 SG_ TrsmOutpNDir : 483|1@0+ (1,0) [0|1] "" IHU
 SG_ TrsmOutpNSpd : 463|14@0+ (1.0,0.0) [0.0|16383.0] "Unitless" IHU
 SG_ TrsmOutpNSpdQf : 465|2@0+ (1,0) [0|3] "" IHU
 SG_ TrsmSelfLrngMod : 503|8@0+ (1.0,0.0) [0.0|255.0] "Unitless" IHU
 SG_ TrsmSelfLrngMod_UB : 510|1@0+ (1,0) [0|1] "" IHU

BO_ 463 ZCUDZCUCANFD2Fr46 : 64 ZCUD
 SG_ DftlFltIndcn : 163|3@0+ (1,0) [0|7] "" Vector__XXX
 SG_ DftlFltIndcn_UB : 160|1@0+ (1,0) [0|1] "" Vector__XXX
 SG_ EldtPmpCmd_UB : 12|1@0+ (1,0) [0|1] "" IHU
 SG_ EldtPmpCmdCooltPmpPostRunReq : 15|3@0+ (1,0) [0|7] "" IHU
 SG_ EldtPmpCmdCooltPmpSpdReq : 7|8@0+ (1.0,0.0) [0.0|254.0] "Unitless" IHU
 SG_ EngCooltPmpSpdReq_UB : 11|1@0+ (1,0) [0|1] "" IHU
 SG_ EngCooltPmpSpdReqCooltPmpPostRunReq : 10|3@0+ (1,0) [0|7] "" IHU
 SG_ EngCooltPmpSpdReqCooltPmpSpdReq : 23|8@0+ (1.0,0.0) [0.0|254.0] "Unitless" IHU
 SG_ EngIdleCtrlRefVal : 31|15@0+ (0.5,0.0) [0.0|16383.5] "rpm" IHU
 SG_ EngIdleCtrlRefVal_UB : 32|1@0+ (1,0) [0|1] "" IHU
 SG_ EngPmpStat_UB : 98|1@0+ (1,0) [0|1] "" IHU
 SG_ EngPmpStatCooltPmpDryErr : 87|2@0+ (1,0) [0|3] "" IHU
 SG_ EngPmpStatCooltPmpEmgyModSts : 85|2@0+ (1,0) [0|3] "" IHU
 SG_ EngPmpStatCooltPmpErrSts : 83|2@0+ (1,0) [0|3] "" IHU
 SG_ EngPmpStatCooltPmpI : 47|8@0+ (0.2,0.0) [0.0|50.800000000000004] "A" IHU
 SG_ EngPmpStatCooltPmpIErr : 81|2@0+ (1,0) [0|3] "" IHU
 SG_ EngPmpStatCooltPmpMonrSpd : 95|2@0+ (1,0) [0|3] "" IHU
 SG_ EngPmpStatCooltPmpPostRunSts : 93|2@0+ (1,0) [0|3] "" IHU
 SG_ EngPmpStatCooltPmpSetPostRunReq : 101|3@0+ (1,0) [0|7] "" IHU
 SG_ EngPmpStatCooltPmpSetSpdReq : 55|8@0+ (1.0,0.0) [0.0|254.0] "Unitless" IHU
 SG_ EngPmpStatCooltPmpSpd : 63|8@0+ (1.0,0.0) [0.0|254.0] "Unitless" IHU
 SG_ EngPmpStatCooltPmpT : 71|8@0+ (1.0,-50.0) [-50.0|200.0] "degC" IHU
 SG_ EngPmpStatCooltPmpTErr : 91|2@0+ (1,0) [0|3] "" IHU
 SG_ EngPmpStatCooltPmpU : 79|8@0+ (0.1,0.0) [0.0|25.0] "Volt" IHU
 SG_ EngPmpStatCooltPmpUErr : 89|2@0+ (1,0) [0|3] "" IHU
 SG_ EngPmpStatCooltPmpUnstallSts : 103|2@0+ (1,0) [0|3] "" IHU
 SG_ FootwellLiSts : 97|1@0+ (1,0) [0|1] "" IHU
 SG_ FootwellLiSts_UB : 96|1@0+ (1,0) [0|1] "" IHU
 SG_ HvBattSocEngStart : 111|11@0+ (0.05,0.0) [0.0|100.0] "%" IHU
 SG_ HvBattSocEngStart_UB : 116|1@0+ (1,0) [0|1] "" IHU
 SG_ PtCluSlipCmdOfClu0 : 114|3@0+ (1,0) [0|7] "" IHU
 SG_ PtCluSlipCmdOfClu0_UB : 115|1@0+ (1,0) [0|1] "" IHU
 SG_ PtCluSlipTarReqOfClu0 : 175|10@0+ (1.0,0.0) [0.0|1023.0] "Unitless" IHU
 SG_ PtCluSlipTarReqOfClu0_UB : 181|1@0+ (1,0) [0|1] "" IHU
 SG_ SldngDoorLeReModSts : 210|1@0+ (1,0) [0|1] "" IHU
 SG_ SldngDoorLeReModSts_UB : 209|1@0+ (1,0) [0|1] "" IHU
 SG_ SldngDoorRiReModSts : 218|1@0+ (1,0) [0|1] "" IHU
 SG_ SldngDoorRiReModSts_UB : 217|1@0+ (1,0) [0|1] "" IHU
 SG_ TankTurnActIndcnMsgForBrkFrntWhl : 215|5@0+ (1.0,0.0) [0.0|31.0] "Unitless" IHU
 SG_ TankTurnActIndcnMsgForBrkFrntWhl_UB : 200|1@0+ (1,0) [0|1] "" IHU
 SG_ TankTurnActIndcnMsgForBrkReWhl : 223|5@0+ (1.0,0.0) [0.0|31.0] "Unitless" IHU
 SG_ TankTurnActIndcnMsgForBrkReWhl_UB : 201|1@0+ (1,0) [0|1] "" IHU
 SG_ TankTurnIndcnMsgForBrkFrntWhl : 231|5@0+ (1.0,0.0) [0.0|31.0] "Unitless" IHU
 SG_ TankTurnIndcnMsgForBrkFrntWhl_UB : 202|1@0+ (1,0) [0|1] "" IHU
 SG_ TankTurnIndcnMsgForBrkReWhl : 239|5@0+ (1.0,0.0) [0.0|31.0] "Unitless" IHU
 SG_ TankTurnIndcnMsgForBrkReWhl_UB : 208|1@0+ (1,0) [0|1] "" IHU
 SG_ TireFil_UB : 128|1@0+ (1,0) [0|1] "" IHU
 SG_ TireFilFilSwt : 136|1@0+ (1,0) [0|1] "" IHU
 SG_ TireFilNoiseFlrSwt : 137|1@0+ (1,0) [0|1] "" IHU
 SG_ TireFilPollingMod : 139|2@0+ (1,0) [0|3] "" IHU
 SG_ TireFilRxSwt : 140|1@0+ (1,0) [0|1] "" IHU
 SG_ TireFilSnsrID : 143|3@0+ (1.0,0.0) [0.0|7.0] "Unitless" IHU
 SG_ TrLockStsRadar : 165|2@0+ (1,0) [0|3] "" IHU
 SG_ TrLockStsRadar_UB : 166|1@0+ (1,0) [0|1] "" IHU
 SG_ TrsmClu0Sts_UB : 129|1@0+ (1,0) [0|1] "" IHU
 SG_ TrsmClu0StsChks : 127|8@0+ (1.0,0.0) [0.0|255.0] "Unitless" IHU
 SG_ TrsmClu0StsCntr : 135|4@0+ (1.0,0.0) [0.0|15.0] "Unitless" IHU
 SG_ TrsmClu0StsTrsm0CluSts : 131|2@0+ (1,0) [0|3] "" IHU
 SG_ TrsmGearActSafe_UB : 167|1@0+ (1,0) [0|1] "" IHU
 SG_ TrsmGearActSafeChks : 151|8@0+ (1.0,0.0) [0.0|255.0] "Unitless" IHU
 SG_ TrsmGearActSafeCntr : 159|4@0+ (1.0,0.0) [0.0|15.0] "Unitless" IHU
 SG_ TrsmGearActSafeTrsmGearActSafe : 155|4@0+ (1,0) [0|15] "" IHU
 SG_ TrsmHardRotReq2 : 180|1@0+ (1,0) [0|1] "" IHU
 SG_ TrsmHardRotReq2_UB : 179|1@0+ (1,0) [0|1] "" IHU
 SG_ TrsmLockMgrWarnlndcn : 177|2@0+ (1,0) [0|3] "" IHU
 SG_ TrsmLockMgrWarnlndcn_UB : 178|1@0+ (1,0) [0|1] "" IHU
 SG_ TrsmModNotAvlSts2 : 191|8@0+ (1.0,0.0) [0.0|255.0] "Unitless" IHU
 SG_ TrsmModNotAvlSts2_UB : 207|1@0+ (1,0) [0|1] "" IHU
 SG_ WcacVlvPosSetReq : 199|8@0+ (1.0,0.0) [0.0|100.0] "%" IHU
 SG_ WcacVlvPosSetReq_UB : 206|1@0+ (1,0) [0|1] "" IHU
 SG_ WcacVlvRefDrvReq : 205|2@0+ (1,0) [0|3] "" IHU
 SG_ WcacVlvRefDrvReq_UB : 203|1@0+ (1,0) [0|1] "" IHU

BO_ 523 ZCUDZCUCANFD2Fr47 : 64 ZCUD
 SG_ AirPtcHVPwrActlFristLe : 49|10@0+ (20.0,0.0) [0.0|20460.0] "W" IHU,ZCUP
 SG_ AirPtcHVPwrActlFristLe_UB : 50|1@0+ (1,0) [0|1] "" IHU,ZCUP
 SG_ AirPtcHVPwrActlFristRi : 71|10@0+ (20.0,0.0) [0.0|20460.0] "W" IHU,ZCUP
 SG_ AirPtcHVPwrActlFristRi_UB : 51|1@0+ (1,0) [0|1] "" IHU,ZCUP
 SG_ AirPtcHVPwrActlSecLe : 73|10@0+ (20.0,0.0) [0.0|20460.0] "W" IHU,ZCUP
 SG_ AirPtcHVPwrActlSecLe_UB : 52|1@0+ (1,0) [0|1] "" IHU,ZCUP
 SG_ CmprReqCmprRunReq : 11|2@0+ (1,0) [0|3] "" IHU
 SG_ CmprReqCmprRunReq_UB : 23|1@0+ (1,0) [0|1] "" IHU
 SG_ CurtBtnSts : 77|3@0+ (1,0) [0|7] "" IHU
 SG_ CurtBtnSts_UB : 74|1@0+ (1,0) [0|1] "" IHU
 SG_ DrvrSeatActvSwtFctMod : 126|2@0+ (1,0) [0|3] "" IHU
 SG_ DrvrSeatActvSwtFctMod_UB : 124|1@0+ (1,0) [0|1] "" IHU
 SG_ DrvrSeatIntgrSwtSts_UB : 131|1@0+ (1,0) [0|1] "" IHU
 SG_ DrvrSeatIntgrSwtStsIntgrSwtHozlSts : 123|2@0+ (1,0) [0|3] "" IHU
 SG_ DrvrSeatIntgrSwtStsIntgrSwtRotSts : 121|2@0+ (1,0) [0|3] "" IHU
 SG_ DrvrSeatIntgrSwtStsIntgrSwtSelnSts : 135|2@0+ (1,0) [0|3] "" IHU
 SG_ DrvrSeatIntgrSwtStsIntgrSwtVertSts : 133|2@0+ (1,0) [0|3] "" IHU
 SG_ EngPwrNormDes : 7|11@0+ (1.0,0.0) [0.0|2047.0] "W" IHU
 SG_ EngPwrNormDes_UB : 12|1@0+ (1,0) [0|1] "" IHU
 SG_ FrCurtBtnSts : 95|3@0+ (1,0) [0|7] "" IHU
 SG_ FrCurtBtnSts_UB : 54|1@0+ (1,0) [0|1] "" IHU
 SG_ HpBattVlvPosSetReq : 39|8@0+ (1.0,0.0) [0.0|100.0] "%" IHU
 SG_ HpBattVlvPosSetReq_UB : 19|1@0+ (1,0) [0|1] "" IHU
 SG_ HpBattVlvRefDrvReq : 9|2@0+ (1,0) [0|3] "" IHU
 SG_ HpBattVlvRefDrvReq_UB : 22|1@0+ (1,0) [0|1] "" IHU
 SG_ IsgMotCooltFlowReq : 17|10@0+ (0.05,0.0) [0.0|51.150000000000006] "L / min" IHU
 SG_ IsgMotCooltFlowReq_UB : 18|1@0+ (1,0) [0|1] "" IHU
 SG_ PassAirbLampStsRec_UB : 100|1@0+ (1,0) [0|1] "" IHU
 SG_ PassAirbLampStsRecPassAirbLampSts : 119|2@0+ (1,0) [0|3] "" IHU
 SG_ PassAirbLampStsRecPassAirbLampStsChks : 111|8@0+ (1.0,0.0) [0.0|255.0] "Unitless" IHU
 SG_ PassAirbLampStsRecPassAirbLampStsCntr : 99|4@0+ (1.0,0.0) [0.0|15.0] "Unitless" IHU
 SG_ RainSnsrLiThd : 117|4@0+ (5.0,-40.0) [-40.0|35.0] "%" IHU
 SG_ RainSnsrLiThd_UB : 88|1@0+ (1,0) [0|1] "" IHU
 SG_ ReAirPtcEnad : 21|1@0+ (1,0) [0|1] "" IHU
 SG_ ReAirPtcEnad_UB : 20|1@0+ (1,0) [0|1] "" IHU
 SG_ ReAirPtcHvPwrReq : 47|8@0+ (20.0,0.0) [0.0|5100.0] "W" IHU
 SG_ ReAirPtcHvPwrReq_UB : 55|1@0+ (1,0) [0|1] "" IHU
 SG_ ReCurtBtnSts : 92|3@0+ (1,0) [0|7] "" IHU
 SG_ ReCurtBtnSts_UB : 53|1@0+ (1,0) [0|1] "" IHU
 SG_ RoofBtnSts : 103|3@0+ (1,0) [0|7] "" IHU
 SG_ RoofBtnSts_UB : 89|1@0+ (1,0) [0|1] "" IHU
 SG_ TrRelsReq : 113|2@0+ (1,0) [0|3] "" IHU
 SG_ TrRelsReq_UB : 127|1@0+ (1,0) [0|1] "" IHU

BO_ 1197 ZCUDZCUCANFD2Fr48 : 64 ZCUD
 SG_ ActvnOfApproachInEITL : 66|1@0+ (1,0) [0|1] "" IHU
 SG_ ActvnOfApproachInEITL_UB : 65|1@0+ (1,0) [0|1] "" IHU
 SG_ ActvnOfCarLoctrInEITL : 64|1@0+ (1,0) [0|1] "" IHU
 SG_ ActvnOfCarLoctrInEITL_UB : 79|1@0+ (1,0) [0|1] "" IHU
 SG_ ActvReSplrPosn : 119|3@0+ (1,0) [0|7] "" IHU
 SG_ ActvReSplrPosn_UB : 116|1@0+ (1,0) [0|1] "" IHU
 SG_ CeilingShieldSwt1 : 115|1@0+ (1,0) [0|1] "" IHU
 SG_ CeilingShieldSwt1_UB : 114|1@0+ (1,0) [0|1] "" IHU
 SG_ EITLActvnCaseDurgDrv : 43|4@0+ (1.0,0.0) [0.0|15.0] "Unitless" IHU
 SG_ EITLActvnCaseDurgDrv_UB : 44|1@0+ (1,0) [0|1] "" IHU
 SG_ ElecMot2ActvDampgGain : 39|8@0+ (0.0002,0.0) [0.0|0.051000000000000004] "Unitless" IHU
 SG_ ElecMot2ActvDampgGain_UB : 47|1@0+ (1,0) [0|1] "" IHU
 SG_ ElecMot2EngSpdOfActvDampg : 23|15@0+ (0.5,0.0) [0.0|16383.5] "rpm" IHU
 SG_ ElecMot2EngSpdOfActvDampg_UB : 24|1@0+ (1,0) [0|1] "" IHU
 SG_ FrntSeatLinReqFromSecSeatLe : 111|4@0+ (1.0,0.0) [0.0|15.0] "Unitless" ZCUP
 SG_ FrntSeatLinReqFromSecSeatLe_UB : 97|1@0+ (1,0) [0|1] "" ZCUP
 SG_ FrntSeatLinReqFromSecSeatRi : 95|4@0+ (1.0,0.0) [0.0|15.0] "Unitless" ZCUP
 SG_ FrntSeatLinReqFromSecSeatRi_UB : 101|1@0+ (1,0) [0|1] "" ZCUP
 SG_ FrntSeatLinStopFromSecSeatLe : 99|1@0+ (1,0) [0|1] "" ZCUP
 SG_ FrntSeatLinStopFromSecSeatLe_UB : 98|1@0+ (1,0) [0|1] "" ZCUP
 SG_ FrntSeatLinStopFromSecSeatRi : 103|1@0+ (1,0) [0|1] "" ZCUP
 SG_ FrntSeatLinStopFromSecSeatRi_UB : 102|1@0+ (1,0) [0|1] "" ZCUP
 SG_ FrntSeatRecoveryFromSecSeatLe : 107|4@0+ (1.0,0.0) [0.0|15.0] "Unitless" ZCUP
 SG_ FrntSeatRecoveryFromSecSeatLe_UB : 96|1@0+ (1,0) [0|1] "" ZCUP
 SG_ FrntSeatRecoveryFromSecSeatRi : 91|4@0+ (1.0,0.0) [0.0|15.0] "Unitless" ZCUP
 SG_ FrntSeatRecoveryFromSecSeatRi_UB : 100|1@0+ (1,0) [0|1] "" ZCUP
 SG_ GVMCVehCtrlrSts_UB : 67|1@0+ (1,0) [0|1] "" IHU
 SG_ GVMCVehCtrlrStsChks : 63|8@0+ (1.0,0.0) [0.0|255.0] "Unitless" IHU
 SG_ GVMCVehCtrlrStsCntr : 71|4@0+ (1.0,0.0) [0.0|15.0] "Unitless" IHU
 SG_ GVMCVehCtrlrStsCtrlrSts : 55|8@0+ (1,0) [0|255] "" IHU
 SG_ IsgEngSpdOfActvDampg : 7|15@0+ (0.5,0.0) [0.0|16383.5] "rpm" IHU
 SG_ IsgEngSpdOfActvDampg_UB : 8|1@0+ (1,0) [0|1] "" IHU
 SG_ MeCnsAvgIndcdMeCnsIndcdVal3 : 76|13@0+ (0.1,0.0) [0.0|819.1] "LPer100kilometer_1" IHU
 SG_ MeCnsAvgIndcdMeCnsIndcdVal3_UB : 77|1@0+ (1,0) [0|1] "" IHU
 SG_ RowSecRiFldRsdSts : 127|3@0+ (1,0) [0|7] "" IHU
 SG_ RowSecRiFldRsdSts_UB : 124|1@0+ (1,0) [0|1] "" IHU
 SG_ TechLiWakeup : 46|1@0+ (1,0) [0|1] "" IHU
 SG_ TechLiWakeup_UB : 45|1@0+ (1,0) [0|1] "" IHU

BO_ 934 ZCUDZCUCANFD2Fr49 : 64 ZCUD
 SG_ FrntSunCurtFailr2_UB : 1|1@0+ (1,0) [0|1] "" IHU
 SG_ FrntSunCurtFailr2CurtMotFailr : 7|1@0+ (1,0) [0|1] "" IHU
 SG_ FrntSunCurtFailr2CurtMotHallFailr : 6|1@0+ (1,0) [0|1] "" IHU
 SG_ FrntSunCurtFailr2CurtMotHallNotAvl : 5|1@0+ (1,0) [0|1] "" IHU
 SG_ FrntSunCurtFailr2CurtMotNotAvl : 4|1@0+ (1,0) [0|1] "" IHU
 SG_ FrntSunCurtFailr2EcuFailrGen : 3|1@0+ (1,0) [0|1] "" IHU
 SG_ FrntSunCurtFailr2Resvd : 2|1@0+ (1,0) [0|1] "" IHU
 SG_ FrSunCurtImpctDetSts : 23|3@0+ (1,0) [0|7] "" IHU
 SG_ FrSunCurtImpctDetSts_UB : 20|1@0+ (1,0) [0|1] "" IHU
 SG_ GVMCPrpsnTqDistbnReqAtAxleRe_UB : 323|1@0+ (1,0) [0|1] "" IHU
 SG_ GVMCPrpsnTqDistbnReqAtAxleReChks : 303|8@0+ (1.0,0.0) [0.0|255.0] "Unitless" IHU
 SG_ GVMCPrpsnTqDistbnReqAtAxleReCntr : 327|4@0+ (1.0,0.0) [0.0|15.0] "Unitless" IHU
 SG_ GVMCPrpsnTqDistbnReqAtAxleReCtrlMod : 312|1@0+ (1,0) [0|1] "" IHU
 SG_ GVMCPrpsnTqDistbnReqAtAxleReDistReq : 311|15@0+ (0.00390625,0.0) [0.0|100.0] "%" IHU
 SG_ GVMCPrpsnTqDistReq_UB : 176|1@0+ (1,0) [0|1] "" IHU
 SG_ GVMCPrpsnTqDistReqChks : 167|8@0+ (1.0,0.0) [0.0|255.0] "Unitless" IHU
 SG_ GVMCPrpsnTqDistReqCntr : 155|4@0+ (1.0,0.0) [0.0|15.0] "Unitless" IHU
 SG_ GVMCPrpsnTqDistReqCtrlMod : 156|1@0+ (1,0) [0|1] "" IHU
 SG_ GVMCPrpsnTqDistReqDistReq : 175|15@0+ (0.00390625,0.0) [0.0|100.0] "%" IHU
 SG_ GVMCSteerWhlAgReqRe_UB : 288|1@0+ (1,0) [0|1] "" IHU
 SG_ GVMCSteerWhlAgReqReAgReqRe : 279|15@0- (0.001,0.0) [-16.384|16.383] "Deg" IHU
 SG_ GVMCSteerWhlAgReqReChks : 271|8@0+ (1.0,0.0) [0.0|255.0] "Unitless" IHU
 SG_ GVMCSteerWhlAgReqReCntr : 295|4@0+ (1.0,0.0) [0.0|15.0] "Unitless" IHU
 SG_ GVMCSteerWhlAgReqReCtrlModRe : 291|3@0+ (1,0) [0|7] "" IHU
 SG_ GVMCSuspDampgCtrlReq_UB : 252|1@0+ (1,0) [0|1] "" IHU
 SG_ GVMCSuspDampgCtrlReqGVMCDampgCtrlReqFL : 191|16@0- (1.0,0.0) [-20000.0|20000.0] "N" IHU
 SG_ GVMCSuspDampgCtrlReqGVMCDampgCtrlReqFR : 207|16@0- (1.0,0.0) [-20000.0|20000.0] "N" IHU
 SG_ GVMCSuspDampgCtrlReqGVMCDampgCtrlReqRL : 223|16@0- (1.0,0.0) [-20000.0|20000.0] "N" IHU
 SG_ GVMCSuspDampgCtrlReqGVMCDampgCtrlReqRR : 239|16@0- (1.0,0.0) [-20000.0|20000.0] "N" IHU
 SG_ GVMCSuspDampgCtrlReqGVMCSuspDampgCtrlMod : 255|1@0+ (1,0) [0|1] "" IHU
 SG_ GVMCSuspDampgCtrlReqGVMCSuspDampgModReq : 254|2@0+ (1,0) [0|3] "" IHU
 SG_ GVMCSuspStfnCtrlReq_UB : 258|1@0+ (1,0) [0|1] "" IHU
 SG_ GVMCSuspStfnCtrlReqGVMCSuspStfnCtrlMod : 259|1@0+ (1,0) [0|1] "" IHU
 SG_ GVMCSuspStfnCtrlReqGVMCSuspStfnReqFL : 261|2@0+ (1,0) [0|3] "" IHU
 SG_ GVMCSuspStfnCtrlReqGVMCSuspStfnReqFR : 263|2@0+ (1,0) [0|3] "" IHU
 SG_ GVMCSuspStfnCtrlReqGVMCSuspStfnReqRL : 249|2@0+ (1,0) [0|3] "" IHU
 SG_ GVMCSuspStfnCtrlReqGVMCSuspStfnReqRR : 251|2@0+ (1,0) [0|3] "" IHU
 SG_ ReSunCurtFailr2_UB : 0|1@0+ (1,0) [0|1] "" IHU
 SG_ ReSunCurtFailr2CurtMotFailr : 15|1@0+ (1,0) [0|1] "" IHU
 SG_ ReSunCurtFailr2CurtMotHallFailr : 14|1@0+ (1,0) [0|1] "" IHU
 SG_ ReSunCurtFailr2CurtMotHallNotAvl : 13|1@0+ (1,0) [0|1] "" IHU
 SG_ ReSunCurtFailr2CurtMotNotAvl : 12|1@0+ (1,0) [0|1] "" IHU
 SG_ ReSunCurtFailr2EcuFailrGen : 11|1@0+ (1,0) [0|1] "" IHU
 SG_ ReSunCurtFailr2Resvd : 10|1@0+ (1,0) [0|1] "" IHU
 SG_ ReSunCurtImpctDetnSts : 18|3@0+ (1,0) [0|7] "" IHU
 SG_ ReSunCurtImpctDetnSts_UB : 19|1@0+ (1,0) [0|1] "" IHU
 SG_ SnsrInclnSts_UB : 33|1@0+ (1,0) [0|1] "" IHU
 SG_ SnsrInclnStsAlrmSts : 35|1@0+ (1,0) [0|1] "" IHU
 SG_ SnsrInclnStsArmSts : 34|1@0+ (1,0) [0|1] "" IHU
 SG_ SnsrInclnStsCfgSts : 39|2@0+ (1,0) [0|3] "" IHU
 SG_ SnsrInclnStsSnsrInclnErrSts : 37|2@0+ (1,0) [0|3] "" IHU
 SG_ SnsrIntrScanSts_UB : 24|1@0+ (1,0) [0|1] "" IHU
 SG_ SnsrIntrScanStsAlrmReq : 27|1@0+ (1,0) [0|1] "" IHU
 SG_ SnsrIntrScanStsArmSts : 26|1@0+ (1,0) [0|1] "" IHU
 SG_ SnsrIntrScanStsCfgSts : 31|2@0+ (1,0) [0|3] "" IHU
 SG_ SnsrIntrScanStsSnsrInclnExist : 25|1@0+ (1,0) [0|1] "" IHU
 SG_ SnsrIntrScanStsSnsrIntrScanErrSts : 29|2@0+ (1,0) [0|3] "" IHU
 SG_ SRSResdSig1ToZCUDMSafety_UB : 32|1@0+ (1,0) [0|1] "" IHU
 SG_ SRSResdSig1ToZCUDMSafetyChks : 79|8@0+ (1.0,0.0) [0.0|255.0] "Unitless" IHU
 SG_ SRSResdSig1ToZCUDMSafetyCntr : 87|4@0+ (1.0,0.0) [0.0|15.0] "Unitless" IHU
 SG_ SRSResdSig1ToZCUDMSafetyUInt32 : 47|32@0+ (1.0,0.0) [0.0|4294967295.0] "Unitless" IHU
 SG_ StsOfLedPosnLampLe1 : 95|2@0+ (1,0) [0|3] "" IHU
 SG_ StsOfLedPosnLampLe1_UB : 83|1@0+ (1,0) [0|1] "" IHU
 SG_ StsOfLedPosnLampRi1 : 93|2@0+ (1,0) [0|3] "" IHU
 SG_ StsOfLedPosnLampRi1_UB : 82|1@0+ (1,0) [0|1] "" IHU
 SG_ StsOfLedReFogLampLe1 : 91|2@0+ (1,0) [0|3] "" IHU
 SG_ StsOfLedReFogLampLe1_UB : 81|1@0+ (1,0) [0|1] "" IHU
 SG_ StsOfLedReFogLampRi1 : 89|2@0+ (1,0) [0|3] "" IHU
 SG_ StsOfLedReFogLampRi1_UB : 80|1@0+ (1,0) [0|1] "" IHU
 SG_ StsOfLedReLampLe1 : 103|2@0+ (1,0) [0|3] "" IHU
 SG_ StsOfLedReLampLe1_UB : 111|1@0+ (1,0) [0|1] "" IHU
 SG_ StsOfLedReLampRi1 : 101|2@0+ (1,0) [0|3] "" IHU
 SG_ StsOfLedReLampRi1_UB : 110|1@0+ (1,0) [0|1] "" IHU
 SG_ StsOfLedRvsgLampLe1 : 99|2@0+ (1,0) [0|3] "" IHU
 SG_ StsOfLedRvsgLampLe1_UB : 109|1@0+ (1,0) [0|1] "" IHU
 SG_ StsOfLedRvsgLampRi1 : 97|2@0+ (1,0) [0|3] "" IHU
 SG_ StsOfLedRvsgLampRi1_UB : 108|1@0+ (1,0) [0|1] "" IHU
 SG_ StsOfLedStopLampLe1 : 119|2@0+ (1,0) [0|3] "" IHU
 SG_ StsOfLedStopLampLe1_UB : 107|1@0+ (1,0) [0|1] "" IHU
 SG_ StsOfLedStopLampRi1 : 117|2@0+ (1,0) [0|3] "" IHU
 SG_ StsOfLedStopLampRi1_UB : 106|1@0+ (1,0) [0|1] "" IHU
 SG_ StsOfLedTurnIndcrLe1 : 115|2@0+ (1,0) [0|3] "" IHU
 SG_ StsOfLedTurnIndcrLe1_UB : 105|1@0+ (1,0) [0|1] "" IHU
 SG_ StsOfLedTurnIndcrRi1 : 113|2@0+ (1,0) [0|3] "" IHU
 SG_ StsOfLedTurnIndcrRi1_UB : 104|1@0+ (1,0) [0|1] "" IHU
 SG_ StsOfWelGbyReLe1 : 127|1@0+ (1,0) [0|1] "" IHU
 SG_ StsOfWelGbyReLe1_UB : 126|1@0+ (1,0) [0|1] "" IHU
 SG_ StsOfWelGbyReRi1 : 125|1@0+ (1,0) [0|1] "" IHU
 SG_ StsOfWelGbyReRi1_UB : 124|1@0+ (1,0) [0|1] "" IHU
 SG_ TrlrBrkLiSts : 123|1@0+ (1,0) [0|1] "" IHU
 SG_ TrlrBrkLiSts_UB : 122|1@0+ (1,0) [0|1] "" IHU
 SG_ TrlrFogLiSts : 121|1@0+ (1,0) [0|1] "" IHU
 SG_ TrlrFogLiSts_UB : 120|1@0+ (1,0) [0|1] "" IHU
 SG_ TrlrIndcrTurnSts : 159|2@0+ (1,0) [0|3] "" IHU
 SG_ TrlrIndcrTurnSts_UB : 157|1@0+ (1,0) [0|1] "" IHU
 SG_ TrlrLeIndcrFltSts : 135|1@0+ (1,0) [0|1] "" IHU
 SG_ TrlrLeIndcrFltSts_UB : 134|1@0+ (1,0) [0|1] "" IHU
 SG_ TrlrPosnLiSts : 133|1@0+ (1,0) [0|1] "" IHU
 SG_ TrlrPosnLiSts_UB : 132|1@0+ (1,0) [0|1] "" IHU
 SG_ TrlrRiIndcrFltSts : 131|1@0+ (1,0) [0|1] "" IHU
 SG_ TrlrRiIndcrFltSts_UB : 130|1@0+ (1,0) [0|1] "" IHU
 SG_ TrlrRvsgLiSts : 129|1@0+ (1,0) [0|1] "" IHU
 SG_ TrlrRvsgLiSts_UB : 128|1@0+ (1,0) [0|1] "" IHU
 SG_ TrsmActrPosnSafe_UB : 144|1@0+ (1,0) [0|1] "" IHU
 SG_ TrsmActrPosnSafeTrsmActrPosn : 147|3@0+ (1,0) [0|7] "" IHU
 SG_ TrsmActrPosnSafeTrsmActrPosnChks : 143|8@0+ (1.0,0.0) [0.0|255.0] "Unitless" IHU
 SG_ TrsmActrPosnSafeTrsmActrPosnCntr : 151|4@0+ (1.0,0.0) [0.0|15.0] "Unitless" IHU
 SG_ TwbrRelsBtn : 9|1@0+ (1,0) [0|1] "" IHU
 SG_ TwbrRelsBtn_UB : 8|1@0+ (1,0) [0|1] "" IHU

BO_ 1180 ZCUDZCUCANFD2Fr50 : 64 ZCUD
 SG_ FanDiagFltSts : 55|5@0+ (1,0) [0|31] "" IHU
 SG_ FanDiagFltSts_UB : 50|1@0+ (1,0) [0|1] "" IHU
 SG_ FrntCurtOpenPosnCmd : 63|5@0+ (1,0) [0|31] "" IHU
 SG_ FrntCurtOpenPosnCmd_UB : 58|1@0+ (1,0) [0|1] "" IHU
 SG_ HctvFltSts : 71|5@0+ (1,0) [0|31] "" IHU
 SG_ HctvFltSts_UB : 66|1@0+ (1,0) [0|1] "" IHU
 SG_ HcwpFltSts : 79|5@0+ (1,0) [0|31] "" IHU
 SG_ HcwpFltSts_UB : 74|1@0+ (1,0) [0|1] "" IHU
 SG_ HeatModeReq4Batt : 49|1@0+ (1,0) [0|1] "" IHU
 SG_ HeatModeReq4Batt_UB : 48|1@0+ (1,0) [0|1] "" IHU
 SG_ HeatModeReq4Hp : 57|1@0+ (1,0) [0|1] "" IHU
 SG_ HeatModeReq4Hp_UB : 56|1@0+ (1,0) [0|1] "" IHU
 SG_ RearCurtOpenPosnCmd : 143|5@0+ (1,0) [0|31] "" IHU
 SG_ RearCurtOpenPosnCmd_UB : 138|1@0+ (1,0) [0|1] "" IHU
 SG_ RefrigModeDes : 87|8@0+ (1,0) [0|255] "" IHU
 SG_ RefrigModeDes_UB : 65|1@0+ (1,0) [0|1] "" IHU
 SG_ RefrigModeReq : 95|8@0+ (1,0) [0|255] "" IHU
 SG_ RefrigModeReq_UB : 64|1@0+ (1,0) [0|1] "" IHU
 SG_ RefrigModeReqSwt : 103|8@0+ (1,0) [0|255] "" IHU
 SG_ RefrigModeReqSwt_UB : 73|1@0+ (1,0) [0|1] "" IHU
 SG_ RefrigModeSts : 111|8@0+ (1,0) [0|255] "" IHU
 SG_ RefrigModeSts_UB : 72|1@0+ (1,0) [0|1] "" IHU
 SG_ RefrigModeSwt : 42|1@0+ (1,0) [0|1] "" IHU
 SG_ RefrigModeSwt_UB : 41|1@0+ (1,0) [0|1] "" IHU
 SG_ SnrCalChillerOutT : 119|11@0+ (0.1,-40.0) [-40.0|140.0] "degC" IHU
 SG_ SnrCalChillerOutT_UB : 124|1@0+ (1,0) [0|1] "" IHU
 SG_ SnrCalClntTforInrCondOut : 122|11@0+ (0.1,-40.0) [-40.0|140.0] "degC" IHU
 SG_ SnrCalClntTforInrCondOut_UB : 123|1@0+ (1,0) [0|1] "" IHU
 SG_ SnrCalEvapOutT : 151|11@0+ (0.1,-40.0) [-40.0|140.0] "degC" IHU
 SG_ SnrCalEvapOutT_UB : 137|1@0+ (1,0) [0|1] "" IHU
 SG_ SnrCalHiSideP : 156|13@0+ (1.0,0.0) [0.0|5000.0] "KiloPa" IHU
 SG_ SnrCalHiSideP_UB : 136|1@0+ (1,0) [0|1] "" IHU
 SG_ SnrCalHiSideT : 175|11@0+ (0.1,-40.0) [-40.0|140.0] "degC" IHU
 SG_ SnrCalHiSideT_UB : 193|1@0+ (1,0) [0|1] "" IHU
 SG_ SnrCalLoSideP : 180|13@0+ (1.0,0.0) [0.0|5000.0] "KiloPa" IHU
 SG_ SnrCalLoSideP_UB : 192|1@0+ (1,0) [0|1] "" IHU
 SG_ TcsDoorEleBailReq : 207|2@0+ (1,0) [0|3] "" IHU
 SG_ TcsDoorEleBailReq_UB : 205|1@0+ (1,0) [0|1] "" IHU
 SG_ TcsModSwtReq : 203|2@0+ (1,0) [0|3] "" IHU
 SG_ TcsModSwtReq_UB : 204|1@0+ (1,0) [0|1] "" IHU
 SG_ TcsTmrOverReq : 199|5@0+ (1.0,0.0) [0.0|31.0] "hours" IHU
 SG_ TcsTmrOverReq_UB : 194|1@0+ (1,0) [0|1] "" IHU
 SG_ ZCUDMResdSig1ToSRSSafety_UB : 43|1@0+ (1,0) [0|1] "" IHU
 SG_ ZCUDMResdSig1ToSRSSafetyChks : 39|8@0+ (1.0,0.0) [0.0|255.0] "Unitless" IHU
 SG_ ZCUDMResdSig1ToSRSSafetyCntr : 47|4@0+ (1.0,0.0) [0.0|15.0] "Unitless" IHU
 SG_ ZCUDMResdSig1ToSRSSafetyUInt32 : 7|32@0+ (1.0,0.0) [0.0|4294967295.0] "Unitless" IHU

CM_ SG_ 813 VFCVectorHVSCBlockID "BlockID";
CM_ SG_ 813 VFCVectorHVSCVFCid0 "SettingsComfort";
CM_ SG_ 813 VFCVectorHVSCVFCid1 "ParkingDrivingClimatization";
CM_ SG_ 813 VFCVectorHVSCVFCid10 "ExteriorLighting";
CM_ SG_ 813 VFCVectorHVSCVFCid11 "VFC11";
CM_ SG_ 813 VFCVectorHVSCVFCid12 "Alarm";
CM_ SG_ 813 VFCVectorHVSCVFCid13 "VFC13";
CM_ SG_ 813 VFCVectorHVSCVFCid14 "InteriorLighting";
CM_ SG_ 813 VFCVectorHVSCVFCid15 "VFC15";
CM_ SG_ 813 VFCVectorHVSCVFCid16 "Locking";
CM_ SG_ 813 VFCVectorHVSCVFCid17 "emoteKeyFunctionality";
CM_ SG_ 813 VFCVectorHVSCVFCid18 "PropulsionStart";
CM_ SG_ 813 VFCVectorHVSCVFCid19 "VFC19";
CM_ SG_ 813 VFCVectorHVSCVFCid2 "PostClimatisation";
CM_ SG_ 813 VFCVectorHVSCVFCid20 "VFC20";
CM_ SG_ 813 VFCVectorHVSCVFCid21 "PowerClosures";
CM_ SG_ 813 VFCVectorHVSCVFCid22 "VehicleDriving";
CM_ SG_ 813 VFCVectorHVSCVFCid23 "VFC23";
CM_ SG_ 813 VFCVectorHVSCVFCid24 "SettingsProfile";
CM_ SG_ 813 VFCVectorHVSCVFCid25 "SeatComfortFunctions";
CM_ SG_ 813 VFCVectorHVSCVFCid26 "Brake";
CM_ SG_ 813 VFCVectorHVSCVFCid27 "InfotainmentPoll";
CM_ SG_ 813 VFCVectorHVSCVFCid28 "HVEnergyStorage";
CM_ SG_ 813 VFCVectorHVSCVFCid29 "VFC29";
CM_ SG_ 813 VFCVectorHVSCVFCid3 "PowertrainParkingClimatization";
CM_ SG_ 813 VFCVectorHVSCVFCid30 "TelematicsConnectivity";
CM_ SG_ 813 VFCVectorHVSCVFCid31 "VFC31";
CM_ SG_ 813 VFCVectorHVSCVFCid32 "VFC32";
CM_ SG_ 813 VFCVectorHVSCVFCid33 "Diagnostics";
CM_ SG_ 813 VFCVectorHVSCVFCid34 "VehicleModeManagement";
CM_ SG_ 813 VFCVectorHVSCVFCid35 "TrailerCaravanFunctions";
CM_ SG_ 813 VFCVectorHVSCVFCid36 "Immobilizer";
CM_ SG_ 813 VFCVectorHVSCVFCid37 "Windows";
CM_ SG_ 813 VFCVectorHVSCVFCid38 "Visibility";
CM_ SG_ 813 VFCVectorHVSCVFCid39 "VFC39";
CM_ SG_ 813 VFCVectorHVSCVFCid4 "VFC4";
CM_ SG_ 813 VFCVectorHVSCVFCid40 "VFC40";
CM_ SG_ 813 VFCVectorHVSCVFCid41 "InfotainmentPush";
CM_ SG_ 813 VFCVectorHVSCVFCid42 "ChargingHV";
CM_ SG_ 813 VFCVectorHVSCVFCid43 "BodyPreClimatisation";
CM_ SG_ 813 VFCVectorHVSCVFCid44 "Crash";
CM_ SG_ 813 VFCVectorHVSCVFCid45 "GlobalShortDuration";
CM_ SG_ 813 VFCVectorHVSCVFCid46 "ExteriorLightsHazard";
CM_ SG_ 813 VFCVectorHVSCVFCid47 "VFC47";
CM_ SG_ 813 VFCVectorHVSCVFCid48 "DoorOpenWarning";
CM_ SG_ 813 VFCVectorHVSCVFCid49 "ChargingLVInit";
CM_ SG_ 813 VFCVectorHVSCVFCid5 "VFC5";
CM_ SG_ 813 VFCVectorHVSCVFCid50 "VFC50";
CM_ SG_ 813 VFCVectorHVSCVFCid51 "VFC51";
CM_ SG_ 813 VFCVectorHVSCVFCid52 "HVBatteryThermalEventWarning";
CM_ SG_ 813 VFCVectorHVSCVFCid53 "VisualAssist";
CM_ SG_ 813 VFCVectorHVSCVFCid54 "PassiveSafety";
CM_ SG_ 813 VFCVectorHVSCVFCid55 "LifeDetection";
CM_ SG_ 813 VFCVectorHVSCVFCid56 "BackboneFlexray";
CM_ SG_ 813 VFCVectorHVSCVFCid57 "Functionmarket";
CM_ SG_ 813 VFCVectorHVSCVFCid58 "VFCid58";
CM_ SG_ 813 VFCVectorHVSCVFCid59 "VFCid59";
CM_ SG_ 813 VFCVectorHVSCVFCid6 "SettingsVehicle";
CM_ SG_ 813 VFCVectorHVSCVFCid60 "VFCid60";
CM_ SG_ 813 VFCVectorHVSCVFCid61 "VFCid61";
CM_ SG_ 813 VFCVectorHVSCVFCid7 "VFC7";
CM_ SG_ 813 VFCVectorHVSCVFCid8 "VFC8";
CM_ SG_ 813 VFCVectorHVSCVFCid9 "IPWakeup";
CM_ SG_ 813 VFCVectorHWAMBlockID "BlockID";
CM_ SG_ 813 VFCVectorHWAMVFCid0 "SettingsComfort";
CM_ SG_ 813 VFCVectorHWAMVFCid1 "ParkingDrivingClimatization";
CM_ SG_ 813 VFCVectorHWAMVFCid10 "ExteriorLighting";
CM_ SG_ 813 VFCVectorHWAMVFCid11 "VFC11";
CM_ SG_ 813 VFCVectorHWAMVFCid12 "Alarm";
CM_ SG_ 813 VFCVectorHWAMVFCid13 "VFC13";
CM_ SG_ 813 VFCVectorHWAMVFCid14 "InteriorLighting";
CM_ SG_ 813 VFCVectorHWAMVFCid15 "VFC15";
CM_ SG_ 813 VFCVectorHWAMVFCid16 "Locking";
CM_ SG_ 813 VFCVectorHWAMVFCid17 "emoteKeyFunctionality";
CM_ SG_ 813 VFCVectorHWAMVFCid18 "PropulsionStart";
CM_ SG_ 813 VFCVectorHWAMVFCid19 "VFC19";
CM_ SG_ 813 VFCVectorHWAMVFCid2 "PostClimatisation";
CM_ SG_ 813 VFCVectorHWAMVFCid20 "VFC20";
CM_ SG_ 813 VFCVectorHWAMVFCid21 "PowerClosures";
CM_ SG_ 813 VFCVectorHWAMVFCid22 "VehicleDriving";
CM_ SG_ 813 VFCVectorHWAMVFCid23 "VFC23";
CM_ SG_ 813 VFCVectorHWAMVFCid24 "SettingsProfile";
CM_ SG_ 813 VFCVectorHWAMVFCid25 "SeatComfortFunctions";
CM_ SG_ 813 VFCVectorHWAMVFCid26 "Brake";
CM_ SG_ 813 VFCVectorHWAMVFCid27 "InfotainmentPoll";
CM_ SG_ 813 VFCVectorHWAMVFCid28 "HVEnergyStorage";
CM_ SG_ 813 VFCVectorHWAMVFCid29 "VFC29";
CM_ SG_ 813 VFCVectorHWAMVFCid3 "PowertrainParkingClimatization";
CM_ SG_ 813 VFCVectorHWAMVFCid30 "TelematicsConnectivity";
CM_ SG_ 813 VFCVectorHWAMVFCid31 "VFC31";
CM_ SG_ 813 VFCVectorHWAMVFCid32 "VFC32";
CM_ SG_ 813 VFCVectorHWAMVFCid33 "Diagnostics";
CM_ SG_ 813 VFCVectorHWAMVFCid34 "VehicleModeManagement";
CM_ SG_ 813 VFCVectorHWAMVFCid35 "TrailerCaravanFunctions";
CM_ SG_ 813 VFCVectorHWAMVFCid36 "Immobilizer";
CM_ SG_ 813 VFCVectorHWAMVFCid37 "Windows";
CM_ SG_ 813 VFCVectorHWAMVFCid38 "Visibility";
CM_ SG_ 813 VFCVectorHWAMVFCid39 "VFC39";
CM_ SG_ 813 VFCVectorHWAMVFCid4 "VFC4";
CM_ SG_ 813 VFCVectorHWAMVFCid40 "VFC40";
CM_ SG_ 813 VFCVectorHWAMVFCid41 "InfotainmentPush";
CM_ SG_ 813 VFCVectorHWAMVFCid42 "ChargingHV";
CM_ SG_ 813 VFCVectorHWAMVFCid43 "BodyPreClimatisation";
CM_ SG_ 813 VFCVectorHWAMVFCid44 "Crash";
CM_ SG_ 813 VFCVectorHWAMVFCid45 "GlobalShortDuration";
CM_ SG_ 813 VFCVectorHWAMVFCid46 "ExteriorLightsHazard";
CM_ SG_ 813 VFCVectorHWAMVFCid47 "VFC47";
CM_ SG_ 813 VFCVectorHWAMVFCid48 "DoorOpenWarning";
CM_ SG_ 813 VFCVectorHWAMVFCid49 "ChargingLVInit";
CM_ SG_ 813 VFCVectorHWAMVFCid5 "VFC5";
CM_ SG_ 813 VFCVectorHWAMVFCid50 "VFC50";
CM_ SG_ 813 VFCVectorHWAMVFCid51 "VFC51";
CM_ SG_ 813 VFCVectorHWAMVFCid52 "HVBatteryThermalEventWarning";
CM_ SG_ 813 VFCVectorHWAMVFCid53 "VisualAssist";
CM_ SG_ 813 VFCVectorHWAMVFCid54 "PassiveSafety";
CM_ SG_ 813 VFCVectorHWAMVFCid55 "LifeDetection";
CM_ SG_ 813 VFCVectorHWAMVFCid56 "BackboneFlexray";
CM_ SG_ 813 VFCVectorHWAMVFCid57 "Functionmarket";
CM_ SG_ 813 VFCVectorHWAMVFCid58 "VFCid58";
CM_ SG_ 813 VFCVectorHWAMVFCid59 "VFCid59";
CM_ SG_ 813 VFCVectorHWAMVFCid6 "SettingsVehicle";
CM_ SG_ 813 VFCVectorHWAMVFCid60 "VFCid60";
CM_ SG_ 813 VFCVectorHWAMVFCid61 "VFCid61";
CM_ SG_ 813 VFCVectorHWAMVFCid7 "VFC7";
CM_ SG_ 813 VFCVectorHWAMVFCid8 "VFC8";
CM_ SG_ 813 VFCVectorHWAMVFCid9 "IPWakeup";
CM_ SG_ 836 SecDcDcChas1DataEvtACnt "HVSC cloud big data";
CM_ SG_ 836 SecDcDcChas1DataEvtAData1 "HVSC cloud big data";
CM_ SG_ 836 SecDcDcChas1DataEvtAData2 "HVSC cloud big data";
CM_ SG_ 836 SecDcDcChas1DataEvtAData3 "HVSC cloud big data";
CM_ SG_ 836 SecDcDcChas1DataEvtAData4 "HVSC cloud big data";
CM_ SG_ 836 SecDcDcChas1DataEvtAData5 "HVSC cloud big data";
CM_ SG_ 836 SecDcDcChas1DataEvtAData6 "HVSC cloud big data";
CM_ SG_ 836 SecDcDcChas1DataEvtAID "HVSC cloud big data";
CM_ SG_ 836 SecDcDcChas1DataPrdACnt "HVSC cloud big data";
CM_ SG_ 836 SecDcDcChas1DataPrdAData1 "HVSC cloud big data";
CM_ SG_ 836 SecDcDcChas1DataPrdAData2 "HVSC cloud big data";
CM_ SG_ 836 SecDcDcChas1DataPrdAData3 "HVSC cloud big data";
CM_ SG_ 836 SecDcDcChas1DataPrdAData4 "HVSC cloud big data";
CM_ SG_ 836 SecDcDcChas1DataPrdAData5 "HVSC cloud big data";
CM_ SG_ 836 SecDcDcChas1DataPrdAData6 "HVSC cloud big data";
CM_ SG_ 836 SecDcDcChas1DataPrdAData7 "HVSC cloud big data";
CM_ SG_ 836 VFCVectorCMDBlockID "BlockID";
CM_ SG_ 836 VFCVectorCMDVFCid0 "SettingsComfort";
CM_ SG_ 836 VFCVectorCMDVFCid1 "ParkingDrivingClimatization";
CM_ SG_ 836 VFCVectorCMDVFCid10 "ExteriorLighting";
CM_ SG_ 836 VFCVectorCMDVFCid11 "VFC11";
CM_ SG_ 836 VFCVectorCMDVFCid12 "Alarm";
CM_ SG_ 836 VFCVectorCMDVFCid13 "VFC13";
CM_ SG_ 836 VFCVectorCMDVFCid14 "InteriorLighting";
CM_ SG_ 836 VFCVectorCMDVFCid15 "VFC15";
CM_ SG_ 836 VFCVectorCMDVFCid16 "Locking";
CM_ SG_ 836 VFCVectorCMDVFCid17 "emoteKeyFunctionality";
CM_ SG_ 836 VFCVectorCMDVFCid18 "PropulsionStart";
CM_ SG_ 836 VFCVectorCMDVFCid19 "VFC19";
CM_ SG_ 836 VFCVectorCMDVFCid2 "PostClimatisation";
CM_ SG_ 836 VFCVectorCMDVFCid20 "VFC20";
CM_ SG_ 836 VFCVectorCMDVFCid21 "PowerClosures";
CM_ SG_ 836 VFCVectorCMDVFCid22 "VehicleDriving";
CM_ SG_ 836 VFCVectorCMDVFCid23 "VFC23";
CM_ SG_ 836 VFCVectorCMDVFCid24 "SettingsProfile";
CM_ SG_ 836 VFCVectorCMDVFCid25 "SeatComfortFunctions";
CM_ SG_ 836 VFCVectorCMDVFCid26 "Brake";
CM_ SG_ 836 VFCVectorCMDVFCid27 "InfotainmentPoll";
CM_ SG_ 836 VFCVectorCMDVFCid28 "HVEnergyStorage";
CM_ SG_ 836 VFCVectorCMDVFCid29 "VFC29";
CM_ SG_ 836 VFCVectorCMDVFCid3 "PowertrainParkingClimatization";
CM_ SG_ 836 VFCVectorCMDVFCid30 "TelematicsConnectivity";
CM_ SG_ 836 VFCVectorCMDVFCid31 "VFC31";
CM_ SG_ 836 VFCVectorCMDVFCid32 "VFC32";
CM_ SG_ 836 VFCVectorCMDVFCid33 "Diagnostics";
CM_ SG_ 836 VFCVectorCMDVFCid34 "VehicleModeManagement";
CM_ SG_ 836 VFCVectorCMDVFCid35 "TrailerCaravanFunctions";
CM_ SG_ 836 VFCVectorCMDVFCid36 "Immobilizer";
CM_ SG_ 836 VFCVectorCMDVFCid37 "Windows";
CM_ SG_ 836 VFCVectorCMDVFCid38 "Visibility";
CM_ SG_ 836 VFCVectorCMDVFCid39 "VFC39";
CM_ SG_ 836 VFCVectorCMDVFCid4 "VFC4";
CM_ SG_ 836 VFCVectorCMDVFCid40 "VFC40";
CM_ SG_ 836 VFCVectorCMDVFCid41 "InfotainmentPush";
CM_ SG_ 836 VFCVectorCMDVFCid42 "ChargingHV";
CM_ SG_ 836 VFCVectorCMDVFCid43 "BodyPreClimatisation";
CM_ SG_ 836 VFCVectorCMDVFCid44 "Crash";
CM_ SG_ 836 VFCVectorCMDVFCid45 "GlobalShortDuration";
CM_ SG_ 836 VFCVectorCMDVFCid46 "ExteriorLightsHazard";
CM_ SG_ 836 VFCVectorCMDVFCid47 "VFC47";
CM_ SG_ 836 VFCVectorCMDVFCid48 "DoorOpenWarning";
CM_ SG_ 836 VFCVectorCMDVFCid49 "ChargingLVInit";
CM_ SG_ 836 VFCVectorCMDVFCid5 "VFC5";
CM_ SG_ 836 VFCVectorCMDVFCid50 "VFC50";
CM_ SG_ 836 VFCVectorCMDVFCid51 "VFC51";
CM_ SG_ 836 VFCVectorCMDVFCid52 "HVBatteryThermalEventWarning";
CM_ SG_ 836 VFCVectorCMDVFCid53 "VisualAssist";
CM_ SG_ 836 VFCVectorCMDVFCid54 "PassiveSafety";
CM_ SG_ 836 VFCVectorCMDVFCid55 "LifeDetection";
CM_ SG_ 836 VFCVectorCMDVFCid56 "BackboneFlexray";
CM_ SG_ 836 VFCVectorCMDVFCid57 "Functionmarket";
CM_ SG_ 836 VFCVectorCMDVFCid58 "VFCid58";
CM_ SG_ 836 VFCVectorCMDVFCid59 "VFCid59";
CM_ SG_ 836 VFCVectorCMDVFCid6 "SettingsVehicle";
CM_ SG_ 836 VFCVectorCMDVFCid60 "VFCid60";
CM_ SG_ 836 VFCVectorCMDVFCid61 "VFCid61";
CM_ SG_ 836 VFCVectorCMDVFCid7 "VFC7";
CM_ SG_ 836 VFCVectorCMDVFCid8 "VFC8";
CM_ SG_ 836 VFCVectorCMDVFCid9 "IPWakeup";
CM_ SG_ 836 VFCVectorCMPBlockID "BlockID";
CM_ SG_ 836 VFCVectorCMPVFCid0 "SettingsComfort";
CM_ SG_ 836 VFCVectorCMPVFCid1 "ParkingDrivingClimatization";
CM_ SG_ 836 VFCVectorCMPVFCid10 "ExteriorLighting";
CM_ SG_ 836 VFCVectorCMPVFCid11 "VFC11";
CM_ SG_ 836 VFCVectorCMPVFCid12 "Alarm";
CM_ SG_ 836 VFCVectorCMPVFCid13 "VFC13";
CM_ SG_ 836 VFCVectorCMPVFCid14 "InteriorLighting";
CM_ SG_ 836 VFCVectorCMPVFCid15 "VFC15";
CM_ SG_ 836 VFCVectorCMPVFCid16 "Locking";
CM_ SG_ 836 VFCVectorCMPVFCid17 "emoteKeyFunctionality";
CM_ SG_ 836 VFCVectorCMPVFCid18 "PropulsionStart";
CM_ SG_ 836 VFCVectorCMPVFCid19 "VFC19";
CM_ SG_ 836 VFCVectorCMPVFCid2 "PostClimatisation";
CM_ SG_ 836 VFCVectorCMPVFCid20 "VFC20";
CM_ SG_ 836 VFCVectorCMPVFCid21 "PowerClosures";
CM_ SG_ 836 VFCVectorCMPVFCid22 "VehicleDriving";
CM_ SG_ 836 VFCVectorCMPVFCid23 "VFC23";
CM_ SG_ 836 VFCVectorCMPVFCid24 "SettingsProfile";
CM_ SG_ 836 VFCVectorCMPVFCid25 "SeatComfortFunctions";
CM_ SG_ 836 VFCVectorCMPVFCid26 "Brake";
CM_ SG_ 836 VFCVectorCMPVFCid27 "InfotainmentPoll";
CM_ SG_ 836 VFCVectorCMPVFCid28 "HVEnergyStorage";
CM_ SG_ 836 VFCVectorCMPVFCid29 "VFC29";
CM_ SG_ 836 VFCVectorCMPVFCid3 "PowertrainParkingClimatization";
CM_ SG_ 836 VFCVectorCMPVFCid30 "TelematicsConnectivity";
CM_ SG_ 836 VFCVectorCMPVFCid31 "VFC31";
CM_ SG_ 836 VFCVectorCMPVFCid32 "VFC32";
CM_ SG_ 836 VFCVectorCMPVFCid33 "Diagnostics";
CM_ SG_ 836 VFCVectorCMPVFCid34 "VehicleModeManagement";
CM_ SG_ 836 VFCVectorCMPVFCid35 "TrailerCaravanFunctions";
CM_ SG_ 836 VFCVectorCMPVFCid36 "Immobilizer";
CM_ SG_ 836 VFCVectorCMPVFCid37 "Windows";
CM_ SG_ 836 VFCVectorCMPVFCid38 "Visibility";
CM_ SG_ 836 VFCVectorCMPVFCid39 "VFC39";
CM_ SG_ 836 VFCVectorCMPVFCid4 "VFC4";
CM_ SG_ 836 VFCVectorCMPVFCid40 "VFC40";
CM_ SG_ 836 VFCVectorCMPVFCid41 "InfotainmentPush";
CM_ SG_ 836 VFCVectorCMPVFCid42 "ChargingHV";
CM_ SG_ 836 VFCVectorCMPVFCid43 "BodyPreClimatisation";
CM_ SG_ 836 VFCVectorCMPVFCid44 "Crash";
CM_ SG_ 836 VFCVectorCMPVFCid45 "GlobalShortDuration";
CM_ SG_ 836 VFCVectorCMPVFCid46 "ExteriorLightsHazard";
CM_ SG_ 836 VFCVectorCMPVFCid47 "VFC47";
CM_ SG_ 836 VFCVectorCMPVFCid48 "DoorOpenWarning";
CM_ SG_ 836 VFCVectorCMPVFCid49 "ChargingLVInit";
CM_ SG_ 836 VFCVectorCMPVFCid5 "VFC5";
CM_ SG_ 836 VFCVectorCMPVFCid50 "VFC50";
CM_ SG_ 836 VFCVectorCMPVFCid51 "VFC51";
CM_ SG_ 836 VFCVectorCMPVFCid52 "HVBatteryThermalEventWarning";
CM_ SG_ 836 VFCVectorCMPVFCid53 "VisualAssist";
CM_ SG_ 836 VFCVectorCMPVFCid54 "PassiveSafety";
CM_ SG_ 836 VFCVectorCMPVFCid55 "LifeDetection";
CM_ SG_ 836 VFCVectorCMPVFCid56 "BackboneFlexray";
CM_ SG_ 836 VFCVectorCMPVFCid57 "Functionmarket";
CM_ SG_ 836 VFCVectorCMPVFCid58 "VFCid58";
CM_ SG_ 836 VFCVectorCMPVFCid59 "VFCid59";
CM_ SG_ 836 VFCVectorCMPVFCid6 "SettingsVehicle";
CM_ SG_ 836 VFCVectorCMPVFCid60 "VFCid60";
CM_ SG_ 836 VFCVectorCMPVFCid61 "VFCid61";
CM_ SG_ 836 VFCVectorCMPVFCid7 "VFC7";
CM_ SG_ 836 VFCVectorCMPVFCid8 "VFC8";
CM_ SG_ 836 VFCVectorCMPVFCid9 "IPWakeup";
CM_ SG_ 836 VFCVectorSDLBlockID "BlockID";
CM_ SG_ 836 VFCVectorSDLVFCid0 "SettingsComfort";
CM_ SG_ 836 VFCVectorSDLVFCid1 "ParkingDrivingClimatization";
CM_ SG_ 836 VFCVectorSDLVFCid10 "ExteriorLighting";
CM_ SG_ 836 VFCVectorSDLVFCid11 "VFC11";
CM_ SG_ 836 VFCVectorSDLVFCid12 "Alarm";
CM_ SG_ 836 VFCVectorSDLVFCid13 "VFC13";
CM_ SG_ 836 VFCVectorSDLVFCid14 "InteriorLighting";
CM_ SG_ 836 VFCVectorSDLVFCid15 "VFC15";
CM_ SG_ 836 VFCVectorSDLVFCid16 "Locking";
CM_ SG_ 836 VFCVectorSDLVFCid17 "RemoteKeyFunctionality";
CM_ SG_ 836 VFCVectorSDLVFCid18 "PropulsionStart";
CM_ SG_ 836 VFCVectorSDLVFCid19 "VFC19";
CM_ SG_ 836 VFCVectorSDLVFCid2 "PostClimatisation";
CM_ SG_ 836 VFCVectorSDLVFCid20 "VFC20";
CM_ SG_ 836 VFCVectorSDLVFCid21 "PowerClosures";
CM_ SG_ 836 VFCVectorSDLVFCid22 "VehicleDriving";
CM_ SG_ 836 VFCVectorSDLVFCid23 "VFC23";
CM_ SG_ 836 VFCVectorSDLVFCid24 "SettingsProfile";
CM_ SG_ 836 VFCVectorSDLVFCid25 "SeatComfortFunctions";
CM_ SG_ 836 VFCVectorSDLVFCid26 "Brake";
CM_ SG_ 836 VFCVectorSDLVFCid27 "InfotainmentPoll";
CM_ SG_ 836 VFCVectorSDLVFCid28 "HVEnergyStorage";
CM_ SG_ 836 VFCVectorSDLVFCid29 "VFC29";
CM_ SG_ 836 VFCVectorSDLVFCid3 "PowertrainParkingClimatization";
CM_ SG_ 836 VFCVectorSDLVFCid30 "TelematicsConnectivity";
CM_ SG_ 836 VFCVectorSDLVFCid31 "VFC31";
CM_ SG_ 836 VFCVectorSDLVFCid32 "VFC32";
CM_ SG_ 836 VFCVectorSDLVFCid33 "Diagnostics";
CM_ SG_ 836 VFCVectorSDLVFCid34 "VehicleModeManagement";
CM_ SG_ 836 VFCVectorSDLVFCid35 "TrailerCaravanFunctions";
CM_ SG_ 836 VFCVectorSDLVFCid36 "Immobilizer";
CM_ SG_ 836 VFCVectorSDLVFCid37 "Windows";
CM_ SG_ 836 VFCVectorSDLVFCid38 "Visibility";
CM_ SG_ 836 VFCVectorSDLVFCid39 "VFC39";
CM_ SG_ 836 VFCVectorSDLVFCid4 "VFC4";
CM_ SG_ 836 VFCVectorSDLVFCid40 "VFC40";
CM_ SG_ 836 VFCVectorSDLVFCid41 "InfotainmentPush";
CM_ SG_ 836 VFCVectorSDLVFCid42 "ChargingHV";
CM_ SG_ 836 VFCVectorSDLVFCid43 "BodyPreClimatisation";
CM_ SG_ 836 VFCVectorSDLVFCid44 "Crash";
CM_ SG_ 836 VFCVectorSDLVFCid45 "GlobalShortDuration";
CM_ SG_ 836 VFCVectorSDLVFCid46 "ExteriorLightsHazard";
CM_ SG_ 836 VFCVectorSDLVFCid47 "VFC47";
CM_ SG_ 836 VFCVectorSDLVFCid48 "DoorOpenWarning";
CM_ SG_ 836 VFCVectorSDLVFCid49 "ChargingLVInit";
CM_ SG_ 836 VFCVectorSDLVFCid5 "VFC5";
CM_ SG_ 836 VFCVectorSDLVFCid50 "VFC50";
CM_ SG_ 836 VFCVectorSDLVFCid51 "VFC51";
CM_ SG_ 836 VFCVectorSDLVFCid52 "HVBatteryThermalEventWarning";
CM_ SG_ 836 VFCVectorSDLVFCid53 "VisualAssist";
CM_ SG_ 836 VFCVectorSDLVFCid54 "PassiveSafety";
CM_ SG_ 836 VFCVectorSDLVFCid55 "LifeDetection";
CM_ SG_ 836 VFCVectorSDLVFCid56 "BackboneFlexray";
CM_ SG_ 836 VFCVectorSDLVFCid57 "Functionmarket";
CM_ SG_ 836 VFCVectorSDLVFCid58 "VFCid58";
CM_ SG_ 836 VFCVectorSDLVFCid59 "VFCid59";
CM_ SG_ 836 VFCVectorSDLVFCid6 "SettingsVehicle";
CM_ SG_ 836 VFCVectorSDLVFCid60 "VFCid60";
CM_ SG_ 836 VFCVectorSDLVFCid61 "VFCid61";
CM_ SG_ 836 VFCVectorSDLVFCid7 "VFC7";
CM_ SG_ 836 VFCVectorSDLVFCid8 "VFC8";
CM_ SG_ 836 VFCVectorSDLVFCid9 "IPWakeup";
CM_ SG_ 836 VFCVectorSDRBlockID "BlockID";
CM_ SG_ 836 VFCVectorSDRVFCid0 "SettingsComfort";
CM_ SG_ 836 VFCVectorSDRVFCid1 "ParkingDrivingClimatization";
CM_ SG_ 836 VFCVectorSDRVFCid10 "ExteriorLighting";
CM_ SG_ 836 VFCVectorSDRVFCid11 "VFC11";
CM_ SG_ 836 VFCVectorSDRVFCid12 "Alarm";
CM_ SG_ 836 VFCVectorSDRVFCid13 "VFC13";
CM_ SG_ 836 VFCVectorSDRVFCid14 "InteriorLighting";
CM_ SG_ 836 VFCVectorSDRVFCid15 "VFC15";
CM_ SG_ 836 VFCVectorSDRVFCid16 "Locking";
CM_ SG_ 836 VFCVectorSDRVFCid17 "RemoteKeyFunctionality";
CM_ SG_ 836 VFCVectorSDRVFCid18 "PropulsionStart";
CM_ SG_ 836 VFCVectorSDRVFCid19 "VFC19";
CM_ SG_ 836 VFCVectorSDRVFCid2 "PostClimatisation";
CM_ SG_ 836 VFCVectorSDRVFCid20 "VFC20";
CM_ SG_ 836 VFCVectorSDRVFCid21 "PowerClosures";
CM_ SG_ 836 VFCVectorSDRVFCid22 "VehicleDriving";
CM_ SG_ 836 VFCVectorSDRVFCid23 "VFC23";
CM_ SG_ 836 VFCVectorSDRVFCid24 "SettingsProfile";
CM_ SG_ 836 VFCVectorSDRVFCid25 "SeatComfortFunctions";
CM_ SG_ 836 VFCVectorSDRVFCid26 "Brake";
CM_ SG_ 836 VFCVectorSDRVFCid27 "InfotainmentPoll";
CM_ SG_ 836 VFCVectorSDRVFCid28 "HVEnergyStorage";
CM_ SG_ 836 VFCVectorSDRVFCid29 "VFC29";
CM_ SG_ 836 VFCVectorSDRVFCid3 "PowertrainParkingClimatization";
CM_ SG_ 836 VFCVectorSDRVFCid30 "TelematicsConnectivity";
CM_ SG_ 836 VFCVectorSDRVFCid31 "VFC31";
CM_ SG_ 836 VFCVectorSDRVFCid32 "VFC32";
CM_ SG_ 836 VFCVectorSDRVFCid33 "Diagnostics";
CM_ SG_ 836 VFCVectorSDRVFCid34 "VehicleModeManagement";
CM_ SG_ 836 VFCVectorSDRVFCid35 "TrailerCaravanFunctions";
CM_ SG_ 836 VFCVectorSDRVFCid36 "Immobilizer";
CM_ SG_ 836 VFCVectorSDRVFCid37 "Windows";
CM_ SG_ 836 VFCVectorSDRVFCid38 "Visibility";
CM_ SG_ 836 VFCVectorSDRVFCid39 "VFC39";
CM_ SG_ 836 VFCVectorSDRVFCid4 "VFC4";
CM_ SG_ 836 VFCVectorSDRVFCid40 "VFC40";
CM_ SG_ 836 VFCVectorSDRVFCid41 "InfotainmentPush";
CM_ SG_ 836 VFCVectorSDRVFCid42 "ChargingHV";
CM_ SG_ 836 VFCVectorSDRVFCid43 "BodyPreClimatisation";
CM_ SG_ 836 VFCVectorSDRVFCid44 "Crash";
CM_ SG_ 836 VFCVectorSDRVFCid45 "GlobalShortDuration";
CM_ SG_ 836 VFCVectorSDRVFCid46 "ExteriorLightsHazard";
CM_ SG_ 836 VFCVectorSDRVFCid47 "VFC47";
CM_ SG_ 836 VFCVectorSDRVFCid48 "DoorOpenWarning";
CM_ SG_ 836 VFCVectorSDRVFCid49 "ChargingLVInit";
CM_ SG_ 836 VFCVectorSDRVFCid5 "VFC5";
CM_ SG_ 836 VFCVectorSDRVFCid50 "VFC50";
CM_ SG_ 836 VFCVectorSDRVFCid51 "VFC51";
CM_ SG_ 836 VFCVectorSDRVFCid52 "HVBatteryThermalEventWarning";
CM_ SG_ 836 VFCVectorSDRVFCid53 "VisualAssist";
CM_ SG_ 836 VFCVectorSDRVFCid54 "PassiveSafety";
CM_ SG_ 836 VFCVectorSDRVFCid55 "LifeDetection";
CM_ SG_ 836 VFCVectorSDRVFCid56 "BackboneFlexray";
CM_ SG_ 836 VFCVectorSDRVFCid57 "Functionmarket";
CM_ SG_ 836 VFCVectorSDRVFCid58 "VFCid58";
CM_ SG_ 836 VFCVectorSDRVFCid59 "VFCid59";
CM_ SG_ 836 VFCVectorSDRVFCid6 "SettingsVehicle";
CM_ SG_ 836 VFCVectorSDRVFCid60 "VFCid60";
CM_ SG_ 836 VFCVectorSDRVFCid61 "VFCid61";
CM_ SG_ 836 VFCVectorSDRVFCid7 "VFC7";
CM_ SG_ 836 VFCVectorSDRVFCid8 "VFC8";
CM_ SG_ 836 VFCVectorSDRVFCid9 "IPWakeup";
CM_ SG_ 928 ExtrLiShowActvnReLeFb "Activation Exterior Light Show Feedback";
CM_ SG_ 928 ExtrLiShowActvnReRiFb "Activation Exterior Light Show Feedback";
CM_ SG_ 928 ZCUDSResdSig10ToZCUDM "ZCUDSResdSig10ToZCUDM";
CM_ SG_ 928 ZCUDSResdSig11ToZCUDM "ZCUDSResdSig11ToZCUDM";
CM_ SG_ 928 ZCUDSResdSig12ToZCUDM "ZCUDSResdSig12ToZCUDM";
CM_ SG_ 928 ZCUDSResdSig13ToZCUDM "ZCUDSResdSig13ToZCUDM";
CM_ SG_ 928 ZCUDSResdSig14ToZCUDM "ZCUDSResdSig14ToZCUDM";
CM_ SG_ 928 ZCUDSResdSig15ToZCUDM "ZCUDSResdSig15ToZCUDM";
CM_ SG_ 928 ZCUDSResdSig16ToZCUDM "ZCUDSResdSig16ToZCUDM";
CM_ SG_ 928 ZCUDSResdSig17ToZCUDM "ZCUDSResdSig17ToZCUDM";
CM_ SG_ 928 ZCUDSResdSig18ToZCUDM "ZCUDSResdSig18ToZCUDM";
CM_ SG_ 928 ZCUDSResdSig19ToZCUDM "ZCUDSResdSig19ToZCUDM";
CM_ SG_ 928 ZCUDSResdSig1ToZCUDM "ZCUDSResdSig1ToZCUDM";
CM_ SG_ 928 ZCUDSResdSig20ToZCUDM "ZCUDSResdSig20ToZCUDM";
CM_ SG_ 928 ZCUDSResdSig21ToZCUDM "ZCUDSResdSig21ToZCUDM";
CM_ SG_ 928 ZCUDSResdSig22ToZCUDMSafetyChks "ZCUDSResdSig22ToZCUDMSafety";
CM_ SG_ 928 ZCUDSResdSig22ToZCUDMSafetyCntr "ZCUDSResdSig22ToZCUDMSafety";
CM_ SG_ 928 ZCUDSResdSig22ToZCUDMSafetyUInt64 "ZCUDSResdSig22ToZCUDMSafety";
CM_ SG_ 928 ZCUDSResdSig2ToZCUDM "ZCUDSResdSig2ToZCUDM";
CM_ SG_ 928 ZCUDSResdSig3ToZCUDM "ZCUDSResdSig3ToZCUDM";
CM_ SG_ 928 ZCUDSResdSig4ToZCUDM "ZCUDSResdSig4ToZCUDM";
CM_ SG_ 928 ZCUDSResdSig5ToZCUDM "ZCUDSResdSig5ToZCUDM";
CM_ SG_ 928 ZCUDSResdSig6ToZCUDM "ZCUDSResdSig6ToZCUDM";
CM_ SG_ 928 ZCUDSResdSig7ToZCUDM "ZCUDSResdSig7ToZCUDM";
CM_ SG_ 928 ZCUDSResdSig8ToZCUDM "ZCUDSResdSig8ToZCUDM";
CM_ SG_ 928 ZCUDSResdSig9ToZCUDM "ZCUDSResdSig9ToZCUDM";
CM_ SG_ 1177 ExvFltSts "EXV fault and status";
CM_ SG_ 1177 ZCUDMResdSig10ToZCUDS "ZCUDMResdSig10ToZCUDS";
CM_ SG_ 1177 ZCUDMResdSig11ToZCUDS "ZCUDMResdSig11ToZCUDS";
CM_ SG_ 1177 ZCUDMResdSig12ToZCUDS "ZCUDMResdSig12ToZCUDS";
CM_ SG_ 1177 ZCUDMResdSig13ToZCUDS "ZCUDMResdSig13ToZCUDS";
CM_ SG_ 1177 ZCUDMResdSig14ToZCUDS "ZCUDMResdSig14ToZCUDS";
CM_ SG_ 1177 ZCUDMResdSig15ToZCUDS "ZCUDMResdSig15ToZCUDS";
CM_ SG_ 1177 ZCUDMResdSig16ToZCUDS "ZCUDMResdSig16ToZCUDS";
CM_ SG_ 1177 ZCUDMResdSig17ToZCUDS "ZCUDMResdSig17ToZCUDS";
CM_ SG_ 1177 ZCUDMResdSig18ToZCUDS "ZCUDMResdSig18ToZCUDS";
CM_ SG_ 1177 ZCUDMResdSig19ToZCUDS "ZCUDMResdSig19ToZCUDS";
CM_ SG_ 1177 ZCUDMResdSig1ToZCUDS "ZCUDMResdSig1ToZCUDS";
CM_ SG_ 1177 ZCUDMResdSig20ToZCUDS "ZCUDMResdSig20ToZCUDS";
CM_ SG_ 1177 ZCUDMResdSig21ToZCUDS "ZCUDMResdSig21ToZCUDS";
CM_ SG_ 1177 ZCUDMResdSig22ToZCUDSSafetyChks "ZCUDMResdSig22ToZCUDSSafety";
CM_ SG_ 1177 ZCUDMResdSig22ToZCUDSSafetyCntr "ZCUDMResdSig22ToZCUDSSafety";
CM_ SG_ 1177 ZCUDMResdSig22ToZCUDSSafetyUInt64 "ZCUDMResdSig22ToZCUDSSafety";
CM_ SG_ 1177 ZCUDMResdSig2ToZCUDS "ZCUDMResdSig2ToZCUDS";
CM_ SG_ 1177 ZCUDMResdSig3ToZCUDS "ZCUDMResdSig3ToZCUDS";
CM_ SG_ 1177 ZCUDMResdSig4ToZCUDS "ZCUDMResdSig4ToZCUDS";
CM_ SG_ 1177 ZCUDMResdSig5ToZCUDS "ZCUDMResdSig5ToZCUDS";
CM_ SG_ 1177 ZCUDMResdSig6ToZCUDS "ZCUDMResdSig6ToZCUDS";
CM_ SG_ 1177 ZCUDMResdSig7ToZCUDS "ZCUDMResdSig7ToZCUDS";
CM_ SG_ 1177 ZCUDMResdSig8ToZCUDS "ZCUDMResdSig8ToZCUDS";
CM_ SG_ 1177 ZCUDMResdSig9ToZCUDS "ZCUDMResdSig9ToZCUDS";
CM_ SG_ 320 BotmSnsrStsFromFootOper "BotmSnsrStsFromFootOper - FMDM Bottom Electrode Status
Ok - Bottom Electrode is connected and no fault is detected
NotOk - Bottom Electrode is not connected, broken or short to GND or Ubat";
CM_ SG_ 320 DockColumGrayReqForTvc "Dock Column Gray Requsest.";
CM_ SG_ 320 GaGearAct "Actual gear for DHT Everest";
CM_ SG_ 320 LinCtrlForRowSecLeSeatAdjmt "Linkage Control Signal for Second Row Left Seat Adjustment";
CM_ SG_ 320 LinCtrlForRowSecRiSeatAdjmt "Linkage Control Signal for Second Row Right Seat Adjustment";
CM_ SG_ 320 LowrTailgOpenerSwt "Lower Tailgate/Bootlid switch status";
CM_ SG_ 320 MagChrgLidTip1 "Magnet charge lid tip 1(push less than 2s)";
CM_ SG_ 320 MagChrgLidTip2 "Magnet charge lid tip2 (charge lid is open)";
CM_ SG_ 320 NFCKeyReadStsToHMIKey0 "key read status";
CM_ SG_ 320 NFCKeyReadStsToHMIKey1 "key read status";
CM_ SG_ 320 NFCKeyReadStsToHMIKey10 "key read status";
CM_ SG_ 320 NFCKeyReadStsToHMIKey11 "key read status";
CM_ SG_ 320 NFCKeyReadStsToHMIKey12 "key read status";
CM_ SG_ 320 NFCKeyReadStsToHMIKey13 "key read status";
CM_ SG_ 320 NFCKeyReadStsToHMIKey14 "key read status";
CM_ SG_ 320 NFCKeyReadStsToHMIKey15 "key read status";
CM_ SG_ 320 NFCKeyReadStsToHMIKey2 "key read status";
CM_ SG_ 320 NFCKeyReadStsToHMIKey3 "key read status";
CM_ SG_ 320 NFCKeyReadStsToHMIKey4 "key read status";
CM_ SG_ 320 NFCKeyReadStsToHMIKey5 "key read status";
CM_ SG_ 320 NFCKeyReadStsToHMIKey6 "key read status";
CM_ SG_ 320 NFCKeyReadStsToHMIKey7 "key read status";
CM_ SG_ 320 NFCKeyReadStsToHMIKey8 "key read status";
CM_ SG_ 320 NFCKeyReadStsToHMIKey9 "key read status";
CM_ SG_ 320 PtCluTqCpReq1 "Torque capacity request 1";
CM_ SG_ 320 PtCluTqCpReq2 "Torque capacity request 2";
CM_ SG_ 320 PtDirAllwdToTrsmActrChks "Checksum for PtDirAllwdToTrsmActr";
CM_ SG_ 320 PtDirAllwdToTrsmActrCntr "Counter for PtDirAllwdToTrsmActr";
CM_ SG_ 320 PtDirAllwdToTrsmActrFwd "Powertrain direction allowance to transmission actuator Forward";
CM_ SG_ 320 PtDirAllwdToTrsmActrNeut "Powertrain direction allowance to transmission actuator Neutral";
CM_ SG_ 320 PtDirAllwdToTrsmActrParkRls "Powertrain direction allowance to transmission actuator Park Release";
CM_ SG_ 320 PtDirAllwdToTrsmActrRvs "Powertrain direction allowance to transmission actuator Reverse";
CM_ SG_ 320 PtEngTqAct "Engine Net torque actual without P1";
CM_ SG_ 320 PtGearActrAdpnCmd "Gear actuator adaptation allowed.";
CM_ SG_ 320 PtGearActtnAllwdSts1 " Drivetrain status 1";
CM_ SG_ 320 PtGearActtnAllwdSts2 " Drivetrain status 2";
CM_ SG_ 320 PtGearActtnModReq "Mode request";
CM_ SG_ 320 PtGearActtnPfmncReq "Performance request";
CM_ SG_ 320 PtGearActtnPrio "Gear engagement prioritization";
CM_ SG_ 320 PtGearActtnReq1 "Gear request 1";
CM_ SG_ 320 PtGearActtnReq2 "Gear request 2";
CM_ SG_ 320 RWA1ColAgTarAg "The target pinion angle which is calculated with the currently steering ratio and the column angle.";
CM_ SG_ 320 RWA1ColAgTarAgSpd "Converted pinion angle speed";
CM_ SG_ 320 RWA1ColAgTarChks "Checksum";
CM_ SG_ 320 RWA1ColAgTarCntr "Counter";
CM_ SG_ 320 RWA1ColAgTarQf "Quality factor";
CM_ SG_ 320 SbWDecoupldStsH1Chks "Checksum";
CM_ SG_ 320 SbWDecoupldStsH1Cntr "Counter";
CM_ SG_ 320 SbWDecoupldStsH1SbWDecoupldSts "To indicated  whether the steering wheel and road wheer are decoupled.";
CM_ SG_ 320 SbWErrReqH1Chks "Checksum";
CM_ SG_ 320 SbWErrReqH1Cntr "Counter";
CM_ SG_ 320 SbWErrReqH1ErrReq "The overall error status of SbW which is sent by HWAM.";
CM_ SG_ 320 SBWErrReqR1Chks "Checksum";
CM_ SG_ 320 SBWErrReqR1Cntr "Counter";
CM_ SG_ 320 SBWErrReqR1ErrReq "The overall error status of SbW which is sent by RWAM.";
CM_ SG_ 320 SumActv "VMM force all the ECUs into sleep mode during abandon. SUM must inform VMM if it is still running.";
CM_ SG_ 320 SupHeatTAct "Actual superheatT of refrigerant at the outlet of high voltage battery";
CM_ SG_ 320 TankTurnIndcnMsg "Tank turn reminder or warning message";
CM_ SG_ 320 TankTurnModStsChks "Checksum";
CM_ SG_ 320 TankTurnModStsCntr "Counter";
CM_ SG_ 320 TankTurnModStsTankTurnModSts "Tank turn control status";
CM_ SG_ 320 TrsmClu0FltIndcn "Shall include the corresponding C0 fault message";
CM_ SG_ 320 TrsmCluSlipStsOfClu0 "Transmission cluch slip actual status of C0";
CM_ SG_ 320 TrsmCluT1Qf "Clutch temperature 1 Clutch temperature quality factor 1";
CM_ SG_ 320 TrsmCluT1Val "Clutch temperature 1 Clutch temperature 1";
CM_ SG_ 320 TrsmCluT2Qf "Coding: -40 to 598,75. Estimated temperature is calculated within the clutch control software based upon the energy put into the clutch and the physical properties of the clutch that affect its ability to retain and dissipate heat. Clutch temperature quality factor 2";
CM_ SG_ 320 TrsmCluT2Val "Coding: -40 to 598,75. Estimated temperature is calculated within the clutch control software based upon the energy put into the clutch and the physical properties of the clutch that affect its ability to retain and dissipate heat. Clutch temperature 2";
CM_ SG_ 320 TrsmCluTqActOfClu0 "Clutch torque  actual  of clutch 0";
CM_ SG_ 320 TrsmCluTqCp1 "Actual torque capacity Actual torque capacity 1";
CM_ SG_ 320 TrsmCluTqCp2 "Actual torque capacity Actual torque capacity 2";
CM_ SG_ 320 TrsmDtModAct "the actual mode of the drivetrain";
CM_ SG_ 320 TrsmEngmtLimd3TrsmEngmtLimd "Reports if the gearbox is in a state with limited ability to transfer torque., e.g. engine standing still with open lockup.";
CM_ SG_ 320 TrsmEngmtLimd3TrsmEngmtLimdChks "Reports if the gearbox is in a state with limited ability to transfer torque., e.g. engine standing still with open lockup.";
CM_ SG_ 320 TrsmEngmtLimd3TrsmEngmtLimdCntr "Reports if the gearbox is in a state with limited ability to transfer torque., e.g. engine standing still with open lockup.";
CM_ SG_ 320 TrsmErrIndcnReq2 "TCM uses signal Transmission Error Indication Request to send a MIL-request to ECM. ECM will then act upon this request and iluminate the MIL. For VEP software, TCM transmits signal after two consecutive failed driving cycles (for a MIL-relevant code).  Default value - 0 (Off)";
CM_ SG_ 320 TrsmGbxActrOff "Gearbox actuator off";
CM_ SG_ 320 TrsmGearActrScanForRefActv "Gear actuator adaption in progress";
CM_ SG_ 320 TrsmGearActrScanForRefReq "Gear actuator adaption request";
CM_ SG_ 320 TrsmGearActrTLvl "Gear actuator temperature level";
CM_ SG_ 320 TrsmGearNotAvlSts2 "TCM use signal Trsm Gear Not Available Status to inform ECM which gears is unavailable for gear shifting.Signal is used during failsafe operation Availability mode.Default 0-no gears unavailable.Bit 0-First gear EB not available.Bit 1-First gear not available.Bit X-Xth gear not available";
CM_ SG_ 320 TrsmHardRotReq1 "Hard antibalking request 1";
CM_ SG_ 320 TrsmModNotAvlSts3 "TCM uses signal Transmissions Mode Not Available Status to inform ECM which modes are unavailable";
CM_ SG_ 320 TrsmNRecChks "E2E checksum";
CM_ SG_ 320 TrsmNRecCntr "Data counter";
CM_ SG_ 320 TrsmNRecInp1 "Transmission input / output speed and direction Transmission input speed 1";
CM_ SG_ 320 TrsmNRecInp2 "Transmission input / output speed and direction Transmission input speed 2";
CM_ SG_ 320 TrsmNRecInpDir1 "Transmission input / output speed and direction Transmission input speed direction 1";
CM_ SG_ 320 TrsmNRecInpDir2 "Transmission input / output speed and direction Transmission input speed direction 2";
CM_ SG_ 320 TrsmNRecInpQf1 "Transmission input / output speed and direction Transmission input speed quality factor 1";
CM_ SG_ 320 TrsmNRecInpQf2 "Transmission input / output speed and direction Transmission input speed quality factor 2";
CM_ SG_ 320 TrsmNRecOutp "Transmission input / output speed and direction Transmission output speed";
CM_ SG_ 320 TrsmNRecOutpDir "Transmission input / output speed and direction Transmission output speed direction";
CM_ SG_ 320 TrsmNRecOutpQf "Transmission input / output speed and direction Transmission output speed quality factor";
CM_ SG_ 320 TrsmOutpNChks "Checksum";
CM_ SG_ 320 TrsmOutpNCntr "rolling counter";
CM_ SG_ 320 TrsmOutpNDir "Transmission outputshaft direction 0 is the forward direction";
CM_ SG_ 320 TrsmOutpNSpd "Tansmission output shaft speed";
CM_ SG_ 320 TrsmOutpNSpdQf "Transmission outputshaft speed signal quality factor";
CM_ SG_ 320 TrsmSelfLrngMod "Transmission Self Learning Mode.";
CM_ SG_ 463 DftlFltIndcn "Differential system fault indication";
CM_ SG_ 463 EldtPmpCmdCooltPmpPostRunReq "Coolant pump post run request.";
CM_ SG_ 463 EldtPmpCmdCooltPmpSpdReq "Coolant pump speed request.";
CM_ SG_ 463 EngCooltPmpSpdReqCooltPmpPostRunReq "Coolant pump post run request";
CM_ SG_ 463 EngCooltPmpSpdReqCooltPmpSpdReq "Coolant pump speed request.";
CM_ SG_ 463 EngIdleCtrlRefVal "Reference speed for idle speed controler.";
CM_ SG_ 463 EngPmpStatCooltPmpDryErr "water pump MT Dryrun error";
CM_ SG_ 463 EngPmpStatCooltPmpEmgyModSts "water pump MT, Status Emergency mode";
CM_ SG_ 463 EngPmpStatCooltPmpErrSts "water pump error status";
CM_ SG_ 463 EngPmpStatCooltPmpI "Actual current consumption";
CM_ SG_ 463 EngPmpStatCooltPmpIErr "water pump MT current error";
CM_ SG_ 463 EngPmpStatCooltPmpMonrSpd "water pump MT, RPM Monitoring";
CM_ SG_ 463 EngPmpStatCooltPmpPostRunSts "water pump post run status";
CM_ SG_ 463 EngPmpStatCooltPmpSetPostRunReq "water pump set post run speed request";
CM_ SG_ 463 EngPmpStatCooltPmpSetSpdReq "water pump MT Set speed";
CM_ SG_ 463 EngPmpStatCooltPmpSpd "Actual speed from coolant pump";
CM_ SG_ 463 EngPmpStatCooltPmpT "water pump MT Temperature";
CM_ SG_ 463 EngPmpStatCooltPmpTErr "water pump MT temperature error";
CM_ SG_ 463 EngPmpStatCooltPmpU "water pump MT Voltage";
CM_ SG_ 463 EngPmpStatCooltPmpUErr "water pump MT voltage error";
CM_ SG_ 463 EngPmpStatCooltPmpUnstallSts "water pump MT, Deblocking";
CM_ SG_ 463 FootwellLiSts "foot well light status feed back";
CM_ SG_ 463 HvBattSocEngStart "Low SOC engine start point in HEV drive mode.";
CM_ SG_ 463 PtCluSlipCmdOfClu0 "Clutch C0 mode request, Reserve for other cases, current only used for Tip in C0 slip";
CM_ SG_ 463 PtCluSlipTarReqOfClu0 "Clutch C0 slip target request (Unit: rpm)";
CM_ SG_ 463 SldngDoorLeReModSts "Left Rear Sliding Door Electrical or Manual Mode Status";
CM_ SG_ 463 SldngDoorRiReModSts "Right Rear Sliding Door Electrical or Manual Mode Status";
CM_ SG_ 463 TankTurnActIndcnMsgForBrkFrntWhl "Tank U-turns often show a request in classical Chinese for brake front wheel.";
CM_ SG_ 463 TankTurnActIndcnMsgForBrkReWhl "Tank U-turns often show a request in classical Chinese for brake rear wheel.";
CM_ SG_ 463 TankTurnIndcnMsgForBrkFrntWhl "Tank turn reminder or warning message for brake front wheel.";
CM_ SG_ 463 TankTurnIndcnMsgForBrkReWhl "Tank turn reminder or warning message for brake rear wheel.";
CM_ SG_ 463 TireFilFilSwt "filter switch";
CM_ SG_ 463 TireFilNoiseFlrSwt "noise floor switch";
CM_ SG_ 463 TireFilPollingMod "polling mode";
CM_ SG_ 463 TireFilRxSwt "receive switch";
CM_ SG_ 463 TireFilSnsrID "sensor ID";
CM_ SG_ 463 TrLockStsRadar "TrLockStsRadar - Tailgate or Tonneau Cover lock status
LockStsUkwn (Lock Status Unknown) - Lock status of tailgate/Tonneau Cover Unknown
Unlckd - Tailgate/Tonneau Cover is unlocked
Lockd - Tailgate/Tonneau Cover is locked
SafeLockd - Not used for Tailgate/Tonneau Cover";
CM_ SG_ 463 TrsmClu0StsChks "Shall include the corresponding status of Clutch 0";
CM_ SG_ 463 TrsmClu0StsCntr "Shall include the corresponding status of Clutch 0";
CM_ SG_ 463 TrsmClu0StsTrsm0CluSts "Shall include the corresponding status of Clutch 0";
CM_ SG_ 463 TrsmGearActSafeChks "Transmission Gear Actual. Actual gear engaged sent by transmission supplier.";
CM_ SG_ 463 TrsmGearActSafeCntr "Transmission Gear Actual. Actual gear engaged sent by transmission supplier.";
CM_ SG_ 463 TrsmGearActSafeTrsmGearActSafe "Transmission Gear Actual. Actual gear engaged sent by transmission supplier.";
CM_ SG_ 463 TrsmHardRotReq2 "Hard antibalking request 2";
CM_ SG_ 463 TrsmLockMgrWarnlndcn "Trsm warning message to be shown in DIM";
CM_ SG_ 463 TrsmModNotAvlSts2 "TCM uses signal Transmissions Mode Not Available Status to inform ECM which modes are unavailable (Neutral, Reverse, Drive, LockUp stuck-Off or LockUp stuck-On). Default value - 0 (no modes unavailable). Bit 0 - 7";
CM_ SG_ 463 WcacVlvPosSetReq "WCAC three-way valve position request.";
CM_ SG_ 463 WcacVlvRefDrvReq "WCAC three-way valve reference drive request to learn mechanical stops.
";
CM_ SG_ 523 AirPtcHVPwrActlFristLe "Measured power consumption of the front left HVAH.
";
CM_ SG_ 523 AirPtcHVPwrActlFristRi "Measured power consumption of the front right HVAH.";
CM_ SG_ 523 AirPtcHVPwrActlSecLe "Measured power consumption of the back rows HVAH.";
CM_ SG_ 523 CmprReqCmprRunReq "Ac compressor run request.";
CM_ SG_ 523 CurtBtnSts "SunCurt switch position";
CM_ SG_ 523 DrvrSeatActvSwtFctMod "Driver Seat Active Integrated Switch Mode";
CM_ SG_ 523 DrvrSeatIntgrSwtStsIntgrSwtHozlSts "Seat Integrated Horizontal Switch Status";
CM_ SG_ 523 DrvrSeatIntgrSwtStsIntgrSwtRotSts "Seat Integrated Rotary Switch Status";
CM_ SG_ 523 DrvrSeatIntgrSwtStsIntgrSwtSelnSts "Seat Integrated Selector Switch Status";
CM_ SG_ 523 DrvrSeatIntgrSwtStsIntgrSwtVertSts "Seat Integrated Vertical Switch Status";
CM_ SG_ 523 EngPwrNormDes "The current desired normal power consumption of power train.";
CM_ SG_ 523 FrCurtBtnSts "FrCurt switch position";
CM_ SG_ 523 HpBattVlvPosSetReq "Battery three-way valve position request.";
CM_ SG_ 523 HpBattVlvRefDrvReq "Battery three-way valve reference drive request to learn mechanical stops.";
CM_ SG_ 523 IsgMotCooltFlowReq "Flow request for coolant to the CISG";
CM_ SG_ 523 PassAirbLampStsRecPassAirbLampSts "Signals if there is a HW fault, SW fault or signaling fault related to the PAD and PAE indication lamps.";
CM_ SG_ 523 PassAirbLampStsRecPassAirbLampStsChks "Ones complement of the data and counter in the signal group.";
CM_ SG_ 523 PassAirbLampStsRecPassAirbLampStsCntr "Counter that increases for each updated (not necessarily changed) value.";
CM_ SG_ 523 RainSnsrLiThd "Rain sensor light threshold settings can be changed through this signal.";
CM_ SG_ 523 ReAirPtcEnad "Air PTC operation allowed flag.";
CM_ SG_ 523 ReAirPtcHvPwrReq "Air PTC target HV power request";
CM_ SG_ 523 ReCurtBtnSts "ReCurt switch position";
CM_ SG_ 523 RoofBtnSts "SunRoof switch position";
CM_ SG_ 523 TrRelsReq "TrRelsReq - Tailgate or Bootlid Release Request

Request to release the tailgate or bootlid.

On  Release request
Off  No release request
Invalid1and2  No release request";
CM_ SG_ 1197 ActvnOfApproachInEITL "Activate approach dynamic light";
CM_ SG_ 1197 ActvnOfCarLoctrInEITL "Activate dynamic effection of FPDM during car locate function";
CM_ SG_ 1197 ActvReSplrPosn "To indicate the Active Rear Spoiler Position";
CM_ SG_ 1197 CeilingShieldSwt1 "CeilingShieldSwt";
CM_ SG_ 1197 EITLActvnCaseDurgDrv "Smart running light function";
CM_ SG_ 1197 ElecMot2ActvDampgGain "Generator motor active damping mode gain";
CM_ SG_ 1197 ElecMot2EngSpdOfActvDampg "Generator motor reference speed of active damping";
CM_ SG_ 1197 FrntSeatLinReqFromSecSeatLe "Request front seat link move";
CM_ SG_ 1197 FrntSeatLinReqFromSecSeatRi "Request front seat link move";
CM_ SG_ 1197 FrntSeatLinStopFromSecSeatLe "Request front seat link moving to stop";
CM_ SG_ 1197 FrntSeatLinStopFromSecSeatRi "Request front seat link moving to stop";
CM_ SG_ 1197 FrntSeatRecoveryFromSecSeatLe "Request front seat recovery";
CM_ SG_ 1197 FrntSeatRecoveryFromSecSeatRi "Request front seat recovery";
CM_ SG_ 1197 GVMCVehCtrlrStsChks "GVMC vehicle controler Status Chks";
CM_ SG_ 1197 GVMCVehCtrlrStsCntr "GVMC vehicle controler Status Cntr";
CM_ SG_ 1197 GVMCVehCtrlrStsCtrlrSts "GVMC vehicle control status";
CM_ SG_ 1197 IsgEngSpdOfActvDampg "Engine speed target for ISG damping function.";
CM_ SG_ 1197 MeCnsAvgIndcdMeCnsIndcdVal3 "Average methanol Consumption signa for Trip Statistics";
CM_ SG_ 1197 RowSecRiFldRsdSts "Second Row Right Seat Fold Raised Status";
CM_ SG_ 1197 TechLiWakeup "technology light wakeup indicator";
CM_ SG_ 934 FrntSunCurtFailr2CurtMotFailr "Curtain motor short circuit";
CM_ SG_ 934 FrntSunCurtFailr2CurtMotHallFailr "Curtain motor hall sensor short circuit";
CM_ SG_ 934 FrntSunCurtFailr2CurtMotHallNotAvl "Curtain motor hall sensor open circuit";
CM_ SG_ 934 FrntSunCurtFailr2CurtMotNotAvl "Curtain motor open circuit";
CM_ SG_ 934 FrntSunCurtFailr2EcuFailrGen "General failure in the ECU";
CM_ SG_ 934 FrntSunCurtFailr2Resvd "Resevered value, not used";
CM_ SG_ 934 FrSunCurtImpctDetSts "Pinch and impact detection. ";
CM_ SG_ 934 GVMCPrpsnTqDistbnReqAtAxleReChks "GVMC rear axle propulsion torque distribution request chks";
CM_ SG_ 934 GVMCPrpsnTqDistbnReqAtAxleReCntr "GVMC rear axle propulsion torque distribution request cntr";
CM_ SG_ 934 GVMCPrpsnTqDistbnReqAtAxleReCtrlMod "Rear axle right and left wheel torque distribution request control mode";
CM_ SG_ 934 GVMCPrpsnTqDistbnReqAtAxleReDistReq "GVMC rear axle propulsion torque distribution request";
CM_ SG_ 934 GVMCPrpsnTqDistReqChks "GVMC front and rear axle propulsion torque distribution request chks";
CM_ SG_ 934 GVMCPrpsnTqDistReqCntr "GVMC front and rear axle propulsion torque distribution request cntr";
CM_ SG_ 934 GVMCPrpsnTqDistReqCtrlMod "Front and rear torque distribution control mode";
CM_ SG_ 934 GVMCPrpsnTqDistReqDistReq "GVMC front and rear axle propulsion torque distribution request";
CM_ SG_ 934 GVMCSteerWhlAgReqReAgReqRe "GVMC steering wheel angle request rear";
CM_ SG_ 934 GVMCSteerWhlAgReqReChks "GVMC steering wheel angle request rear chks";
CM_ SG_ 934 GVMCSteerWhlAgReqReCntr "GVMC steering wheel angle request rear cntr";
CM_ SG_ 934 GVMCSteerWhlAgReqReCtrlModRe "GVMC steering wheel angle request rear control mode";
CM_ SG_ 934 GVMCSuspDampgCtrlReqGVMCDampgCtrlReqFL "GVMC Suspension damping control request front left";
CM_ SG_ 934 GVMCSuspDampgCtrlReqGVMCDampgCtrlReqFR "GVMC Suspension damping control request front right";
CM_ SG_ 934 GVMCSuspDampgCtrlReqGVMCDampgCtrlReqRL "GVMC Suspension damping control request rear left";
CM_ SG_ 934 GVMCSuspDampgCtrlReqGVMCDampgCtrlReqRR "GVMC Suspension damping control request rear right";
CM_ SG_ 934 GVMCSuspDampgCtrlReqGVMCSuspDampgCtrlMod "GVMC Suspension damping control mode";
CM_ SG_ 934 GVMCSuspDampgCtrlReqGVMCSuspDampgModReq "GVMC Suspension damping control request";
CM_ SG_ 934 GVMCSuspStfnCtrlReqGVMCSuspStfnCtrlMod "GVMC suspension stiffness control mode";
CM_ SG_ 934 GVMCSuspStfnCtrlReqGVMCSuspStfnReqFL "GVMC suspension stiffness request front left";
CM_ SG_ 934 GVMCSuspStfnCtrlReqGVMCSuspStfnReqFR "GVMC suspension stiffness request front right";
CM_ SG_ 934 GVMCSuspStfnCtrlReqGVMCSuspStfnReqRL "GVMC suspension stiffness request rear left";
CM_ SG_ 934 GVMCSuspStfnCtrlReqGVMCSuspStfnReqRR "GVMC suspension stiffness request rear right";
CM_ SG_ 934 ReSunCurtFailr2CurtMotFailr "Curtain motor short circuit";
CM_ SG_ 934 ReSunCurtFailr2CurtMotHallFailr "Curtain motor hall sensor short circuit";
CM_ SG_ 934 ReSunCurtFailr2CurtMotHallNotAvl "Curtain motor hall sensor open circuit";
CM_ SG_ 934 ReSunCurtFailr2CurtMotNotAvl "Curtain motor open circuit";
CM_ SG_ 934 ReSunCurtFailr2EcuFailrGen "General failure in the ECU";
CM_ SG_ 934 ReSunCurtFailr2Resvd "Resevered value, not used";
CM_ SG_ 934 ReSunCurtImpctDetnSts "Pinch and impact detection. ";
CM_ SG_ 934 SnsrInclnStsAlrmSts "Inclination sensor status signal, including arm status, trigger status, error status and configuration status.";
CM_ SG_ 934 SnsrInclnStsArmSts "Inclination sensor status signal, including arm status, trigger status, error status and configuration status.";
CM_ SG_ 934 SnsrInclnStsCfgSts "Inclination sensor status signal, including arm status, trigger status, error status and configuration status.";
CM_ SG_ 934 SnsrInclnStsSnsrInclnErrSts "Inclination sensor status signal, including arm status, trigger status, error status and configuration status.";
CM_ SG_ 934 SnsrIntrScanStsAlrmReq "IMS status signal, including arm status, trigger status, internal fault status, calibration status and if inclination sensor exists.";
CM_ SG_ 934 SnsrIntrScanStsArmSts "IMS status signal, including arm status, trigger status, internal fault status, calibration status and if inclination sensor exists.";
CM_ SG_ 934 SnsrIntrScanStsCfgSts "IMS status signal, including arm status, trigger status, internal fault status, calibration status and if inclination sensor exists.";
CM_ SG_ 934 SnsrIntrScanStsSnsrInclnExist "IMS status signal, including arm status, trigger status, internal fault status, calibration status and if inclination sensor exists.";
CM_ SG_ 934 SnsrIntrScanStsSnsrIntrScanErrSts "IMS status signal, including arm status, trigger status, internal fault status, calibration status and if inclination sensor exists.";
CM_ SG_ 934 SRSResdSig1ToZCUDMSafetyChks "SRSResdSig1ToZCUDMSafety";
CM_ SG_ 934 SRSResdSig1ToZCUDMSafetyCntr "SRSResdSig1ToZCUDMSafety";
CM_ SG_ 934 SRSResdSig1ToZCUDMSafetyUInt32 "SRSResdSig1ToZCUDMSafety";
CM_ SG_ 934 StsOfLedPosnLampLe1 "Status of Led Position Lamp Left 1. ";
CM_ SG_ 934 StsOfLedPosnLampRi1 "Status of Led Position Lamp Right 1. ";
CM_ SG_ 934 StsOfLedReFogLampLe1 "Status of Led Rear Fog Lampp Left 1.";
CM_ SG_ 934 StsOfLedReFogLampRi1 "Status of Led Rear Fog Lamp Right. ";
CM_ SG_ 934 StsOfLedReLampLe1 "Status Of LED Rear Lamp Left 1.";
CM_ SG_ 934 StsOfLedReLampRi1 "Status Of LED Rear Lamp Right 1.";
CM_ SG_ 934 StsOfLedRvsgLampLe1 "Status of Led Reversing Lamp left 1.";
CM_ SG_ 934 StsOfLedRvsgLampRi1 "Status of Led Reversing Lamp 1.";
CM_ SG_ 934 StsOfLedStopLampLe1 "Status of Led Stop Lamp Left 1.";
CM_ SG_ 934 StsOfLedStopLampRi1 "Status of Led Stop Lamp Right 1. ";
CM_ SG_ 934 StsOfLedTurnIndcrLe1 "Status of Led Turn Indicator Left 1.";
CM_ SG_ 934 StsOfLedTurnIndcrRi1 "Status of Led Turn Indicator Right 1.";
CM_ SG_ 934 StsOfWelGbyReLe1 "status of welcome and goodbye light from RCML";
CM_ SG_ 934 StsOfWelGbyReRi1 "status of welcome and goodbye light from RCMR";
CM_ SG_ 934 TrlrBrkLiSts "Trailer brake lights on/off status.";
CM_ SG_ 934 TrlrFogLiSts "Trailer fog lights on/off status.";
CM_ SG_ 934 TrlrIndcrTurnSts "Trailer direction indicators on/off status.";
CM_ SG_ 934 TrlrLeIndcrFltSts "No Flt - Left DI works well.
Flt - Left DI is in fault status.";
CM_ SG_ 934 TrlrPosnLiSts "Trailer position lights on/off status.";
CM_ SG_ 934 TrlrRiIndcrFltSts "No Flt - Right DI works well.
Flt - Right DI is in fault status.";
CM_ SG_ 934 TrlrRvsgLiSts "Trailer reversing light on/off status.";
CM_ SG_ 934 TrsmActrPosnSafeTrsmActrPosn "Describes the transmission position (P, R, N, D). Can also take intermediate positions (PR, RN, ND). If error are detected on position sensors undefined is set. Transmission measured gear lever position";
CM_ SG_ 934 TrsmActrPosnSafeTrsmActrPosnChks "Describes the transmission position (P, R, N, D). Can also take intermediate positions (PR, RN, ND). If error are detected on position sensors undefined is set. Transmission measured gear lever position";
CM_ SG_ 934 TrsmActrPosnSafeTrsmActrPosnCntr "Describes the transmission position (P, R, N, D). Can also take intermediate positions (PR, RN, ND). If error are detected on position sensors undefined is set. Transmission measured gear lever position";
CM_ SG_ 934 TwbrRelsBtn "To indicate if the towbar release button is pressed or not.";
CM_ SG_ 1180 FanDiagFltSts "Fan fault and status";
CM_ SG_ 1180 FrntCurtOpenPosnCmd "What is the target position";
CM_ SG_ 1180 HctvFltSts "HCTV fault and status";
CM_ SG_ 1180 HcwpFltSts "HVCH water pump fault and status";
CM_ SG_ 1180 HeatModeReq4Batt "Requests to use HVCH to battery";
CM_ SG_ 1180 HeatModeReq4Hp "Requests to use HVCH in car";
CM_ SG_ 1180 RearCurtOpenPosnCmd "What is the target position";
CM_ SG_ 1180 RefrigModeDes "AC compressor mode request status desired";
CM_ SG_ 1180 RefrigModeReq "AC compressor mode request";
CM_ SG_ 1180 RefrigModeReqSwt "Switching of AC compressor mode request status";
CM_ SG_ 1180 RefrigModeSts "AC compressor mode status";
CM_ SG_ 1180 RefrigModeSwt "AC compressor mode request status";
CM_ SG_ 1180 SnrCalChillerOutT "Temperature sensor of the low pressure side";
CM_ SG_ 1180 SnrCalClntTforInrCondOut "Temperature sensor at the water cooling outlet of the condenser";
CM_ SG_ 1180 SnrCalEvapOutT "Temperature sensor of the refrigerant at the evaporator outlet";
CM_ SG_ 1180 SnrCalHiSideP "Pressure sensor of the high pressure side";
CM_ SG_ 1180 SnrCalHiSideT "Temperature sensor of the high pressure side";
CM_ SG_ 1180 SnrCalLoSideP "Pressure sensor of the low pressure side";
CM_ SG_ 1180 TcsDoorEleBailReq "TcsDoorEleBailReq";
CM_ SG_ 1180 TcsModSwtReq "TcsModSwtReq";
CM_ SG_ 1180 TcsTmrOverReq "TcsTmrOverReq";
CM_ SG_ 1180 ZCUDMResdSig1ToSRSSafetyChks "ZCUDMResdSig1ToSRSSafety";
CM_ SG_ 1180 ZCUDMResdSig1ToSRSSafetyCntr "ZCUDMResdSig1ToSRSSafety";
CM_ SG_ 1180 ZCUDMResdSig1ToSRSSafetyUInt32 "ZCUDMResdSig1ToSRSSafety";
BA_DEF_ BO_ "CANFD_BRS" ENUM "0","1";
BA_DEF_ BO_ "GenMsgCycleTime" INT 0 65536; // [ms]
BA_DEF_ BO_ "GenMsgDelayTime" INT 0 65536; // [ms]
BA_DEF_ BO_ "GenMsgSendType" ENUM "cyclic", "spontaneous", "not-used", "not-used", "not-used", "cyclicAndSpontaneous", "not-used", "cyclicIfActive", "NoMsgSendType"; // [us]
BA_DEF_ BO_ "GenMsgStartDelayTime" INT 0 65536; // [ms]
BA_DEF_ BO_ "VFrameFormat" ENUM "StandardCAN","ExtendedCAN","reserved","J1939PG","reserved","reserved","reserved","reserved","reserved","reserved","reserved","reserved","reserved","reserved","StandardCAN_FD","ExtendedCAN_FD";
BA_DEF_ SG_ "GenSigSendType" ENUM "Cyclic","OnWrite","OnWriteWithRepetition","OnChange","OnChangeWithRepetition","IfActive","IfActiveWithRepetition","NoSigSendType";
BA_DEF_ SG_ "GenSigStartValue" HEX 0 80000000;
BA_DEF_ BO_ "GenMsgILSupport" ENUM "No","Yes";
BA_DEF_ BO_ "NmAsrMessage" ENUM "No","Yes";
BA_DEF_ SG_ "GenSigFuncType" ENUM "NoFunction","n/a","n/a","n/a","n/a","n/a","n/a","n/a","n/a","n/a","n/a","n/a","n/a","n/a","n/a","CHK","CNTR","n/a","n/a","n/a","CNTR_AR_01","CRC_AR_01_BOTH","CRC_AR_01_ALT","CRC_AR_01_LOW","CRC_AR_01_NIBBLE","CNTR_AR_04","CRC_AR_04A","CNTR_AR_05","CRC_AR_05";
BA_DEF_ SG_ "GenSigDataID" STRING;
BA_DEF_DEF_ "CANFD_BRS" "1";
BA_DEF_DEF_ "GenSigStartValue" 0;
BA_DEF_DEF_ "VFrameFormat" "J1939PG";
BA_DEF_DEF_ "GenSigSendType" "NoSigSendType";
BA_DEF_DEF_ "GenMsgCycleTime" 0;
BA_DEF_DEF_ "GenMsgDelayTime" 0;
BA_DEF_DEF_ "GenMsgStartDelayTime" 0;
BA_DEF_DEF_ "GenMsgSendType" "NoMsgSendType";
BA_DEF_DEF_ "GenMsgILSupport" "Yes";
BA_DEF_DEF_ "NmAsrMessage" "No";
BA_DEF_DEF_ "GenSigFuncType" "NoFunction";
BA_DEF_DEF_ "GenSigDataID" "";
// Frame: ZCUDZCUCANFD2Fr41
BA_ "GenMsgCycleTime" BO_ 813 500.000;
BA_ "GenMsgSendType" BO_ 813 0;
BA_ "VFrameFormat" BO_ 813 14;
// Frame: ZCUDZCUCANFD2Fr42
BA_ "GenMsgCycleTime" BO_ 836 500.000;
BA_ "GenMsgSendType" BO_ 836 0;
BA_ "VFrameFormat" BO_ 836 14;
// Frame: ZCUDZCUCANFD2Fr43
BA_ "GenMsgCycleTime" BO_ 928 800.000;
BA_ "GenMsgSendType" BO_ 928 0;
BA_ "VFrameFormat" BO_ 928 14;
// Frame: ZCUDZCUCANFD2Fr44
BA_ "GenMsgCycleTime" BO_ 1177 1000.000;
BA_ "GenMsgSendType" BO_ 1177 0;
BA_ "VFrameFormat" BO_ 1177 14;
// Frame: ZCUDZCUCANFD2Fr45
BA_ "GenMsgCycleTime" BO_ 320 50.000;
BA_ "GenMsgSendType" BO_ 320 0;
BA_ "VFrameFormat" BO_ 320 14;
// Frame: ZCUDZCUCANFD2Fr46
BA_ "GenMsgCycleTime" BO_ 463 150.000;
BA_ "GenMsgSendType" BO_ 463 0;
BA_ "VFrameFormat" BO_ 463 14;
// Frame: ZCUDZCUCANFD2Fr47
BA_ "GenMsgCycleTime" BO_ 523 200.000;
BA_ "GenMsgSendType" BO_ 523 0;
BA_ "VFrameFormat" BO_ 523 14;
// Frame: ZCUDZCUCANFD2Fr48
BA_ "GenMsgCycleTime" BO_ 1197 10.000;
BA_ "GenMsgSendType" BO_ 1197 0;
BA_ "VFrameFormat" BO_ 1197 14;
// Frame: ZCUDZCUCANFD2Fr49
BA_ "GenMsgCycleTime" BO_ 934 800.000;
BA_ "GenMsgSendType" BO_ 934 0;
BA_ "VFrameFormat" BO_ 934 14;
// Frame: ZCUDZCUCANFD2Fr50
BA_ "GenMsgCycleTime" BO_ 1180 1000.000;
BA_ "GenMsgSendType" BO_ 1180 0;
BA_ "VFrameFormat" BO_ 1180 14;
BA_ "GenSigSendType" SG_ 1197 ActvnOfApproachInEITL 0;
BA_ "GenSigSendType" SG_ 1197 ActvnOfCarLoctrInEITL 0;
BA_ "GenSigSendType" SG_ 523 AirPtcHVPwrActlFristLe 0;
BA_ "GenSigSendType" SG_ 523 AirPtcHVPwrActlFristRi 0;
BA_ "GenSigSendType" SG_ 523 AirPtcHVPwrActlSecLe 0;
BA_ "GenSigSendType" SG_ 320 BotmSnsrStsFromFootOper 0;
BA_ "GenSigSendType" SG_ 523 CmprReqCmprRunReq 0;
BA_ "GenSigSendType" SG_ 523 CurtBtnSts 0;
BA_ "GenSigSendType" SG_ 320 DockColumGrayReqForTvc 0;
BA_ "GenSigSendType" SG_ 523 DrvrSeatActvSwtFctMod 0;
BA_ "GenSigSendType" SG_ 523 DrvrSeatIntgrSwtStsIntgrSwtHozlSts 0;
BA_ "GenSigSendType" SG_ 523 DrvrSeatIntgrSwtStsIntgrSwtRotSts 0;
BA_ "GenSigSendType" SG_ 523 DrvrSeatIntgrSwtStsIntgrSwtSelnSts 0;
BA_ "GenSigSendType" SG_ 523 DrvrSeatIntgrSwtStsIntgrSwtVertSts 0;
BA_ "GenSigSendType" SG_ 1197 EITLActvnCaseDurgDrv 0;
BA_ "GenSigSendType" SG_ 463 EldtPmpCmdCooltPmpPostRunReq 0;
BA_ "GenSigSendType" SG_ 463 EldtPmpCmdCooltPmpSpdReq 0;
BA_ "GenSigSendType" SG_ 1197 ElecMot2ActvDampgGain 0;
BA_ "GenSigSendType" SG_ 1197 ElecMot2EngSpdOfActvDampg 0;
BA_ "GenSigSendType" SG_ 463 EngCooltPmpSpdReqCooltPmpPostRunReq 0;
BA_ "GenSigSendType" SG_ 463 EngCooltPmpSpdReqCooltPmpSpdReq 0;
BA_ "GenSigSendType" SG_ 463 EngIdleCtrlRefVal 0;
BA_ "GenSigSendType" SG_ 463 EngPmpStatCooltPmpDryErr 0;
BA_ "GenSigSendType" SG_ 463 EngPmpStatCooltPmpEmgyModSts 0;
BA_ "GenSigSendType" SG_ 463 EngPmpStatCooltPmpErrSts 0;
BA_ "GenSigSendType" SG_ 463 EngPmpStatCooltPmpI 0;
BA_ "GenSigSendType" SG_ 463 EngPmpStatCooltPmpIErr 0;
BA_ "GenSigSendType" SG_ 463 EngPmpStatCooltPmpMonrSpd 0;
BA_ "GenSigSendType" SG_ 463 EngPmpStatCooltPmpPostRunSts 0;
BA_ "GenSigSendType" SG_ 463 EngPmpStatCooltPmpSetPostRunReq 0;
BA_ "GenSigSendType" SG_ 463 EngPmpStatCooltPmpSetSpdReq 0;
BA_ "GenSigSendType" SG_ 463 EngPmpStatCooltPmpSpd 0;
BA_ "GenSigSendType" SG_ 463 EngPmpStatCooltPmpT 0;
BA_ "GenSigStartValue" SG_ 463 EngPmpStatCooltPmpT 100;
BA_ "GenSigSendType" SG_ 463 EngPmpStatCooltPmpTErr 0;
BA_ "GenSigSendType" SG_ 463 EngPmpStatCooltPmpU 0;
BA_ "GenSigSendType" SG_ 463 EngPmpStatCooltPmpUErr 0;
BA_ "GenSigSendType" SG_ 463 EngPmpStatCooltPmpUnstallSts 0;
BA_ "GenSigSendType" SG_ 523 EngPwrNormDes 0;
BA_ "GenSigSendType" SG_ 463 FootwellLiSts 0;
BA_ "GenSigSendType" SG_ 523 FrCurtBtnSts 0;
BA_ "GenSigSendType" SG_ 934 FrSunCurtImpctDetSts 0;
BA_ "GenSigSendType" SG_ 1180 FrntCurtOpenPosnCmd 0;
BA_ "GenSigSendType" SG_ 1197 FrntSeatLinReqFromSecSeatLe 0;
BA_ "GenSigSendType" SG_ 1197 FrntSeatLinReqFromSecSeatRi 0;
BA_ "GenSigSendType" SG_ 1197 FrntSeatLinStopFromSecSeatLe 0;
BA_ "GenSigSendType" SG_ 1197 FrntSeatLinStopFromSecSeatRi 0;
BA_ "GenSigSendType" SG_ 1197 FrntSeatRecoveryFromSecSeatLe 0;
BA_ "GenSigSendType" SG_ 1197 FrntSeatRecoveryFromSecSeatRi 0;
BA_ "GenSigSendType" SG_ 934 FrntSunCurtFailr2CurtMotFailr 0;
BA_ "GenSigSendType" SG_ 934 FrntSunCurtFailr2CurtMotHallFailr 0;
BA_ "GenSigSendType" SG_ 934 FrntSunCurtFailr2CurtMotHallNotAvl 0;
BA_ "GenSigSendType" SG_ 934 FrntSunCurtFailr2CurtMotNotAvl 0;
BA_ "GenSigSendType" SG_ 934 FrntSunCurtFailr2EcuFailrGen 0;
BA_ "GenSigSendType" SG_ 934 FrntSunCurtFailr2Resvd 0;
BA_ "GenSigDataID" SG_ 934 GVMCPrpsnTqDistReqChks "0x1A7A";
BA_ "GenSigFuncType" SG_ 934 GVMCPrpsnTqDistReqChks 15;
BA_ "GenSigSendType" SG_ 934 GVMCPrpsnTqDistReqChks 0;
BA_ "GenSigFuncType" SG_ 934 GVMCPrpsnTqDistReqCntr 16;
BA_ "GenSigSendType" SG_ 934 GVMCPrpsnTqDistReqCntr 0;
BA_ "GenSigSendType" SG_ 934 GVMCPrpsnTqDistReqCtrlMod 0;
BA_ "GenSigSendType" SG_ 934 GVMCPrpsnTqDistReqDistReq 0;
BA_ "GenSigStartValue" SG_ 934 GVMCPrpsnTqDistReqDistReq 12800;
BA_ "GenSigSendType" SG_ 934 GVMCPrpsnTqDistbnReqAtAxleReChks 0;
BA_ "GenSigSendType" SG_ 934 GVMCPrpsnTqDistbnReqAtAxleReCntr 0;
BA_ "GenSigSendType" SG_ 934 GVMCPrpsnTqDistbnReqAtAxleReCtrlMod 0;
BA_ "GenSigSendType" SG_ 934 GVMCPrpsnTqDistbnReqAtAxleReDistReq 0;
BA_ "GenSigStartValue" SG_ 934 GVMCPrpsnTqDistbnReqAtAxleReDistReq 12800;
BA_ "GenSigSendType" SG_ 934 GVMCSteerWhlAgReqReAgReqRe 0;
BA_ "GenSigDataID" SG_ 934 GVMCSteerWhlAgReqReChks "0x1A7D";
BA_ "GenSigFuncType" SG_ 934 GVMCSteerWhlAgReqReChks 15;
BA_ "GenSigSendType" SG_ 934 GVMCSteerWhlAgReqReChks 0;
BA_ "GenSigFuncType" SG_ 934 GVMCSteerWhlAgReqReCntr 16;
BA_ "GenSigSendType" SG_ 934 GVMCSteerWhlAgReqReCntr 0;
BA_ "GenSigSendType" SG_ 934 GVMCSteerWhlAgReqReCtrlModRe 0;
BA_ "GenSigSendType" SG_ 934 GVMCSuspDampgCtrlReqGVMCDampgCtrlReqFL 0;
BA_ "GenSigSendType" SG_ 934 GVMCSuspDampgCtrlReqGVMCDampgCtrlReqFR 0;
BA_ "GenSigSendType" SG_ 934 GVMCSuspDampgCtrlReqGVMCDampgCtrlReqRL 0;
BA_ "GenSigSendType" SG_ 934 GVMCSuspDampgCtrlReqGVMCDampgCtrlReqRR 0;
BA_ "GenSigSendType" SG_ 934 GVMCSuspDampgCtrlReqGVMCSuspDampgCtrlMod 0;
BA_ "GenSigSendType" SG_ 934 GVMCSuspDampgCtrlReqGVMCSuspDampgModReq 0;
BA_ "GenSigSendType" SG_ 934 GVMCSuspStfnCtrlReqGVMCSuspStfnCtrlMod 0;
BA_ "GenSigSendType" SG_ 934 GVMCSuspStfnCtrlReqGVMCSuspStfnReqFL 0;
BA_ "GenSigSendType" SG_ 934 GVMCSuspStfnCtrlReqGVMCSuspStfnReqFR 0;
BA_ "GenSigSendType" SG_ 934 GVMCSuspStfnCtrlReqGVMCSuspStfnReqRL 0;
BA_ "GenSigSendType" SG_ 934 GVMCSuspStfnCtrlReqGVMCSuspStfnReqRR 0;
BA_ "GenSigDataID" SG_ 1197 GVMCVehCtrlrStsChks "0x1A79";
BA_ "GenSigFuncType" SG_ 1197 GVMCVehCtrlrStsChks 15;
BA_ "GenSigSendType" SG_ 1197 GVMCVehCtrlrStsChks 0;
BA_ "GenSigFuncType" SG_ 1197 GVMCVehCtrlrStsCntr 16;
BA_ "GenSigSendType" SG_ 1197 GVMCVehCtrlrStsCntr 0;
BA_ "GenSigSendType" SG_ 1197 GVMCVehCtrlrStsCtrlrSts 0;
BA_ "GenSigSendType" SG_ 320 GaGearAct 0;
BA_ "GenSigSendType" SG_ 523 HpBattVlvPosSetReq 0;
BA_ "GenSigSendType" SG_ 523 HpBattVlvRefDrvReq 0;
BA_ "GenSigSendType" SG_ 463 HvBattSocEngStart 0;
BA_ "GenSigSendType" SG_ 1197 IsgEngSpdOfActvDampg 0;
BA_ "GenSigSendType" SG_ 523 IsgMotCooltFlowReq 0;
BA_ "GenSigSendType" SG_ 320 LinCtrlForRowSecLeSeatAdjmt 0;
BA_ "GenSigSendType" SG_ 320 LinCtrlForRowSecRiSeatAdjmt 0;
BA_ "GenSigSendType" SG_ 320 LowrTailgOpenerSwt 0;
BA_ "GenSigSendType" SG_ 320 MagChrgLidTip1 0;
BA_ "GenSigSendType" SG_ 320 MagChrgLidTip2 0;
BA_ "GenSigSendType" SG_ 1197 MeCnsAvgIndcdMeCnsIndcdVal3 0;
BA_ "GenSigSendType" SG_ 320 NFCKeyReadStsToHMIKey0 0;
BA_ "GenSigSendType" SG_ 320 NFCKeyReadStsToHMIKey1 0;
BA_ "GenSigSendType" SG_ 320 NFCKeyReadStsToHMIKey10 0;
BA_ "GenSigSendType" SG_ 320 NFCKeyReadStsToHMIKey11 0;
BA_ "GenSigSendType" SG_ 320 NFCKeyReadStsToHMIKey12 0;
BA_ "GenSigSendType" SG_ 320 NFCKeyReadStsToHMIKey13 0;
BA_ "GenSigSendType" SG_ 320 NFCKeyReadStsToHMIKey14 0;
BA_ "GenSigSendType" SG_ 320 NFCKeyReadStsToHMIKey15 0;
BA_ "GenSigSendType" SG_ 320 NFCKeyReadStsToHMIKey2 0;
BA_ "GenSigSendType" SG_ 320 NFCKeyReadStsToHMIKey3 0;
BA_ "GenSigSendType" SG_ 320 NFCKeyReadStsToHMIKey4 0;
BA_ "GenSigSendType" SG_ 320 NFCKeyReadStsToHMIKey5 0;
BA_ "GenSigSendType" SG_ 320 NFCKeyReadStsToHMIKey6 0;
BA_ "GenSigSendType" SG_ 320 NFCKeyReadStsToHMIKey7 0;
BA_ "GenSigSendType" SG_ 320 NFCKeyReadStsToHMIKey8 0;
BA_ "GenSigSendType" SG_ 320 NFCKeyReadStsToHMIKey9 0;
BA_ "GenSigSendType" SG_ 523 PassAirbLampStsRecPassAirbLampSts 0;
BA_ "GenSigStartValue" SG_ 523 PassAirbLampStsRecPassAirbLampSts 1;
BA_ "GenSigDataID" SG_ 523 PassAirbLampStsRecPassAirbLampStsChks "0x474";
BA_ "GenSigFuncType" SG_ 523 PassAirbLampStsRecPassAirbLampStsChks 15;
BA_ "GenSigSendType" SG_ 523 PassAirbLampStsRecPassAirbLampStsChks 0;
BA_ "GenSigStartValue" SG_ 523 PassAirbLampStsRecPassAirbLampStsChks 255;
BA_ "GenSigFuncType" SG_ 523 PassAirbLampStsRecPassAirbLampStsCntr 16;
BA_ "GenSigSendType" SG_ 523 PassAirbLampStsRecPassAirbLampStsCntr 0;
BA_ "GenSigSendType" SG_ 463 PtCluSlipCmdOfClu0 0;
BA_ "GenSigSendType" SG_ 463 PtCluSlipTarReqOfClu0 0;
BA_ "GenSigSendType" SG_ 320 PtEngTqAct 0;
BA_ "GenSigStartValue" SG_ 320 PtEngTqAct 1024;
BA_ "GenSigStartValue" SG_ 320 RWA1ColAgTarQf 1;
BA_ "GenSigSendType" SG_ 523 RainSnsrLiThd 0;
BA_ "GenSigStartValue" SG_ 523 RainSnsrLiThd 8;
BA_ "GenSigSendType" SG_ 523 ReAirPtcEnad 0;
BA_ "GenSigSendType" SG_ 523 ReAirPtcHvPwrReq 0;
BA_ "GenSigSendType" SG_ 523 ReCurtBtnSts 0;
BA_ "GenSigSendType" SG_ 934 ReSunCurtFailr2CurtMotFailr 0;
BA_ "GenSigSendType" SG_ 934 ReSunCurtFailr2CurtMotHallFailr 0;
BA_ "GenSigSendType" SG_ 934 ReSunCurtFailr2CurtMotHallNotAvl 0;
BA_ "GenSigSendType" SG_ 934 ReSunCurtFailr2CurtMotNotAvl 0;
BA_ "GenSigSendType" SG_ 934 ReSunCurtFailr2EcuFailrGen 0;
BA_ "GenSigSendType" SG_ 934 ReSunCurtFailr2Resvd 0;
BA_ "GenSigSendType" SG_ 934 ReSunCurtImpctDetnSts 0;
BA_ "GenSigSendType" SG_ 1180 RearCurtOpenPosnCmd 0;
BA_ "GenSigSendType" SG_ 523 RoofBtnSts 0;
BA_ "GenSigSendType" SG_ 1197 RowSecRiFldRsdSts 0;
BA_ "GenSigDataID" SG_ 934 SRSResdSig1ToZCUDMSafetyChks "0xEDE";
BA_ "GenSigFuncType" SG_ 934 SRSResdSig1ToZCUDMSafetyChks 15;
BA_ "GenSigSendType" SG_ 934 SRSResdSig1ToZCUDMSafetyChks 0;
BA_ "GenSigFuncType" SG_ 934 SRSResdSig1ToZCUDMSafetyCntr 16;
BA_ "GenSigSendType" SG_ 934 SRSResdSig1ToZCUDMSafetyCntr 0;
BA_ "GenSigSendType" SG_ 934 SRSResdSig1ToZCUDMSafetyUInt32 0;
BA_ "GenSigSendType" SG_ 463 SldngDoorLeReModSts 0;
BA_ "GenSigSendType" SG_ 463 SldngDoorRiReModSts 0;
BA_ "GenSigStartValue" SG_ 1180 SnrCalChillerOutT 400;
BA_ "GenSigStartValue" SG_ 1180 SnrCalClntTforInrCondOut 400;
BA_ "GenSigStartValue" SG_ 1180 SnrCalEvapOutT 400;
BA_ "GenSigStartValue" SG_ 1180 SnrCalHiSideT 400;
BA_ "GenSigSendType" SG_ 320 SumActv 0;
BA_ "GenSigSendType" SG_ 320 SupHeatTAct 0;
BA_ "GenSigStartValue" SG_ 320 SupHeatTAct 30;
BA_ "GenSigSendType" SG_ 463 TankTurnActIndcnMsgForBrkFrntWhl 0;
BA_ "GenSigSendType" SG_ 463 TankTurnActIndcnMsgForBrkReWhl 0;
BA_ "GenSigSendType" SG_ 320 TankTurnIndcnMsg 0;
BA_ "GenSigSendType" SG_ 463 TankTurnIndcnMsgForBrkFrntWhl 0;
BA_ "GenSigSendType" SG_ 463 TankTurnIndcnMsgForBrkReWhl 0;
BA_ "GenSigDataID" SG_ 320 TankTurnModStsChks "0x1B77";
BA_ "GenSigFuncType" SG_ 320 TankTurnModStsChks 15;
BA_ "GenSigSendType" SG_ 320 TankTurnModStsChks 0;
BA_ "GenSigFuncType" SG_ 320 TankTurnModStsCntr 16;
BA_ "GenSigSendType" SG_ 320 TankTurnModStsCntr 0;
BA_ "GenSigSendType" SG_ 320 TankTurnModStsTankTurnModSts 0;
BA_ "GenSigSendType" SG_ 1180 TcsDoorEleBailReq 0;
BA_ "GenSigSendType" SG_ 1180 TcsModSwtReq 0;
BA_ "GenSigSendType" SG_ 1180 TcsTmrOverReq 0;
BA_ "GenSigSendType" SG_ 1197 TechLiWakeup 0;
BA_ "GenSigSendType" SG_ 463 TireFilFilSwt 1;
BA_ "GenSigSendType" SG_ 463 TireFilNoiseFlrSwt 1;
BA_ "GenSigSendType" SG_ 463 TireFilPollingMod 1;
BA_ "GenSigSendType" SG_ 463 TireFilRxSwt 1;
BA_ "GenSigSendType" SG_ 463 TireFilSnsrID 1;
BA_ "GenSigSendType" SG_ 463 TrLockStsRadar 0;
BA_ "GenSigSendType" SG_ 523 TrRelsReq 0;
BA_ "GenSigSendType" SG_ 934 TrlrBrkLiSts 0;
BA_ "GenSigSendType" SG_ 934 TrlrFogLiSts 0;
BA_ "GenSigSendType" SG_ 934 TrlrIndcrTurnSts 0;
BA_ "GenSigSendType" SG_ 934 TrlrLeIndcrFltSts 0;
BA_ "GenSigSendType" SG_ 934 TrlrPosnLiSts 0;
BA_ "GenSigSendType" SG_ 934 TrlrRiIndcrFltSts 0;
BA_ "GenSigSendType" SG_ 934 TrlrRvsgLiSts 0;
BA_ "GenSigSendType" SG_ 934 TrsmActrPosnSafeTrsmActrPosn 0;
BA_ "GenSigStartValue" SG_ 934 TrsmActrPosnSafeTrsmActrPosn 7;
BA_ "GenSigDataID" SG_ 934 TrsmActrPosnSafeTrsmActrPosnChks "0x40";
BA_ "GenSigFuncType" SG_ 934 TrsmActrPosnSafeTrsmActrPosnChks 15;
BA_ "GenSigSendType" SG_ 934 TrsmActrPosnSafeTrsmActrPosnChks 0;
BA_ "GenSigFuncType" SG_ 934 TrsmActrPosnSafeTrsmActrPosnCntr 16;
BA_ "GenSigSendType" SG_ 934 TrsmActrPosnSafeTrsmActrPosnCntr 0;
BA_ "GenSigSendType" SG_ 320 TrsmClu0FltIndcn 0;
BA_ "GenSigDataID" SG_ 463 TrsmClu0StsChks "0x1776";
BA_ "GenSigFuncType" SG_ 463 TrsmClu0StsChks 15;
BA_ "GenSigSendType" SG_ 463 TrsmClu0StsChks 0;
BA_ "GenSigFuncType" SG_ 463 TrsmClu0StsCntr 16;
BA_ "GenSigSendType" SG_ 463 TrsmClu0StsCntr 0;
BA_ "GenSigSendType" SG_ 463 TrsmClu0StsTrsm0CluSts 0;
BA_ "GenSigSendType" SG_ 320 TrsmCluSlipStsOfClu0 0;
BA_ "GenSigStartValue" SG_ 320 TrsmCluT1Val 32;
BA_ "GenSigStartValue" SG_ 320 TrsmCluT2Val 32;
BA_ "GenSigSendType" SG_ 320 TrsmCluTqActOfClu0 0;
BA_ "GenSigStartValue" SG_ 320 TrsmCluTqActOfClu0 1024;
BA_ "GenSigSendType" SG_ 320 TrsmDtModAct 0;
BA_ "GenSigDataID" SG_ 463 TrsmGearActSafeChks "0x1775";
BA_ "GenSigFuncType" SG_ 463 TrsmGearActSafeChks 15;
BA_ "GenSigSendType" SG_ 463 TrsmGearActSafeChks 0;
BA_ "GenSigFuncType" SG_ 463 TrsmGearActSafeCntr 16;
BA_ "GenSigSendType" SG_ 463 TrsmGearActSafeCntr 0;
BA_ "GenSigSendType" SG_ 463 TrsmGearActSafeTrsmGearActSafe 0;
BA_ "GenSigSendType" SG_ 463 TrsmLockMgrWarnlndcn 0;
BA_ "GenSigSendType" SG_ 320 TrsmModNotAvlSts3 0;
BA_ "GenSigDataID" SG_ 320 TrsmOutpNChks "0x466";
BA_ "GenSigFuncType" SG_ 320 TrsmOutpNChks 15;
BA_ "GenSigSendType" SG_ 320 TrsmOutpNChks 0;
BA_ "GenSigFuncType" SG_ 320 TrsmOutpNCntr 16;
BA_ "GenSigSendType" SG_ 320 TrsmOutpNCntr 0;
BA_ "GenSigSendType" SG_ 320 TrsmOutpNDir 0;
BA_ "GenSigSendType" SG_ 320 TrsmOutpNSpd 0;
BA_ "GenSigSendType" SG_ 320 TrsmOutpNSpdQf 0;
BA_ "GenSigSendType" SG_ 934 TwbrRelsBtn 0;
BA_ "GenSigSendType" SG_ 463 WcacVlvPosSetReq 0;
BA_ "GenSigSendType" SG_ 463 WcacVlvRefDrvReq 0;
BA_ "GenSigSendType" SG_ 1177 ZCUDMResdSig10ToZCUDS 0;
BA_ "GenSigSendType" SG_ 1177 ZCUDMResdSig11ToZCUDS 0;
BA_ "GenSigSendType" SG_ 1177 ZCUDMResdSig12ToZCUDS 0;
BA_ "GenSigSendType" SG_ 1177 ZCUDMResdSig13ToZCUDS 0;
BA_ "GenSigSendType" SG_ 1177 ZCUDMResdSig14ToZCUDS 0;
BA_ "GenSigSendType" SG_ 1177 ZCUDMResdSig15ToZCUDS 0;
BA_ "GenSigSendType" SG_ 1177 ZCUDMResdSig16ToZCUDS 0;
BA_ "GenSigSendType" SG_ 1177 ZCUDMResdSig17ToZCUDS 0;
BA_ "GenSigSendType" SG_ 1177 ZCUDMResdSig18ToZCUDS 0;
BA_ "GenSigSendType" SG_ 1177 ZCUDMResdSig19ToZCUDS 0;
BA_ "GenSigSendType" SG_ 1180 ZCUDMResdSig1ToSRSSafetyChks 0;
BA_ "GenSigSendType" SG_ 1180 ZCUDMResdSig1ToSRSSafetyCntr 0;
BA_ "GenSigSendType" SG_ 1180 ZCUDMResdSig1ToSRSSafetyUInt32 0;
BA_ "GenSigSendType" SG_ 1177 ZCUDMResdSig1ToZCUDS 0;
BA_ "GenSigSendType" SG_ 1177 ZCUDMResdSig20ToZCUDS 0;
BA_ "GenSigSendType" SG_ 1177 ZCUDMResdSig21ToZCUDS 0;
BA_ "GenSigDataID" SG_ 1177 ZCUDMResdSig22ToZCUDSSafetyChks "0x1FA6";
BA_ "GenSigFuncType" SG_ 1177 ZCUDMResdSig22ToZCUDSSafetyChks 15;
BA_ "GenSigSendType" SG_ 1177 ZCUDMResdSig22ToZCUDSSafetyChks 0;
BA_ "GenSigFuncType" SG_ 1177 ZCUDMResdSig22ToZCUDSSafetyCntr 16;
BA_ "GenSigSendType" SG_ 1177 ZCUDMResdSig22ToZCUDSSafetyCntr 0;
BA_ "GenSigSendType" SG_ 1177 ZCUDMResdSig22ToZCUDSSafetyUInt64 0;
BA_ "GenSigSendType" SG_ 1177 ZCUDMResdSig2ToZCUDS 0;
BA_ "GenSigSendType" SG_ 1177 ZCUDMResdSig3ToZCUDS 0;
BA_ "GenSigSendType" SG_ 1177 ZCUDMResdSig4ToZCUDS 0;
BA_ "GenSigSendType" SG_ 1177 ZCUDMResdSig5ToZCUDS 0;
BA_ "GenSigSendType" SG_ 1177 ZCUDMResdSig6ToZCUDS 0;
BA_ "GenSigSendType" SG_ 1177 ZCUDMResdSig7ToZCUDS 0;
BA_ "GenSigSendType" SG_ 1177 ZCUDMResdSig8ToZCUDS 0;
BA_ "GenSigSendType" SG_ 1177 ZCUDMResdSig9ToZCUDS 0;
BA_ "GenSigSendType" SG_ 928 ZCUDSResdSig10ToZCUDM 0;
BA_ "GenSigSendType" SG_ 928 ZCUDSResdSig11ToZCUDM 0;
BA_ "GenSigSendType" SG_ 928 ZCUDSResdSig12ToZCUDM 0;
BA_ "GenSigSendType" SG_ 928 ZCUDSResdSig13ToZCUDM 0;
BA_ "GenSigSendType" SG_ 928 ZCUDSResdSig14ToZCUDM 0;
BA_ "GenSigSendType" SG_ 928 ZCUDSResdSig15ToZCUDM 0;
BA_ "GenSigSendType" SG_ 928 ZCUDSResdSig16ToZCUDM 0;
BA_ "GenSigSendType" SG_ 928 ZCUDSResdSig17ToZCUDM 0;
BA_ "GenSigSendType" SG_ 928 ZCUDSResdSig18ToZCUDM 0;
BA_ "GenSigSendType" SG_ 928 ZCUDSResdSig19ToZCUDM 0;
BA_ "GenSigSendType" SG_ 928 ZCUDSResdSig1ToZCUDM 0;
BA_ "GenSigSendType" SG_ 928 ZCUDSResdSig20ToZCUDM 0;
BA_ "GenSigSendType" SG_ 928 ZCUDSResdSig21ToZCUDM 0;
BA_ "GenSigDataID" SG_ 928 ZCUDSResdSig22ToZCUDMSafetyChks "0x1FA7";
BA_ "GenSigFuncType" SG_ 928 ZCUDSResdSig22ToZCUDMSafetyChks 15;
BA_ "GenSigSendType" SG_ 928 ZCUDSResdSig22ToZCUDMSafetyChks 0;
BA_ "GenSigFuncType" SG_ 928 ZCUDSResdSig22ToZCUDMSafetyCntr 16;
BA_ "GenSigSendType" SG_ 928 ZCUDSResdSig22ToZCUDMSafetyCntr 0;
BA_ "GenSigSendType" SG_ 928 ZCUDSResdSig22ToZCUDMSafetyUInt64 0;
BA_ "GenSigSendType" SG_ 928 ZCUDSResdSig2ToZCUDM 0;
BA_ "GenSigSendType" SG_ 928 ZCUDSResdSig3ToZCUDM 0;
BA_ "GenSigSendType" SG_ 928 ZCUDSResdSig4ToZCUDM 0;
BA_ "GenSigSendType" SG_ 928 ZCUDSResdSig5ToZCUDM 0;
BA_ "GenSigSendType" SG_ 928 ZCUDSResdSig6ToZCUDM 0;
BA_ "GenSigSendType" SG_ 928 ZCUDSResdSig7ToZCUDM 0;
BA_ "GenSigSendType" SG_ 928 ZCUDSResdSig8ToZCUDM 0;
BA_ "GenSigSendType" SG_ 928 ZCUDSResdSig9ToZCUDM 0;
VAL_ 813 VFCVectorHVSCVFCid0 0 "VFCOnOff_Off" 1 "VFCOnOff_On";
VAL_ 813 VFCVectorHVSCVFCid1 0 "VFCOnOff_Off" 1 "VFCOnOff_On";
VAL_ 813 VFCVectorHVSCVFCid10 0 "VFCOnOff_Off" 1 "VFCOnOff_On";
VAL_ 813 VFCVectorHVSCVFCid11 0 "VFCOnOff_Off" 1 "VFCOnOff_On";
VAL_ 813 VFCVectorHVSCVFCid12 0 "VFCOnOff_Off" 1 "VFCOnOff_On";
VAL_ 813 VFCVectorHVSCVFCid13 0 "VFCOnOff_Off" 1 "VFCOnOff_On";
VAL_ 813 VFCVectorHVSCVFCid14 0 "VFCOnOff_Off" 1 "VFCOnOff_On";
VAL_ 813 VFCVectorHVSCVFCid15 0 "VFCOnOff_Off" 1 "VFCOnOff_On";
VAL_ 813 VFCVectorHVSCVFCid16 0 "VFCOnOff_Off" 1 "VFCOnOff_On";
VAL_ 813 VFCVectorHVSCVFCid17 0 "VFCOnOff_Off" 1 "VFCOnOff_On";
VAL_ 813 VFCVectorHVSCVFCid18 0 "VFCOnOff_Off" 1 "VFCOnOff_On";
VAL_ 813 VFCVectorHVSCVFCid19 0 "VFCOnOff_Off" 1 "VFCOnOff_On";
VAL_ 813 VFCVectorHVSCVFCid2 0 "VFCOnOff_Off" 1 "VFCOnOff_On";
VAL_ 813 VFCVectorHVSCVFCid20 0 "VFCOnOff_Off" 1 "VFCOnOff_On";
VAL_ 813 VFCVectorHVSCVFCid21 0 "VFCOnOff_Off" 1 "VFCOnOff_On";
VAL_ 813 VFCVectorHVSCVFCid22 0 "VFCOnOff_Off" 1 "VFCOnOff_On";
VAL_ 813 VFCVectorHVSCVFCid23 0 "VFCOnOff_Off" 1 "VFCOnOff_On";
VAL_ 813 VFCVectorHVSCVFCid24 0 "VFCOnOff_Off" 1 "VFCOnOff_On";
VAL_ 813 VFCVectorHVSCVFCid25 0 "VFCOnOff_Off" 1 "VFCOnOff_On";
VAL_ 813 VFCVectorHVSCVFCid26 0 "VFCOnOff_Off" 1 "VFCOnOff_On";
VAL_ 813 VFCVectorHVSCVFCid27 0 "VFCOnOff_Off" 1 "VFCOnOff_On";
VAL_ 813 VFCVectorHVSCVFCid28 0 "VFCOnOff_Off" 1 "VFCOnOff_On";
VAL_ 813 VFCVectorHVSCVFCid29 0 "VFCOnOff_Off" 1 "VFCOnOff_On";
VAL_ 813 VFCVectorHVSCVFCid3 0 "VFCOnOff_Off" 1 "VFCOnOff_On";
VAL_ 813 VFCVectorHVSCVFCid30 0 "VFCOnOff_Off" 1 "VFCOnOff_On";
VAL_ 813 VFCVectorHVSCVFCid31 0 "VFCOnOff_Off" 1 "VFCOnOff_On";
VAL_ 813 VFCVectorHVSCVFCid32 0 "VFCOnOff_Off" 1 "VFCOnOff_On";
VAL_ 813 VFCVectorHVSCVFCid33 0 "VFCOnOff_Off" 1 "VFCOnOff_On";
VAL_ 813 VFCVectorHVSCVFCid34 0 "VFCOnOff_Off" 1 "VFCOnOff_On";
VAL_ 813 VFCVectorHVSCVFCid35 0 "VFCOnOff_Off" 1 "VFCOnOff_On";
VAL_ 813 VFCVectorHVSCVFCid36 0 "VFCOnOff_Off" 1 "VFCOnOff_On";
VAL_ 813 VFCVectorHVSCVFCid37 0 "VFCOnOff_Off" 1 "VFCOnOff_On";
VAL_ 813 VFCVectorHVSCVFCid38 0 "VFCOnOff_Off" 1 "VFCOnOff_On";
VAL_ 813 VFCVectorHVSCVFCid39 0 "VFCOnOff_Off" 1 "VFCOnOff_On";
VAL_ 813 VFCVectorHVSCVFCid4 0 "VFCOnOff_Off" 1 "VFCOnOff_On";
VAL_ 813 VFCVectorHVSCVFCid40 0 "VFCOnOff_Off" 1 "VFCOnOff_On";
VAL_ 813 VFCVectorHVSCVFCid41 0 "VFCOnOff_Off" 1 "VFCOnOff_On";
VAL_ 813 VFCVectorHVSCVFCid42 0 "VFCOnOff_Off" 1 "VFCOnOff_On";
VAL_ 813 VFCVectorHVSCVFCid43 0 "VFCOnOff_Off" 1 "VFCOnOff_On";
VAL_ 813 VFCVectorHVSCVFCid44 0 "VFCOnOff_Off" 1 "VFCOnOff_On";
VAL_ 813 VFCVectorHVSCVFCid45 0 "VFCOnOff_Off" 1 "VFCOnOff_On";
VAL_ 813 VFCVectorHVSCVFCid46 0 "VFCOnOff_Off" 1 "VFCOnOff_On";
VAL_ 813 VFCVectorHVSCVFCid47 0 "VFCOnOff_Off" 1 "VFCOnOff_On";
VAL_ 813 VFCVectorHVSCVFCid48 0 "VFCOnOff_Off" 1 "VFCOnOff_On";
VAL_ 813 VFCVectorHVSCVFCid49 0 "VFCOnOff_Off" 1 "VFCOnOff_On";
VAL_ 813 VFCVectorHVSCVFCid5 0 "VFCOnOff_Off" 1 "VFCOnOff_On";
VAL_ 813 VFCVectorHVSCVFCid50 0 "VFCOnOff_Off" 1 "VFCOnOff_On";
VAL_ 813 VFCVectorHVSCVFCid51 0 "VFCOnOff_Off" 1 "VFCOnOff_On";
VAL_ 813 VFCVectorHVSCVFCid52 0 "VFCOnOff_Off" 1 "VFCOnOff_On";
VAL_ 813 VFCVectorHVSCVFCid53 0 "VFCOnOff_Off" 1 "VFCOnOff_On";
VAL_ 813 VFCVectorHVSCVFCid54 0 "VFCOnOff_Off" 1 "VFCOnOff_On";
VAL_ 813 VFCVectorHVSCVFCid55 0 "VFCOnOff_Off" 1 "VFCOnOff_On";
VAL_ 813 VFCVectorHVSCVFCid56 0 "VFCOnOff_Off" 1 "VFCOnOff_On";
VAL_ 813 VFCVectorHVSCVFCid57 0 "VFCOnOff_Off" 1 "VFCOnOff_On";
VAL_ 813 VFCVectorHVSCVFCid58 0 "VFCOnOff_Off" 1 "VFCOnOff_On";
VAL_ 813 VFCVectorHVSCVFCid59 0 "VFCOnOff_Off" 1 "VFCOnOff_On";
VAL_ 813 VFCVectorHVSCVFCid6 0 "VFCOnOff_Off" 1 "VFCOnOff_On";
VAL_ 813 VFCVectorHVSCVFCid60 0 "VFCOnOff_Off" 1 "VFCOnOff_On";
VAL_ 813 VFCVectorHVSCVFCid61 0 "VFCOnOff_Off" 1 "VFCOnOff_On";
VAL_ 813 VFCVectorHVSCVFCid7 0 "VFCOnOff_Off" 1 "VFCOnOff_On";
VAL_ 813 VFCVectorHVSCVFCid8 0 "VFCOnOff_Off" 1 "VFCOnOff_On";
VAL_ 813 VFCVectorHVSCVFCid9 0 "VFCOnOff_Off" 1 "VFCOnOff_On";
VAL_ 813 VFCVectorHWAMVFCid0 0 "VFCOnOff_Off" 1 "VFCOnOff_On";
VAL_ 813 VFCVectorHWAMVFCid1 0 "VFCOnOff_Off" 1 "VFCOnOff_On";
VAL_ 813 VFCVectorHWAMVFCid10 0 "VFCOnOff_Off" 1 "VFCOnOff_On";
VAL_ 813 VFCVectorHWAMVFCid11 0 "VFCOnOff_Off" 1 "VFCOnOff_On";
VAL_ 813 VFCVectorHWAMVFCid12 0 "VFCOnOff_Off" 1 "VFCOnOff_On";
VAL_ 813 VFCVectorHWAMVFCid13 0 "VFCOnOff_Off" 1 "VFCOnOff_On";
VAL_ 813 VFCVectorHWAMVFCid14 0 "VFCOnOff_Off" 1 "VFCOnOff_On";
VAL_ 813 VFCVectorHWAMVFCid15 0 "VFCOnOff_Off" 1 "VFCOnOff_On";
VAL_ 813 VFCVectorHWAMVFCid16 0 "VFCOnOff_Off" 1 "VFCOnOff_On";
VAL_ 813 VFCVectorHWAMVFCid17 0 "VFCOnOff_Off" 1 "VFCOnOff_On";
VAL_ 813 VFCVectorHWAMVFCid18 0 "VFCOnOff_Off" 1 "VFCOnOff_On";
VAL_ 813 VFCVectorHWAMVFCid19 0 "VFCOnOff_Off" 1 "VFCOnOff_On";
VAL_ 813 VFCVectorHWAMVFCid2 0 "VFCOnOff_Off" 1 "VFCOnOff_On";
VAL_ 813 VFCVectorHWAMVFCid20 0 "VFCOnOff_Off" 1 "VFCOnOff_On";
VAL_ 813 VFCVectorHWAMVFCid21 0 "VFCOnOff_Off" 1 "VFCOnOff_On";
VAL_ 813 VFCVectorHWAMVFCid22 0 "VFCOnOff_Off" 1 "VFCOnOff_On";
VAL_ 813 VFCVectorHWAMVFCid23 0 "VFCOnOff_Off" 1 "VFCOnOff_On";
VAL_ 813 VFCVectorHWAMVFCid24 0 "VFCOnOff_Off" 1 "VFCOnOff_On";
VAL_ 813 VFCVectorHWAMVFCid25 0 "VFCOnOff_Off" 1 "VFCOnOff_On";
VAL_ 813 VFCVectorHWAMVFCid26 0 "VFCOnOff_Off" 1 "VFCOnOff_On";
VAL_ 813 VFCVectorHWAMVFCid27 0 "VFCOnOff_Off" 1 "VFCOnOff_On";
VAL_ 813 VFCVectorHWAMVFCid28 0 "VFCOnOff_Off" 1 "VFCOnOff_On";
VAL_ 813 VFCVectorHWAMVFCid29 0 "VFCOnOff_Off" 1 "VFCOnOff_On";
VAL_ 813 VFCVectorHWAMVFCid3 0 "VFCOnOff_Off" 1 "VFCOnOff_On";
VAL_ 813 VFCVectorHWAMVFCid30 0 "VFCOnOff_Off" 1 "VFCOnOff_On";
VAL_ 813 VFCVectorHWAMVFCid31 0 "VFCOnOff_Off" 1 "VFCOnOff_On";
VAL_ 813 VFCVectorHWAMVFCid32 0 "VFCOnOff_Off" 1 "VFCOnOff_On";
VAL_ 813 VFCVectorHWAMVFCid33 0 "VFCOnOff_Off" 1 "VFCOnOff_On";
VAL_ 813 VFCVectorHWAMVFCid34 0 "VFCOnOff_Off" 1 "VFCOnOff_On";
VAL_ 813 VFCVectorHWAMVFCid35 0 "VFCOnOff_Off" 1 "VFCOnOff_On";
VAL_ 813 VFCVectorHWAMVFCid36 0 "VFCOnOff_Off" 1 "VFCOnOff_On";
VAL_ 813 VFCVectorHWAMVFCid37 0 "VFCOnOff_Off" 1 "VFCOnOff_On";
VAL_ 813 VFCVectorHWAMVFCid38 0 "VFCOnOff_Off" 1 "VFCOnOff_On";
VAL_ 813 VFCVectorHWAMVFCid39 0 "VFCOnOff_Off" 1 "VFCOnOff_On";
VAL_ 813 VFCVectorHWAMVFCid4 0 "VFCOnOff_Off" 1 "VFCOnOff_On";
VAL_ 813 VFCVectorHWAMVFCid40 0 "VFCOnOff_Off" 1 "VFCOnOff_On";
VAL_ 813 VFCVectorHWAMVFCid41 0 "VFCOnOff_Off" 1 "VFCOnOff_On";
VAL_ 813 VFCVectorHWAMVFCid42 0 "VFCOnOff_Off" 1 "VFCOnOff_On";
VAL_ 813 VFCVectorHWAMVFCid43 0 "VFCOnOff_Off" 1 "VFCOnOff_On";
VAL_ 813 VFCVectorHWAMVFCid44 0 "VFCOnOff_Off" 1 "VFCOnOff_On";
VAL_ 813 VFCVectorHWAMVFCid45 0 "VFCOnOff_Off" 1 "VFCOnOff_On";
VAL_ 813 VFCVectorHWAMVFCid46 0 "VFCOnOff_Off" 1 "VFCOnOff_On";
VAL_ 813 VFCVectorHWAMVFCid47 0 "VFCOnOff_Off" 1 "VFCOnOff_On";
VAL_ 813 VFCVectorHWAMVFCid48 0 "VFCOnOff_Off" 1 "VFCOnOff_On";
VAL_ 813 VFCVectorHWAMVFCid49 0 "VFCOnOff_Off" 1 "VFCOnOff_On";
VAL_ 813 VFCVectorHWAMVFCid5 0 "VFCOnOff_Off" 1 "VFCOnOff_On";
VAL_ 813 VFCVectorHWAMVFCid50 0 "VFCOnOff_Off" 1 "VFCOnOff_On";
VAL_ 813 VFCVectorHWAMVFCid51 0 "VFCOnOff_Off" 1 "VFCOnOff_On";
VAL_ 813 VFCVectorHWAMVFCid52 0 "VFCOnOff_Off" 1 "VFCOnOff_On";
VAL_ 813 VFCVectorHWAMVFCid53 0 "VFCOnOff_Off" 1 "VFCOnOff_On";
VAL_ 813 VFCVectorHWAMVFCid54 0 "VFCOnOff_Off" 1 "VFCOnOff_On";
VAL_ 813 VFCVectorHWAMVFCid55 0 "VFCOnOff_Off" 1 "VFCOnOff_On";
VAL_ 813 VFCVectorHWAMVFCid56 0 "VFCOnOff_Off" 1 "VFCOnOff_On";
VAL_ 813 VFCVectorHWAMVFCid57 0 "VFCOnOff_Off" 1 "VFCOnOff_On";
VAL_ 813 VFCVectorHWAMVFCid58 0 "VFCOnOff_Off" 1 "VFCOnOff_On";
VAL_ 813 VFCVectorHWAMVFCid59 0 "VFCOnOff_Off" 1 "VFCOnOff_On";
VAL_ 813 VFCVectorHWAMVFCid6 0 "VFCOnOff_Off" 1 "VFCOnOff_On";
VAL_ 813 VFCVectorHWAMVFCid60 0 "VFCOnOff_Off" 1 "VFCOnOff_On";
VAL_ 813 VFCVectorHWAMVFCid61 0 "VFCOnOff_Off" 1 "VFCOnOff_On";
VAL_ 813 VFCVectorHWAMVFCid7 0 "VFCOnOff_Off" 1 "VFCOnOff_On";
VAL_ 813 VFCVectorHWAMVFCid8 0 "VFCOnOff_Off" 1 "VFCOnOff_On";
VAL_ 813 VFCVectorHWAMVFCid9 0 "VFCOnOff_Off" 1 "VFCOnOff_On";
VAL_ 836 VFCVectorCMDVFCid0 0 "VFCOnOff_Off" 1 "VFCOnOff_On";
VAL_ 836 VFCVectorCMDVFCid1 0 "VFCOnOff_Off" 1 "VFCOnOff_On";
VAL_ 836 VFCVectorCMDVFCid10 0 "VFCOnOff_Off" 1 "VFCOnOff_On";
VAL_ 836 VFCVectorCMDVFCid11 0 "VFCOnOff_Off" 1 "VFCOnOff_On";
VAL_ 836 VFCVectorCMDVFCid12 0 "VFCOnOff_Off" 1 "VFCOnOff_On";
VAL_ 836 VFCVectorCMDVFCid13 0 "VFCOnOff_Off" 1 "VFCOnOff_On";
VAL_ 836 VFCVectorCMDVFCid14 0 "VFCOnOff_Off" 1 "VFCOnOff_On";
VAL_ 836 VFCVectorCMDVFCid15 0 "VFCOnOff_Off" 1 "VFCOnOff_On";
VAL_ 836 VFCVectorCMDVFCid16 0 "VFCOnOff_Off" 1 "VFCOnOff_On";
VAL_ 836 VFCVectorCMDVFCid17 0 "VFCOnOff_Off" 1 "VFCOnOff_On";
VAL_ 836 VFCVectorCMDVFCid18 0 "VFCOnOff_Off" 1 "VFCOnOff_On";
VAL_ 836 VFCVectorCMDVFCid19 0 "VFCOnOff_Off" 1 "VFCOnOff_On";
VAL_ 836 VFCVectorCMDVFCid2 0 "VFCOnOff_Off" 1 "VFCOnOff_On";
VAL_ 836 VFCVectorCMDVFCid20 0 "VFCOnOff_Off" 1 "VFCOnOff_On";
VAL_ 836 VFCVectorCMDVFCid21 0 "VFCOnOff_Off" 1 "VFCOnOff_On";
VAL_ 836 VFCVectorCMDVFCid22 0 "VFCOnOff_Off" 1 "VFCOnOff_On";
VAL_ 836 VFCVectorCMDVFCid23 0 "VFCOnOff_Off" 1 "VFCOnOff_On";
VAL_ 836 VFCVectorCMDVFCid24 0 "VFCOnOff_Off" 1 "VFCOnOff_On";
VAL_ 836 VFCVectorCMDVFCid25 0 "VFCOnOff_Off" 1 "VFCOnOff_On";
VAL_ 836 VFCVectorCMDVFCid26 0 "VFCOnOff_Off" 1 "VFCOnOff_On";
VAL_ 836 VFCVectorCMDVFCid27 0 "VFCOnOff_Off" 1 "VFCOnOff_On";
VAL_ 836 VFCVectorCMDVFCid28 0 "VFCOnOff_Off" 1 "VFCOnOff_On";
VAL_ 836 VFCVectorCMDVFCid29 0 "VFCOnOff_Off" 1 "VFCOnOff_On";
VAL_ 836 VFCVectorCMDVFCid3 0 "VFCOnOff_Off" 1 "VFCOnOff_On";
VAL_ 836 VFCVectorCMDVFCid30 0 "VFCOnOff_Off" 1 "VFCOnOff_On";
VAL_ 836 VFCVectorCMDVFCid31 0 "VFCOnOff_Off" 1 "VFCOnOff_On";
VAL_ 836 VFCVectorCMDVFCid32 0 "VFCOnOff_Off" 1 "VFCOnOff_On";
VAL_ 836 VFCVectorCMDVFCid33 0 "VFCOnOff_Off" 1 "VFCOnOff_On";
VAL_ 836 VFCVectorCMDVFCid34 0 "VFCOnOff_Off" 1 "VFCOnOff_On";
VAL_ 836 VFCVectorCMDVFCid35 0 "VFCOnOff_Off" 1 "VFCOnOff_On";
VAL_ 836 VFCVectorCMDVFCid36 0 "VFCOnOff_Off" 1 "VFCOnOff_On";
VAL_ 836 VFCVectorCMDVFCid37 0 "VFCOnOff_Off" 1 "VFCOnOff_On";
VAL_ 836 VFCVectorCMDVFCid38 0 "VFCOnOff_Off" 1 "VFCOnOff_On";
VAL_ 836 VFCVectorCMDVFCid39 0 "VFCOnOff_Off" 1 "VFCOnOff_On";
VAL_ 836 VFCVectorCMDVFCid4 0 "VFCOnOff_Off" 1 "VFCOnOff_On";
VAL_ 836 VFCVectorCMDVFCid40 0 "VFCOnOff_Off" 1 "VFCOnOff_On";
VAL_ 836 VFCVectorCMDVFCid41 0 "VFCOnOff_Off" 1 "VFCOnOff_On";
VAL_ 836 VFCVectorCMDVFCid42 0 "VFCOnOff_Off" 1 "VFCOnOff_On";
VAL_ 836 VFCVectorCMDVFCid43 0 "VFCOnOff_Off" 1 "VFCOnOff_On";
VAL_ 836 VFCVectorCMDVFCid44 0 "VFCOnOff_Off" 1 "VFCOnOff_On";
VAL_ 836 VFCVectorCMDVFCid45 0 "VFCOnOff_Off" 1 "VFCOnOff_On";
VAL_ 836 VFCVectorCMDVFCid46 0 "VFCOnOff_Off" 1 "VFCOnOff_On";
VAL_ 836 VFCVectorCMDVFCid47 0 "VFCOnOff_Off" 1 "VFCOnOff_On";
VAL_ 836 VFCVectorCMDVFCid48 0 "VFCOnOff_Off" 1 "VFCOnOff_On";
VAL_ 836 VFCVectorCMDVFCid49 0 "VFCOnOff_Off" 1 "VFCOnOff_On";
VAL_ 836 VFCVectorCMDVFCid5 0 "VFCOnOff_Off" 1 "VFCOnOff_On";
VAL_ 836 VFCVectorCMDVFCid50 0 "VFCOnOff_Off" 1 "VFCOnOff_On";
VAL_ 836 VFCVectorCMDVFCid51 0 "VFCOnOff_Off" 1 "VFCOnOff_On";
VAL_ 836 VFCVectorCMDVFCid52 0 "VFCOnOff_Off" 1 "VFCOnOff_On";
VAL_ 836 VFCVectorCMDVFCid53 0 "VFCOnOff_Off" 1 "VFCOnOff_On";
VAL_ 836 VFCVectorCMDVFCid54 0 "VFCOnOff_Off" 1 "VFCOnOff_On";
VAL_ 836 VFCVectorCMDVFCid55 0 "VFCOnOff_Off" 1 "VFCOnOff_On";
VAL_ 836 VFCVectorCMDVFCid56 0 "VFCOnOff_Off" 1 "VFCOnOff_On";
VAL_ 836 VFCVectorCMDVFCid57 0 "VFCOnOff_Off" 1 "VFCOnOff_On";
VAL_ 836 VFCVectorCMDVFCid58 0 "VFCOnOff_Off" 1 "VFCOnOff_On";
VAL_ 836 VFCVectorCMDVFCid59 0 "VFCOnOff_Off" 1 "VFCOnOff_On";
VAL_ 836 VFCVectorCMDVFCid6 0 "VFCOnOff_Off" 1 "VFCOnOff_On";
VAL_ 836 VFCVectorCMDVFCid60 0 "VFCOnOff_Off" 1 "VFCOnOff_On";
VAL_ 836 VFCVectorCMDVFCid61 0 "VFCOnOff_Off" 1 "VFCOnOff_On";
VAL_ 836 VFCVectorCMDVFCid7 0 "VFCOnOff_Off" 1 "VFCOnOff_On";
VAL_ 836 VFCVectorCMDVFCid8 0 "VFCOnOff_Off" 1 "VFCOnOff_On";
VAL_ 836 VFCVectorCMDVFCid9 0 "VFCOnOff_Off" 1 "VFCOnOff_On";
VAL_ 836 VFCVectorCMPVFCid0 0 "VFCOnOff_Off" 1 "VFCOnOff_On";
VAL_ 836 VFCVectorCMPVFCid1 0 "VFCOnOff_Off" 1 "VFCOnOff_On";
VAL_ 836 VFCVectorCMPVFCid10 0 "VFCOnOff_Off" 1 "VFCOnOff_On";
VAL_ 836 VFCVectorCMPVFCid11 0 "VFCOnOff_Off" 1 "VFCOnOff_On";
VAL_ 836 VFCVectorCMPVFCid12 0 "VFCOnOff_Off" 1 "VFCOnOff_On";
VAL_ 836 VFCVectorCMPVFCid13 0 "VFCOnOff_Off" 1 "VFCOnOff_On";
VAL_ 836 VFCVectorCMPVFCid14 0 "VFCOnOff_Off" 1 "VFCOnOff_On";
VAL_ 836 VFCVectorCMPVFCid15 0 "VFCOnOff_Off" 1 "VFCOnOff_On";
VAL_ 836 VFCVectorCMPVFCid16 0 "VFCOnOff_Off" 1 "VFCOnOff_On";
VAL_ 836 VFCVectorCMPVFCid17 0 "VFCOnOff_Off" 1 "VFCOnOff_On";
VAL_ 836 VFCVectorCMPVFCid18 0 "VFCOnOff_Off" 1 "VFCOnOff_On";
VAL_ 836 VFCVectorCMPVFCid19 0 "VFCOnOff_Off" 1 "VFCOnOff_On";
VAL_ 836 VFCVectorCMPVFCid2 0 "VFCOnOff_Off" 1 "VFCOnOff_On";
VAL_ 836 VFCVectorCMPVFCid20 0 "VFCOnOff_Off" 1 "VFCOnOff_On";
VAL_ 836 VFCVectorCMPVFCid21 0 "VFCOnOff_Off" 1 "VFCOnOff_On";
VAL_ 836 VFCVectorCMPVFCid22 0 "VFCOnOff_Off" 1 "VFCOnOff_On";
VAL_ 836 VFCVectorCMPVFCid23 0 "VFCOnOff_Off" 1 "VFCOnOff_On";
VAL_ 836 VFCVectorCMPVFCid24 0 "VFCOnOff_Off" 1 "VFCOnOff_On";
VAL_ 836 VFCVectorCMPVFCid25 0 "VFCOnOff_Off" 1 "VFCOnOff_On";
VAL_ 836 VFCVectorCMPVFCid26 0 "VFCOnOff_Off" 1 "VFCOnOff_On";
VAL_ 836 VFCVectorCMPVFCid27 0 "VFCOnOff_Off" 1 "VFCOnOff_On";
VAL_ 836 VFCVectorCMPVFCid28 0 "VFCOnOff_Off" 1 "VFCOnOff_On";
VAL_ 836 VFCVectorCMPVFCid29 0 "VFCOnOff_Off" 1 "VFCOnOff_On";
VAL_ 836 VFCVectorCMPVFCid3 0 "VFCOnOff_Off" 1 "VFCOnOff_On";
VAL_ 836 VFCVectorCMPVFCid30 0 "VFCOnOff_Off" 1 "VFCOnOff_On";
VAL_ 836 VFCVectorCMPVFCid31 0 "VFCOnOff_Off" 1 "VFCOnOff_On";
VAL_ 836 VFCVectorCMPVFCid32 0 "VFCOnOff_Off" 1 "VFCOnOff_On";
VAL_ 836 VFCVectorCMPVFCid33 0 "VFCOnOff_Off" 1 "VFCOnOff_On";
VAL_ 836 VFCVectorCMPVFCid34 0 "VFCOnOff_Off" 1 "VFCOnOff_On";
VAL_ 836 VFCVectorCMPVFCid35 0 "VFCOnOff_Off" 1 "VFCOnOff_On";
VAL_ 836 VFCVectorCMPVFCid36 0 "VFCOnOff_Off" 1 "VFCOnOff_On";
VAL_ 836 VFCVectorCMPVFCid37 0 "VFCOnOff_Off" 1 "VFCOnOff_On";
VAL_ 836 VFCVectorCMPVFCid38 0 "VFCOnOff_Off" 1 "VFCOnOff_On";
VAL_ 836 VFCVectorCMPVFCid39 0 "VFCOnOff_Off" 1 "VFCOnOff_On";
VAL_ 836 VFCVectorCMPVFCid4 0 "VFCOnOff_Off" 1 "VFCOnOff_On";
VAL_ 836 VFCVectorCMPVFCid40 0 "VFCOnOff_Off" 1 "VFCOnOff_On";
VAL_ 836 VFCVectorCMPVFCid41 0 "VFCOnOff_Off" 1 "VFCOnOff_On";
VAL_ 836 VFCVectorCMPVFCid42 0 "VFCOnOff_Off" 1 "VFCOnOff_On";
VAL_ 836 VFCVectorCMPVFCid43 0 "VFCOnOff_Off" 1 "VFCOnOff_On";
VAL_ 836 VFCVectorCMPVFCid44 0 "VFCOnOff_Off" 1 "VFCOnOff_On";
VAL_ 836 VFCVectorCMPVFCid45 0 "VFCOnOff_Off" 1 "VFCOnOff_On";
VAL_ 836 VFCVectorCMPVFCid46 0 "VFCOnOff_Off" 1 "VFCOnOff_On";
VAL_ 836 VFCVectorCMPVFCid47 0 "VFCOnOff_Off" 1 "VFCOnOff_On";
VAL_ 836 VFCVectorCMPVFCid48 0 "VFCOnOff_Off" 1 "VFCOnOff_On";
VAL_ 836 VFCVectorCMPVFCid49 0 "VFCOnOff_Off" 1 "VFCOnOff_On";
VAL_ 836 VFCVectorCMPVFCid5 0 "VFCOnOff_Off" 1 "VFCOnOff_On";
VAL_ 836 VFCVectorCMPVFCid50 0 "VFCOnOff_Off" 1 "VFCOnOff_On";
VAL_ 836 VFCVectorCMPVFCid51 0 "VFCOnOff_Off" 1 "VFCOnOff_On";
VAL_ 836 VFCVectorCMPVFCid52 0 "VFCOnOff_Off" 1 "VFCOnOff_On";
VAL_ 836 VFCVectorCMPVFCid53 0 "VFCOnOff_Off" 1 "VFCOnOff_On";
VAL_ 836 VFCVectorCMPVFCid54 0 "VFCOnOff_Off" 1 "VFCOnOff_On";
VAL_ 836 VFCVectorCMPVFCid55 0 "VFCOnOff_Off" 1 "VFCOnOff_On";
VAL_ 836 VFCVectorCMPVFCid56 0 "VFCOnOff_Off" 1 "VFCOnOff_On";
VAL_ 836 VFCVectorCMPVFCid57 0 "VFCOnOff_Off" 1 "VFCOnOff_On";
VAL_ 836 VFCVectorCMPVFCid58 0 "VFCOnOff_Off" 1 "VFCOnOff_On";
VAL_ 836 VFCVectorCMPVFCid59 0 "VFCOnOff_Off" 1 "VFCOnOff_On";
VAL_ 836 VFCVectorCMPVFCid6 0 "VFCOnOff_Off" 1 "VFCOnOff_On";
VAL_ 836 VFCVectorCMPVFCid60 0 "VFCOnOff_Off" 1 "VFCOnOff_On";
VAL_ 836 VFCVectorCMPVFCid61 0 "VFCOnOff_Off" 1 "VFCOnOff_On";
VAL_ 836 VFCVectorCMPVFCid7 0 "VFCOnOff_Off" 1 "VFCOnOff_On";
VAL_ 836 VFCVectorCMPVFCid8 0 "VFCOnOff_Off" 1 "VFCOnOff_On";
VAL_ 836 VFCVectorCMPVFCid9 0 "VFCOnOff_Off" 1 "VFCOnOff_On";
VAL_ 836 VFCVectorSDLVFCid0 0 "VFCOnOff_Off" 1 "VFCOnOff_On";
VAL_ 836 VFCVectorSDLVFCid1 0 "VFCOnOff_Off" 1 "VFCOnOff_On";
VAL_ 836 VFCVectorSDLVFCid10 0 "VFCOnOff_Off" 1 "VFCOnOff_On";
VAL_ 836 VFCVectorSDLVFCid11 0 "VFCOnOff_Off" 1 "VFCOnOff_On";
VAL_ 836 VFCVectorSDLVFCid12 0 "VFCOnOff_Off" 1 "VFCOnOff_On";
VAL_ 836 VFCVectorSDLVFCid13 0 "VFCOnOff_Off" 1 "VFCOnOff_On";
VAL_ 836 VFCVectorSDLVFCid14 0 "VFCOnOff_Off" 1 "VFCOnOff_On";
VAL_ 836 VFCVectorSDLVFCid15 0 "VFCOnOff_Off" 1 "VFCOnOff_On";
VAL_ 836 VFCVectorSDLVFCid16 0 "VFCOnOff_Off" 1 "VFCOnOff_On";
VAL_ 836 VFCVectorSDLVFCid17 0 "VFCOnOff_Off" 1 "VFCOnOff_On";
VAL_ 836 VFCVectorSDLVFCid18 0 "VFCOnOff_Off" 1 "VFCOnOff_On";
VAL_ 836 VFCVectorSDLVFCid19 0 "VFCOnOff_Off" 1 "VFCOnOff_On";
VAL_ 836 VFCVectorSDLVFCid2 0 "VFCOnOff_Off" 1 "VFCOnOff_On";
VAL_ 836 VFCVectorSDLVFCid20 0 "VFCOnOff_Off" 1 "VFCOnOff_On";
VAL_ 836 VFCVectorSDLVFCid21 0 "VFCOnOff_Off" 1 "VFCOnOff_On";
VAL_ 836 VFCVectorSDLVFCid22 0 "VFCOnOff_Off" 1 "VFCOnOff_On";
VAL_ 836 VFCVectorSDLVFCid23 0 "VFCOnOff_Off" 1 "VFCOnOff_On";
VAL_ 836 VFCVectorSDLVFCid24 0 "VFCOnOff_Off" 1 "VFCOnOff_On";
VAL_ 836 VFCVectorSDLVFCid25 0 "VFCOnOff_Off" 1 "VFCOnOff_On";
VAL_ 836 VFCVectorSDLVFCid26 0 "VFCOnOff_Off" 1 "VFCOnOff_On";
VAL_ 836 VFCVectorSDLVFCid27 0 "VFCOnOff_Off" 1 "VFCOnOff_On";
VAL_ 836 VFCVectorSDLVFCid28 0 "VFCOnOff_Off" 1 "VFCOnOff_On";
VAL_ 836 VFCVectorSDLVFCid29 0 "VFCOnOff_Off" 1 "VFCOnOff_On";
VAL_ 836 VFCVectorSDLVFCid3 0 "VFCOnOff_Off" 1 "VFCOnOff_On";
VAL_ 836 VFCVectorSDLVFCid30 0 "VFCOnOff_Off" 1 "VFCOnOff_On";
VAL_ 836 VFCVectorSDLVFCid31 0 "VFCOnOff_Off" 1 "VFCOnOff_On";
VAL_ 836 VFCVectorSDLVFCid32 0 "VFCOnOff_Off" 1 "VFCOnOff_On";
VAL_ 836 VFCVectorSDLVFCid33 0 "VFCOnOff_Off" 1 "VFCOnOff_On";
VAL_ 836 VFCVectorSDLVFCid34 0 "VFCOnOff_Off" 1 "VFCOnOff_On";
VAL_ 836 VFCVectorSDLVFCid35 0 "VFCOnOff_Off" 1 "VFCOnOff_On";
VAL_ 836 VFCVectorSDLVFCid36 0 "VFCOnOff_Off" 1 "VFCOnOff_On";
VAL_ 836 VFCVectorSDLVFCid37 0 "VFCOnOff_Off" 1 "VFCOnOff_On";
VAL_ 836 VFCVectorSDLVFCid38 0 "VFCOnOff_Off" 1 "VFCOnOff_On";
VAL_ 836 VFCVectorSDLVFCid39 0 "VFCOnOff_Off" 1 "VFCOnOff_On";
VAL_ 836 VFCVectorSDLVFCid4 0 "VFCOnOff_Off" 1 "VFCOnOff_On";
VAL_ 836 VFCVectorSDLVFCid40 0 "VFCOnOff_Off" 1 "VFCOnOff_On";
VAL_ 836 VFCVectorSDLVFCid41 0 "VFCOnOff_Off" 1 "VFCOnOff_On";
VAL_ 836 VFCVectorSDLVFCid42 0 "VFCOnOff_Off" 1 "VFCOnOff_On";
VAL_ 836 VFCVectorSDLVFCid43 0 "VFCOnOff_Off" 1 "VFCOnOff_On";
VAL_ 836 VFCVectorSDLVFCid44 0 "VFCOnOff_Off" 1 "VFCOnOff_On";
VAL_ 836 VFCVectorSDLVFCid45 0 "VFCOnOff_Off" 1 "VFCOnOff_On";
VAL_ 836 VFCVectorSDLVFCid46 0 "VFCOnOff_Off" 1 "VFCOnOff_On";
VAL_ 836 VFCVectorSDLVFCid47 0 "VFCOnOff_Off" 1 "VFCOnOff_On";
VAL_ 836 VFCVectorSDLVFCid48 0 "VFCOnOff_Off" 1 "VFCOnOff_On";
VAL_ 836 VFCVectorSDLVFCid49 0 "VFCOnOff_Off" 1 "VFCOnOff_On";
VAL_ 836 VFCVectorSDLVFCid5 0 "VFCOnOff_Off" 1 "VFCOnOff_On";
VAL_ 836 VFCVectorSDLVFCid50 0 "VFCOnOff_Off" 1 "VFCOnOff_On";
VAL_ 836 VFCVectorSDLVFCid51 0 "VFCOnOff_Off" 1 "VFCOnOff_On";
VAL_ 836 VFCVectorSDLVFCid52 0 "VFCOnOff_Off" 1 "VFCOnOff_On";
VAL_ 836 VFCVectorSDLVFCid53 0 "VFCOnOff_Off" 1 "VFCOnOff_On";
VAL_ 836 VFCVectorSDLVFCid54 0 "VFCOnOff_Off" 1 "VFCOnOff_On";
VAL_ 836 VFCVectorSDLVFCid55 0 "VFCOnOff_Off" 1 "VFCOnOff_On";
VAL_ 836 VFCVectorSDLVFCid56 0 "VFCOnOff_Off" 1 "VFCOnOff_On";
VAL_ 836 VFCVectorSDLVFCid57 0 "VFCOnOff_Off" 1 "VFCOnOff_On";
VAL_ 836 VFCVectorSDLVFCid58 0 "VFCOnOff_Off" 1 "VFCOnOff_On";
VAL_ 836 VFCVectorSDLVFCid59 0 "VFCOnOff_Off" 1 "VFCOnOff_On";
VAL_ 836 VFCVectorSDLVFCid6 0 "VFCOnOff_Off" 1 "VFCOnOff_On";
VAL_ 836 VFCVectorSDLVFCid60 0 "VFCOnOff_Off" 1 "VFCOnOff_On";
VAL_ 836 VFCVectorSDLVFCid61 0 "VFCOnOff_Off" 1 "VFCOnOff_On";
VAL_ 836 VFCVectorSDLVFCid7 0 "VFCOnOff_Off" 1 "VFCOnOff_On";
VAL_ 836 VFCVectorSDLVFCid8 0 "VFCOnOff_Off" 1 "VFCOnOff_On";
VAL_ 836 VFCVectorSDLVFCid9 0 "VFCOnOff_Off" 1 "VFCOnOff_On";
VAL_ 836 VFCVectorSDRVFCid0 0 "VFCOnOff_Off" 1 "VFCOnOff_On";
VAL_ 836 VFCVectorSDRVFCid1 0 "VFCOnOff_Off" 1 "VFCOnOff_On";
VAL_ 836 VFCVectorSDRVFCid10 0 "VFCOnOff_Off" 1 "VFCOnOff_On";
VAL_ 836 VFCVectorSDRVFCid11 0 "VFCOnOff_Off" 1 "VFCOnOff_On";
VAL_ 836 VFCVectorSDRVFCid12 0 "VFCOnOff_Off" 1 "VFCOnOff_On";
VAL_ 836 VFCVectorSDRVFCid13 0 "VFCOnOff_Off" 1 "VFCOnOff_On";
VAL_ 836 VFCVectorSDRVFCid14 0 "VFCOnOff_Off" 1 "VFCOnOff_On";
VAL_ 836 VFCVectorSDRVFCid15 0 "VFCOnOff_Off" 1 "VFCOnOff_On";
VAL_ 836 VFCVectorSDRVFCid16 0 "VFCOnOff_Off" 1 "VFCOnOff_On";
VAL_ 836 VFCVectorSDRVFCid17 0 "VFCOnOff_Off" 1 "VFCOnOff_On";
VAL_ 836 VFCVectorSDRVFCid18 0 "VFCOnOff_Off" 1 "VFCOnOff_On";
VAL_ 836 VFCVectorSDRVFCid19 0 "VFCOnOff_Off" 1 "VFCOnOff_On";
VAL_ 836 VFCVectorSDRVFCid2 0 "VFCOnOff_Off" 1 "VFCOnOff_On";
VAL_ 836 VFCVectorSDRVFCid20 0 "VFCOnOff_Off" 1 "VFCOnOff_On";
VAL_ 836 VFCVectorSDRVFCid21 0 "VFCOnOff_Off" 1 "VFCOnOff_On";
VAL_ 836 VFCVectorSDRVFCid22 0 "VFCOnOff_Off" 1 "VFCOnOff_On";
VAL_ 836 VFCVectorSDRVFCid23 0 "VFCOnOff_Off" 1 "VFCOnOff_On";
VAL_ 836 VFCVectorSDRVFCid24 0 "VFCOnOff_Off" 1 "VFCOnOff_On";
VAL_ 836 VFCVectorSDRVFCid25 0 "VFCOnOff_Off" 1 "VFCOnOff_On";
VAL_ 836 VFCVectorSDRVFCid26 0 "VFCOnOff_Off" 1 "VFCOnOff_On";
VAL_ 836 VFCVectorSDRVFCid27 0 "VFCOnOff_Off" 1 "VFCOnOff_On";
VAL_ 836 VFCVectorSDRVFCid28 0 "VFCOnOff_Off" 1 "VFCOnOff_On";
VAL_ 836 VFCVectorSDRVFCid29 0 "VFCOnOff_Off" 1 "VFCOnOff_On";
VAL_ 836 VFCVectorSDRVFCid3 0 "VFCOnOff_Off" 1 "VFCOnOff_On";
VAL_ 836 VFCVectorSDRVFCid30 0 "VFCOnOff_Off" 1 "VFCOnOff_On";
VAL_ 836 VFCVectorSDRVFCid31 0 "VFCOnOff_Off" 1 "VFCOnOff_On";
VAL_ 836 VFCVectorSDRVFCid32 0 "VFCOnOff_Off" 1 "VFCOnOff_On";
VAL_ 836 VFCVectorSDRVFCid33 0 "VFCOnOff_Off" 1 "VFCOnOff_On";
VAL_ 836 VFCVectorSDRVFCid34 0 "VFCOnOff_Off" 1 "VFCOnOff_On";
VAL_ 836 VFCVectorSDRVFCid35 0 "VFCOnOff_Off" 1 "VFCOnOff_On";
VAL_ 836 VFCVectorSDRVFCid36 0 "VFCOnOff_Off" 1 "VFCOnOff_On";
VAL_ 836 VFCVectorSDRVFCid37 0 "VFCOnOff_Off" 1 "VFCOnOff_On";
VAL_ 836 VFCVectorSDRVFCid38 0 "VFCOnOff_Off" 1 "VFCOnOff_On";
VAL_ 836 VFCVectorSDRVFCid39 0 "VFCOnOff_Off" 1 "VFCOnOff_On";
VAL_ 836 VFCVectorSDRVFCid4 0 "VFCOnOff_Off" 1 "VFCOnOff_On";
VAL_ 836 VFCVectorSDRVFCid40 0 "VFCOnOff_Off" 1 "VFCOnOff_On";
VAL_ 836 VFCVectorSDRVFCid41 0 "VFCOnOff_Off" 1 "VFCOnOff_On";
VAL_ 836 VFCVectorSDRVFCid42 0 "VFCOnOff_Off" 1 "VFCOnOff_On";
VAL_ 836 VFCVectorSDRVFCid43 0 "VFCOnOff_Off" 1 "VFCOnOff_On";
VAL_ 836 VFCVectorSDRVFCid44 0 "VFCOnOff_Off" 1 "VFCOnOff_On";
VAL_ 836 VFCVectorSDRVFCid45 0 "VFCOnOff_Off" 1 "VFCOnOff_On";
VAL_ 836 VFCVectorSDRVFCid46 0 "VFCOnOff_Off" 1 "VFCOnOff_On";
VAL_ 836 VFCVectorSDRVFCid47 0 "VFCOnOff_Off" 1 "VFCOnOff_On";
VAL_ 836 VFCVectorSDRVFCid48 0 "VFCOnOff_Off" 1 "VFCOnOff_On";
VAL_ 836 VFCVectorSDRVFCid49 0 "VFCOnOff_Off" 1 "VFCOnOff_On";
VAL_ 836 VFCVectorSDRVFCid5 0 "VFCOnOff_Off" 1 "VFCOnOff_On";
VAL_ 836 VFCVectorSDRVFCid50 0 "VFCOnOff_Off" 1 "VFCOnOff_On";
VAL_ 836 VFCVectorSDRVFCid51 0 "VFCOnOff_Off" 1 "VFCOnOff_On";
VAL_ 836 VFCVectorSDRVFCid52 0 "VFCOnOff_Off" 1 "VFCOnOff_On";
VAL_ 836 VFCVectorSDRVFCid53 0 "VFCOnOff_Off" 1 "VFCOnOff_On";
VAL_ 836 VFCVectorSDRVFCid54 0 "VFCOnOff_Off" 1 "VFCOnOff_On";
VAL_ 836 VFCVectorSDRVFCid55 0 "VFCOnOff_Off" 1 "VFCOnOff_On";
VAL_ 836 VFCVectorSDRVFCid56 0 "VFCOnOff_Off" 1 "VFCOnOff_On";
VAL_ 836 VFCVectorSDRVFCid57 0 "VFCOnOff_Off" 1 "VFCOnOff_On";
VAL_ 836 VFCVectorSDRVFCid58 0 "VFCOnOff_Off" 1 "VFCOnOff_On";
VAL_ 836 VFCVectorSDRVFCid59 0 "VFCOnOff_Off" 1 "VFCOnOff_On";
VAL_ 836 VFCVectorSDRVFCid6 0 "VFCOnOff_Off" 1 "VFCOnOff_On";
VAL_ 836 VFCVectorSDRVFCid60 0 "VFCOnOff_Off" 1 "VFCOnOff_On";
VAL_ 836 VFCVectorSDRVFCid61 0 "VFCOnOff_Off" 1 "VFCOnOff_On";
VAL_ 836 VFCVectorSDRVFCid7 0 "VFCOnOff_Off" 1 "VFCOnOff_On";
VAL_ 836 VFCVectorSDRVFCid8 0 "VFCOnOff_Off" 1 "VFCOnOff_On";
VAL_ 836 VFCVectorSDRVFCid9 0 "VFCOnOff_Off" 1 "VFCOnOff_On";
VAL_ 928 ExtrLiShowActvnReLeFb 0 "Sts_Resd" 1 "Sts_Err" 2 "Sts_CmplOk" 3 "Sts_InProgs";
VAL_ 928 ExtrLiShowActvnReRiFb 0 "Sts_Resd" 1 "Sts_Err" 2 "Sts_CmplOk" 3 "Sts_InProgs";
VAL_ 1177 ExvFltSts 0 "TMcloudFltSts_NoFault" 1 "TMcloudFltSts_CPSRPowerOff" 2 "TMcloudFltSts_FaultByAmbientTemp" 3 "TMcloudFltSts_CPSRVoltageFault" 4 "TMcloudFltSts_MissingMessage" 10 "TMcloudFltSts_InitializationUnsuccess" 11 "TMcloudFltSts_Fault" 12 "TMcloudFltSts_Blocked" 13 "TMcloudFltSts_HighTempFault" 14 "TMcloudFltSts_Resd";
VAL_ 320 BotmSnsrStsFromFootOper 0 "OkNotOk1_Ok" 1 "OkNotOk1_NotOk";
VAL_ 320 DockColumGrayReqForTvc 0 "ReqSts1_NotReqd" 1 "ReqSts1_Reqd";
VAL_ 320 LinCtrlForRowSecLeSeatAdjmt 0 "CmftSet_NoReq" 1 "CmftSet_ComfortReq" 2 "CmftSet_ReturnReq";
VAL_ 320 LinCtrlForRowSecRiSeatAdjmt 0 "CmftSet_NoReq" 1 "CmftSet_ComfortReq" 2 "CmftSet_ReturnReq";
VAL_ 320 LowrTailgOpenerSwt 0 "PsdNotPsd_NotPsd" 1 "PsdNotPsd_Psd";
VAL_ 320 MagChrgLidTip1 0 "Boolean_FALSE" 1 "Boolean_TRUE";
VAL_ 320 MagChrgLidTip2 0 "Boolean_FALSE" 1 "Boolean_TRUE";
VAL_ 320 NFCKeyReadStsToHMIKey0 0 "KeyPrsntSts1_KeyPrsntStsIdle" 1 "KeyPrsntSts1_KeyPrsntStsInProgs" 2 "KeyPrsntSts1_KeyPrsntStsNotPrsnt" 3 "KeyPrsntSts1_KeyPrsntStsPrsnt";
VAL_ 320 NFCKeyReadStsToHMIKey1 0 "KeyPrsntSts1_KeyPrsntStsIdle" 1 "KeyPrsntSts1_KeyPrsntStsInProgs" 2 "KeyPrsntSts1_KeyPrsntStsNotPrsnt" 3 "KeyPrsntSts1_KeyPrsntStsPrsnt";
VAL_ 320 NFCKeyReadStsToHMIKey10 0 "KeyPrsntSts1_KeyPrsntStsIdle" 1 "KeyPrsntSts1_KeyPrsntStsInProgs" 2 "KeyPrsntSts1_KeyPrsntStsNotPrsnt" 3 "KeyPrsntSts1_KeyPrsntStsPrsnt";
VAL_ 320 NFCKeyReadStsToHMIKey11 0 "KeyPrsntSts1_KeyPrsntStsIdle" 1 "KeyPrsntSts1_KeyPrsntStsInProgs" 2 "KeyPrsntSts1_KeyPrsntStsNotPrsnt" 3 "KeyPrsntSts1_KeyPrsntStsPrsnt";
VAL_ 320 NFCKeyReadStsToHMIKey12 0 "KeyPrsntSts1_KeyPrsntStsIdle" 1 "KeyPrsntSts1_KeyPrsntStsInProgs" 2 "KeyPrsntSts1_KeyPrsntStsNotPrsnt" 3 "KeyPrsntSts1_KeyPrsntStsPrsnt";
VAL_ 320 NFCKeyReadStsToHMIKey13 0 "KeyPrsntSts1_KeyPrsntStsIdle" 1 "KeyPrsntSts1_KeyPrsntStsInProgs" 2 "KeyPrsntSts1_KeyPrsntStsNotPrsnt" 3 "KeyPrsntSts1_KeyPrsntStsPrsnt";
VAL_ 320 NFCKeyReadStsToHMIKey14 0 "KeyPrsntSts1_KeyPrsntStsIdle" 1 "KeyPrsntSts1_KeyPrsntStsInProgs" 2 "KeyPrsntSts1_KeyPrsntStsNotPrsnt" 3 "KeyPrsntSts1_KeyPrsntStsPrsnt";
VAL_ 320 NFCKeyReadStsToHMIKey15 0 "KeyPrsntSts1_KeyPrsntStsIdle" 1 "KeyPrsntSts1_KeyPrsntStsInProgs" 2 "KeyPrsntSts1_KeyPrsntStsNotPrsnt" 3 "KeyPrsntSts1_KeyPrsntStsPrsnt";
VAL_ 320 NFCKeyReadStsToHMIKey2 0 "KeyPrsntSts1_KeyPrsntStsIdle" 1 "KeyPrsntSts1_KeyPrsntStsInProgs" 2 "KeyPrsntSts1_KeyPrsntStsNotPrsnt" 3 "KeyPrsntSts1_KeyPrsntStsPrsnt";
VAL_ 320 NFCKeyReadStsToHMIKey3 0 "KeyPrsntSts1_KeyPrsntStsIdle" 1 "KeyPrsntSts1_KeyPrsntStsInProgs" 2 "KeyPrsntSts1_KeyPrsntStsNotPrsnt" 3 "KeyPrsntSts1_KeyPrsntStsPrsnt";
VAL_ 320 NFCKeyReadStsToHMIKey4 0 "KeyPrsntSts1_KeyPrsntStsIdle" 1 "KeyPrsntSts1_KeyPrsntStsInProgs" 2 "KeyPrsntSts1_KeyPrsntStsNotPrsnt" 3 "KeyPrsntSts1_KeyPrsntStsPrsnt";
VAL_ 320 NFCKeyReadStsToHMIKey5 0 "KeyPrsntSts1_KeyPrsntStsIdle" 1 "KeyPrsntSts1_KeyPrsntStsInProgs" 2 "KeyPrsntSts1_KeyPrsntStsNotPrsnt" 3 "KeyPrsntSts1_KeyPrsntStsPrsnt";
VAL_ 320 NFCKeyReadStsToHMIKey6 0 "KeyPrsntSts1_KeyPrsntStsIdle" 1 "KeyPrsntSts1_KeyPrsntStsInProgs" 2 "KeyPrsntSts1_KeyPrsntStsNotPrsnt" 3 "KeyPrsntSts1_KeyPrsntStsPrsnt";
VAL_ 320 NFCKeyReadStsToHMIKey7 0 "KeyPrsntSts1_KeyPrsntStsIdle" 1 "KeyPrsntSts1_KeyPrsntStsInProgs" 2 "KeyPrsntSts1_KeyPrsntStsNotPrsnt" 3 "KeyPrsntSts1_KeyPrsntStsPrsnt";
VAL_ 320 NFCKeyReadStsToHMIKey8 0 "KeyPrsntSts1_KeyPrsntStsIdle" 1 "KeyPrsntSts1_KeyPrsntStsInProgs" 2 "KeyPrsntSts1_KeyPrsntStsNotPrsnt" 3 "KeyPrsntSts1_KeyPrsntStsPrsnt";
VAL_ 320 NFCKeyReadStsToHMIKey9 0 "KeyPrsntSts1_KeyPrsntStsIdle" 1 "KeyPrsntSts1_KeyPrsntStsInProgs" 2 "KeyPrsntSts1_KeyPrsntStsNotPrsnt" 3 "KeyPrsntSts1_KeyPrsntStsPrsnt";
VAL_ 320 PtDirAllwdToTrsmActrFwd 0 "Flg1_Rst" 1 "Flg1_Set";
VAL_ 320 PtDirAllwdToTrsmActrNeut 0 "Flg1_Rst" 1 "Flg1_Set";
VAL_ 320 PtDirAllwdToTrsmActrParkRls 0 "Flg1_Rst" 1 "Flg1_Set";
VAL_ 320 PtDirAllwdToTrsmActrRvs 0 "Flg1_Rst" 1 "Flg1_Set";
VAL_ 320 PtGearActrAdpnCmd 0 "Boolean_FALSE" 1 "Boolean_TRUE";
VAL_ 320 PtGearActtnAllwdSts1 0 "PtGearActtnAllwdSts_DtInUse" 1 "PtGearActtnAllwdSts_DtSafeToDisengmt" 2 "PtGearActtnAllwdSts_DtSafeToSync" 3 "PtGearActtnAllwdSts_Resd";
VAL_ 320 PtGearActtnAllwdSts2 0 "PtGearActtnAllwdSts_DtInUse" 1 "PtGearActtnAllwdSts_DtSafeToDisengmt" 2 "PtGearActtnAllwdSts_DtSafeToSync" 3 "PtGearActtnAllwdSts_Resd";
VAL_ 320 PtGearActtnModReq 0 "PtGearActtnModReq_Mod0" 1 "PtGearActtnModReq_Mod1" 2 "PtGearActtnModReq_Mod2" 3 "PtGearActtnModReq_Mod3";
VAL_ 320 PtGearActtnPrio 0 "PtGearActtnPrio_Shaft1" 1 "PtGearActtnPrio_Shaft2";
VAL_ 320 PtGearActtnReq1 0 "TrsmGear_Neut" 1 "TrsmGear_Gear1" 2 "TrsmGear_Gear2" 3 "TrsmGear_Gear3" 4 "TrsmGear_Gear4" 5 "TrsmGear_Gear5" 6 "TrsmGear_Gear6" 7 "TrsmGear_Gear7" 8 "TrsmGear_Gear8" 9 "TrsmGear_Gear9" 10 "TrsmGear_Gear10" 11 "TrsmGear_Gear11" 12 "TrsmGear_Gear12" 13 "TrsmGear_Gear13" 14 "TrsmGear_Rvs" 15 "TrsmGear_Park";
VAL_ 320 PtGearActtnReq2 0 "TrsmGear_Neut" 1 "TrsmGear_Gear1" 2 "TrsmGear_Gear2" 3 "TrsmGear_Gear3" 4 "TrsmGear_Gear4" 5 "TrsmGear_Gear5" 6 "TrsmGear_Gear6" 7 "TrsmGear_Gear7" 8 "TrsmGear_Gear8" 9 "TrsmGear_Gear9" 10 "TrsmGear_Gear10" 11 "TrsmGear_Gear11" 12 "TrsmGear_Gear12" 13 "TrsmGear_Gear13" 14 "TrsmGear_Rvs" 15 "TrsmGear_Park";
VAL_ 320 RWA1ColAgTarQf 0 "GenQf1_UndefindDataAccur" 1 "GenQf1_TmpUndefdData" 2 "GenQf1_DataAccurNotWithinSpcn" 3 "GenQf1_AccurData";
VAL_ 320 SbWDecoupldStsH1SbWDecoupldSts 0 "OkNotOk_NotOk" 1 "OkNotOk_Ok";
VAL_ 320 SbWErrReqH1ErrReq 0 "ErrReq_AllOk" 1 "ErrReq_TemporarilyDegradation" 2 "ErrReq_NormalPerformance_HWFailure" 3 "ErrReq_Hwa_HalfPerfmAndRwa_AllPerfm" 4 "ErrReq_Hwa_ZeroPerfmAndRwa_AllPerfm" 5 "ErrReq_Rwa_HalfPerformance" 6 "ErrReq_Rwa_ZeroPerfmOrHwaBlockOrRwaBlock";
VAL_ 320 SBWErrReqR1ErrReq 0 "ErrReq_AllOk" 1 "ErrReq_TemporarilyDegradation" 2 "ErrReq_NormalPerformance_HWFailure" 3 "ErrReq_Hwa_HalfPerfmAndRwa_AllPerfm" 4 "ErrReq_Hwa_ZeroPerfmAndRwa_AllPerfm" 5 "ErrReq_Rwa_HalfPerformance" 6 "ErrReq_Rwa_ZeroPerfmOrHwaBlockOrRwaBlock";
VAL_ 320 SumActv 0 "Boolean_FALSE" 1 "Boolean_TRUE";
VAL_ 320 TankTurnModStsTankTurnModSts 0 "TurnModSts_OFF" 1 "TurnModSts_Standby" 2 "TurnModSts_Ready" 3 "TurnModSts_Active";
VAL_ 320 TrsmClu0FltIndcn 0 "TrsmClu0FltIndcn_Default" 1 "TrsmClu0FltIndcn_FailToDisengage" 2 "TrsmClu0FltIndcn_FailToEngage" 3 "TrsmClu0FltIndcn_LongSlip";
VAL_ 320 TrsmCluSlipStsOfClu0 0 "CluSlipCmd_NoEcmControlReq" 1 "CluSlipCmd_ClutchSlip" 2 "CluSlipCmd_ClutchTorqueFollow" 3 "CluSlipCmd_OpenForParallelGearshift";
VAL_ 320 TrsmCluT1Qf 0 "TrsmCluTQf_Invld" 1 "TrsmCluTQf_Ini" 2 "TrsmCluTQf_NotWithinRng" 3 "TrsmCluTQf_Ok";
VAL_ 320 TrsmCluT2Qf 0 "TrsmCluTQf_Invld" 1 "TrsmCluTQf_Ini" 2 "TrsmCluTQf_NotWithinRng" 3 "TrsmCluTQf_Ok";
VAL_ 320 TrsmDtModAct 0 "PtModReq_Ev" 1 "PtModReq_Serial" 2 "PtModReq_Parallel" 3 "PtModReq_P2Gen" 4 "PtModReq_ParallelLaunch";
VAL_ 320 TrsmEngmtLimd3TrsmEngmtLimd 0 "YesNo1_Yes" 1 "YesNo1_No";
VAL_ 320 TrsmErrIndcnReq2 0 "OnOff1_Off" 1 "OnOff1_On";
VAL_ 320 TrsmGbxActrOff 0 "TrsmGbxActrOff_NotOff" 1 "TrsmGbxActrOff_Faild";
VAL_ 320 TrsmGearActrScanForRefActv 0 "TrsmGearActrScanForRefActv_ScanRefNotActv" 1 "TrsmGearActrScanForRefActv_ScanRefActv";
VAL_ 320 TrsmGearActrScanForRefReq 0 "TrsmGearActrScanForRefReq_ScanRefNotReqd" 1 "TrsmGearActrScanForRefReq_ScanRefReqd";
VAL_ 320 TrsmGearActrTLvl 0 "TrsmGearActrTLvl_NormOper" 1 "TrsmGearActrTLvl_TLvl1" 2 "TrsmGearActrTLvl_TLvl2" 3 "TrsmGearActrTLvl_TLvl3";
VAL_ 320 TrsmHardRotReq1 0 "Boolean_FALSE" 1 "Boolean_TRUE";
VAL_ 320 TrsmNRecInpDir1 0 "TrsmNInpOutpDir_NotBackw" 1 "TrsmNInpOutpDir_Backw";
VAL_ 320 TrsmNRecInpDir2 0 "TrsmNInpOutpDir_NotBackw" 1 "TrsmNInpOutpDir_Backw";
VAL_ 320 TrsmNRecInpQf1 0 "TrsmNInpOutpQf_Nok" 1 "TrsmNInpOutpQf_Lvl0" 2 "TrsmNInpOutpQf_Lvl1" 3 "TrsmNInpOutpQf_Lvl2";
VAL_ 320 TrsmNRecInpQf2 0 "TrsmNInpOutpQf_Nok" 1 "TrsmNInpOutpQf_Lvl0" 2 "TrsmNInpOutpQf_Lvl1" 3 "TrsmNInpOutpQf_Lvl2";
VAL_ 320 TrsmNRecOutpDir 0 "TrsmNInpOutpDir_NotBackw" 1 "TrsmNInpOutpDir_Backw";
VAL_ 320 TrsmNRecOutpQf 0 "TrsmNInpOutpQf_Nok" 1 "TrsmNInpOutpQf_Lvl0" 2 "TrsmNInpOutpQf_Lvl1" 3 "TrsmNInpOutpQf_Lvl2";
VAL_ 320 TrsmOutpNDir 0 "TrsmOutpDir_NotBackw" 1 "TrsmOutpDir_Backw";
VAL_ 320 TrsmOutpNSpdQf 0 "GenQf1_UndefindDataAccur" 1 "GenQf1_TmpUndefdData" 2 "GenQf1_DataAccurNotWithinSpcn" 3 "GenQf1_AccurData";
VAL_ 463 DftlFltIndcn 0 "DftlFltIndcn1_Ok" 1 "DftlFltIndcn1_DftlTHi" 2 "DftlFltIndcn1_DftlSysPfmncLo" 3 "DftlFltIndcn1_DftlSysSrvRqrd" 4 "DftlFltIndcn1_Resd1" 5 "DftlFltIndcn1_Resd2" 6 "DftlFltIndcn1_Resd3" 7 "DftlFltIndcn1_Resd4";
VAL_ 463 EldtPmpCmdCooltPmpPostRunReq 0 "CooltPmpPostRun_CooltPmpNoPostRun" 1 "CooltPmpPostRun_CooltPmpPostRun1" 2 "CooltPmpPostRun_CooltPmpPostRun2" 3 "CooltPmpPostRun_CooltPmpPostRun3" 4 "CooltPmpPostRun_CooltPmpPostRun4" 5 "CooltPmpPostRun_Resvd1" 6 "CooltPmpPostRun_Resvd2" 7 "CooltPmpPostRun_Resvd3";
VAL_ 463 EngCooltPmpSpdReqCooltPmpPostRunReq 0 "CooltPmpPostRun_CooltPmpNoPostRun" 1 "CooltPmpPostRun_CooltPmpPostRun1" 2 "CooltPmpPostRun_CooltPmpPostRun2" 3 "CooltPmpPostRun_CooltPmpPostRun3" 4 "CooltPmpPostRun_CooltPmpPostRun4" 5 "CooltPmpPostRun_Resvd1" 6 "CooltPmpPostRun_Resvd2" 7 "CooltPmpPostRun_Resvd3";
VAL_ 463 EngPmpStatCooltPmpDryErr 0 "CooltPmpDryErr_RunDryNotDetd" 1 "CooltPmpDryErr_RunDryDetd" 2 "CooltPmpDryErr_Resd1" 3 "CooltPmpDryErr_Resd2";
VAL_ 463 EngPmpStatCooltPmpEmgyModSts 0 "CooltPmpEmgyModSts_EmgyRunNotActv" 1 "CooltPmpEmgyModSts_EmgyRunActv" 2 "CooltPmpEmgyModSts_Resd1" 3 "CooltPmpEmgyModSts_Resd2";
VAL_ 463 EngPmpStatCooltPmpErrSts 0 "CooltPmpErrSts_StNoErr" 1 "CooltPmpErrSts_StErr" 2 "CooltPmpErrSts_StNewErr" 3 "CooltPmpErrSts_Resd";
VAL_ 463 EngPmpStatCooltPmpIErr 0 "CooltPmpIErr_INoErr" 1 "CooltPmpIErr_IErr" 2 "CooltPmpIErr_Resd1" 3 "CooltPmpIErr_Resd2";
VAL_ 463 EngPmpStatCooltPmpMonrSpd 0 "CooltPmpMonrSpd_MonrSpdActv" 1 "CooltPmpMonrSpd_MonrSpdNoActv" 2 "CooltPmpMonrSpd_Resd1" 3 "CooltPmpMonrSpd_Resd2";
VAL_ 463 EngPmpStatCooltPmpPostRunSts 0 "CooltPmpPostRunSts_CooltPmpPostRunFinshd" 1 "CooltPmpPostRunSts_CooltPmpPostRunCncld" 2 "CooltPmpPostRunSts_Resd1" 3 "CooltPmpPostRunSts_Resd2";
VAL_ 463 EngPmpStatCooltPmpSetPostRunReq 0 "CooltPmpSetPostRunReq_CooltPmpSetNoPostRun" 1 "CooltPmpSetPostRunReq_CooltPmpSetPostRun1" 2 "CooltPmpSetPostRunReq_CooltPmpSetPostRun2" 3 "CooltPmpSetPostRunReq_CooltPmpSetPostRun3" 4 "CooltPmpSetPostRunReq_CooltPmpSetPostRun4" 5 "CooltPmpSetPostRunReq_CooltPmpSetPostRun5" 6 "CooltPmpSetPostRunReq_Resd1" 7 "CooltPmpSetPostRunReq_Resd2";
VAL_ 463 EngPmpStatCooltPmpTErr 0 "CooltPmpTErr_CooltPmpNoTErr" 1 "CooltPmpTErr_CooltPmpTErr" 2 "CooltPmpTErr_Resd1" 3 "CooltPmpTErr_Resd2";
VAL_ 463 EngPmpStatCooltPmpUErr 0 "CooltPmpUErr_CooltPmpNoUErr" 1 "CooltPmpUErr_CooltPmpUErr" 2 "CooltPmpUErr_Resd1" 3 "CooltPmpUErr_Resd2";
VAL_ 463 EngPmpStatCooltPmpUnstallSts 0 "CooltPmpUnstallSts_CooltPmpUnstallNotActv" 1 "CooltPmpUnstallSts_CooltPmpUnstallActv" 2 "CooltPmpUnstallSts_Resd1" 3 "CooltPmpUnstallSts_Resd2";
VAL_ 463 FootwellLiSts 0 "OnOff1_Off" 1 "OnOff1_On";
VAL_ 463 PtCluSlipCmdOfClu0 0 "CluSlipCmd_NoEcmControlReq" 1 "CluSlipCmd_ClutchSlip" 2 "CluSlipCmd_ClutchTorqueFollow" 3 "CluSlipCmd_OpenForParallelGearshift";
VAL_ 463 SldngDoorLeReModSts 0 "DoorModSts_Electronal" 1 "DoorModSts_Manual";
VAL_ 463 SldngDoorRiReModSts 0 "DoorModSts_Electronal" 1 "DoorModSts_Manual";
VAL_ 463 TireFilFilSwt 0 "OnOff1_Off" 1 "OnOff1_On";
VAL_ 463 TireFilNoiseFlrSwt 0 "NormalMode" 1 "PolarPlotMode";
VAL_ 463 TireFilPollingMod 0 "PollingMod_PolllingMode" 1 "PollingMod_RunningMode" 2 "PollingMod_ActivePollingMode";
VAL_ 463 TireFilRxSwt 0 "OnOff1_Off" 1 "OnOff1_On";
VAL_ 463 TrLockStsRadar 0 "LockSts2_LockStsUkwn" 1 "LockSts2_Unlckd" 2 "LockSts2_Lockd" 3 "LockSts2_SafeLockd";
VAL_ 463 TrsmClu0StsTrsm0CluSts 0 "TrsmClu0Sts_Invalid" 1 "TrsmClu0Sts_Enggaged" 2 "TrsmClu0Sts_Disengaged" 3 "TrsmClu0Sts_Unkown";
VAL_ 463 TrsmGearActSafeTrsmGearActSafe 0 "PtGearAct1_Neut" 1 "PtGearAct1_Gear1" 2 "PtGearAct1_Gear2" 3 "PtGearAct1_Gear3" 4 "PtGearAct1_Gear4" 5 "PtGearAct1_Gear5" 6 "PtGearAct1_Gear6" 7 "PtGearAct1_Gear7" 8 "PtGearAct1_Gear8" 9 "PtGearAct1_Gear9" 10 "PtGearAct1_Gear10" 11 "PtGearAct1_Gear11" 12 "PtGearAct1_Gear12" 13 "PtGearAct1_Drv" 14 "PtGearAct1_Ukwn" 15 "PtGearAct1_Rvs";
VAL_ 463 TrsmHardRotReq2 0 "Boolean_FALSE" 1 "Boolean_TRUE";
VAL_ 463 TrsmLockMgrWarnlndcn 0 "TrsmLockMgrIndcn_TrsmLockMgrNoMsg" 1 "TrsmLockMgrIndcn_TrsmLockTiOutMsgMgr" 2 "TrsmLockMgrIndcn_TrsmLockMsgServReq" 3 "TrsmLockMgrIndcn_Reserved";
VAL_ 463 WcacVlvRefDrvReq 0 "RefDrvReq_NoReq" 1 "RefDrvReq_REFDRV_Req" 2 "RefDrvReq_Reserved" 3 "RefDrvReq_SNA";
VAL_ 523 CmprReqCmprRunReq 0 "CmprRunReq_CmprOff" 1 "CmprRunReq_CmprOn" 2 "CmprRunReq_Resd" 3 "CmprRunReq_SigNotAvl";
VAL_ 523 CurtBtnSts 0 "SunRoofAndCurtBtnStsTyp2_Idle" 1 "SunRoofAndCurtBtnStsTyp2_BackwStep1" 2 "SunRoofAndCurtBtnStsTyp2_BackwStep2" 3 "SunRoofAndCurtBtnStsTyp2_ForwStep1" 4 "SunRoofAndCurtBtnStsTyp2_ForwStep2" 5 "SunRoofAndCurtBtnStsTyp2_TiltUpStep1" 6 "SunRoofAndCurtBtnStsTyp2_TiltDwnStep1" 7 "SunRoofAndCurtBtnStsTyp2_Failr";
VAL_ 523 DrvrSeatActvSwtFctMod 0 "SwtFctMod_Mod1" 1 "SwtFctMod_Mod2" 2 "SwtFctMod_Mod3" 3 "SwtFctMod_Mod4";
VAL_ 523 DrvrSeatIntgrSwtStsIntgrSwtHozlSts 0 "SwtHozlSts1_Idle" 1 "SwtHozlSts1_Fwd" 2 "SwtHozlSts1_Backw";
VAL_ 523 DrvrSeatIntgrSwtStsIntgrSwtRotSts 0 "SwtHozlSts1_Idle" 1 "SwtHozlSts1_Fwd" 2 "SwtHozlSts1_Backw";
VAL_ 523 DrvrSeatIntgrSwtStsIntgrSwtSelnSts 0 "SwtVertSts1_Idle" 1 "SwtVertSts1_Up" 2 "SwtVertSts1_Dwn";
VAL_ 523 DrvrSeatIntgrSwtStsIntgrSwtVertSts 0 "SwtVertSts1_Idle" 1 "SwtVertSts1_Up" 2 "SwtVertSts1_Dwn";
VAL_ 523 FrCurtBtnSts 0 "SunRoofAndCurtBtnStsTyp2_Idle" 1 "SunRoofAndCurtBtnStsTyp2_BackwStep1" 2 "SunRoofAndCurtBtnStsTyp2_BackwStep2" 3 "SunRoofAndCurtBtnStsTyp2_ForwStep1" 4 "SunRoofAndCurtBtnStsTyp2_ForwStep2" 5 "SunRoofAndCurtBtnStsTyp2_TiltUpStep1" 6 "SunRoofAndCurtBtnStsTyp2_TiltDwnStep1" 7 "SunRoofAndCurtBtnStsTyp2_Failr";
VAL_ 523 HpBattVlvRefDrvReq 0 "RefDrvReq_NoReq" 1 "RefDrvReq_REFDRV_Req" 2 "RefDrvReq_Reserved" 3 "RefDrvReq_SNA";
VAL_ 523 PassAirbLampStsRecPassAirbLampSts 0 "PassAirbLampSts1_Resd1" 1 "PassAirbLampSts1_LampStsOk" 2 "PassAirbLampSts1_LampStsNotOk" 3 "PassAirbLampSts1_Resd2";
VAL_ 523 ReAirPtcEnad 0 "Boolean_FALSE" 1 "Boolean_TRUE";
VAL_ 523 ReCurtBtnSts 0 "SunRoofAndCurtBtnStsTyp2_Idle" 1 "SunRoofAndCurtBtnStsTyp2_BackwStep1" 2 "SunRoofAndCurtBtnStsTyp2_BackwStep2" 3 "SunRoofAndCurtBtnStsTyp2_ForwStep1" 4 "SunRoofAndCurtBtnStsTyp2_ForwStep2" 5 "SunRoofAndCurtBtnStsTyp2_TiltUpStep1" 6 "SunRoofAndCurtBtnStsTyp2_TiltDwnStep1" 7 "SunRoofAndCurtBtnStsTyp2_Failr";
VAL_ 523 RoofBtnSts 0 "SunRoofAndCurtBtnStsTyp2_Idle" 1 "SunRoofAndCurtBtnStsTyp2_BackwStep1" 2 "SunRoofAndCurtBtnStsTyp2_BackwStep2" 3 "SunRoofAndCurtBtnStsTyp2_ForwStep1" 4 "SunRoofAndCurtBtnStsTyp2_ForwStep2" 5 "SunRoofAndCurtBtnStsTyp2_TiltUpStep1" 6 "SunRoofAndCurtBtnStsTyp2_TiltDwnStep1" 7 "SunRoofAndCurtBtnStsTyp2_Failr";
VAL_ 523 TrRelsReq 0 "OnOffSafe1_OnOffSafeInvld1" 1 "OnOffSafe1_OnOffSafeOn" 2 "OnOffSafe1_OnOffSafeOff" 3 "OnOffSafe1_OnOffSafeInvld2";
VAL_ 1197 ActvnOfApproachInEITL 0 "OnOff1_Off" 1 "OnOff1_On";
VAL_ 1197 ActvnOfCarLoctrInEITL 0 "OnOff1_Off" 1 "OnOff1_On";
VAL_ 1197 ActvReSplrPosn 0 "ActvSplr_Ukwn" 1 "ActvSplr_P0" 2 "ActvSplr_P1" 3 "ActvSplr_P2" 4 "ActvSplr_P3" 5 "ActvSplr_Shifting" 6 "ActvSplr_Reserved" 7 "ActvSplr_Error";
VAL_ 1197 CeilingShieldSwt1 0 "PsdNotPsd_NotPsd" 1 "PsdNotPsd_Psd";
VAL_ 1197 FrntSeatLinStopFromSecSeatLe 0 "Boolean_FALSE" 1 "Boolean_TRUE";
VAL_ 1197 FrntSeatLinStopFromSecSeatRi 0 "Boolean_FALSE" 1 "Boolean_TRUE";
VAL_ 1197 GVMCVehCtrlrStsCtrlrSts 0 "GVMCVehCtrlrSts2_Init" 1 "GVMCVehCtrlrSts2_Enabled" 2 "GVMCVehCtrlrSts2_Disabled" 3 "GVMCVehCtrlrSts2_RWSDisabled" 4 "GVMCVehCtrlrSts2_DisabledWithError" 5 "GVMCVehCtrlrSts2_RWSDisabledWithError" 6 "GVMCVehCtrlrSts2_TorqueDistributionDisabledWithError" 7 "GVMCVehCtrlrSts2_BrakeTorqueControlDisabledWithError" 8 "GVMCVehCtrlrSts2_VMCYawTorqueControlDegraded" 9 "GVMCVehCtrlrSts2_SuspensionDegrade" 10 "GVMCVehCtrlrSts2_EnterToBoth8And9DegradationStatus" 11 "GVMCVehCtrlrSts2_NotAvailableForPilot" 12 "GVMCVehCtrlrSts2_NotAvailableForCrabMov_LowSpdStr_TankTurn" 13 "GVMCVehCtrlrSts2_EnterToBoth11And12" 14 "GVMCVehCtrlrSts2_GVMCOff" 15 "GVMCVehCtrlrSts2_Resd";
VAL_ 1197 RowSecRiFldRsdSts 0 "FoldRaiseMovmt_Uknwn" 1 "FoldRaiseMovmt_Fld" 2 "FoldRaiseMovmt_Rsd" 3 "FoldRaiseMovmt_MovmtToFld" 4 "FoldRaiseMovmt_MovmtToRsd" 5 "FoldRaiseMovmt_BtwnFldAndRsd";
VAL_ 1197 TechLiWakeup 0 "OnOff1_Off" 1 "OnOff1_On";
VAL_ 934 FrntSunCurtFailr2CurtMotFailr 0 "Boolean_FALSE" 1 "Boolean_TRUE";
VAL_ 934 FrntSunCurtFailr2CurtMotHallFailr 0 "Boolean_FALSE" 1 "Boolean_TRUE";
VAL_ 934 FrntSunCurtFailr2CurtMotHallNotAvl 0 "Boolean_FALSE" 1 "Boolean_TRUE";
VAL_ 934 FrntSunCurtFailr2CurtMotNotAvl 0 "Boolean_FALSE" 1 "Boolean_TRUE";
VAL_ 934 FrntSunCurtFailr2EcuFailrGen 0 "Boolean_FALSE" 1 "Boolean_TRUE";
VAL_ 934 FrntSunCurtFailr2Resvd 0 "Boolean_FALSE" 1 "Boolean_TRUE";
VAL_ 934 FrSunCurtImpctDetSts 0 "SunRoofAndCurtImpctDetnStsTyp_ImpctDetnDi" 1 "SunRoofAndCurtImpctDetnStsTyp_ImpctDetnEna" 2 "SunRoofAndCurtImpctDetnStsTyp_ClsPinch" 3 "SunRoofAndCurtImpctDetnStsTyp_ClsBlk" 4 "SunRoofAndCurtImpctDetnStsTyp_OpenPinch" 5 "SunRoofAndCurtImpctDetnStsTyp_OpenBlk";
VAL_ 934 GVMCPrpsnTqDistbnReqAtAxleReCtrlMod 0 "Boolean_FALSE" 1 "Boolean_TRUE";
VAL_ 934 GVMCPrpsnTqDistReqCtrlMod 0 "Boolean_FALSE" 1 "Boolean_TRUE";
VAL_ 934 GVMCSteerWhlAgReqReCtrlModRe 0 "CtrlSts3b_INIT" 1 "CtrlSts3b_CONTROL_NOT_REQUESTED" 2 "CtrlSts3b_CONTROL_REQUESTED" 3 "CtrlSts3b_ERROR" 4 "CtrlSts3b_RESERVED_1" 5 "CtrlSts3b_RESERVED_2" 6 "CtrlSts3b_RESERVED_3" 7 "CtrlSts3b_RESERVED_4";
VAL_ 934 GVMCSuspDampgCtrlReqGVMCSuspDampgCtrlMod 0 "CtrlSts1_NoCtrl" 1 "CtrlSts1_InCtrl";
VAL_ 934 GVMCSuspDampgCtrlReqGVMCSuspDampgModReq 0 "Level2_Lvl0" 1 "Level2_Lvl1" 2 "Level2_Lvl2" 3 "Level2_Lvl3";
VAL_ 934 GVMCSuspStfnCtrlReqGVMCSuspStfnCtrlMod 0 "CtrlSts1_NoCtrl" 1 "CtrlSts1_InCtrl";
VAL_ 934 GVMCSuspStfnCtrlReqGVMCSuspStfnReqFL 0 "Level2_Lvl0" 1 "Level2_Lvl1" 2 "Level2_Lvl2" 3 "Level2_Lvl3";
VAL_ 934 GVMCSuspStfnCtrlReqGVMCSuspStfnReqFR 0 "Level2_Lvl0" 1 "Level2_Lvl1" 2 "Level2_Lvl2" 3 "Level2_Lvl3";
VAL_ 934 GVMCSuspStfnCtrlReqGVMCSuspStfnReqRL 0 "Level2_Lvl0" 1 "Level2_Lvl1" 2 "Level2_Lvl2" 3 "Level2_Lvl3";
VAL_ 934 GVMCSuspStfnCtrlReqGVMCSuspStfnReqRR 0 "Level2_Lvl0" 1 "Level2_Lvl1" 2 "Level2_Lvl2" 3 "Level2_Lvl3";
VAL_ 934 ReSunCurtFailr2CurtMotFailr 0 "Boolean_FALSE" 1 "Boolean_TRUE";
VAL_ 934 ReSunCurtFailr2CurtMotHallFailr 0 "Boolean_FALSE" 1 "Boolean_TRUE";
VAL_ 934 ReSunCurtFailr2CurtMotHallNotAvl 0 "Boolean_FALSE" 1 "Boolean_TRUE";
VAL_ 934 ReSunCurtFailr2CurtMotNotAvl 0 "Boolean_FALSE" 1 "Boolean_TRUE";
VAL_ 934 ReSunCurtFailr2EcuFailrGen 0 "Boolean_FALSE" 1 "Boolean_TRUE";
VAL_ 934 ReSunCurtFailr2Resvd 0 "Boolean_FALSE" 1 "Boolean_TRUE";
VAL_ 934 ReSunCurtImpctDetnSts 0 "SunRoofAndCurtImpctDetnStsTyp_ImpctDetnDi" 1 "SunRoofAndCurtImpctDetnStsTyp_ImpctDetnEna" 2 "SunRoofAndCurtImpctDetnStsTyp_ClsPinch" 3 "SunRoofAndCurtImpctDetnStsTyp_ClsBlk" 4 "SunRoofAndCurtImpctDetnStsTyp_OpenPinch" 5 "SunRoofAndCurtImpctDetnStsTyp_OpenBlk";
VAL_ 934 SnsrInclnStsAlrmSts 0 "ReqSts1_NotReqd" 1 "ReqSts1_Reqd";
VAL_ 934 SnsrInclnStsArmSts 0 "ArmingTyp1_Disarmd" 1 "ArmingTyp1_Armd";
VAL_ 934 SnsrInclnStsCfgSts 0 "CfgSts_NotCfgd" 1 "CfgSts_InProgs" 2 "CfgSts_Rx" 3 "CfgSts_Cfgd";
VAL_ 934 SnsrInclnStsSnsrInclnErrSts 0 "SnsrAlrmErrSts_NotTest" 1 "SnsrAlrmErrSts_Passd" 2 "SnsrAlrmErrSts_Faild";
VAL_ 934 SnsrIntrScanStsAlrmReq 0 "ReqSts1_NotReqd" 1 "ReqSts1_Reqd";
VAL_ 934 SnsrIntrScanStsArmSts 0 "ArmingTyp1_Disarmd" 1 "ArmingTyp1_Armd";
VAL_ 934 SnsrIntrScanStsCfgSts 0 "CfgSts_NotCfgd" 1 "CfgSts_InProgs" 2 "CfgSts_Rx" 3 "CfgSts_Cfgd";
VAL_ 934 SnsrIntrScanStsSnsrInclnExist 0 "Boolean_FALSE" 1 "Boolean_TRUE";
VAL_ 934 SnsrIntrScanStsSnsrIntrScanErrSts 0 "SnsrAlrmErrSts_NotTest" 1 "SnsrAlrmErrSts_Passd" 2 "SnsrAlrmErrSts_Faild";
VAL_ 934 StsOfLedPosnLampLe1 0 "DevSts4_Off" 1 "DevSts4_On" 2 "DevSts4_Err" 3 "DevSts4_Resd";
VAL_ 934 StsOfLedPosnLampRi1 0 "DevSts4_Off" 1 "DevSts4_On" 2 "DevSts4_Err" 3 "DevSts4_Resd";
VAL_ 934 StsOfLedReFogLampLe1 0 "DevSts4_Off" 1 "DevSts4_On" 2 "DevSts4_Err" 3 "DevSts4_Resd";
VAL_ 934 StsOfLedReFogLampRi1 0 "DevSts4_Off" 1 "DevSts4_On" 2 "DevSts4_Err" 3 "DevSts4_Resd";
VAL_ 934 StsOfLedReLampLe1 0 "DevSts4_Off" 1 "DevSts4_On" 2 "DevSts4_Err" 3 "DevSts4_Resd";
VAL_ 934 StsOfLedReLampRi1 0 "DevSts4_Off" 1 "DevSts4_On" 2 "DevSts4_Err" 3 "DevSts4_Resd";
VAL_ 934 StsOfLedRvsgLampLe1 0 "DevSts4_Off" 1 "DevSts4_On" 2 "DevSts4_Err" 3 "DevSts4_Resd";
VAL_ 934 StsOfLedRvsgLampRi1 0 "DevSts4_Off" 1 "DevSts4_On" 2 "DevSts4_Err" 3 "DevSts4_Resd";
VAL_ 934 StsOfLedStopLampLe1 0 "DevSts4_Off" 1 "DevSts4_On" 2 "DevSts4_Err" 3 "DevSts4_Resd";
VAL_ 934 StsOfLedStopLampRi1 0 "DevSts4_Off" 1 "DevSts4_On" 2 "DevSts4_Err" 3 "DevSts4_Resd";
VAL_ 934 StsOfLedTurnIndcrLe1 0 "DevSts4_Off" 1 "DevSts4_On" 2 "DevSts4_Err" 3 "DevSts4_Resd";
VAL_ 934 StsOfLedTurnIndcrRi1 0 "DevSts4_Off" 1 "DevSts4_On" 2 "DevSts4_Err" 3 "DevSts4_Resd";
VAL_ 934 StsOfWelGbyReLe1 0 "OnOff1_Off" 1 "OnOff1_On";
VAL_ 934 StsOfWelGbyReRi1 0 "OnOff1_Off" 1 "OnOff1_On";
VAL_ 934 TrlrBrkLiSts 0 "OnOff1_Off" 1 "OnOff1_On";
VAL_ 934 TrlrFogLiSts 0 "OnOff1_Off" 1 "OnOff1_On";
VAL_ 934 TrlrIndcrTurnSts 0 "IndcrSts1_Off" 1 "IndcrSts1_LeOn" 2 "IndcrSts1_RiOn" 3 "IndcrSts1_LeAndRiOn";
VAL_ 934 TrlrLeIndcrFltSts 0 "DevErrSts2_NoFlt" 1 "DevErrSts2_Flt";
VAL_ 934 TrlrPosnLiSts 0 "OnOff1_Off" 1 "OnOff1_On";
VAL_ 934 TrlrRiIndcrFltSts 0 "DevErrSts2_NoFlt" 1 "DevErrSts2_Flt";
VAL_ 934 TrlrRvsgLiSts 0 "OnOff1_Off" 1 "OnOff1_On";
VAL_ 934 TrsmActrPosnSafeTrsmActrPosn 0 "TrsmActrPosn1_Park" 1 "TrsmActrPosn1_ParkRvs" 2 "TrsmActrPosn1_Rvs" 3 "TrsmActrPosn1_RvsNeut" 4 "TrsmActrPosn1_Neut" 5 "TrsmActrPosn1_NeutDrv" 6 "TrsmActrPosn1_Drv" 7 "TrsmActrPosn1_Undefd";
VAL_ 934 TwbrRelsBtn 0 "PsdNotPsd1_NotPsd" 1 "PsdNotPsd1_Psd";
VAL_ 1180 FanDiagFltSts 0 "TMcloudFltSts_NoFault" 1 "TMcloudFltSts_CPSRPowerOff" 2 "TMcloudFltSts_FaultByAmbientTemp" 3 "TMcloudFltSts_CPSRVoltageFault" 4 "TMcloudFltSts_MissingMessage" 10 "TMcloudFltSts_InitializationUnsuccess" 11 "TMcloudFltSts_Fault" 12 "TMcloudFltSts_Blocked" 13 "TMcloudFltSts_HighTempFault" 14 "TMcloudFltSts_Resd";
VAL_ 1180 FrntCurtOpenPosnCmd 0 "PosnCmdType_Idle" 1 "PosnCmdType_ClsFull" 2 "PosnCmdType_PercOpen4" 3 "PosnCmdType_PercOpen8" 4 "PosnCmdType_PercOpen12" 5 "PosnCmdType_PercOpen16" 6 "PosnCmdType_PercOpen20" 7 "PosnCmdType_PercOpen24" 8 "PosnCmdType_PercOpen28" 9 "PosnCmdType_PercOpen32" 10 "PosnCmdType_PercOpen36" 11 "PosnCmdType_PercOpen40" 12 "PosnCmdType_PercOpen44" 13 "PosnCmdType_PercOpen48" 14 "PosnCmdType_PercOpen52" 15 "PosnCmdType_PercOpen56" 16 "PosnCmdType_PercOpen60" 17 "PosnCmdType_PercOpen64" 18 "PosnCmdType_PercOpen68" 19 "PosnCmdType_PercOpen72" 20 "PosnCmdType_PercOpen76" 21 "PosnCmdType_PercOpen80" 22 "PosnCmdType_PercOpen84" 23 "PosnCmdType_PercOpen88" 24 "PosnCmdType_PercOpen92" 25 "PosnCmdType_PercOpen96" 26 "PosnCmdType_OpenFull" 27 "PosnCmdType_Stop" 28 "PosnCmdType_Resd2" 29 "PosnCmdType_Resd3" 30 "PosnCmdType_Init" 31 "PosnCmdType_Movg";
VAL_ 1180 HctvFltSts 0 "TMcloudFltSts_NoFault" 1 "TMcloudFltSts_CPSRPowerOff" 2 "TMcloudFltSts_FaultByAmbientTemp" 3 "TMcloudFltSts_CPSRVoltageFault" 4 "TMcloudFltSts_MissingMessage" 10 "TMcloudFltSts_InitializationUnsuccess" 11 "TMcloudFltSts_Fault" 12 "TMcloudFltSts_Blocked" 13 "TMcloudFltSts_HighTempFault" 14 "TMcloudFltSts_Resd";
VAL_ 1180 HcwpFltSts 0 "TMcloudFltSts_NoFault" 1 "TMcloudFltSts_CPSRPowerOff" 2 "TMcloudFltSts_FaultByAmbientTemp" 3 "TMcloudFltSts_CPSRVoltageFault" 4 "TMcloudFltSts_MissingMessage" 10 "TMcloudFltSts_InitializationUnsuccess" 11 "TMcloudFltSts_Fault" 12 "TMcloudFltSts_Blocked" 13 "TMcloudFltSts_HighTempFault" 14 "TMcloudFltSts_Resd";
VAL_ 1180 HeatModeReq4Batt 0 "ReqSts1_NotReqd" 1 "ReqSts1_Reqd";
VAL_ 1180 HeatModeReq4Hp 0 "ReqSts1_NotReqd" 1 "ReqSts1_Reqd";
VAL_ 1180 RearCurtOpenPosnCmd 0 "PosnCmdType_Idle" 1 "PosnCmdType_ClsFull" 2 "PosnCmdType_PercOpen4" 3 "PosnCmdType_PercOpen8" 4 "PosnCmdType_PercOpen12" 5 "PosnCmdType_PercOpen16" 6 "PosnCmdType_PercOpen20" 7 "PosnCmdType_PercOpen24" 8 "PosnCmdType_PercOpen28" 9 "PosnCmdType_PercOpen32" 10 "PosnCmdType_PercOpen36" 11 "PosnCmdType_PercOpen40" 12 "PosnCmdType_PercOpen44" 13 "PosnCmdType_PercOpen48" 14 "PosnCmdType_PercOpen52" 15 "PosnCmdType_PercOpen56" 16 "PosnCmdType_PercOpen60" 17 "PosnCmdType_PercOpen64" 18 "PosnCmdType_PercOpen68" 19 "PosnCmdType_PercOpen72" 20 "PosnCmdType_PercOpen76" 21 "PosnCmdType_PercOpen80" 22 "PosnCmdType_PercOpen84" 23 "PosnCmdType_PercOpen88" 24 "PosnCmdType_PercOpen92" 25 "PosnCmdType_PercOpen96" 26 "PosnCmdType_OpenFull" 27 "PosnCmdType_Stop" 28 "PosnCmdType_Resd2" 29 "PosnCmdType_Resd3" 30 "PosnCmdType_Init" 31 "PosnCmdType_Movg";
VAL_ 1180 RefrigModeDes 0 "RefrigModeDes_OffMode" 1 "RefrigModeDes_ACCooling" 2 "RefrigModeDes_BatteryCooling" 5 "RefrigModeDes_DehumidifyMode3" 9 "RefrigModeDes_HeatingMode1" 14 "RefrigModeDes_ACAndBattCooling" 17 "RefrigModeDes_DehumidifyMode3AndBattCooling" 21 "RefrigModeDes_HeatingMode1AndBattCooling" 26 "RefrigModeDes_BattHeating" 27 "RefrigModeDes_DehumidifyMode3AndBattHeating" 29 "RefrigModeDes_HeatingMode1AndBattHeating" 99 "RefrigModeDes_FailureMode" 254 "RefrigModeDes_FaultModeSwitching" 255 "RefrigModeDes_NormalModeSwitching";
VAL_ 1180 RefrigModeReq 0 "RefrigModeDes_OffMode" 1 "RefrigModeDes_ACCooling" 2 "RefrigModeDes_BatteryCooling" 5 "RefrigModeDes_DehumidifyMode3" 9 "RefrigModeDes_HeatingMode1" 14 "RefrigModeDes_ACAndBattCooling" 17 "RefrigModeDes_DehumidifyMode3AndBattCooling" 21 "RefrigModeDes_HeatingMode1AndBattCooling" 26 "RefrigModeDes_BattHeating" 27 "RefrigModeDes_DehumidifyMode3AndBattHeating" 29 "RefrigModeDes_HeatingMode1AndBattHeating" 99 "RefrigModeDes_FailureMode" 254 "RefrigModeDes_FaultModeSwitching" 255 "RefrigModeDes_NormalModeSwitching";
VAL_ 1180 RefrigModeReqSwt 0 "RefrigModeDes_OffMode" 1 "RefrigModeDes_ACCooling" 2 "RefrigModeDes_BatteryCooling" 5 "RefrigModeDes_DehumidifyMode3" 9 "RefrigModeDes_HeatingMode1" 14 "RefrigModeDes_ACAndBattCooling" 17 "RefrigModeDes_DehumidifyMode3AndBattCooling" 21 "RefrigModeDes_HeatingMode1AndBattCooling" 26 "RefrigModeDes_BattHeating" 27 "RefrigModeDes_DehumidifyMode3AndBattHeating" 29 "RefrigModeDes_HeatingMode1AndBattHeating" 99 "RefrigModeDes_FailureMode" 254 "RefrigModeDes_FaultModeSwitching" 255 "RefrigModeDes_NormalModeSwitching";
VAL_ 1180 RefrigModeSts 0 "RefrigModeDes_OffMode" 1 "RefrigModeDes_ACCooling" 2 "RefrigModeDes_BatteryCooling" 5 "RefrigModeDes_DehumidifyMode3" 9 "RefrigModeDes_HeatingMode1" 14 "RefrigModeDes_ACAndBattCooling" 17 "RefrigModeDes_DehumidifyMode3AndBattCooling" 21 "RefrigModeDes_HeatingMode1AndBattCooling" 26 "RefrigModeDes_BattHeating" 27 "RefrigModeDes_DehumidifyMode3AndBattHeating" 29 "RefrigModeDes_HeatingMode1AndBattHeating" 99 "RefrigModeDes_FailureMode" 254 "RefrigModeDes_FaultModeSwitching" 255 "RefrigModeDes_NormalModeSwitching";
VAL_ 1180 RefrigModeSwt 0 "Not_InProgress" 1 "InProgress";
VAL_ 1180 TcsDoorEleBailReq 0 "NoReq" 1 "ReqOpen" 2 "ReqClsd" 3 "Reserved";
VAL_ 1180 TcsModSwtReq 0 "Req_NoReq" 1 "Req_off" 2 "Req_Coolg" 3 "Req_Heatlg";
SIG_GROUP_ 523 DrvrSeatIntgrSwtSts 1 : DrvrSeatIntgrSwtStsIntgrSwtHozlSts DrvrSeatIntgrSwtStsIntgrSwtRotSts DrvrSeatIntgrSwtStsIntgrSwtSelnSts DrvrSeatIntgrSwtStsIntgrSwtVertSts;
SIG_GROUP_ 463 EldtPmpCmd 1 : EldtPmpCmdCooltPmpPostRunReq EldtPmpCmdCooltPmpSpdReq;
SIG_GROUP_ 463 EngCooltPmpSpdReq 1 : EngCooltPmpSpdReqCooltPmpPostRunReq EngCooltPmpSpdReqCooltPmpSpdReq;
SIG_GROUP_ 463 EngPmpStat 1 : EngPmpStatCooltPmpDryErr EngPmpStatCooltPmpEmgyModSts EngPmpStatCooltPmpErrSts EngPmpStatCooltPmpI EngPmpStatCooltPmpIErr EngPmpStatCooltPmpMonrSpd EngPmpStatCooltPmpPostRunSts EngPmpStatCooltPmpSetPostRunReq EngPmpStatCooltPmpSetSpdReq EngPmpStatCooltPmpSpd EngPmpStatCooltPmpT EngPmpStatCooltPmpTErr EngPmpStatCooltPmpU EngPmpStatCooltPmpUErr EngPmpStatCooltPmpUnstallSts;
SIG_GROUP_ 934 FrntSunCurtFailr2 1 : FrntSunCurtFailr2CurtMotFailr FrntSunCurtFailr2CurtMotHallFailr FrntSunCurtFailr2CurtMotHallNotAvl FrntSunCurtFailr2CurtMotNotAvl FrntSunCurtFailr2EcuFailrGen FrntSunCurtFailr2Resvd;
SIG_GROUP_ 934 GVMCPrpsnTqDistbnReqAtAxleRe 1 : GVMCPrpsnTqDistbnReqAtAxleReChks GVMCPrpsnTqDistbnReqAtAxleReCntr GVMCPrpsnTqDistbnReqAtAxleReCtrlMod GVMCPrpsnTqDistbnReqAtAxleReDistReq;
SIG_GROUP_ 934 GVMCPrpsnTqDistReq 1 : GVMCPrpsnTqDistReqChks GVMCPrpsnTqDistReqCntr GVMCPrpsnTqDistReqCtrlMod GVMCPrpsnTqDistReqDistReq;
SIG_GROUP_ 934 GVMCSteerWhlAgReqRe 1 : GVMCSteerWhlAgReqReAgReqRe GVMCSteerWhlAgReqReChks GVMCSteerWhlAgReqReCntr GVMCSteerWhlAgReqReCtrlModRe;
SIG_GROUP_ 934 GVMCSuspDampgCtrlReq 1 : GVMCSuspDampgCtrlReqGVMCDampgCtrlReqFL GVMCSuspDampgCtrlReqGVMCDampgCtrlReqFR GVMCSuspDampgCtrlReqGVMCDampgCtrlReqRL GVMCSuspDampgCtrlReqGVMCDampgCtrlReqRR GVMCSuspDampgCtrlReqGVMCSuspDampgCtrlMod GVMCSuspDampgCtrlReqGVMCSuspDampgModReq;
SIG_GROUP_ 934 GVMCSuspStfnCtrlReq 1 : GVMCSuspStfnCtrlReqGVMCSuspStfnCtrlMod GVMCSuspStfnCtrlReqGVMCSuspStfnReqFL GVMCSuspStfnCtrlReqGVMCSuspStfnReqFR GVMCSuspStfnCtrlReqGVMCSuspStfnReqRL GVMCSuspStfnCtrlReqGVMCSuspStfnReqRR;
SIG_GROUP_ 1197 GVMCVehCtrlrSts 1 : GVMCVehCtrlrStsChks GVMCVehCtrlrStsCntr GVMCVehCtrlrStsCtrlrSts;
SIG_GROUP_ 320 NFCKeyReadStsToHMI 1 : NFCKeyReadStsToHMIKey0 NFCKeyReadStsToHMIKey1 NFCKeyReadStsToHMIKey10 NFCKeyReadStsToHMIKey11 NFCKeyReadStsToHMIKey12 NFCKeyReadStsToHMIKey13 NFCKeyReadStsToHMIKey14 NFCKeyReadStsToHMIKey15 NFCKeyReadStsToHMIKey2 NFCKeyReadStsToHMIKey3 NFCKeyReadStsToHMIKey4 NFCKeyReadStsToHMIKey5 NFCKeyReadStsToHMIKey6 NFCKeyReadStsToHMIKey7 NFCKeyReadStsToHMIKey8 NFCKeyReadStsToHMIKey9;
SIG_GROUP_ 523 PassAirbLampStsRec 1 : PassAirbLampStsRecPassAirbLampSts PassAirbLampStsRecPassAirbLampStsChks PassAirbLampStsRecPassAirbLampStsCntr;
SIG_GROUP_ 320 PtCluTqCp 1 : PtCluTqCpReq1 PtCluTqCpReq2;
SIG_GROUP_ 320 PtDirAllwdToTrsmActr 1 : PtDirAllwdToTrsmActrChks PtDirAllwdToTrsmActrCntr PtDirAllwdToTrsmActrFwd PtDirAllwdToTrsmActrNeut PtDirAllwdToTrsmActrParkRls PtDirAllwdToTrsmActrRvs;
SIG_GROUP_ 320 PtGearActtn 1 : PtGearActtnAllwdSts1 PtGearActtnAllwdSts2 PtGearActtnModReq PtGearActtnPfmncReq PtGearActtnPrio PtGearActtnReq1 PtGearActtnReq2;
SIG_GROUP_ 934 ReSunCurtFailr2 1 : ReSunCurtFailr2CurtMotFailr ReSunCurtFailr2CurtMotHallFailr ReSunCurtFailr2CurtMotHallNotAvl ReSunCurtFailr2CurtMotNotAvl ReSunCurtFailr2EcuFailrGen ReSunCurtFailr2Resvd;
SIG_GROUP_ 320 RWA1ColAgTar 1 : RWA1ColAgTarAg RWA1ColAgTarAgSpd RWA1ColAgTarChks RWA1ColAgTarCntr RWA1ColAgTarQf;
SIG_GROUP_ 320 SbWDecoupldStsH1 1 : SbWDecoupldStsH1Chks SbWDecoupldStsH1Cntr SbWDecoupldStsH1SbWDecoupldSts;
SIG_GROUP_ 320 SbWErrReqH1 1 : SbWErrReqH1Chks SbWErrReqH1Cntr SbWErrReqH1ErrReq;
SIG_GROUP_ 320 SBWErrReqR1 1 : SBWErrReqR1Chks SBWErrReqR1Cntr SBWErrReqR1ErrReq;
SIG_GROUP_ 836 SecDcDcChas1DataEvtA 1 : SecDcDcChas1DataEvtACnt SecDcDcChas1DataEvtAData1 SecDcDcChas1DataEvtAData2 SecDcDcChas1DataEvtAData3 SecDcDcChas1DataEvtAData4 SecDcDcChas1DataEvtAData5 SecDcDcChas1DataEvtAData6 SecDcDcChas1DataEvtAID;
SIG_GROUP_ 836 SecDcDcChas1DataPrdA 1 : SecDcDcChas1DataPrdACnt SecDcDcChas1DataPrdAData1 SecDcDcChas1DataPrdAData2 SecDcDcChas1DataPrdAData3 SecDcDcChas1DataPrdAData4 SecDcDcChas1DataPrdAData5 SecDcDcChas1DataPrdAData6 SecDcDcChas1DataPrdAData7;
SIG_GROUP_ 934 SnsrInclnSts 1 : SnsrInclnStsAlrmSts SnsrInclnStsArmSts SnsrInclnStsCfgSts SnsrInclnStsSnsrInclnErrSts;
SIG_GROUP_ 934 SnsrIntrScanSts 1 : SnsrIntrScanStsAlrmReq SnsrIntrScanStsArmSts SnsrIntrScanStsCfgSts SnsrIntrScanStsSnsrInclnExist SnsrIntrScanStsSnsrIntrScanErrSts;
SIG_GROUP_ 934 SRSResdSig1ToZCUDMSafety 1 : SRSResdSig1ToZCUDMSafetyChks SRSResdSig1ToZCUDMSafetyCntr SRSResdSig1ToZCUDMSafetyUInt32;
SIG_GROUP_ 320 TankTurnModSts 1 : TankTurnModStsChks TankTurnModStsCntr TankTurnModStsTankTurnModSts;
SIG_GROUP_ 463 TireFil 1 : TireFilFilSwt TireFilNoiseFlrSwt TireFilPollingMod TireFilRxSwt TireFilSnsrID;
SIG_GROUP_ 934 TrsmActrPosnSafe 1 : TrsmActrPosnSafeTrsmActrPosn TrsmActrPosnSafeTrsmActrPosnChks TrsmActrPosnSafeTrsmActrPosnCntr;
SIG_GROUP_ 463 TrsmClu0Sts 1 : TrsmClu0StsChks TrsmClu0StsCntr TrsmClu0StsTrsm0CluSts;
SIG_GROUP_ 320 TrsmCluT1 1 : TrsmCluT1Qf TrsmCluT1Val;
SIG_GROUP_ 320 TrsmCluT2 1 : TrsmCluT2Qf TrsmCluT2Val;
SIG_GROUP_ 320 TrsmCluTq 1 : TrsmCluTqCp1 TrsmCluTqCp2;
SIG_GROUP_ 320 TrsmEngmtLimd3 1 : TrsmEngmtLimd3TrsmEngmtLimd TrsmEngmtLimd3TrsmEngmtLimdChks TrsmEngmtLimd3TrsmEngmtLimdCntr;
SIG_GROUP_ 463 TrsmGearActSafe 1 : TrsmGearActSafeChks TrsmGearActSafeCntr TrsmGearActSafeTrsmGearActSafe;
SIG_GROUP_ 320 TrsmNRec 1 : TrsmNRecChks TrsmNRecCntr TrsmNRecInp1 TrsmNRecInp2 TrsmNRecInpDir1 TrsmNRecInpDir2 TrsmNRecInpQf1 TrsmNRecInpQf2 TrsmNRecOutp TrsmNRecOutpDir TrsmNRecOutpQf;
SIG_GROUP_ 320 TrsmOutpN 1 : TrsmOutpNChks TrsmOutpNCntr TrsmOutpNDir TrsmOutpNSpd TrsmOutpNSpdQf;
SIG_GROUP_ 836 VFCVectorCMD 1 : VFCVectorCMDBlockID VFCVectorCMDVFCid0 VFCVectorCMDVFCid1 VFCVectorCMDVFCid10 VFCVectorCMDVFCid11 VFCVectorCMDVFCid12 VFCVectorCMDVFCid13 VFCVectorCMDVFCid14 VFCVectorCMDVFCid15 VFCVectorCMDVFCid16 VFCVectorCMDVFCid17 VFCVectorCMDVFCid18 VFCVectorCMDVFCid19 VFCVectorCMDVFCid2 VFCVectorCMDVFCid20 VFCVectorCMDVFCid21 VFCVectorCMDVFCid22 VFCVectorCMDVFCid23 VFCVectorCMDVFCid24 VFCVectorCMDVFCid25 VFCVectorCMDVFCid26 VFCVectorCMDVFCid27 VFCVectorCMDVFCid28 VFCVectorCMDVFCid29 VFCVectorCMDVFCid3 VFCVectorCMDVFCid30 VFCVectorCMDVFCid31 VFCVectorCMDVFCid32 VFCVectorCMDVFCid33 VFCVectorCMDVFCid34 VFCVectorCMDVFCid35 VFCVectorCMDVFCid36 VFCVectorCMDVFCid37 VFCVectorCMDVFCid38 VFCVectorCMDVFCid39 VFCVectorCMDVFCid4 VFCVectorCMDVFCid40 VFCVectorCMDVFCid41 VFCVectorCMDVFCid42 VFCVectorCMDVFCid43 VFCVectorCMDVFCid44 VFCVectorCMDVFCid45 VFCVectorCMDVFCid46 VFCVectorCMDVFCid47 VFCVectorCMDVFCid48 VFCVectorCMDVFCid49 VFCVectorCMDVFCid5 VFCVectorCMDVFCid50 VFCVectorCMDVFCid51 VFCVectorCMDVFCid52 VFCVectorCMDVFCid53 VFCVectorCMDVFCid54 VFCVectorCMDVFCid55 VFCVectorCMDVFCid56 VFCVectorCMDVFCid57 VFCVectorCMDVFCid58 VFCVectorCMDVFCid59 VFCVectorCMDVFCid6 VFCVectorCMDVFCid60 VFCVectorCMDVFCid61 VFCVectorCMDVFCid7 VFCVectorCMDVFCid8 VFCVectorCMDVFCid9;
SIG_GROUP_ 836 VFCVectorCMP 1 : VFCVectorCMPBlockID VFCVectorCMPVFCid0 VFCVectorCMPVFCid1 VFCVectorCMPVFCid10 VFCVectorCMPVFCid11 VFCVectorCMPVFCid12 VFCVectorCMPVFCid13 VFCVectorCMPVFCid14 VFCVectorCMPVFCid15 VFCVectorCMPVFCid16 VFCVectorCMPVFCid17 VFCVectorCMPVFCid18 VFCVectorCMPVFCid19 VFCVectorCMPVFCid2 VFCVectorCMPVFCid20 VFCVectorCMPVFCid21 VFCVectorCMPVFCid22 VFCVectorCMPVFCid23 VFCVectorCMPVFCid24 VFCVectorCMPVFCid25 VFCVectorCMPVFCid26 VFCVectorCMPVFCid27 VFCVectorCMPVFCid28 VFCVectorCMPVFCid29 VFCVectorCMPVFCid3 VFCVectorCMPVFCid30 VFCVectorCMPVFCid31 VFCVectorCMPVFCid32 VFCVectorCMPVFCid33 VFCVectorCMPVFCid34 VFCVectorCMPVFCid35 VFCVectorCMPVFCid36 VFCVectorCMPVFCid37 VFCVectorCMPVFCid38 VFCVectorCMPVFCid39 VFCVectorCMPVFCid4 VFCVectorCMPVFCid40 VFCVectorCMPVFCid41 VFCVectorCMPVFCid42 VFCVectorCMPVFCid43 VFCVectorCMPVFCid44 VFCVectorCMPVFCid45 VFCVectorCMPVFCid46 VFCVectorCMPVFCid47 VFCVectorCMPVFCid48 VFCVectorCMPVFCid49 VFCVectorCMPVFCid5 VFCVectorCMPVFCid50 VFCVectorCMPVFCid51 VFCVectorCMPVFCid52 VFCVectorCMPVFCid53 VFCVectorCMPVFCid54 VFCVectorCMPVFCid55 VFCVectorCMPVFCid56 VFCVectorCMPVFCid57 VFCVectorCMPVFCid58 VFCVectorCMPVFCid59 VFCVectorCMPVFCid6 VFCVectorCMPVFCid60 VFCVectorCMPVFCid61 VFCVectorCMPVFCid7 VFCVectorCMPVFCid8 VFCVectorCMPVFCid9;
SIG_GROUP_ 813 VFCVectorHVSC 1 : VFCVectorHVSCBlockID VFCVectorHVSCVFCid0 VFCVectorHVSCVFCid1 VFCVectorHVSCVFCid10 VFCVectorHVSCVFCid11 VFCVectorHVSCVFCid12 VFCVectorHVSCVFCid13 VFCVectorHVSCVFCid14 VFCVectorHVSCVFCid15 VFCVectorHVSCVFCid16 VFCVectorHVSCVFCid17 VFCVectorHVSCVFCid18 VFCVectorHVSCVFCid19 VFCVectorHVSCVFCid2 VFCVectorHVSCVFCid20 VFCVectorHVSCVFCid21 VFCVectorHVSCVFCid22 VFCVectorHVSCVFCid23 VFCVectorHVSCVFCid24 VFCVectorHVSCVFCid25 VFCVectorHVSCVFCid26 VFCVectorHVSCVFCid27 VFCVectorHVSCVFCid28 VFCVectorHVSCVFCid29 VFCVectorHVSCVFCid3 VFCVectorHVSCVFCid30 VFCVectorHVSCVFCid31 VFCVectorHVSCVFCid32 VFCVectorHVSCVFCid33 VFCVectorHVSCVFCid34 VFCVectorHVSCVFCid35 VFCVectorHVSCVFCid36 VFCVectorHVSCVFCid37 VFCVectorHVSCVFCid38 VFCVectorHVSCVFCid39 VFCVectorHVSCVFCid4 VFCVectorHVSCVFCid40 VFCVectorHVSCVFCid41 VFCVectorHVSCVFCid42 VFCVectorHVSCVFCid43 VFCVectorHVSCVFCid44 VFCVectorHVSCVFCid45 VFCVectorHVSCVFCid46 VFCVectorHVSCVFCid47 VFCVectorHVSCVFCid48 VFCVectorHVSCVFCid49 VFCVectorHVSCVFCid5 VFCVectorHVSCVFCid50 VFCVectorHVSCVFCid51 VFCVectorHVSCVFCid52 VFCVectorHVSCVFCid53 VFCVectorHVSCVFCid54 VFCVectorHVSCVFCid55 VFCVectorHVSCVFCid56 VFCVectorHVSCVFCid57 VFCVectorHVSCVFCid58 VFCVectorHVSCVFCid59 VFCVectorHVSCVFCid6 VFCVectorHVSCVFCid60 VFCVectorHVSCVFCid61 VFCVectorHVSCVFCid7 VFCVectorHVSCVFCid8 VFCVectorHVSCVFCid9;
SIG_GROUP_ 813 VFCVectorHWAM 1 : VFCVectorHWAMBlockID VFCVectorHWAMVFCid0 VFCVectorHWAMVFCid1 VFCVectorHWAMVFCid10 VFCVectorHWAMVFCid11 VFCVectorHWAMVFCid12 VFCVectorHWAMVFCid13 VFCVectorHWAMVFCid14 VFCVectorHWAMVFCid15 VFCVectorHWAMVFCid16 VFCVectorHWAMVFCid17 VFCVectorHWAMVFCid18 VFCVectorHWAMVFCid19 VFCVectorHWAMVFCid2 VFCVectorHWAMVFCid20 VFCVectorHWAMVFCid21 VFCVectorHWAMVFCid22 VFCVectorHWAMVFCid23 VFCVectorHWAMVFCid24 VFCVectorHWAMVFCid25 VFCVectorHWAMVFCid26 VFCVectorHWAMVFCid27 VFCVectorHWAMVFCid28 VFCVectorHWAMVFCid29 VFCVectorHWAMVFCid3 VFCVectorHWAMVFCid30 VFCVectorHWAMVFCid31 VFCVectorHWAMVFCid32 VFCVectorHWAMVFCid33 VFCVectorHWAMVFCid34 VFCVectorHWAMVFCid35 VFCVectorHWAMVFCid36 VFCVectorHWAMVFCid37 VFCVectorHWAMVFCid38 VFCVectorHWAMVFCid39 VFCVectorHWAMVFCid4 VFCVectorHWAMVFCid40 VFCVectorHWAMVFCid41 VFCVectorHWAMVFCid42 VFCVectorHWAMVFCid43 VFCVectorHWAMVFCid44 VFCVectorHWAMVFCid45 VFCVectorHWAMVFCid46 VFCVectorHWAMVFCid47 VFCVectorHWAMVFCid48 VFCVectorHWAMVFCid49 VFCVectorHWAMVFCid5 VFCVectorHWAMVFCid50 VFCVectorHWAMVFCid51 VFCVectorHWAMVFCid52 VFCVectorHWAMVFCid53 VFCVectorHWAMVFCid54 VFCVectorHWAMVFCid55 VFCVectorHWAMVFCid56 VFCVectorHWAMVFCid57 VFCVectorHWAMVFCid58 VFCVectorHWAMVFCid59 VFCVectorHWAMVFCid6 VFCVectorHWAMVFCid60 VFCVectorHWAMVFCid61 VFCVectorHWAMVFCid7 VFCVectorHWAMVFCid8 VFCVectorHWAMVFCid9;
SIG_GROUP_ 836 VFCVectorSDL 1 : VFCVectorSDLBlockID VFCVectorSDLVFCid0 VFCVectorSDLVFCid1 VFCVectorSDLVFCid10 VFCVectorSDLVFCid11 VFCVectorSDLVFCid12 VFCVectorSDLVFCid13 VFCVectorSDLVFCid14 VFCVectorSDLVFCid15 VFCVectorSDLVFCid16 VFCVectorSDLVFCid17 VFCVectorSDLVFCid18 VFCVectorSDLVFCid19 VFCVectorSDLVFCid2 VFCVectorSDLVFCid20 VFCVectorSDLVFCid21 VFCVectorSDLVFCid22 VFCVectorSDLVFCid23 VFCVectorSDLVFCid24 VFCVectorSDLVFCid25 VFCVectorSDLVFCid26 VFCVectorSDLVFCid27 VFCVectorSDLVFCid28 VFCVectorSDLVFCid29 VFCVectorSDLVFCid3 VFCVectorSDLVFCid30 VFCVectorSDLVFCid31 VFCVectorSDLVFCid32 VFCVectorSDLVFCid33 VFCVectorSDLVFCid34 VFCVectorSDLVFCid35 VFCVectorSDLVFCid36 VFCVectorSDLVFCid37 VFCVectorSDLVFCid38 VFCVectorSDLVFCid39 VFCVectorSDLVFCid4 VFCVectorSDLVFCid40 VFCVectorSDLVFCid41 VFCVectorSDLVFCid42 VFCVectorSDLVFCid43 VFCVectorSDLVFCid44 VFCVectorSDLVFCid45 VFCVectorSDLVFCid46 VFCVectorSDLVFCid47 VFCVectorSDLVFCid48 VFCVectorSDLVFCid49 VFCVectorSDLVFCid5 VFCVectorSDLVFCid50 VFCVectorSDLVFCid51 VFCVectorSDLVFCid52 VFCVectorSDLVFCid53 VFCVectorSDLVFCid54 VFCVectorSDLVFCid55 VFCVectorSDLVFCid56 VFCVectorSDLVFCid57 VFCVectorSDLVFCid58 VFCVectorSDLVFCid59 VFCVectorSDLVFCid6 VFCVectorSDLVFCid60 VFCVectorSDLVFCid61 VFCVectorSDLVFCid7 VFCVectorSDLVFCid8 VFCVectorSDLVFCid9;
SIG_GROUP_ 836 VFCVectorSDR 1 : VFCVectorSDRBlockID VFCVectorSDRVFCid0 VFCVectorSDRVFCid1 VFCVectorSDRVFCid10 VFCVectorSDRVFCid11 VFCVectorSDRVFCid12 VFCVectorSDRVFCid13 VFCVectorSDRVFCid14 VFCVectorSDRVFCid15 VFCVectorSDRVFCid16 VFCVectorSDRVFCid17 VFCVectorSDRVFCid18 VFCVectorSDRVFCid19 VFCVectorSDRVFCid2 VFCVectorSDRVFCid20 VFCVectorSDRVFCid21 VFCVectorSDRVFCid22 VFCVectorSDRVFCid23 VFCVectorSDRVFCid24 VFCVectorSDRVFCid25 VFCVectorSDRVFCid26 VFCVectorSDRVFCid27 VFCVectorSDRVFCid28 VFCVectorSDRVFCid29 VFCVectorSDRVFCid3 VFCVectorSDRVFCid30 VFCVectorSDRVFCid31 VFCVectorSDRVFCid32 VFCVectorSDRVFCid33 VFCVectorSDRVFCid34 VFCVectorSDRVFCid35 VFCVectorSDRVFCid36 VFCVectorSDRVFCid37 VFCVectorSDRVFCid38 VFCVectorSDRVFCid39 VFCVectorSDRVFCid4 VFCVectorSDRVFCid40 VFCVectorSDRVFCid41 VFCVectorSDRVFCid42 VFCVectorSDRVFCid43 VFCVectorSDRVFCid44 VFCVectorSDRVFCid45 VFCVectorSDRVFCid46 VFCVectorSDRVFCid47 VFCVectorSDRVFCid48 VFCVectorSDRVFCid49 VFCVectorSDRVFCid5 VFCVectorSDRVFCid50 VFCVectorSDRVFCid51 VFCVectorSDRVFCid52 VFCVectorSDRVFCid53 VFCVectorSDRVFCid54 VFCVectorSDRVFCid55 VFCVectorSDRVFCid56 VFCVectorSDRVFCid57 VFCVectorSDRVFCid58 VFCVectorSDRVFCid59 VFCVectorSDRVFCid6 VFCVectorSDRVFCid60 VFCVectorSDRVFCid61 VFCVectorSDRVFCid7 VFCVectorSDRVFCid8 VFCVectorSDRVFCid9;
SIG_GROUP_ 1180 ZCUDMResdSig1ToSRSSafety 1 : ZCUDMResdSig1ToSRSSafetyChks ZCUDMResdSig1ToSRSSafetyCntr ZCUDMResdSig1ToSRSSafetyUInt32;
SIG_GROUP_ 1177 ZCUDMResdSig22ToZCUDSSafety 1 : ZCUDMResdSig22ToZCUDSSafetyChks ZCUDMResdSig22ToZCUDSSafetyCntr ZCUDMResdSig22ToZCUDSSafetyUInt64;
SIG_GROUP_ 928 ZCUDSResdSig22ToZCUDMSafety 1 : ZCUDSResdSig22ToZCUDMSafetyChks ZCUDSResdSig22ToZCUDMSafetyCntr ZCUDSResdSig22ToZCUDMSafetyUInt64;
